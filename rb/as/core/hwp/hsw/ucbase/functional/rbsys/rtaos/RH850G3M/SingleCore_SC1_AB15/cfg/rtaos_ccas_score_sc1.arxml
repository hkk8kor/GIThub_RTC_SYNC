AUTOSAR XML (schema 00048)
package /RB/UBK/Project/EcucModuleConfigurationValuess
  module config OsRTA: definition=Os
    OsOS:
      OsNumberOfCores = 1
      OsScalabilityClass = SC1
      OsStatus = STANDARD
      OsStackMonitoring = false
      OsUseGetServiceId = true
      OsUseParameterAccess = true
      OsUseResScheduler = false
      OsSuppressVectorGen = false
      OsDefaultInterrupt = InvalidInt
      OsCyclesPerSecond = 1000000
      OsTicksPerSecond = 1000000
      OsHooks: OsStartupHook=false, OsShutdownHook=false, OsPreTaskHook=false, OsPostTaskHook=false, OsStackFaultHook=false, OsProtectionHook=false, OsErrorHook=true
      19 x Param:
        meter_execution: Value=true
        no_timing_protection: Value=true
        lightweight: Value=true
        no_upward_activation: Value=false
        no_chain: Value=false
        no_schedule: Value=false
        optimize_schedule: Value=true
        std_sc34_checks: Value=false
        sc234_alarmcallbacks: Value=false
        function_protection: Value=false
        no_memory_protection: Value=true
        protection_allows_os_reads: Value=true
        no_service_protection: Value=true
        no_terminate_application: Value=true
        only_terminate_untrusted: Value=true
        meter_elapsed_time: Value=true
        monitor_activations: Value=true
        task_lifetime_hooks: Value=true
        isr_lifetime_hooks: Value=true
    OsRTATarget: OsRTATargetName=RH850GHS, OsRTATargetVariant=P1MC, OsRTATargetVersion=5.0.36
      9 x Param:
        Orti22Lauterbach: Value=true
        DirectVectors: Value=true
        OsLinkerModel: Value=FLASH
        OsTrustTrap: Value=0x40
        EBASE_value: Value=0x0
        handle_FPU_context: Value=true
        SDA_size: Value=23-bit
        Optimizer_setting: Value=Ogeneral
        use_ghs_headers: Value=true
    TrustedAppCore0 (OsApplication):
      OsTrusted = true
      OsTrustedApplicationDelayTimingViolationCall = false
      OsTrustedApplicationWithProtection = false
      OsAppTaskRef = TaskBaseCtrlCycx1High
      OsAppTaskRef = TaskBaseCtrlCycx1Low
      OsAppTaskRef = TaskBaseCtrlCycx2p
      OsAppTaskRef = TaskBaseCtrlCycx8
      OsAppTaskRef = TaskInit
      OsAppTaskRef = TaskTPSWKillCore0
      OsAppIsrRef = b_EXCDEBUG
      OsAppIsrRef = b_EXCFEINT
      OsAppIsrRef = b_EXCFPP
      OsAppIsrRef = b_EXCMAE
      OsAppIsrRef = b_EXCRIE
      OsAppIsrRef = b_EXCSYSERR
      OsAppIsrRef = EXCFENMI
      OsAppIsrRef = EXCFETRAP
      OsAppIsrRef = EXCHVTRAP
      OsAppIsrRef = EXCMDP
      OsAppIsrRef = EXCPIE
      OsAppIsrRef = EXCUCPOP
      OsAppIsrRef = ISRFLX0LINE0
      OsAppIsrRef = ISRFLX1LINE0
      OsAppIsrRef = ISRMCAN{0..2}I0
      OsAppIsrRef = ISRMTTCANI0
      OsAppIsrRef = ISRSTM05
      OsAppIsrRef = ISRSWINT0
      OsApplicationCoreRef = EcucCoreDefinition_0
      OsAppIsrRef = ISRRLIN30RX
      OsAppIsrRef = ISRRLIN30STATUS
      OsAppIsrRef = ISRRLIN31RX
      OsAppIsrRef = ISRRLIN31STATUS
      OsAppTaskRef = TaskBaseCtrlCycx10
      OsAppTaskRef = TaskBaseCtrlCycx20
      OsAppTaskRef = Task1ms
      OsAppTaskRef = TaskBaseCtrlCycx2
      OsAppIsrRef = ISR0p5ms
      OsApplicationHooks: OsAppStartupHook=false, OsAppShutdownHook=false, OsAppErrorHook=false
    TrustedAppCore1 (OsApplication):
      OsTrusted = true
      OsTrustedApplicationDelayTimingViolationCall = false
      OsTrustedApplicationWithProtection = false
      OsAppTaskRef = Task0p5ms
      OsAppTaskRef = TaskBaseCtrlCycx24
      OsAppTaskRef = TaskBaseCtrlCycx4
      OsAppTaskRef = TaskFlexray
      OsAppTaskRef = TaskInitP
      OsAppTaskRef = TaskTPSWKillCore1
      OsAppIsrRef = ISRSTM04
      OsApplicationCoreRef = EcucCoreDefinition_0
      OsApplicationHooks: OsAppStartupHook=false, OsAppShutdownHook=false, OsAppErrorHook=false
    OSDEFAULTAPPMODE (OsAppMode)
    RTE_RESOURCE_OS_APP_TrustedAppCore0 (OsResource): OsResourceProperty=STANDARD, OsResourceAccessingApplication=TrustedAppCore0, OsResourceAccessingApplication=TrustedAppCore1
    RTE_RESOURCE_OS_APP_TrustedAppCore1 (OsResource): OsResourceProperty=STANDARD, OsResourceAccessingApplication=TrustedAppCore0, OsResourceAccessingApplication=TrustedAppCore1
    14 x OsTask, all with OsTaskSchedule=FULL, OsTaskResourceRef=RTE_RESOURCE_OS_APP_TrustedAppCore0, OsTaskResourceRef=RTE_RESOURCE_OS_APP_TrustedAppCore1, OsTaskAccessingApplication=TrustedAppCore0, OsTaskAccessingApplication=TrustedAppCore1:
      Task0p5ms: OsTaskPriority=47, OsTaskActivation=1
      Task1ms: OsTaskPriority=45, OsTaskActivation=1
      TaskBaseCtrlCycx1High: OsTaskPriority=40, OsTaskActivation=1
      TaskBaseCtrlCycx1Low: OsTaskPriority=30, OsTaskActivation=1
      TaskBaseCtrlCycx2: OsTaskPriority=25, OsTaskActivation=1
      TaskBaseCtrlCycx24: OsTaskPriority=10, OsTaskActivation=1
      TaskBaseCtrlCycx2p: OsTaskPriority=22, OsTaskActivation=1
      TaskBaseCtrlCycx4: OsTaskPriority=20, OsTaskActivation=1
      TaskBaseCtrlCycx8: OsTaskPriority=15, OsTaskActivation=1
      TaskFlexray: OsTaskPriority=35, OsTaskActivation=1
      TaskInit: OsTaskPriority=55, OsTaskActivation=1
        OsTaskAutostart: OsTaskAppModeRef=OSDEFAULTAPPMODE
      TaskInitP: OsTaskPriority=50, OsTaskActivation=1
      TaskTPSWKillCore0: OsTaskPriority=100, OsTaskActivation=250
      TaskTPSWKillCore1: OsTaskPriority=101, OsTaskActivation=250
    25 x OsIsr:
      b_EXCDEBUG: OsIsrCategory=CATEGORY_1, OsIsrPriority=18, OsIsrAddress=00B0
      b_EXCFEINT: OsIsrCategory=CATEGORY_1, OsIsrPriority=18, OsIsrAddress=00F0
      b_EXCFPP: OsIsrCategory=CATEGORY_1, OsIsrPriority=17, OsIsrAddress=0070
      b_EXCMAE: OsIsrCategory=CATEGORY_1, OsIsrPriority=18, OsIsrAddress=00C0
      b_EXCRIE: OsIsrCategory=CATEGORY_1, OsIsrPriority=18, OsIsrAddress=0060
      b_EXCSYSERR: OsIsrCategory=CATEGORY_1, OsIsrPriority=19, OsIsrAddress=0010
      EXCFENMI: OsIsrCategory=CATEGORY_1, OsIsrPriority=19, OsIsrAddress=00E0
      EXCFETRAP: OsIsrCategory=CATEGORY_1, OsIsrPriority=18, OsIsrAddress=0030
      EXCHVTRAP: OsIsrCategory=CATEGORY_1, OsIsrPriority=18, OsIsrAddress=0020
      EXCMDP: OsIsrCategory=CATEGORY_1, OsIsrPriority=18, OsIsrAddress=0090
      EXCPIE: OsIsrCategory=CATEGORY_1, OsIsrPriority=18, OsIsrAddress=00A0
      EXCUCPOP: OsIsrCategory=CATEGORY_1, OsIsrPriority=18, OsIsrAddress=0080
      ISRFLX0LINE0: OsIsrCategory=CATEGORY_2, OsIsrPriority=10, OsIsrAddress=03E8, OsIsrResourceRef=RTE_RESOURCE_OS_APP_TrustedAppCore0, OsIsrResourceRef=RTE_RESOURCE_OS_APP_TrustedAppCore1
      ISRFLX1LINE0: OsIsrCategory=CATEGORY_2, OsIsrPriority=10, OsIsrAddress=0414, OsIsrResourceRef=RTE_RESOURCE_OS_APP_TrustedAppCore0, OsIsrResourceRef=RTE_RESOURCE_OS_APP_TrustedAppCore1
      ISRMCAN0I0: OsIsrCategory=CATEGORY_2, OsIsrPriority=10, OsIsrAddress=03BC, OsIsrResourceRef=RTE_RESOURCE_OS_APP_TrustedAppCore0, OsIsrResourceRef=RTE_RESOURCE_OS_APP_TrustedAppCore1
      ISRMCAN1I0: OsIsrCategory=CATEGORY_2, OsIsrPriority=10, OsIsrAddress=03C8, OsIsrResourceRef=RTE_RESOURCE_OS_APP_TrustedAppCore0, OsIsrResourceRef=RTE_RESOURCE_OS_APP_TrustedAppCore1
      ISRMCAN2I0: OsIsrCategory=CATEGORY_2, OsIsrPriority=10, OsIsrAddress=03D4, OsIsrResourceRef=RTE_RESOURCE_OS_APP_TrustedAppCore0, OsIsrResourceRef=RTE_RESOURCE_OS_APP_TrustedAppCore1
      ISRMTTCANI0: OsIsrCategory=CATEGORY_2, OsIsrPriority=10, OsIsrAddress=03B0, OsIsrResourceRef=RTE_RESOURCE_OS_APP_TrustedAppCore0, OsIsrResourceRef=RTE_RESOURCE_OS_APP_TrustedAppCore1
      ISRSTM04: OsIsrCategory=CATEGORY_2, OsIsrPriority=10, OsIsrAddress=0138, OsIsrResourceRef=RTE_RESOURCE_OS_APP_TrustedAppCore0, OsIsrResourceRef=RTE_RESOURCE_OS_APP_TrustedAppCore1
      ISRSTM05: OsIsrCategory=CATEGORY_2, OsIsrPriority=10, OsIsrAddress=013C, OsIsrResourceRef=RTE_RESOURCE_OS_APP_TrustedAppCore0, OsIsrResourceRef=RTE_RESOURCE_OS_APP_TrustedAppCore1
      ISRSWINT0: OsIsrCategory=CATEGORY_2, OsIsrPriority=15, OsIsrAddress=0124, OsIsrResourceRef=RTE_RESOURCE_OS_APP_TrustedAppCore0, OsIsrResourceRef=RTE_RESOURCE_OS_APP_TrustedAppCore1
      ISRRLIN30RX: OsIsrCategory=CATEGORY_2, OsIsrPriority=10, OsIsrAddress=029C, OsIsrResourceRef=RTE_RESOURCE_OS_APP_TrustedAppCore0, OsIsrResourceRef=RTE_RESOURCE_OS_APP_TrustedAppCore1
      ISRRLIN30STATUS: OsIsrCategory=CATEGORY_2, OsIsrPriority=10, OsIsrAddress=0298, OsIsrResourceRef=RTE_RESOURCE_OS_APP_TrustedAppCore0, OsIsrResourceRef=RTE_RESOURCE_OS_APP_TrustedAppCore1
      ISRRLIN31RX: OsIsrCategory=CATEGORY_2, OsIsrPriority=10, OsIsrAddress=02A8, OsIsrResourceRef=RTE_RESOURCE_OS_APP_TrustedAppCore0, OsIsrResourceRef=RTE_RESOURCE_OS_APP_TrustedAppCore1
      ISRRLIN31STATUS: OsIsrCategory=CATEGORY_2, OsIsrPriority=10, OsIsrAddress=02A4, OsIsrResourceRef=RTE_RESOURCE_OS_APP_TrustedAppCore0, OsIsrResourceRef=RTE_RESOURCE_OS_APP_TrustedAppCore1
    TaskBaseCtrlCycx10 (OsTask):
      OsTaskSchedule = FULL
      OsTaskActivation = 1
      OsTaskPriority = 12
      OsTaskAccessingApplication = TrustedAppCore0
      OsTaskAccessingApplication = TrustedAppCore1
      OsTaskResourceRef = RTE_RESOURCE_OS_APP_TrustedAppCore0
      OsTaskResourceRef = RTE_RESOURCE_OS_APP_TrustedAppCore1
    TaskBaseCtrlCycx20 (OsTask):
      OsTaskSchedule = FULL
      OsTaskActivation = 1
      OsTaskPriority = 11
      OsTaskAccessingApplication = TrustedAppCore0
      OsTaskAccessingApplication = TrustedAppCore1
      OsTaskResourceRef = RTE_RESOURCE_OS_APP_TrustedAppCore0
      OsTaskResourceRef = RTE_RESOURCE_OS_APP_TrustedAppCore1
    ISR0p5ms (OsIsr): OsIsrCategory=CATEGORY_2, OsIsrPriority=14, OsIsrAddress=0214
