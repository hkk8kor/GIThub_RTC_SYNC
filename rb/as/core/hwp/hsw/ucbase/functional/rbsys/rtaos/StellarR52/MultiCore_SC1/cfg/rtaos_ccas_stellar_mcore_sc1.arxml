AUTOSAR XML (schema 00048)
package /RB/UBK/Project/EcucModuleConfigurationValuess
  module config OsRTA: definition=Os
    OsOS:
      OsScalabilityClass = SC1
      OsStatus = STANDARD
      OsUseGetServiceId = true
      OsUseParameterAccess = true
      OsUseResScheduler = false
      OsSuppressVectorGen = false
      OsDefaultInterrupt = InvalidInt
      OsStackMonitoring = false
      OsCyclesPerSecond = 1000000
      OsTicksPerSecond = 1000000
      OsNumberOfCores = 2
      OsHooks: OsStartupHook=false, OsShutdownHook=false, OsPreTaskHook=false, OsPostTaskHook=false, OsStackFaultHook=false, OsProtectionHook=false, OsErrorHook=true
      21 x Param:
        meter_execution: Value=true
        no_timing_protection: Value=true
        lightweight: Value=true
        no_upward_activation: Value=false
        no_chain: Value=false
        no_schedule: Value=false
        optimize_schedule: Value=true
        std_sc34_checks: Value=true
        sc234_alarmcallbacks: Value=false
        function_protection: Value=false
        no_memory_protection: Value=true
        protection_allows_os_reads: Value=true
        no_service_protection: Value=true
        no_terminate_application: Value=true
        task_lifetime_hooks: Value=true
        isr_lifetime_hooks: Value=true
        monitor_activations: Value=true
        meter_elapsed_time: Value=true
        only_terminate_untrusted: Value=true
        core_local: Value=false
        memmap_level: Value=NONE
    OSDEFAULTAPPMODE (OsAppMode)
    9 x OsTask, all with OsTaskSchedule=FULL, OsTaskActivation=1, OsTaskAccessingApplication=TrustedAppCore1, OsTaskAccessingApplication=TrustedAppCore0:
      Task1ms: OsTaskPriority=45, OsTaskResourceRef=OS_RTE_RESOURCE_CORE1
      TaskBaseCtrlCycx1High: OsTaskPriority=40, OsTaskResourceRef=OS_RTE_RESOURCE_CORE0
      TaskBaseCtrlCycx1Low: OsTaskPriority=30, OsTaskResourceRef=OS_RTE_RESOURCE_CORE0
      TaskBaseCtrlCycx2: OsTaskPriority=25, OsTaskResourceRef=OS_RTE_RESOURCE_CORE1
      TaskBaseCtrlCycx24: OsTaskPriority=10, OsTaskResourceRef=OS_RTE_RESOURCE_CORE1
      TaskBaseCtrlCycx4: OsTaskPriority=20, OsTaskResourceRef=OS_RTE_RESOURCE_CORE1
      TaskBaseCtrlCycx8: OsTaskPriority=15, OsTaskResourceRef=OS_RTE_RESOURCE_CORE0
      TaskFlexray: OsTaskPriority=35, OsTaskResourceRef=OS_RTE_RESOURCE_CORE1
      TaskInit: OsTaskPriority=55, OsTaskResourceRef=OS_RTE_RESOURCE_CORE0
        OsTaskAutostart: OsTaskAppModeRef=OSDEFAULTAPPMODE
    TrustedAppCore0 (OsApplication):
      OsTrusted = true
      OsApplicationCoreRef = EcucCoreDefinition_0
      OsAppTaskRef = TaskBaseCtrlCycx1High
      OsAppTaskRef = TaskBaseCtrlCycx1Low
      OsAppTaskRef = TaskBaseCtrlCycx8
      OsAppTaskRef = TaskInit
      OsAppTaskRef = TaskBaseCtrlCycx2p
      OsAppTaskRef = TaskTPSWKillCore0
      OsAppIsrRef = b_EXCDataAbort0
      OsAppIsrRef = b_EXCPrefetchAbort0
      OsAppIsrRef = b_EXCUndefinedInstruction0
      OsAppIsrRef = ISRGenericTimerCore0
      OsApplicationHooks: OsAppStartupHook=false, OsAppShutdownHook=false, OsAppErrorHook=false
    3 x OsTask, all with OsTaskSchedule=FULL, OsTaskActivation=1, OsTaskAccessingApplication=TrustedAppCore0, OsTaskAccessingApplication=TrustedAppCore1:
      TaskBaseCtrlCycx2p: OsTaskPriority=22, OsTaskResourceRef=OS_RTE_RESOURCE_CORE0
      TaskInitP: OsTaskPriority=50, OsTaskResourceRef=OS_RTE_RESOURCE_CORE1
        OsTaskAutostart: OsTaskAppModeRef=OSDEFAULTAPPMODE
      Task0p5ms: OsTaskPriority=47, OsTaskResourceRef=OS_RTE_RESOURCE_CORE1
    OS_RTE_RESOURCE_CORE0 (OsResource): OsResourceProperty=STANDARD, OsResourceAccessingApplication=TrustedAppCore0
    OS_RTE_RESOURCE_CORE1 (OsResource): OsResourceProperty=STANDARD, OsResourceAccessingApplication=TrustedAppCore1
    TaskTPSWKillCore0 (OsTask):
      OsTaskPriority = 100
      OsTaskSchedule = FULL
      OsTaskActivation = 250
      OsTaskResourceRef = OS_RTE_RESOURCE_CORE0
      OsTaskAccessingApplication = TrustedAppCore0
      OsTaskAccessingApplication = TrustedAppCore1
    TaskTPSWKillCore1 (OsTask):
      OsTaskPriority = 101
      OsTaskSchedule = FULL
      OsTaskActivation = 250
      OsTaskResourceRef = OS_RTE_RESOURCE_CORE1
      OsTaskAccessingApplication = TrustedAppCore1
      OsTaskAccessingApplication = TrustedAppCore0
    ISRCommonTimer (OsIsr): OsIsrCategory=CATEGORY_2, OsIsrPriority=5, OsIsrAddress=CPU1_INTID317
    TrustedAppCore1 (OsApplication):
      OsTrusted = true
      OsApplicationCoreRef = EcucCoreDefinition_1
      OsAppTaskRef = Task0p5ms
      OsAppTaskRef = Task1ms
      OsAppTaskRef = TaskBaseCtrlCycx2
      OsAppTaskRef = TaskBaseCtrlCycx4
      OsAppTaskRef = TaskBaseCtrlCycx24
      OsAppTaskRef = TaskFlexray
      OsAppTaskRef = TaskInitP
      OsAppTaskRef = TaskTPSWKillCore1
      OsAppIsrRef = ISRCommonTimer
      OsAppIsrRef = b_EXCDataAbort1
      OsAppIsrRef = b_EXCPrefetchAbort1
      OsAppIsrRef = b_EXCUndefinedInstruction1
      OsAppIsrRef = ISRGenericTimerCore1
      OsApplicationHooks: OsAppStartupHook=false, OsAppShutdownHook=false, OsAppErrorHook=false
    OsRTATarget: OsRTATargetName=Stellar-R52-GHS, OsRTATargetVersion=5.0.4, OsRTATargetVariant=SR6P6
      Orti22Lauterbach (Param): Value=true
    8 x OsIsr, all with OsIsrCategory=CATEGORY_1:
      b_EXCUndefinedInstruction0: OsIsrPriority=32, OsIsrAddress=CPU0_TRAP1, OsIsrResourceRef=OS_RTE_RESOURCE_CORE0
      b_EXCPrefetchAbort0: OsIsrAddress=CPU0_TRAP3, OsIsrPriority=32, OsIsrResourceRef=OS_RTE_RESOURCE_CORE0
      b_EXCDataAbort0: OsIsrAddress=CPU0_TRAP4, OsIsrPriority=32, OsIsrResourceRef=OS_RTE_RESOURCE_CORE0
      b_EXCDataAbort1: OsIsrPriority=32, OsIsrAddress=CPU1_TRAP4, OsIsrResourceRef=OS_RTE_RESOURCE_CORE1
      b_EXCPrefetchAbort1: OsIsrPriority=32, OsIsrAddress=CPU1_TRAP3, OsIsrResourceRef=OS_RTE_RESOURCE_CORE1
      b_EXCUndefinedInstruction1: OsIsrPriority=32, OsIsrAddress=CPU1_TRAP1, OsIsrResourceRef=OS_RTE_RESOURCE_CORE1
      ISRGenericTimerCore0: OsIsrPriority=11, OsIsrAddress=CPU0_INTID30
      ISRGenericTimerCore1: OsIsrPriority=11, OsIsrAddress=CPU1_INTID30
