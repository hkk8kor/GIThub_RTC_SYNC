AUTOSAR XML (schema 4-0-2)
package /RB/Common/Documentations
  documentation EB_DOCUMENTATION_MONITOR_OBDDOCUMENTATION: category=ARREP  # EB Documentation - Monitor Description | OBDDocumentation View
    documentation-content:
      chapter OBDDOCU_MONIT_STRAT_DESCR
        table tgroup=tbody=[[p=l-1=Monitoring one sentence description, p=l-1=This monitoring checks if there is a too high jitter within the IO (input/output) sensitive processes.], [p=l-1=Additional description of Monitoring strategy, p=l-1=The jitter monitoring works in a way that a monitor process checks the difference in time between the current and the last point of the process execution against the ideal task cycle time +/- an allowed jitter.], [p=l-1=Monitoring LongName, p=l-1=Task Execution Jitter Monitoring]]:
          table caption TAB_STRAT_  # Monitoring Strategy description
        table tgroup=tbody=[entry=p=l-1=Malfunction Criteria Free Text]:
          table caption TAB_MALFUNC_CRIT_FREE_TEXT_  # Malfunction Criteria Free Text
        table tgroup={thead=row=[p=l-1=Secondary Parameters, p=l-1=Enable Condition, p=l-1=Malfunction Criteria Threshold Value for Summary Table, p=l-1=Frequency of checks, p=l-1=Time Required], tbody=[[p=l-1=Secondary Parameters, p=l-1=Enable Conditions Summary Table Operator, p=l-1=Enable Conditions Summary Table Parameter Value/Name, p=l-1=Enable Conditions Summary Table Unit, p=l-1=Enable Conditions Technical Description, p=l-1=Malfunction Criteria, p=l-1=Operator, p=l-1=Parameter Value/Name, p=l-1=Unit, p=l-1=Frequency of checks, p=l-1=Time Required], [p=l-1=Detailed View, p=l-1=Detailed View, p=l-1=Detailed View, p=l-1=Detailed View, p=l-1=e=Detailed View, p=l-1=e=Detailed View, p=l-1=Detailed view, p=l-1=Detailed view, p=l-1=Detailed view, p=l-1=Detailed view, p=l-1=Detailed View, p=l-1=Detailed View], [p=l-1=Ignition state, p=l-1==, p=l-1=ON, p=l-1==, p=l-1=ON, p=l-1=Jitter limit of IO (input/output) sensitive part is not held, p=l-1==, p=l-1=True, p=l-1=Continuous], [p=l-1=e=Customer View, p=l-1=e=Customer View, p=l-1=e=Customer View, p=l-1=e=Customer View, p=l-1=e=Customer View, p=l-1=e=Customer View, p=l-1=e=Customer view, p=l-1=e=Customer view, p=l-1=e=Customer view, p=l-1=e=Customer view, p=l-1=e=Customer View, p=l-1=e=Customer View], [p=l-1=Ignition state, p=l-1==, p=l-1=ON, p=l-1==, p=l-1=ON, p=l-1=Jitter limit of IO (input/output) sensitive part is not held, p=l-1==, p=l-1=True, p=l-1=Continuous]]}:
          table caption ENA_COND_  # Enable Conditions
        table tgroup={thead=row=[p=l-1=Good Check Secondary Parameters, p=l-1=Good Check Enable Condition, p=l-1=Good Check Thershold Value for Summary Table, p=l-1=Good Check Frequency of Checks, p=l-1=Good Check Time Required], tbody=[[p=l-1=Secondary Parameters for Good Check, p=l-1=Enable Conditions Summary Table Operator for Good Check, p=l-1=Enable Conditions Summary Table Parameter Value/Name for Good Check, p=l-1=Enable Conditions Summary Table Unit for Good Check Criteria, p=l-1=Enable Conditions Technical Description for Good Check, p=l-1=Good Check Criteria, p=l-1=Operator for Good Check, p=l-1=Parameter Value/Name for Good Check, p=l-1=Unit for Good Check, p=l-1=Frequency of Checks for Good Check, p=l-1=Time Required for Good Check], [p=l-1=Detailed View, p=l-1=Detailed View, p=l-1=Detailed View, p=l-1=Detailed View, p=l-1=e=Detailed View, p=l-1=e=Detailed View, p=l-1=Detailed view, p=l-1=Detailed view, p=l-1=Detailed view, p=l-1=Detailed view, p=l-1=Detailed View, p=l-1=Detailed View], [], [p=l-1=e=Customer View, p=l-1=e=Customer View, p=l-1=e=Customer View, p=l-1=e=Customer View, p=l-1=e=Customer View, p=l-1=e=Customer View, p=l-1=e=Customer view, p=l-1=e=Customer view, p=l-1=e=Customer view, p=l-1=e=Customer view, p=l-1=e=Customer View, p=l-1=e=Customer View], []]}:
          table caption Goodcheck_COND_  # Goodcheck Conditions
        table tgroup={thead=row=entry=p=l-1=Monitoring Category, tbody=[entry=p=l-1=Mention all the categories which are relevant to this monitoring, entry=p=l-1=Input Other Rationality]}:
          table caption MONITORING_CATEGORY  # Monitoring Category
        topic 1 Picture_: p=l-1=Picture of monitor
          figure l-graphic=short-label=monitor_picture:
            figure caption monitor_picture
        topic 1 Flowchart_: p=l-1=flowchart of the monitoring, generated out of Enterprise Architect; it will appear in Technical Description
          figure l-graphic=short-label=flowchart_picture:
            figure caption flowchart_picture
