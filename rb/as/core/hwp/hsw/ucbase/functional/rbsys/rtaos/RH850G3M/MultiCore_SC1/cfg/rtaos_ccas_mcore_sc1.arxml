AUTOSAR XML (schema 00048)
package /RB/UBK/Project/EcucModuleConfigurationValuess
  module config OsRTA: definition=Os
    OsOS:
      OsNumberOfCores = 2
      OsScalabilityClass = SC1
      OsStatus = STANDARD
      OsStackMonitoring = false
      OsUseParameterAccess = true
      OsUseGetServiceId = true
      OsSuppressVectorGen = false
      OsDefaultInterrupt = InvalidInt
      OsCyclesPerSecond = 1000000
      OsTicksPerSecond = 1000000
      OsUseResScheduler = false
      OsHooks: OsProtectionHook=false, OsShutdownHook=false, OsStartupHook=false, OsPreTaskHook=false, OsPostTaskHook=false, OsStackFaultHook=false, OsErrorHook=true
      19 x Param:
        meter_execution: Value=true
        no_timing_protection: Value=true
        lightweight: Value=true
        no_upward_activation: Value=false
        no_chain: Value=false
        no_schedule: Value=false
        optimize_schedule: Value=true
        std_sc34_checks: Value=true
        sc234_alarmcallbacks: Value=false
        function_protection: Value=false
        no_memory_protection: Value=true
        protection_allows_os_reads: Value=true
        no_service_protection: Value=true
        no_terminate_application: Value=true
        only_terminate_untrusted: Value=true
        meter_elapsed_time: Value=true
        monitor_activations: Value=true
        task_lifetime_hooks: Value=true
        isr_lifetime_hooks: Value=true
    14 x OsTask, all with OsTaskSchedule=FULL, OsTaskAccessingApplication=TrustedAppCore0, OsTaskAccessingApplication=TrustedAppCore1:
      Task0p5ms: OsTaskActivation=1, OsTaskPriority=47, OsTaskResourceRef=OS_RTE_RESOURCE_CORE1
      Task1ms: OsTaskActivation=1, OsTaskPriority=45, OsTaskResourceRef=OS_RTE_RESOURCE_CORE1
      TaskBaseCtrlCycx1High: OsTaskActivation=1, OsTaskPriority=40, OsTaskResourceRef=OS_RTE_RESOURCE_CORE0
      TaskBaseCtrlCycx1Low: OsTaskActivation=1, OsTaskPriority=30, OsTaskResourceRef=OS_RTE_RESOURCE_CORE0
      TaskBaseCtrlCycx2: OsTaskActivation=1, OsTaskPriority=25, OsTaskResourceRef=OS_RTE_RESOURCE_CORE1
      TaskBaseCtrlCycx24: OsTaskActivation=1, OsTaskPriority=10, OsTaskResourceRef=OS_RTE_RESOURCE_CORE1
      TaskBaseCtrlCycx2p: OsTaskActivation=1, OsTaskPriority=22, OsTaskResourceRef=OS_RTE_RESOURCE_CORE0
      TaskBaseCtrlCycx4: OsTaskActivation=1, OsTaskPriority=20, OsTaskResourceRef=OS_RTE_RESOURCE_CORE1
      TaskBaseCtrlCycx8: OsTaskActivation=1, OsTaskPriority=15, OsTaskResourceRef=OS_RTE_RESOURCE_CORE0
      TaskFlexray: OsTaskActivation=1, OsTaskPriority=35, OsTaskResourceRef=OS_RTE_RESOURCE_CORE1
      TaskInit: OsTaskActivation=1, OsTaskPriority=55, OsTaskResourceRef=OS_RTE_RESOURCE_CORE0
        OsTaskAutostart: OsTaskAppModeRef=OSDEFAULTAPPMODE
      TaskInitP: OsTaskActivation=1, OsTaskPriority=50, OsTaskResourceRef=OS_RTE_RESOURCE_CORE1
        OsTaskAutostart: OsTaskAppModeRef=OSDEFAULTAPPMODE
      TaskTPSWKillCore0: OsTaskActivation=250, OsTaskPriority=100, OsTaskResourceRef=OS_RTE_RESOURCE_CORE0
      TaskTPSWKillCore1: OsTaskActivation=250, OsTaskPriority=101, OsTaskResourceRef=OS_RTE_RESOURCE_CORE1
    TrustedAppCore0 (OsApplication):
      OsTrusted = true
      OsApplicationCoreRef = EcucCoreDefinition_0
      OsAppTaskRef = TaskTPSWKillCore0
      OsAppTaskRef = TaskInit
      OsAppTaskRef = TaskBaseCtrlCycx8
      OsAppTaskRef = TaskBaseCtrlCycx2p
      OsAppTaskRef = TaskBaseCtrlCycx1Low
      OsAppTaskRef = TaskBaseCtrlCycx1High
      OsAppIsrRef = b_EXCDEBUG
      OsAppIsrRef = b_EXCFEINT
      OsAppIsrRef = b_EXCFPP
      OsAppIsrRef = b_EXCMAE
      OsAppIsrRef = b_EXCRIE
      OsAppIsrRef = b_EXCSYSERR
      OsAppIsrRef = EXCFENMI
      OsAppIsrRef = EXCFETRAP
      OsAppIsrRef = EXCHVTRAP
      OsAppIsrRef = EXCMDP
      OsAppIsrRef = EXCPIE
      OsAppIsrRef = EXCUCPOP
      OsAppIsrRef = ISRFLX0LINE0
      OsAppIsrRef = ISRFLX1LINE0
      OsAppIsrRef = ISRMCAN{0..2}I0
      OsAppIsrRef = ISRMTTCANI0
      OsAppIsrRef = ISRSTM05
      OsAppIsrRef = ISRRLIN30STATUS
      OsAppIsrRef = ISRRLIN31RX
      OsAppIsrRef = ISRRLIN31STATUS
      OsAppIsrRef = ISRRLIN30RX
      OsApplicationHooks: OsAppStartupHook=false, OsAppShutdownHook=false, OsAppErrorHook=false
    TrustedAppCore1 (OsApplication):
      OsTrusted = true
      OsApplicationCoreRef = EcucCoreDefinition_1
      OsAppTaskRef = TaskTPSWKillCore1
      OsAppTaskRef = TaskInitP
      OsAppTaskRef = TaskFlexray
      OsAppTaskRef = TaskBaseCtrlCycx4
      OsAppTaskRef = TaskBaseCtrlCycx24
      OsAppTaskRef = TaskBaseCtrlCycx2
      OsAppTaskRef = Task1ms
      OsAppIsrRef = ISRSTM04
      OsAppTaskRef = Task0p5ms
      OsAppIsrRef = ISRSWINT0
      OsApplicationHooks: OsAppStartupHook=false, OsAppShutdownHook=false, OsAppErrorHook=false
    OsRTATarget: OsRTATargetName=RH850GHS, OsRTATargetVariant=P1HC, OsRTATargetVersion=5.0.36
      9 x Param:
        Orti22Lauterbach: Value=true
        DirectVectors: Value=true
        OsLinkerModel: Value=FLASH
        OsTrustTrap: Value=0x40
        EBASE_value: Value=0x0
        handle_FPU_context: Value=true
        SDA_size: Value=23-bit
        Optimizer_setting: Value=Ogeneral
        use_ghs_headers: Value=true
    OSDEFAULTAPPMODE (OsAppMode)
    OS_RTE_RESOURCE_CORE0 (OsResource): OsResourceProperty=STANDARD, OsResourceAccessingApplication=TrustedAppCore0
    OS_RTE_RESOURCE_CORE1 (OsResource): OsResourceProperty=STANDARD, OsResourceAccessingApplication=TrustedAppCore1
    25 x OsIsr:
      b_EXCDEBUG: OsIsrCategory=CATEGORY_1, OsIsrPriority=18, OsIsrAddress=00B0
      b_EXCFEINT: OsIsrCategory=CATEGORY_1, OsIsrPriority=18, OsIsrAddress=00F0
      b_EXCFPP: OsIsrCategory=CATEGORY_1, OsIsrPriority=17, OsIsrAddress=0070
      b_EXCMAE: OsIsrCategory=CATEGORY_1, OsIsrPriority=18, OsIsrAddress=00C0
      b_EXCRIE: OsIsrCategory=CATEGORY_1, OsIsrPriority=18, OsIsrAddress=0060
      b_EXCSYSERR: OsIsrCategory=CATEGORY_1, OsIsrPriority=19, OsIsrAddress=0010
      EXCFENMI: OsIsrCategory=CATEGORY_1, OsIsrPriority=19, OsIsrAddress=00E0
      EXCFETRAP: OsIsrCategory=CATEGORY_1, OsIsrPriority=18, OsIsrAddress=0030
      EXCHVTRAP: OsIsrCategory=CATEGORY_1, OsIsrPriority=18, OsIsrAddress=0020
      EXCMDP: OsIsrCategory=CATEGORY_1, OsIsrPriority=18, OsIsrAddress=0090
      EXCPIE: OsIsrCategory=CATEGORY_1, OsIsrPriority=18, OsIsrAddress=00A0
      EXCUCPOP: OsIsrCategory=CATEGORY_1, OsIsrPriority=18, OsIsrAddress=0080
      ISRFLX0LINE0: OsIsrCategory=CATEGORY_2, OsIsrPriority=10, OsIsrAddress=03E8, OsIsrResourceRef=OS_RTE_RESOURCE_CORE0
      ISRFLX1LINE0: OsIsrCategory=CATEGORY_2, OsIsrPriority=10, OsIsrAddress=0414, OsIsrResourceRef=OS_RTE_RESOURCE_CORE0
      ISRMCAN0I0: OsIsrCategory=CATEGORY_2, OsIsrPriority=10, OsIsrAddress=03BC, OsIsrResourceRef=OS_RTE_RESOURCE_CORE0
      ISRMCAN1I0: OsIsrCategory=CATEGORY_2, OsIsrPriority=10, OsIsrAddress=03C8, OsIsrResourceRef=OS_RTE_RESOURCE_CORE0
      ISRMCAN2I0: OsIsrCategory=CATEGORY_2, OsIsrPriority=10, OsIsrAddress=03D4, OsIsrResourceRef=OS_RTE_RESOURCE_CORE0
      ISRMTTCANI0: OsIsrCategory=CATEGORY_2, OsIsrPriority=10, OsIsrAddress=03B0, OsIsrResourceRef=OS_RTE_RESOURCE_CORE0
      ISRSTM04: OsIsrCategory=CATEGORY_2, OsIsrPriority=10, OsIsrAddress=0138, OsIsrResourceRef=OS_RTE_RESOURCE_CORE1
      ISRSTM05: OsIsrCategory=CATEGORY_2, OsIsrPriority=10, OsIsrAddress=013C, OsIsrResourceRef=OS_RTE_RESOURCE_CORE0
      ISRSWINT0: OsIsrCategory=CATEGORY_2, OsIsrPriority=11, OsIsrAddress=0124, OsIsrResourceRef=OS_RTE_RESOURCE_CORE1
      ISRRLIN30RX: OsIsrCategory=CATEGORY_2, OsIsrPriority=10, OsIsrAddress=029C, OsIsrResourceRef=OS_RTE_RESOURCE_CORE0
      ISRRLIN30STATUS: OsIsrCategory=CATEGORY_2, OsIsrPriority=10, OsIsrAddress=0298, OsIsrResourceRef=OS_RTE_RESOURCE_CORE0
      ISRRLIN31RX: OsIsrCategory=CATEGORY_2, OsIsrPriority=10, OsIsrAddress=02A8, OsIsrResourceRef=OS_RTE_RESOURCE_CORE0
      ISRRLIN31STATUS: OsIsrCategory=CATEGORY_2, OsIsrPriority=10, OsIsrAddress=02A4, OsIsrResourceRef=OS_RTE_RESOURCE_CORE0
