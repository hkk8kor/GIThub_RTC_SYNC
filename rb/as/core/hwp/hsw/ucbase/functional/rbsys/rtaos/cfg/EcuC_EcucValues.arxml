AUTOSAR XML (schema 00048)
package /RB/UBK/Project/EcucModuleConfigurationValuess
  module config EcuC
    EcucHardware
      EcucCoreDefinition_0 (EcucCoreDefinition): EcucCoreId=0
      EcucCoreDefinition_1 (EcucCoreDefinition): EcucCoreId=1
    EcuCRbSettings: EcuCRbRteInUse=false
