AUTOSAR XML (schema 00048)
package /RB/UBK/Project/EcucModuleConfigurationValuess
  module config OsRTA: definition=Os
    OsOS:
      OsNumberOfCores = 2
      OsSuppressVectorGen = false
      OsDefaultInterrupt = InvalidInt
      OsCyclesPerSecond = 1000000
      OsTicksPerSecond = 1000000
      OsUseResScheduler = false
      OsScalabilityClass = SC4
      OsStatus = STANDARD
      OsStackMonitoring = false
      OsUseParameterAccess = true
      OsUseGetServiceId = true
      17 x Param:
        lightweight: Value=true
        no_upward_activation: Value=false
        no_chain: Value=false
        no_schedule: Value=false
        optimize_schedule: Value=true
        std_sc34_checks: Value=true
        sc234_alarmcallbacks: Value=false
        function_protection: Value=true
        no_memory_protection: Value=false
        protection_allows_os_reads: Value=true
        no_service_protection: Value=true
        no_terminate_application: Value=true
        only_terminate_untrusted: Value=true
        meter_elapsed_time: Value=true
        monitor_activations: Value=true
        task_lifetime_hooks: Value=true
        isr_lifetime_hooks: Value=true
      OsHooks: OsProtectionHook=true, OsShutdownHook=false, OsStartupHook=false, OsPreTaskHook=false, OsPostTaskHook=false, OsStackFaultHook=false, OsErrorHook=true
      3 x Param:
        meter_execution: Value=true
        no_timing_protection: Value=false
        timing_interrupt: Value=true
    OsRTATarget: OsRTATargetName=RH850GHS, OsRTATargetVariant=P1HC, OsRTATargetVersion=5.0.36
      13 x Param:
        Orti22Lauterbach: Value=true
        DirectVectors: Value=true
        OsLinkerModel: Value=FLASH
        OsTrustTrap: Value=0x40
        AlignUntrustedStacks: Value=true
        DistrustStacks: Value=true
        EBASE_value: Value=0x0
        handle_FPU_context: Value=true
        always_call_GetAbortStack: Value=true
        SDA_size: Value=23-bit
        Optimizer_setting: Value=Ogeneral
        EnhancedIsolation: Value=true
        use_ghs_headers: Value=true
    OSDEFAULTAPPMODE (OsAppMode)
    4 x OsApplication:
      TrustedAppCore0: OsTrusted=true, OsApplicationCoreRef=EcucCoreDefinition_0, OsAppTaskRef=TaskInit, OsAppTaskRef=TaskTPSWKillCore0, OsAppIsrRef=EXCUCPOP, OsAppIsrRef=EXCHVTRAP, OsAppIsrRef=EXCFETRAP, OsAppIsrRef=EXCFENMI, OsAppIsrRef=b_EXCSYSERR, OsAppIsrRef=b_EXCRIE, OsAppIsrRef=b_EXCMAE, OsAppIsrRef=b_EXCFPP, OsAppIsrRef=b_EXCFEINT, OsAppIsrRef=b_EXCDEBUG, OsAppIsrRef=ISRSTM06_SC4core0, OsAppTaskRef=TaskBaseCtrlCycx1Low, OsAppTaskRef=TaskBaseCtrlCycx1High, OsAppTaskRef=Task1ms, OsAppTaskRef=Task0p5ms, OsAppTaskRef=TaskBaseCtrlCycx2, OsAppTaskRef=TaskBaseCtrlCycx8, OsAppTaskRef=TaskBaseCtrlCycx4, OsAppTaskRef=TaskBaseCtrlCycx24, OsAppTaskRef=TaskFlexray, OsAppIsrRef=ISRSTM05, OsAppIsrRef=ISRSTM04, OsAppIsrRef=ISRRLIN31STATUS, OsAppIsrRef=ISRRLIN31RX, OsAppIsrRef=ISRRLIN30STATUS, OsAppIsrRef=ISRRLIN30RX, OsAppIsrRef=ISRMTTCANI0, OsAppIsrRef=ISRMCAN2I0, OsAppIsrRef=ISRMCAN1I0, OsAppIsrRef=ISRMCAN0I0, OsAppIsrRef=ISRFLX1LINE0, OsAppIsrRef=ISRFLX0LINE0
        OsApplicationHooks: OsAppStartupHook=false, OsAppShutdownHook=false, OsAppErrorHook=false
      TrustedAppCore1: OsTrusted=true, OsApplicationCoreRef=EcucCoreDefinition_1, OsAppTaskRef=TaskInitP, OsAppTaskRef=TaskTPSWKillCore1, OsAppIsrRef=ISRSTM07_SC4core1, OsAppIsrRef=ISRSWINT0, OsAppTaskRef=TaskEventCtrlExtPrio2, OsAppTaskRef=TaskEventCtrlExtPrio1, OsAppTaskRef=TaskBaseCtrlCycx4pLow, OsAppTaskRef=TaskBaseCtrlCycx2p, OsAppTaskRef=TaskBaseCtrlCycx200Background
        OsApplicationHooks: OsAppStartupHook=false, OsAppShutdownHook=false, OsAppErrorHook=false
      UntrustedAppCore0: OsTrusted=false, OsApplicationCoreRef=EcucCoreDefinition_0
        UntrustedFuncCore0 (OsApplicationTrustedFunction): OsTrustedFunctionName=UntrustedFuncCore0
        OsApplicationHooks: OsAppStartupHook=false, OsAppShutdownHook=false, OsAppErrorHook=false
      UntrustedAppCore1: OsTrusted=false, OsApplicationCoreRef=EcucCoreDefinition_1
        UntrustedFuncCore1 (OsApplicationTrustedFunction): OsTrustedFunctionName=UntrustedFuncCore1
        OsApplicationHooks: OsAppStartupHook=false, OsAppShutdownHook=false, OsAppErrorHook=false
    OS_RTE_RESOURCE_CORE0 (OsResource): OsResourceProperty=STANDARD, OsResourceAccessingApplication=TrustedAppCore0, OsResourceAccessingApplication=UntrustedAppCore0
    OS_RTE_RESOURCE_CORE1 (OsResource): OsResourceProperty=STANDARD, OsResourceAccessingApplication=TrustedAppCore1, OsResourceAccessingApplication=UntrustedAppCore1
    14 x OsTask, all with OsTaskSchedule=FULL, OsTaskAccessingApplication=TrustedAppCore0, OsTaskAccessingApplication=TrustedAppCore1, OsTaskAccessingApplication=UntrustedAppCore0, OsTaskAccessingApplication=UntrustedAppCore1:
      Task0p5ms: OsTaskActivation=1, OsTaskPriority=47, OsTaskResourceRef=OS_RTE_RESOURCE_CORE0
      Task1ms: OsTaskActivation=1, OsTaskPriority=45, OsTaskResourceRef=OS_RTE_RESOURCE_CORE0
      TaskBaseCtrlCycx1High: OsTaskActivation=1, OsTaskPriority=40, OsTaskResourceRef=OS_RTE_RESOURCE_CORE0
      TaskBaseCtrlCycx1Low: OsTaskActivation=1, OsTaskPriority=30, OsTaskResourceRef=OS_RTE_RESOURCE_CORE0
      TaskBaseCtrlCycx2: OsTaskActivation=1, OsTaskPriority=25, OsTaskResourceRef=OS_RTE_RESOURCE_CORE0
      TaskBaseCtrlCycx24: OsTaskActivation=1, OsTaskPriority=10, OsTaskResourceRef=OS_RTE_RESOURCE_CORE0
      TaskBaseCtrlCycx2p: OsTaskActivation=1, OsTaskPriority=22, OsTaskResourceRef=OS_RTE_RESOURCE_CORE1
      TaskBaseCtrlCycx4: OsTaskActivation=1, OsTaskPriority=20, OsTaskResourceRef=OS_RTE_RESOURCE_CORE0
      TaskBaseCtrlCycx8: OsTaskActivation=1, OsTaskPriority=15, OsTaskResourceRef=OS_RTE_RESOURCE_CORE0
      TaskFlexray: OsTaskActivation=1, OsTaskPriority=35, OsTaskResourceRef=OS_RTE_RESOURCE_CORE0
      TaskInit: OsTaskActivation=1, OsTaskPriority=55, OsTaskResourceRef=OS_RTE_RESOURCE_CORE0
        OsTaskAutostart: OsTaskAppModeRef=OSDEFAULTAPPMODE
      TaskInitP: OsTaskActivation=1, OsTaskPriority=50, OsTaskResourceRef=OS_RTE_RESOURCE_CORE1
        OsTaskAutostart: OsTaskAppModeRef=OSDEFAULTAPPMODE
      TaskTPSWKillCore0: OsTaskActivation=250, OsTaskPriority=100, OsTaskResourceRef=OS_RTE_RESOURCE_CORE0
      TaskTPSWKillCore1: OsTaskActivation=250, OsTaskPriority=101, OsTaskResourceRef=OS_RTE_RESOURCE_CORE1
    25 x OsIsr:
      b_EXCDEBUG: OsIsrCategory=CATEGORY_1, OsIsrPriority=18, OsIsrAddress=00B0
      b_EXCFEINT: OsIsrCategory=CATEGORY_1, OsIsrPriority=18, OsIsrAddress=00F0
      b_EXCFPP: OsIsrCategory=CATEGORY_1, OsIsrPriority=17, OsIsrAddress=0070
      b_EXCMAE: OsIsrCategory=CATEGORY_1, OsIsrPriority=18, OsIsrAddress=00C0
      b_EXCRIE: OsIsrCategory=CATEGORY_1, OsIsrPriority=18, OsIsrAddress=0060
      b_EXCSYSERR: OsIsrCategory=CATEGORY_1, OsIsrPriority=19, OsIsrAddress=0010
      EXCFENMI: OsIsrCategory=CATEGORY_1, OsIsrPriority=19, OsIsrAddress=00E0
      EXCFETRAP: OsIsrCategory=CATEGORY_1, OsIsrPriority=18, OsIsrAddress=0030
      EXCHVTRAP: OsIsrCategory=CATEGORY_1, OsIsrPriority=18, OsIsrAddress=0020
      EXCUCPOP: OsIsrCategory=CATEGORY_1, OsIsrPriority=18, OsIsrAddress=0080
      ISRFLX0LINE0: OsIsrCategory=CATEGORY_2, OsIsrPriority=10, OsIsrAddress=03E8, OsIsrResourceRef=OS_RTE_RESOURCE_CORE0
      ISRFLX1LINE0: OsIsrCategory=CATEGORY_2, OsIsrPriority=10, OsIsrAddress=0414, OsIsrResourceRef=OS_RTE_RESOURCE_CORE0
      ISRMCAN0I0: OsIsrCategory=CATEGORY_2, OsIsrPriority=10, OsIsrAddress=03BC, OsIsrResourceRef=OS_RTE_RESOURCE_CORE0
      ISRMCAN1I0: OsIsrCategory=CATEGORY_2, OsIsrPriority=10, OsIsrAddress=03C8, OsIsrResourceRef=OS_RTE_RESOURCE_CORE0
      ISRMCAN2I0: OsIsrCategory=CATEGORY_2, OsIsrPriority=10, OsIsrAddress=03D4, OsIsrResourceRef=OS_RTE_RESOURCE_CORE0
      ISRMTTCANI0: OsIsrCategory=CATEGORY_2, OsIsrPriority=10, OsIsrAddress=03B0, OsIsrResourceRef=OS_RTE_RESOURCE_CORE0
      ISRSTM04: OsIsrCategory=CATEGORY_2, OsIsrPriority=10, OsIsrAddress=0138, OsIsrResourceRef=OS_RTE_RESOURCE_CORE0
      ISRSTM05: OsIsrCategory=CATEGORY_2, OsIsrPriority=10, OsIsrAddress=013C, OsIsrResourceRef=OS_RTE_RESOURCE_CORE0
      ISRSWINT0: OsIsrCategory=CATEGORY_2, OsIsrPriority=11, OsIsrAddress=0124, OsIsrResourceRef=OS_RTE_RESOURCE_CORE1
      ISRSTM07_SC4core1: OsIsrCategory=CATEGORY_1, OsIsrPriority=11, OsIsrAddress=01A8
      ISRSTM06_SC4core0: OsIsrCategory=CATEGORY_1, OsIsrPriority=11, OsIsrAddress=01A4
      ISRRLIN30RX: OsIsrCategory=CATEGORY_2, OsIsrPriority=10, OsIsrAddress=029C, OsIsrResourceRef=OS_RTE_RESOURCE_CORE0
      ISRRLIN30STATUS: OsIsrCategory=CATEGORY_2, OsIsrPriority=10, OsIsrAddress=0298, OsIsrResourceRef=OS_RTE_RESOURCE_CORE0
      ISRRLIN31RX: OsIsrCategory=CATEGORY_2, OsIsrPriority=10, OsIsrAddress=02A8, OsIsrResourceRef=OS_RTE_RESOURCE_CORE0
      ISRRLIN31STATUS: OsIsrCategory=CATEGORY_2, OsIsrPriority=10, OsIsrAddress=02A4, OsIsrResourceRef=OS_RTE_RESOURCE_CORE0
    4 x OsTask, all with OsTaskSchedule=FULL, OsTaskActivation=1, OsTaskAccessingApplication=TrustedAppCore0, OsTaskAccessingApplication=TrustedAppCore1, OsTaskAccessingApplication=UntrustedAppCore0, OsTaskAccessingApplication=UntrustedAppCore1, OsTaskResourceRef=OS_RTE_RESOURCE_CORE1:
      TaskBaseCtrlCycx200Background: OsTaskPriority=5
      TaskEventCtrlExtPrio2: OsTaskPriority=5
      TaskEventCtrlExtPrio1: OsTaskPriority=6
      TaskBaseCtrlCycx4pLow: OsTaskPriority=17
