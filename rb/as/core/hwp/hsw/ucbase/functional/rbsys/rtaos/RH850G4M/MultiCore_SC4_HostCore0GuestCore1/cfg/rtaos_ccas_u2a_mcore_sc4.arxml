AUTOSAR XML (schema 00048)
package /RB/UBK/Project/EcucModuleConfigurationValuess
  module config OsRTA: definition=Os
    OsOS:
      OsScalabilityClass = SC4
      OsStatus = STANDARD
      OsUseGetServiceId = true
      OsUseParameterAccess = true
      OsUseResScheduler = false
      OsSuppressVectorGen = false
      OsDefaultInterrupt = InvalidInt
      OsStackMonitoring = false
      OsCyclesPerSecond = 1000000
      OsTicksPerSecond = 1000000
      OsNumberOfCores = 2
      OsHooks: OsStartupHook=false, OsShutdownHook=false, OsPreTaskHook=false, OsPostTaskHook=false, OsStackFaultHook=false, OsProtectionHook=true, OsErrorHook=true
      20 x Param:
        meter_execution: Value=true
        no_timing_protection: Value=false
        lightweight: Value=true
        no_upward_activation: Value=false
        no_chain: Value=false
        no_schedule: Value=false
        optimize_schedule: Value=true
        std_sc34_checks: Value=true
        sc234_alarmcallbacks: Value=false
        function_protection: Value=true
        no_memory_protection: Value=false
        protection_allows_os_reads: Value=true
        no_service_protection: Value=true
        no_terminate_application: Value=true
        task_lifetime_hooks: Value=true
        isr_lifetime_hooks: Value=true
        monitor_activations: Value=true
        meter_elapsed_time: Value=true
        only_terminate_untrusted: Value=true
        timing_interrupt: Value=true
    OSDEFAULTAPPMODE (OsAppMode)
    9 x OsTask, all with OsTaskSchedule=FULL, OsTaskActivation=1, OsTaskAccessingApplication=TrustedAppCore0, OsTaskAccessingApplication=TrustedAppCore1, OsTaskResourceRef=OS_RTE_RESOURCE_CORE0:
      Task1ms: OsTaskPriority=45
      TaskBaseCtrlCycx1High: OsTaskPriority=40
      TaskBaseCtrlCycx1Low: OsTaskPriority=30
      TaskBaseCtrlCycx2: OsTaskPriority=25
      TaskBaseCtrlCycx24: OsTaskPriority=10
      TaskBaseCtrlCycx4: OsTaskPriority=20
      TaskBaseCtrlCycx8: OsTaskPriority=15
      TaskFlexray: OsTaskPriority=35
      TaskInit: OsTaskPriority=55
        OsTaskAutostart: OsTaskAppModeRef=OSDEFAULTAPPMODE
    4 x OsIsr, all with OsIsrCategory=CATEGORY_2, OsIsrPriority=10, OsIsrResourceRef=OS_RTE_RESOURCE_CORE0:
      ISRSTM04: OsIsrAddress=0x0444
      ISRSTM05: OsIsrAddress=0x0448
      ISRCAN6REC: OsIsrAddress=0x05F4
      ISRFLX0LINE0: OsIsrAddress=0x0ABC
    TrustedAppCore0 (OsApplication):
      OsTrusted = true
      OsApplicationCoreRef = EcucCoreDefinition_0
      OsAppIsrRef = ISRCAN6REC
      OsAppIsrRef = ISRFLX0LINE0
      OsAppIsrRef = ISRSTM05
      OsAppTaskRef = TaskBaseCtrlCycx1High
      OsAppTaskRef = TaskBaseCtrlCycx1Low
      OsAppTaskRef = TaskBaseCtrlCycx8
      OsAppTaskRef = TaskInit
      OsAppIsrRef = b_EXCFEINT
      OsAppIsrRef = EXCFENMI
      OsAppIsrRef = EXCFETRAP
      OsAppIsrRef = b_EXCFPP
      OsAppIsrRef = EXCHVTRAP
      OsAppIsrRef = b_EXCMAE
      OsAppIsrRef = b_EXCRIE
      OsAppIsrRef = b_EXCSYSERR
      OsAppIsrRef = EXCUCPOP
      OsAppIsrRef = b_EXCDEBUG
      OsAppIsrRef = ISRFLX1LINE0
      OsAppTaskRef = TaskTPSWKillCore0
      OsAppIsrRef = ISRCAN0REC
      OsAppIsrRef = ISRCAN1REC
      OsAppIsrRef = ISRCAN0TRX
      OsAppIsrRef = ISRCAN1TRX
      OsAppIsrRef = ISRCAN6TRX
      OsAppIsrRef = ISRSTM06_SC4core0
      OsAppIsrRef = ISRCAN8REC
      OsAppIsrRef = ISRCAN8TRX
      OsAppTaskRef = TaskFlexray
      OsAppTaskRef = TaskBaseCtrlCycx4
      OsAppTaskRef = TaskBaseCtrlCycx24
      OsAppTaskRef = TaskBaseCtrlCycx2
      OsAppTaskRef = Task1ms
      OsAppTaskRef = Task0p5ms
      OsAppIsrRef = ISRSTM04
      OsAppIsrRef = ISRCAN2TRX
      OsAppIsrRef = ISRCAN2REC
      OsApplicationHooks: OsAppStartupHook=false, OsAppShutdownHook=false, OsAppErrorHook=false
    TrustedAppCore1 (OsApplication):
      OsTrusted = true
      OsApplicationCoreRef = EcucCoreDefinition_1
      OsAppTaskRef = TaskInitP
      OsAppTaskRef = TaskTPSWKillCore1
      OsAppIsrRef = ISRSWINT0
      OsAppIsrRef = ISRSTM07_SC4core1
      OsAppTaskRef = TaskBaseCtrlCycx2p
      OsAppTaskRef = TaskBaseCtrlCycx1Guest
      OsAppTaskRef = TaskBaseCtrlCycx4Guest
      OsAppTaskRef = TaskBaseCtrlCycx10Guest
      OsAppTaskRef = TaskBaseCtrlCycx20Guest
      OsAppTaskRef = TaskBaseCtrlCycx2Guest
      OsApplicationHooks: OsAppStartupHook=false, OsAppShutdownHook=false, OsAppErrorHook=false
    10 x OsIsr, all with OsIsrCategory=CATEGORY_1, OsIsrPriority=17:
      b_EXCSYSERR: OsIsrAddress=CPU0 0x0010
      EXCHVTRAP: OsIsrAddress=CPU0 0x0020
      EXCFETRAP: OsIsrAddress=CPU0 0x0030
      b_EXCRIE: OsIsrAddress=CPU0 0x0060
      b_EXCFPP: OsIsrAddress=CPU0 0x0070
      EXCUCPOP: OsIsrAddress=CPU0 0x0080
      b_EXCMAE: OsIsrAddress=CPU0 0x00C0
      EXCFENMI: OsIsrAddress=CPU0 0x00E0
      b_EXCFEINT: OsIsrAddress=CPU0 0x00F0
      b_EXCDEBUG: OsIsrAddress=CPU0 0x00B0
    TaskBaseCtrlCycx2p (OsTask):
      OsTaskPriority = 22
      OsTaskSchedule = FULL
      OsTaskActivation = 1
      OsTaskAccessingApplication = TrustedAppCore0
      OsTaskAccessingApplication = TrustedAppCore1
      OsTaskResourceRef = OS_RTE_RESOURCE_CORE1
    ISRSWINT0 (OsIsr): OsIsrCategory=CATEGORY_2, OsIsrPriority=11, OsIsrAddress=CPU0 0x0138, OsIsrResourceRef=OS_RTE_RESOURCE_CORE1
    TaskInitP (OsTask):
      OsTaskPriority = 50
      OsTaskSchedule = FULL
      OsTaskActivation = 1
      OsTaskAccessingApplication = TrustedAppCore0
      OsTaskAccessingApplication = TrustedAppCore1
      OsTaskResourceRef = OS_RTE_RESOURCE_CORE1
      OsTaskAutostart: OsTaskAppModeRef=OSDEFAULTAPPMODE
    ISRFLX1LINE0 (OsIsr): OsIsrCategory=CATEGORY_2, OsIsrAddress=0x0AE8, OsIsrPriority=10, OsIsrResourceRef=OS_RTE_RESOURCE_CORE0
    Task0p5ms (OsTask):
      OsTaskPriority = 47
      OsTaskSchedule = FULL
      OsTaskActivation = 1
      OsTaskAccessingApplication = TrustedAppCore0
      OsTaskAccessingApplication = TrustedAppCore1
      OsTaskResourceRef = OS_RTE_RESOURCE_CORE0
    OS_RTE_RESOURCE_CORE0 (OsResource): OsResourceProperty=STANDARD, OsResourceAccessingApplication=TrustedAppCore0
    OS_RTE_RESOURCE_CORE1 (OsResource): OsResourceProperty=STANDARD, OsResourceAccessingApplication=TrustedAppCore1
    TaskTPSWKillCore0 (OsTask):
      OsTaskPriority = 100
      OsTaskSchedule = FULL
      OsTaskActivation = 250
      OsTaskResourceRef = OS_RTE_RESOURCE_CORE0
      OsTaskAccessingApplication = TrustedAppCore0
      OsTaskAccessingApplication = TrustedAppCore1
      OsTaskAccessingApplication = UntrustedAppCore0
      OsTaskAccessingApplication = UntrustedAppCore1
    TaskTPSWKillCore1 (OsTask):
      OsTaskPriority = 101
      OsTaskSchedule = FULL
      OsTaskActivation = 250
      OsTaskResourceRef = OS_RTE_RESOURCE_CORE1
      OsTaskAccessingApplication = TrustedAppCore0
      OsTaskAccessingApplication = TrustedAppCore1
      OsTaskAccessingApplication = UntrustedAppCore0
      OsTaskAccessingApplication = UntrustedAppCore1
    OsRTATarget: OsRTATargetName=RH850x2GHS, OsRTATargetVariant=U2A, OsRTATargetVersion=5.0.6
      10 x Param:
        Orti22Lauterbach: Value=true
        DirectVectors: Value=true
        EBASE_register: Value=0x0
        handle_FPU_context: Value=true
        Optimizer_setting: Value=general
        SDA_size: Value=23-bit
        misalign_pack: Value=false
        Linker_Model: Value=FLASH
        DistrustStacks: Value=true
        EnhancedIsolation: Value=true
    5 x OsIsr, all with OsIsrCategory=CATEGORY_2, OsIsrPriority=10, OsIsrResourceRef=OS_RTE_RESOURCE_CORE0:
      ISRCAN0REC: OsIsrAddress=0x05AC
      ISRCAN1REC: OsIsrAddress=0x05B8
      ISRCAN0TRX: OsIsrAddress=0x05B0
      ISRCAN1TRX: OsIsrAddress=0x05BC
      ISRCAN6TRX: OsIsrAddress=0x05F8
    UntrustedAppCore0 (OsApplication): OsTrusted=false, OsApplicationCoreRef=EcucCoreDefinition_0
      OsApplicationHooks: OsAppStartupHook=false, OsAppShutdownHook=false, OsAppErrorHook=false
      UntrustedFuncCore0 (OsApplicationTrustedFunction): OsTrustedFunctionName=UntrustedFuncCore0
    UntrustedAppCore1 (OsApplication): OsTrusted=false, OsApplicationCoreRef=EcucCoreDefinition_1
      UntrustedFuncCore1 (OsApplicationTrustedFunction): OsTrustedFunctionName=UntrustedFuncCore1
      OsApplicationHooks: OsAppStartupHook=false, OsAppShutdownHook=false, OsAppErrorHook=false
    4 x OsIsr:
      ISRSTM06_SC4core0: OsIsrCategory=CATEGORY_1, OsIsrPriority=11, OsIsrAddress=0x044C
      ISRSTM07_SC4core1: OsIsrCategory=CATEGORY_1, OsIsrPriority=11, OsIsrAddress=0x0450
      ISRCAN8REC: OsIsrCategory=CATEGORY_2, OsIsrPriority=10, OsIsrAddress=0x0614, OsIsrResourceRef=OS_RTE_RESOURCE_CORE0
      ISRCAN8TRX: OsIsrCategory=CATEGORY_2, OsIsrPriority=10, OsIsrAddress=0x0618, OsIsrResourceRef=OS_RTE_RESOURCE_CORE0
    5 x OsTask, all with OsTaskSchedule=FULL, OsTaskActivation=1, OsTaskResourceRef=OS_RTE_RESOURCE_CORE1:
      TaskBaseCtrlCycx1Guest: OsTaskPriority=34
      TaskBaseCtrlCycx4Guest: OsTaskPriority=18
      TaskBaseCtrlCycx10Guest: OsTaskPriority=13
      TaskBaseCtrlCycx20Guest: OsTaskPriority=12
      TaskBaseCtrlCycx2Guest: OsTaskPriority=21
    ISRCAN2TRX (OsIsr): OsIsrCategory=CATEGORY_2, OsIsrPriority=10, OsIsrAddress=0x05C8, OsIsrResourceRef=OS_RTE_RESOURCE_CORE0
    ISRCAN2REC (OsIsr): OsIsrCategory=CATEGORY_2, OsIsrPriority=10, OsIsrAddress=0x05C4, OsIsrResourceRef=OS_RTE_RESOURCE_CORE0
