AUTOSAR XML (schema 00048)
package /RB/UBK/Project/EcucModuleConfigurationValuess
  module config OsRTA: definition=Os
    OsOS:
      OsScalabilityClass = SC1
      OsStatus = STANDARD
      OsUseGetServiceId = true
      OsUseParameterAccess = true
      OsUseResScheduler = false
      OsSuppressVectorGen = false
      OsDefaultInterrupt = InvalidInt
      OsStackMonitoring = false
      OsCyclesPerSecond = 1000000
      OsTicksPerSecond = 1000000
      OsNumberOfCores = 2
      OsHooks: OsStartupHook=false, OsShutdownHook=false, OsPreTaskHook=false, OsPostTaskHook=false, OsStackFaultHook=false, OsProtectionHook=false, OsErrorHook=true
      19 x Param:
        meter_execution: Value=true
        no_timing_protection: Value=true
        lightweight: Value=true
        no_upward_activation: Value=false
        no_chain: Value=false
        no_schedule: Value=false
        optimize_schedule: Value=true
        std_sc34_checks: Value=true
        sc234_alarmcallbacks: Value=false
        function_protection: Value=false
        no_memory_protection: Value=true
        protection_allows_os_reads: Value=true
        no_service_protection: Value=true
        no_terminate_application: Value=true
        task_lifetime_hooks: Value=true
        isr_lifetime_hooks: Value=true
        monitor_activations: Value=true
        meter_elapsed_time: Value=true
        only_terminate_untrusted: Value=true
    OSDEFAULTAPPMODE (OsAppMode)
    9 x OsTask, all with OsTaskSchedule=FULL, OsTaskActivation=1, OsTaskAccessingApplication=TrustedAppCore0, OsTaskAccessingApplication=TrustedAppCore1:
      Task1ms: OsTaskPriority=45, OsTaskResourceRef=OS_RTE_RESOURCE_CORE1
      TaskBaseCtrlCycx1High: OsTaskPriority=40, OsTaskResourceRef=OS_RTE_RESOURCE_CORE0
      TaskBaseCtrlCycx1Low: OsTaskPriority=30, OsTaskResourceRef=OS_RTE_RESOURCE_CORE0
      TaskBaseCtrlCycx2: OsTaskPriority=25, OsTaskResourceRef=OS_RTE_RESOURCE_CORE1
      TaskBaseCtrlCycx24: OsTaskPriority=10, OsTaskResourceRef=OS_RTE_RESOURCE_CORE1
      TaskBaseCtrlCycx4: OsTaskPriority=20, OsTaskResourceRef=OS_RTE_RESOURCE_CORE1
      TaskBaseCtrlCycx8: OsTaskPriority=15, OsTaskResourceRef=OS_RTE_RESOURCE_CORE0
      TaskFlexray: OsTaskPriority=35, OsTaskResourceRef=OS_RTE_RESOURCE_CORE1
      TaskInit: OsTaskPriority=55, OsTaskResourceRef=OS_RTE_RESOURCE_CORE0
        OsTaskAutostart: OsTaskAppModeRef=OSDEFAULTAPPMODE
    4 x OsIsr, all with OsIsrCategory=CATEGORY_2, OsIsrPriority=10:
      ISRSTM04: OsIsrAddress=0x0200, OsIsrResourceRef=OS_RTE_RESOURCE_CORE1
      ISRSTM05: OsIsrAddress=0x0204, OsIsrResourceRef=OS_RTE_RESOURCE_CORE0
      ISRCAN3REC: OsIsrAddress=0x02F4, OsIsrResourceRef=OS_RTE_RESOURCE_CORE0
      ISRFLX0LINE0: OsIsrAddress=0x08F4, OsIsrResourceRef=OS_RTE_RESOURCE_CORE0
    TrustedAppCore0 (OsApplication):
      OsTrusted = true
      OsApplicationCoreRef = EcucCoreDefinition_0
      OsAppIsrRef = ISRCAN3REC
      OsAppIsrRef = ISRFLX0LINE0
      OsAppIsrRef = ISRSTM05
      OsAppTaskRef = TaskBaseCtrlCycx1High
      OsAppTaskRef = TaskBaseCtrlCycx1Low
      OsAppTaskRef = TaskBaseCtrlCycx8
      OsAppTaskRef = TaskInit
      OsAppIsrRef = b_EXCFEINT
      OsAppIsrRef = EXCFENMI
      OsAppIsrRef = EXCFETRAP
      OsAppIsrRef = b_EXCFPP
      OsAppIsrRef = b_EXCMAE
      OsAppIsrRef = b_EXCRIE
      OsAppIsrRef = b_EXCSYSERR
      OsAppIsrRef = EXCUCPOP
      OsAppIsrRef = b_EXCDEBUG
      OsAppTaskRef = TaskBaseCtrlCycx2p
      OsAppTaskRef = TaskTPSWKillCore0
      OsAppIsrRef = EXCPIE
      OsAppIsrRef = EXCMDP
      OsAppIsrRef = ISRCAN0REC
      OsAppIsrRef = ISRCAN1REC
      OsAppIsrRef = ISRCAN0TRX
      OsAppIsrRef = ISRCAN1TRX
      OsAppIsrRef = ISRCAN3TRX
      OsAppIsrRef = ISRCAN2REC
      OsAppIsrRef = ISRCAN2TRX
      OsAppIsrRef = EXCHVTRAP
      OsApplicationHooks: OsAppStartupHook=false, OsAppShutdownHook=false, OsAppErrorHook=false
    TrustedAppCore1 (OsApplication):
      OsTrusted = true
      OsApplicationCoreRef = EcucCoreDefinition_1
      OsAppTaskRef = Task1ms
      OsAppTaskRef = TaskBaseCtrlCycx2
      OsAppTaskRef = TaskBaseCtrlCycx24
      OsAppTaskRef = TaskBaseCtrlCycx4
      OsAppTaskRef = TaskFlexray
      OsAppTaskRef = TaskInitP
      OsAppTaskRef = Task0p5ms
      OsAppTaskRef = TaskTPSWKillCore1
      OsAppIsrRef = ISRSTM04
      OsAppIsrRef = ISRSWINT0
      OsApplicationHooks: OsAppStartupHook=false, OsAppShutdownHook=false, OsAppErrorHook=false
    9 x OsIsr, all with OsIsrCategory=CATEGORY_1, OsIsrPriority=17:
      b_EXCSYSERR: OsIsrAddress=CPU0 0x0010
      EXCFETRAP: OsIsrAddress=CPU0 0x0030
      b_EXCRIE: OsIsrAddress=CPU0 0x0060
      b_EXCFPP: OsIsrAddress=CPU0 0x0070
      EXCUCPOP: OsIsrAddress=CPU0 0x0080
      b_EXCMAE: OsIsrAddress=CPU0 0x00C0
      EXCFENMI: OsIsrAddress=CPU0 0x00E0
      b_EXCFEINT: OsIsrAddress=CPU0 0x00F0
      b_EXCDEBUG: OsIsrAddress=CPU0 0x00B0
    TaskBaseCtrlCycx2p (OsTask):
      OsTaskPriority = 22
      OsTaskSchedule = FULL
      OsTaskActivation = 1
      OsTaskAccessingApplication = TrustedAppCore0
      OsTaskAccessingApplication = TrustedAppCore1
      OsTaskResourceRef = OS_RTE_RESOURCE_CORE0
    ISRSWINT0 (OsIsr): OsIsrCategory=CATEGORY_2, OsIsrPriority=11, OsIsrAddress=CPU0 0x0138, OsIsrResourceRef=OS_RTE_RESOURCE_CORE1
    TaskInitP (OsTask):
      OsTaskPriority = 50
      OsTaskSchedule = FULL
      OsTaskActivation = 1
      OsTaskAccessingApplication = TrustedAppCore0
      OsTaskAccessingApplication = TrustedAppCore1
      OsTaskResourceRef = OS_RTE_RESOURCE_CORE1
      OsTaskAutostart: OsTaskAppModeRef=OSDEFAULTAPPMODE
    Task0p5ms (OsTask):
      OsTaskPriority = 47
      OsTaskSchedule = FULL
      OsTaskActivation = 1
      OsTaskAccessingApplication = TrustedAppCore0
      OsTaskAccessingApplication = TrustedAppCore1
      OsTaskResourceRef = OS_RTE_RESOURCE_CORE1
    OS_RTE_RESOURCE_CORE0 (OsResource): OsResourceProperty=STANDARD, OsResourceAccessingApplication=TrustedAppCore0
    OS_RTE_RESOURCE_CORE1 (OsResource): OsResourceProperty=STANDARD, OsResourceAccessingApplication=TrustedAppCore1
    TaskTPSWKillCore0 (OsTask):
      OsTaskPriority = 100
      OsTaskSchedule = FULL
      OsTaskActivation = 250
      OsTaskResourceRef = OS_RTE_RESOURCE_CORE0
      OsTaskAccessingApplication = TrustedAppCore0
      OsTaskAccessingApplication = TrustedAppCore1
    TaskTPSWKillCore1 (OsTask):
      OsTaskPriority = 101
      OsTaskSchedule = FULL
      OsTaskActivation = 250
      OsTaskResourceRef = OS_RTE_RESOURCE_CORE1
      OsTaskAccessingApplication = TrustedAppCore0
      OsTaskAccessingApplication = TrustedAppCore1
    EXCPIE (OsIsr): OsIsrCategory=CATEGORY_1, OsIsrAddress=CPU0 0x00A0, OsIsrPriority=17
    EXCMDP (OsIsr): OsIsrCategory=CATEGORY_1, OsIsrPriority=17, OsIsrAddress=CPU0 0x0090
    OsRTATarget: OsRTATargetName=RH850x2GHS, OsRTATargetVariant=U2C4, OsRTATargetVersion=5.0.11
      10 x Param:
        Orti22Lauterbach: Value=true
        DirectVectors: Value=true
        EBASE_register: Value=0x0
        handle_FPU_context: Value=true
        Linker_Model: Value=FLASH
        PhysicalCoreAssignment: Value=0,1
        use_ghs_headers: Value=true
        Optimizer_setting: Value=general
        SDA_size: Value=23-bit
        option_set_1: Value=true
    8 x OsIsr:
      ISRCAN0REC: OsIsrCategory=CATEGORY_2, OsIsrPriority=10, OsIsrAddress=0x02AC, OsIsrResourceRef=OS_RTE_RESOURCE_CORE0
      ISRCAN1REC: OsIsrCategory=CATEGORY_2, OsIsrPriority=10, OsIsrAddress=0x02C4, OsIsrResourceRef=OS_RTE_RESOURCE_CORE0
      ISRCAN0TRX: OsIsrCategory=CATEGORY_2, OsIsrPriority=10, OsIsrAddress=0x02B0, OsIsrResourceRef=OS_RTE_RESOURCE_CORE0
      ISRCAN1TRX: OsIsrCategory=CATEGORY_2, OsIsrPriority=10, OsIsrAddress=0x02C8, OsIsrResourceRef=OS_RTE_RESOURCE_CORE0
      ISRCAN3TRX: OsIsrCategory=CATEGORY_2, OsIsrAddress=0x02F8, OsIsrPriority=10, OsIsrResourceRef=OS_RTE_RESOURCE_CORE0
      ISRCAN2REC: OsIsrCategory=CATEGORY_2, OsIsrPriority=10, OsIsrAddress=0x02DC, OsIsrResourceRef=OS_RTE_RESOURCE_CORE0
      ISRCAN2TRX: OsIsrCategory=CATEGORY_2, OsIsrPriority=10, OsIsrAddress=0x02E0, OsIsrResourceRef=OS_RTE_RESOURCE_CORE0
      EXCHVTRAP: OsIsrCategory=CATEGORY_1, OsIsrPriority=17, OsIsrAddress=CPU0 0x0020
