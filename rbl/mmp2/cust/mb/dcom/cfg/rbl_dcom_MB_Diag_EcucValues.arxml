AUTOSAR XML (schema 4-2-2)
package /RB/UBK/Project/EcucModuleConfigurationValuess
  module config Dcm: implementation-config-variant=VARIANT-PRE-COMPILE
    DcmConfigSet
      DcmDsd: DcmRbDsdRequestManufacturerNotificationEnabled=true, DcmRbDsdRequestSupplierNotificationEnabled=true
        DcmDsdServiceTableUDS (DcmDsdServiceTable)
          11 x DcmDsdService:
            SessionControlClass: DcmDsdSidTabServiceId=16, DcmDsdSidTabSubfuncAvail=true
              3 x DcmDsdSubService:
                DEFAULT_SESSION: DcmDsdSubServiceId=1
                EXTENDED_DIAGNOSTIC_SESSION: DcmDsdSubServiceId=3
                PROGRAMMING_SESSION: DcmDsdSubServiceId=2
            TesterPresent: DcmDsdSidTabServiceId=62, DcmDsdSidTabSubfuncAvail=true
              zeroSubFunction (DcmDsdSubService): DcmDsdSubServiceId=0
            PlantModeActivation: DcmDsdSidTabFnc=rba_DcmPma_PlantModeActivationService, DcmDsdSidTabServiceId=128, DcmDsdSidTabSubfuncAvail=false, DcmRbDsdSidTabSidInitFunction=rba_DcmPma_PlantModeActivation_Ini
            EcuResetClass: DcmDsdSidTabServiceId=17, DcmDsdSidTabSubfuncAvail=true
              Hard (DcmDsdSubService): DcmDsdSubServiceId=1
              Soft (DcmDsdSubService): DcmDsdSubServiceId=3
            ReadDtcInformationClass: DcmDsdSidTabServiceId=25, DcmDsdSidTabSubfuncAvail=true, DcmDsdSidTabSessionLevelRef=DcmDspSession/DEFAULT_SESSION, DcmDsdSidTabSessionLevelRef=DcmDspSession/EXTENDED_DIAGNOSTIC_SESSION
              6 x DcmDsdSubService, all with DcmDsdSubServiceSessionLevelRef=DcmDspSession/DEFAULT_SESSION, DcmDsdSubServiceSessionLevelRef=DcmDspSession/EXTENDED_DIAGNOSTIC_SESSION:
                RDTCBSM: DcmDsdSubServiceId=2
                RDTCEDRBDN: DcmDsdSubServiceId=6
                RDTCFDC: DcmDsdSubServiceId=20
                RDTCSSBDTC: DcmDsdSubServiceId=4
                RNODTCBSM: DcmDsdSubServiceId=1
                RSUPDTC: DcmDsdSubServiceId=10
            ControlDtcSettingClass: DcmDsdSidTabServiceId=133, DcmDsdSidTabSubfuncAvail=true, DcmDsdSidTabSessionLevelRef=DcmDspSession/EXTENDED_DIAGNOSTIC_SESSION
              Disable (DcmDsdSubService): DcmDsdSubServiceId=2, DcmDsdSubServiceSessionLevelRef=DcmDspSession/EXTENDED_DIAGNOSTIC_SESSION
              Enable (DcmDsdSubService): DcmDsdSubServiceId=1, DcmDsdSubServiceSessionLevelRef=DcmDspSession/EXTENDED_DIAGNOSTIC_SESSION
            ClearDiagnosticInformationClass: DcmDsdSidTabServiceId=20, DcmDsdSidTabSubfuncAvail=false, DcmDsdSidTabSessionLevelRef=DcmDspSession/DEFAULT_SESSION, DcmDsdSidTabSessionLevelRef=DcmDspSession/EXTENDED_DIAGNOSTIC_SESSION
            ReadDataByIdentifierClass: DcmDsdSidTabServiceId=34, DcmDsdSidTabSubfuncAvail=false, DcmDsdSidTabSessionLevelRef=DcmDspSession/DEFAULT_SESSION, DcmDsdSidTabSessionLevelRef=DcmDspSession/EXTENDED_DIAGNOSTIC_SESSION, DcmDsdSidTabSessionLevelRef=DcmDspSession/PROGRAMMING_SESSION
            WriteDataByIdentifierClass: DcmDsdSidTabServiceId=46, DcmDsdSidTabSubfuncAvail=false, DcmDsdSidTabSessionLevelRef=DcmDspSession/EXTENDED_DIAGNOSTIC_SESSION, DcmDsdSidTabSessionLevelRef=DcmDspSession/PROGRAMMING_SESSION
            ComControlClass: DcmDsdSidTabServiceId=40, DcmDsdSidTabSubfuncAvail=true, DcmDsdSidTabSessionLevelRef=DcmDspSession/EXTENDED_DIAGNOSTIC_SESSION
              EnableRxAndDisableTx (DcmDsdSubService): DcmDsdSubServiceId=1, DcmDsdSubServiceSessionLevelRef=DcmDspSession/EXTENDED_DIAGNOSTIC_SESSION
              EnableRxAndTx (DcmDsdSubService): DcmDsdSubServiceId=0, DcmDsdSubServiceSessionLevelRef=DcmDspSession/EXTENDED_DIAGNOSTIC_SESSION
            RoutineControlClass: DcmDsdSidTabServiceId=49, DcmDsdSidTabSubfuncAvail=true, DcmDsdSidTabSessionLevelRef=DcmDspSession/EXTENDED_DIAGNOSTIC_SESSION, DcmDsdSidTabSessionLevelRef=DcmDspSession/PROGRAMMING_SESSION, DcmDsdSidTabSessionLevelRef=DcmDspSession/DEFAULT_SESSION
      DcmDsp: DcmDspDataDefaultEndianness=BIG_ENDIAN, DcmDspEnableObdMirror=false, DcmDspMaxDidToRead=1
        DcmDspComControl
          DcmDspComControlAllChannelCan (DcmDspComControlAllChannel): DcmDspAllComMChannelRef=ComMChannel_Can
          DcmDspComControlAllChannelCan1 (DcmDspComControlAllChannel): DcmDspAllComMChannelRef=ComMChannel_Can1
        4 x DcmDspCommonAuthorization:
          AP_All
          AP_Comb_0023: DcmDspCommonAuthorizationSessionRef=DcmDspSession/EXTENDED_DIAGNOSTIC_SESSION
          AP_Comb_0001: DcmDspCommonAuthorizationSessionRef=DcmDspSession/DEFAULT_SESSION, DcmDspCommonAuthorizationSessionRef=DcmDspSession/EXTENDED_DIAGNOSTIC_SESSION
          AP_Comb_0015: DcmDspCommonAuthorizationSessionRef=DcmDspSession/EXTENDED_DIAGNOSTIC_SESSION
        DcmDspControlDTCSetting: DcmSupportDTCSettingControlOptionRecord=false
        30 x DcmDspData, all with DcmDspDataConditionCheckReadFncUsed=false, DcmDspDataUsePort=USE_DATA_SYNCH_FNC:
          Active_Diagnostic_Information: DcmDspDataByteSize=4, DcmDspDataEndianness=opaque, DcmDspDataReadFnc=dcom_ActiveDiagnosticSession_F100_ReadData, DcmDspDataType=UINT8_N
            DcmDspDiagnosisScaling
              DcmDspAlternativeDataType: DcmApplicationDataType=Dcm_ArrDataType_0xF100_Identification
          Boot_SW_Version: DcmDspDataByteSize=3, DcmDspDataEndianness=BIG_ENDIAN, DcmDspDataReadFnc=dcom_BootSoftwareVersion_F151_F153_ReadData, DcmDspDataType=UINT8_N
            DcmDspDiagnosisScaling
              DcmDspAlternativeDataType: DcmApplicationDataType=Dcm_DataType_0xF153_Boot_SW_year
          DDS_Package_Release_Info_Data: DcmDspDataByteSize=4, DcmDspDataEndianness=opaque, DcmDspDataReadFnc=dcom_DDS_Package_Release_F10D_ReadData, DcmDspDataType=UINT8_N
            DcmDspDiagnosisScaling
              DcmDspAlternativeDataType: DcmApplicationDataType=Dcm_DataType_0xF10D_DDS_Package_Release_of_Application_Software_Year_Appl
          Diagnostic_Trace_Memory_Information: DcmDspDataByteSize=12, DcmDspDataEndianness=opaque, DcmDspDataReadFnc=dcom_Diagnostic_Trace_Memory_102_ReadData, DcmDspDataType=UINT8_N, DcmDspDataWriteFnc=dcom_DiagnosticTraceMemory_102_WriteData
            DcmDspDiagnosisScaling
              DcmDspAlternativeDataType: DcmApplicationDataType=Dcm_ArrDataType_0x102_Diagnostic_Trace_Memory
          ECU_Extract_Version_ECU_Extract_Version_Data: DcmDspDataByteSize=94, DcmDspDataEndianness=opaque, DcmDspDataReadFnc=dcom_Ecu_Extract_Version_EF00_ReadData, DcmDspDataType=UINT8_N
            DcmDspDiagnosisScaling
              DcmDspAlternativeDataType: DcmApplicationDataType=Dcm_DataType_0xEF00_ECU_Extract_Major_Version
          ECU_Serial_Number: DcmDspDataByteSize=17, DcmDspDataEndianness=opaque, DcmDspDataReadFnc=dcom_ECUSerialNumber_F18C_ReadData, DcmDspDataType=UINT8_N
            DcmDspDiagnosisScaling
              DcmDspAlternativeDataType: DcmApplicationDataType=Dcm_ArrDataType_0xF18C_ECU_Serial_Number
          Hardware_Supplier_Identification: DcmDspDataByteSize=2, DcmDspDataEndianness=BIG_ENDIAN, DcmDspDataReadFnc=dcom_HardwareSupplier_F154_ReadData, DcmDspDataType=UINT16_N
            DcmDspDiagnosisScaling
              DcmDspAlternativeDataType: DcmApplicationDataType=Dcm_DataType_0xF154_Hardware_Supplier_Identification
          HardwareVersion_Info_Data: DcmDspDataByteSize=3, DcmDspDataEndianness=opaque, DcmDspDataReadFnc=dcom_HardwareVersion_F150_ReadData, DcmDspDataType=UINT8_N
            DcmDspDiagnosisScaling
              DcmDspAlternativeDataType: DcmApplicationDataType=Dcm_DataType_0xF150_HW_year
          MercedesCarGroup_Hardware_Part_Number: DcmDspDataByteSize=10, DcmDspDataEndianness=opaque, DcmDspDataReadFnc=dcom_MercedesCarGroupHardware_F111_ReadData, DcmDspDataType=UINT8_N
            DcmDspDiagnosisScaling
              DcmDspAlternativeDataType: DcmApplicationDataType=Dcm_ArrDataType_0xF111_Hardware_Part_Number
          Read_Software_Fingerprints_Application_Data: DcmDspDataByteSize=20, DcmDspDataEndianness=opaque, DcmDspDataReadFnc=dcom_Read_Software_Fingerprint_s_Application_Data_F15B_ReadData, DcmDspDataType=UINT8_N
            DcmDspDiagnosisScaling
              DcmDspAlternativeDataType: DcmApplicationDataType=Dcm_ArrDataType_0xF15B_Software_Fingerprint_s
          Read_Software_Fingerprints_Bootloader_Data: DcmDspDataByteSize=20, DcmDspDataEndianness=opaque, DcmDspDataReadFnc=dcom_Read_Software_Fingerprint_s_Bootloader_Data_F15B_ReadData, DcmDspDataType=UINT8_N
            DcmDspDiagnosisScaling
              DcmDspAlternativeDataType: DcmApplicationDataType=Dcm_ArrDataType_0xF15B_Software_Fingerprint_s
          Reprog_Attempt_Counter_Attempts_Application_Data: DcmDspDataByteSize=4, DcmDspDataEndianness=opaque, DcmDspDataReadFnc=dcom_ReprogrammingAttemptCounter_Application_Data_0100_ReadData, DcmDspDataType=UINT8_N
            DcmDspDiagnosisScaling
              DcmDspAlternativeDataType: DcmApplicationDataType=Dcm_ArrDataType_0x100_Reprogramming_Attempts
          Reprog_Attempt_Counter_Attempts_Bootloader_data: DcmDspDataByteSize=4, DcmDspDataEndianness=opaque, DcmDspDataReadFnc=dcom_ReprogrammingAttemptCounter_Bootloader_Data_0100_ReadData, DcmDspDataType=UINT8_N
            DcmDspDiagnosisScaling
              DcmDspAlternativeDataType: DcmApplicationDataType=Dcm_ArrDataType_0x100_Reprogramming_Attempts
          Software_Logical_Block_Supplier_Application: DcmDspDataByteSize=2, DcmDspDataEndianness=BIG_ENDIAN, DcmDspDataReadFnc=dcom_SoftwareSupplier_Application_F155_ReadData, DcmDspDataType=UINT8_N
            DcmDspDiagnosisScaling
              DcmDspAlternativeDataType: DcmApplicationDataType=Dcm_ArrDataType_0xF155_Software_Logical_Block_Supplier_Identification
          Diagnostic_Extract_Version_Data: DcmDspDataByteSize=53, DcmDspDataEndianness=opaque, DcmDspDataReadFnc=dcom_Diagnostic_Extract_Version_EF01_ReadData, DcmDspDataType=UINT8_N
            DcmDspDiagnosisScaling
              DcmDspAlternativeDataType: DcmApplicationDataType=Dcm_DataType_0xEF01_Diagnostic_Extract_Major_Version
          Diagnostic_ECU_Name: DcmDspDataByteSize=1000, DcmDspDataEndianness=opaque, DcmDspDataReadFnc=dcom_ECU_Name_F104_ReadData, DcmDspDataType=UINT8_N
            DcmDspDiagnosisScaling
              DcmDspAlternativeDataType: DcmApplicationDataType=Dcm_ArrDataType_0xF104_Diagnostic_ECU_Name
          MercedesCarGroup_Software_Logical_Block_Numbers: DcmDspDataByteSize=20, DcmDspDataEndianness=opaque, DcmDspDataReadFnc=dcom_MercedesCarGroupSoftware_F121_ReadData, DcmDspDataType=UINT8_N
            DcmDspDiagnosisScaling
              DcmDspAlternativeDataType: DcmApplicationDataType=Dcm_ArrDataType_0xF121_Software_Logical_Block_Numbers
          Minimum_Software_Version_Identifier_Application: DcmDspDataByteSize=3, DcmDspDataEndianness=BIG_ENDIAN, DcmDspDataReadFnc=dcom_Minimum_Software_Version_Application_EF05_ReadData, DcmDspDataType=UINT8_N
            DcmDspDiagnosisScaling
              DcmDspAlternativeDataType: DcmApplicationDataType=Dcm_ArrDataType_0xEF05_Minimum_Software_Version
          Software_Logical_Block_Version_Information_Application: DcmDspDataByteSize=3, DcmDspDataEndianness=BIG_ENDIAN, DcmDspDataReadFnc=dcom_SoftwareVersion_Application_F151_ReadData, DcmDspDataType=UINT8_N
            DcmDspDiagnosisScaling
              DcmDspAlternativeDataType: DcmApplicationDataType=Dcm_ArrDataType_0xF151_Software_Logical_Block_Version_Information
          Standard_Application_SW_Package_Info: DcmDspDataByteSize=4, DcmDspDataEndianness=opaque, DcmDspDataReadFnc=dcom_StandardApplicationSWPackageSWVersion_EF03_ReadData, DcmDspDataType=UINT8_N
            DcmDspDiagnosisScaling
              DcmDspAlternativeDataType: DcmApplicationDataType=Dcm_DataType_0xEF03_Standard_Application_SW_Package_Major_Version
          SW_Package_Information_X_C_Identification: DcmDspDataByteSize=10, DcmDspDataEndianness=opaque, DcmDspDataReadFnc=dcom_StandardApplicationSWPackageXCIdentification_EF03_ReadData, DcmDspDataType=UINT8_N
            DcmDspDiagnosisScaling
              DcmDspAlternativeDataType: DcmApplicationDataType=Dcm_ArrDataType_0xEF03_X_C_Identification
          SW_Package_Information_Supplier_Identification: DcmDspDataByteSize=2, DcmDspDataEndianness=BIG_ENDIAN, DcmDspDataReadFnc=dcom_StandardApplicationSWPackageSupplierIdentification_EF03_ReadData, DcmDspDataType=UINT16_N
            DcmDspDiagnosisScaling
              DcmDspAlternativeDataType: DcmApplicationDataType=Dcm_DataType_0xEF03_Supplier_Identification
          Supported_configuration_mechanisms_Config: DcmDspDataByteSize=1, DcmDspDataEndianness=opaque, DcmDspDataReadFnc=dcom_Supported_Configuration_Mechanisms_F131_ReadData, DcmDspDataType=UINT8_N
            DcmDspDiagnosisScaling
              DcmDspAlternativeDataType: DcmApplicationDataType=Dcm_DataType_0xF131_Config_mechanisms
          Vedoc_Relevant_Hardware_PartNumber: DcmDspDataByteSize=10, DcmDspDataEndianness=opaque, DcmDspDataReadFnc=dcom_VedocRelavantHardwarePartNumber_F103_ReadData, DcmDspDataType=UINT8_N
          Vedoc_Relevant_Hardware_Supplier_Identification: DcmDspDataByteSize=5, DcmDspDataEndianness=opaque, DcmDspDataReadFnc=dcom_VedocRelavantHardwareSupplierIdentification_F103_ReadData, DcmDspDataType=UINT8_N
          Vedoc_Relevant_ECU_Serial_Number: DcmDspDataByteSize=17, DcmDspDataEndianness=opaque, DcmDspDataReadFnc=dcom_VedocRelavantECUSerialNumber_F103_ReadData, DcmDspDataType=UINT8_N
          Current_Operating_Time_Period: DcmDspDataByteSize=5, DcmDspDataEndianness=opaque, DcmDspDataReadFnc=dcom_CurrentOperatingTime_133_ReadData, DcmDspDataType=UINT8_N
            DcmDspDiagnosisScaling
              DcmDspAlternativeDataType: DcmApplicationDataType=Dcm_DataType_0x133_Current_Operating_Time
          Vehicle_Odometer_Low_Resolution: DcmDspDataByteSize=2, DcmDspDataEndianness=opaque, DcmDspDataReadFnc=dcom_VehicleOdometerLowResolution_10A_ReadData, DcmDspDataType=UINT8_N
            DcmDspDiagnosisScaling
              DcmDspAlternativeDataType: DcmApplicationDataType=Dcm_DataType_0x10A_Vehicle_Odometer_in_Low_Resolution
          Global_Time_Sync_Meas_Values: DcmDspDataByteSize=201, DcmDspDataEndianness=BIG_ENDIAN, DcmDspDataReadFnc=dcom_Global_Time_Sync_Measured_Values_0107_ReadData, DcmDspDataType=UINT8_N
            DcmDspDiagnosisScaling
              DcmDspAlternativeDataType: DcmApplicationDataType=Dcm_ArrDataType_0x107_Global_Time_Sync_Measured_Values
          Supplier_Specific_Message_Mode: DcmDspDataByteSize=1, DcmDspDataEndianness=opaque, DcmDspDataReadFnc=dcom_ActivateSupplierSpecificMessages_012A_ReadData, DcmDspDataType=UINT8_N, DcmDspDataWriteFnc=dcom_ActivateSupplierSpecificMessages_012A_WriteData
        24 x DcmDspDid, all with DcmDspDidUsePort=USE_DATA_ELEMENT_SPECIFIC_INTERFACES, DcmRbAtomicSenderReceiverCommunication=false:
          ActiveDiagnosticInformation: DcmDspDidIdentifier=61696, DcmDspDidInfoRef=ActiveDiagnosticInformation_info
            Identification (DcmDspDidSignal): DcmDspDidByteOffset=0, DcmDspDidDataRef=Active_Diagnostic_Information
          BootSoftwareVersion: DcmDspDidIdentifier=61779, DcmDspDidInfoRef=BootSoftwareVersion_info
            Boot_SW_Version (DcmDspDidSignal): DcmDspDidByteOffset=0, DcmDspDidDataRef=DcmDsp/Boot_SW_Version
          DDS_Package_Release: DcmDspDidIdentifier=61709, DcmDspDidInfoRef=DDS_Package_Release_info
            DDS_Package_Release (DcmDspDidSignal): DcmDspDidByteOffset=0, DcmDspDidDataRef=DDS_Package_Release_Info_Data
          Diagnostic_Trace_Memory: DcmDspDidIdentifier=258, DcmDspDidInfoRef=Diagnostic_Trace_Memory_info
            Diagnostic_Trace_Memory (DcmDspDidSignal): DcmDspDidByteOffset=0, DcmDspDidDataRef=Diagnostic_Trace_Memory_Information
          ECU_Extract_Version: DcmDspDidIdentifier=61184, DcmDspDidInfoRef=ECU_Extract_Version_info
            ECU_Extract_Version_signal (DcmDspDidSignal): DcmDspDidByteOffset=0, DcmDspDidDataRef=ECU_Extract_Version_ECU_Extract_Version_Data
          ECUSerialNumberDataIdentifier: DcmDspDidIdentifier=61836, DcmDspDidInfoRef=ECUSerialNumberDataIdentifier_info
            ECU_Serial_Number (DcmDspDidSignal): DcmDspDidByteOffset=0, DcmDspDidDataRef=DcmDsp/ECU_Serial_Number
          HardwareSupplier: DcmDspDidIdentifier=61780, DcmDspDidInfoRef=HardwareSupplier_info
            Hardware_Supplier_Identification (DcmDspDidSignal): DcmDspDidByteOffset=0, DcmDspDidDataRef=DcmDsp/Hardware_Supplier_Identification
          HardwareVersion: DcmDspDidIdentifier=61776, DcmDspDidInfoRef=HardwareVersion_info
            HW_Version (DcmDspDidSignal): DcmDspDidByteOffset=0, DcmDspDidDataRef=HardwareVersion_Info_Data
          MercedesCarGroupHardware: DcmDspDidIdentifier=61713, DcmDspDidInfoRef=MercedesCarGroupHardware_info
            Hardware_Part_Number (DcmDspDidSignal): DcmDspDidByteOffset=0, DcmDspDidDataRef=MercedesCarGroup_Hardware_Part_Number
          Read_Software_Fingerprint_s: DcmDspDidIdentifier=61787, DcmDspDidInfoRef=Read_Software_Fingerprint_s_info
            Software_Fingerprint_s (DcmDspDidSignal): DcmDspDidByteOffset=20, DcmDspDidDataRef=Read_Software_Fingerprints_Application_Data
            Software_Fingerprint_s_Bootloader_Data (DcmDspDidSignal): DcmDspDidByteOffset=0, DcmDspDidDataRef=Read_Software_Fingerprints_Bootloader_Data
          Reprogramming_Attempt_Counter: DcmDspDidIdentifier=256, DcmDspDidInfoRef=Reprogramming_Attempt_Counter_info
            Reprogramming_Attempts (DcmDspDidSignal): DcmDspDidByteOffset=4, DcmDspDidDataRef=Reprog_Attempt_Counter_Attempts_Application_Data
            Reprogramming_Attempts_Bootloader_Data (DcmDspDidSignal): DcmDspDidByteOffset=0, DcmDspDidDataRef=Reprog_Attempt_Counter_Attempts_Bootloader_data
          SoftwareSupplier: DcmDspDidIdentifier=61781, DcmDspDidInfoRef=SoftwareSupplier_info
            Software_Logical_Block_Supplier_Identification_Application (DcmDspDidSignal): DcmDspDidByteOffset=2, DcmDspDidDataRef=Software_Logical_Block_Supplier_Application
            Software_Logical_Block_Supplier_Identification_Bootloader (DcmDspDidSignal): DcmDspDidByteOffset=0, DcmDspDidDataRef=SoftwareSupplier_Software_Logical_Block_Supplier_Identification_Bootloader
          Diagnostic_Extract_Version: DcmDspDidIdentifier=61185, DcmDspDidInfoRef=Diagnostic_Extract_Version_info
            Diagnostic_Extract_Version_signal (DcmDspDidSignal): DcmDspDidByteOffset=0, DcmDspDidDataRef=Diagnostic_Extract_Version_Data
          ECU_Name: DcmDspDidIdentifier=61700, DcmDspDidInfoRef=ECU_Name_info
            Diagnostic_ECU_Name (DcmDspDidSignal): DcmDspDidByteOffset=0, DcmDspDidDataRef=DcmDsp/Diagnostic_ECU_Name
          MercedesCarGroupSoftware: DcmDspDidIdentifier=61729, DcmDspDidInfoRef=MercedesCarGroupSoftware_info
            Software_Logical_Block_Numbers (DcmDspDidSignal): DcmDspDidByteOffset=0, DcmDspDidDataRef=MercedesCarGroup_Software_Logical_Block_Numbers
          Minimum_Software_Version: DcmDspDidIdentifier=61189, DcmDspDidInfoRef=Minimum_Software_Version_info
            Minimum_Software_Version_Application (DcmDspDidSignal): DcmDspDidByteOffset=3, DcmDspDidDataRef=Minimum_Software_Version_Identifier_Application
            Minimum_Software_Version_Bootloader (DcmDspDidSignal): DcmDspDidByteOffset=0, DcmDspDidDataRef=Minimum_Software_Version_Minimum_Software_Version_Bootloader
          SoftwareVersion: DcmDspDidIdentifier=61777, DcmDspDidInfoRef=SoftwareVersion_info
            Software_Logical_Block_Version_Information_Application (DcmDspDidSignal): DcmDspDidByteOffset=3, DcmDspDidDataRef=DcmDsp/Software_Logical_Block_Version_Information_Application
            Software_Logical_Block_Version_Information_Bootloader (DcmDspDidSignal): DcmDspDidByteOffset=0, DcmDspDidDataRef=DcmDsp/Boot_SW_Version
          Standard_Application_SW_Package_Information: DcmDspDidIdentifier=61187, DcmDspDidInfoRef=Standard_Application_SW_Package_Information_info
            4 x DcmDspDidSignal:
              Standard_Application_SW_Version: DcmDspDidByteOffset=0, DcmDspDidDataRef=Standard_Application_SW_Package_Info
              X_C_Identification: DcmDspDidByteOffset=4, DcmDspDidDataRef=SW_Package_Information_X_C_Identification
              Supplier_Identification: DcmDspDidByteOffset=24, DcmDspDidDataRef=SW_Package_Information_Supplier_Identification
              AUTOSAR_PLATFORM: DcmDspDidByteOffset=26, DcmDspDidDataRef=Standard_Application_SW_Package_Information_AUTOSAR_Platform
          Supported_configuration_mechanisms: DcmDspDidIdentifier=61745, DcmDspDidInfoRef=Supported_configuration_mechanisms_info
            Config_mechanisms (DcmDspDidSignal): DcmDspDidByteOffset=0, DcmDspDidDataRef=Supported_configuration_mechanisms_Config
          Vedoc_Relevant_Information: DcmDspDidIdentifier=61699, DcmDspDidInfoRef=Vedoc_Relevant_Information_info
            3 x DcmDspDidSignal:
              Vedoc_Relevant_Information_Hardware_Part_Number: DcmDspDidByteOffset=0, DcmDspDidDataRef=Vedoc_Relevant_Hardware_PartNumber
              Vedoc_Relevant_Information_Hardware_Supplier_Identification: DcmDspDidByteOffset=10, DcmDspDidDataRef=Vedoc_Relevant_Hardware_Supplier_Identification
              Vedoc_Relevant_Information_ECU_Serial_Number: DcmDspDidByteOffset=15, DcmDspDidDataRef=Vedoc_Relevant_ECU_Serial_Number
          Current_Operating_Time: DcmDspDidIdentifier=307, DcmDspDidInfoRef=Current_Operating_Time_info
            Current_Operating_Time (DcmDspDidSignal): DcmDspDidByteOffset=0, DcmDspDidDataRef=Current_Operating_Time_Period
          Vehicle_Odometer_in_Low_Resolution: DcmDspDidIdentifier=266, DcmDspDidInfoRef=Vehicle_Odometer_in_Low_Resolution_info
            Vehicle_Odometer_in_Low_Resolution (DcmDspDidSignal): DcmDspDidByteOffset=0, DcmDspDidDataRef=Vehicle_Odometer_Low_Resolution
          Global_Time_Sync_Measured_Values: DcmDspDidIdentifier=263, DcmDspDidInfoRef=Global_Time_Sync_Measured_Values_info
            Global_Time_Sync_Measured_Values (DcmDspDidSignal): DcmDspDidByteOffset=0, DcmDspDidDataRef=Global_Time_Sync_Meas_Values
          ActivateSupplierSpecificMessages: DcmDspDidIdentifier=298, DcmDspDidInfoRef=ActivateSupplierSpecificMessages_info
            Supplier_Specific_Message_Mode (DcmDspDidSignal): DcmDspDidByteOffset=0, DcmDspDidDataRef=DcmDsp/Supplier_Specific_Message_Mode
        24 x DcmDspDidInfo, all with DcmDspDidDynamicallyDefined=false:
          ActiveDiagnosticInformation_info
            DcmDspDidRead
          BootSoftwareVersion_info
            DcmDspDidRead
          DDS_Package_Release_info
            DcmDspDidRead
          Diagnostic_Trace_Memory_info
            DcmDspDidRead: DcmDspDidReadSessionRef=DcmDspSession/DEFAULT_SESSION, DcmDspDidReadSessionRef=DcmDspSession/EXTENDED_DIAGNOSTIC_SESSION
            DcmDspDidWrite: DcmDspDidWriteSessionRef=DcmDspSession/EXTENDED_DIAGNOSTIC_SESSION
          ECU_Extract_Version_info
            DcmDspDidRead
          ECUSerialNumberDataIdentifier_info
            DcmDspDidRead: DcmDspDidReadSessionRef=DcmDspSession/DEFAULT_SESSION, DcmDspDidReadSessionRef=DcmDspSession/EXTENDED_DIAGNOSTIC_SESSION
          HardwareSupplier_info
            DcmDspDidRead
          HardwareVersion_info
            DcmDspDidRead
          MercedesCarGroupHardware_info
            DcmDspDidRead
          Read_Software_Fingerprint_s_info
            DcmDspDidRead
          Reprogramming_Attempt_Counter_info
            DcmDspDidRead
          SoftwareSupplier_info
            DcmDspDidRead
          Diagnostic_Extract_Version_info
            DcmDspDidRead: DcmDspDidReadSessionRef=DcmDspSession/DEFAULT_SESSION, DcmDspDidReadSessionRef=DcmDspSession/EXTENDED_DIAGNOSTIC_SESSION
          ECU_Name_info
            DcmDspDidRead
          MercedesCarGroupSoftware_info
            DcmDspDidRead
          Minimum_Software_Version_info
            DcmDspDidRead
          SoftwareVersion_info
            DcmDspDidRead
          Standard_Application_SW_Package_Information_info
            DcmDspDidRead
          Supported_configuration_mechanisms_info
            DcmDspDidRead: DcmDspDidReadSessionRef=DcmDspSession/DEFAULT_SESSION, DcmDspDidReadSessionRef=DcmDspSession/EXTENDED_DIAGNOSTIC_SESSION
          Vedoc_Relevant_Information_info
            DcmDspDidRead: DcmDspDidReadSessionRef=DcmDspSession/EXTENDED_DIAGNOSTIC_SESSION, DcmDspDidReadSessionRef=DcmDspSession/DEFAULT_SESSION
          Current_Operating_Time_info
            DcmDspDidRead
          Vehicle_Odometer_in_Low_Resolution_info
            DcmDspDidRead
          Global_Time_Sync_Measured_Values_info
            DcmDspDidRead
          ActivateSupplierSpecificMessages_info
            DcmDspDidRead
            DcmDspDidWrite: DcmDspDidWriteSessionRef=DcmDspSession/EXTENDED_DIAGNOSTIC_SESSION
        Check_Reprogramming_Preconditions (DcmDspRoutine): DcmDspRoutineIdentifier=515, DcmDspRoutineUsePort=false, DcmRbDspStopRoutineOnSessionChange=false
          DcmDspStartRoutine: DcmDspStartRoutineFnc=dcom_CheckReprogrammingPreconditions_0203_Start, DcmDspStartRoutineCommonAuthorizationRef=AP_Comb_0023
            DcmDspStartRoutineOut
              DcmDspStartRoutineOutSignal_0 (DcmDspStartRoutineOutSignal): DcmDspRoutineSignalEndianness=opaque, DcmDspRoutineSignalLength=8, DcmDspRoutineSignalPos=0, DcmDspRoutineSignalType=UINT8
              DcmDspStartRoutineOutSignal_1 (DcmDspStartRoutineOutSignal): DcmDspRoutineSignalEndianness=opaque, DcmDspRoutineSignalLength=24, DcmDspRoutineSignalPos=8, DcmDspRoutineSignalType=VARIABLE_LENGTH
        DcmDspSecurity:
          DcmDspSecurityMaxAttemptCounterReadoutTime = 0.005
          DcmRbDspSecurityDelayTimerMonitor = REQUEST_SEED
          DcmRbDspSecurityNRCExceedNoOfAttempt = NumAttDelayAndNumAttLock
          DcmRbDspSecurityStoreSeed = false
          DCM_SEC_LEVEL_51 (DcmDspSecurityRow):
            DcmDspSecurityADRSize = 1
            DcmDspSecurityAttemptCounterEnabled = false
            DcmDspSecurityCompareKeyFnc = dcom_CompareResponse
            DcmDspSecurityDelayTime = 10
            DcmDspSecurityDelayTimeOnBoot = 0
            DcmDspSecurityGetSeedFnc = dcom_GetChallenge
            DcmDspSecurityKeySize = 957
            DcmDspSecurityLevel = 51
            DcmDspSecurityNumAttDelay = 2
            DcmDspSecuritySeedSize = 162
            DcmDspSecurityUsePort = USE_ASYNCH_FNC
            DcmRbDspSecurityNumAttLock = 3
        DcmDspSession
          3 x DcmDspSessionRow, all with DcmDspSessionP2ServerMax=0.02, DcmDspSessionP2StarServerMax=2:
            DEFAULT_SESSION: DcmDspSessionForBoot=DCM_NO_BOOT, DcmDspSessionLevel=1
            EXTENDED_DIAGNOSTIC_SESSION: DcmDspSessionForBoot=DCM_NO_BOOT, DcmDspSessionLevel=3
            PROGRAMMING_SESSION: DcmDspSessionForBoot=DCM_SYS_BOOT, DcmDspSessionLevel=2
        DcmRbDspReadDTC: DcmRbDspReadDTCMaxNumDTCRead=20, DcmRbDspReadDTCMaxNumRecordRead=10
        3 x DcmDspData, all with DcmDspDataEndianness=BIG_ENDIAN, DcmDspDataType=UINT8_N, DcmDspDataUsePort=USE_DATA_SYNCH_FNC, DcmDspDataConditionCheckReadFncUsed=false:
          SoftwareSupplier_Software_Logical_Block_Supplier_Identification_Bootloader: DcmDspDataByteSize=2, DcmDspDataReadFnc=dcom_SoftwareSupplier_Bootloader_F155_ReadData
          Minimum_Software_Version_Minimum_Software_Version_Bootloader: DcmDspDataByteSize=3, DcmDspDataReadFnc=dcom_Minimum_Software_Version_Bootloader_EF05_ReadData
          Standard_Application_SW_Package_Information_AUTOSAR_Platform: DcmDspDataByteSize=1, DcmDspDataReadFnc=dcom_StandardApplicationSWPackage_AUTOSAR_Platform_EF03_ReadData
        Trust_Model_CSR_Supplier_Signature (DcmDspDid):
          DcmDspDidUsePort = USE_DATA_ELEMENT_SPECIFIC_INTERFACES
          DcmRbAtomicSenderReceiverCommunication = 0
          DcmDspDidIdentifier = 418
          DcmDspDidInfoRef = Trust_Model_CSR_Supplier_Signature_Info
          DcmDspDidSignal: DcmDspDidByteOffset=0, DcmDspDidDataRef=CSR_Supplier_Public_Key_Signature
        Trust_Model_CSR_Supplier_Signature_Info (DcmDspDidInfo): DcmDspDidDynamicallyDefined=false
          DcmDspDidRead: DcmDspDidReadSessionRef=DcmDspSession/EXTENDED_DIAGNOSTIC_SESSION, DcmDspDidReadSessionRef=DcmDspSession/DEFAULT_SESSION
          DcmDspDidWrite: DcmDspDidWriteSessionRef=DcmDspSession/EXTENDED_DIAGNOSTIC_SESSION, DcmDspDidWriteSessionRef=DcmDspSession/DEFAULT_SESSION
        CSR_Supplier_Public_Key_Signature (DcmDspData):
          DcmDspDataByteSize = 258
          DcmDspDataConditionCheckReadFncUsed = false
          DcmDspDataEndianness = opaque
          DcmDspDataType = UINT8_DYN
          DcmDspDataUsePort = USE_DATA_SYNCH_FNC
          DcmDspDataReadFnc = dcom_Trust_Model_CSR_Supplier_Signature_01A2_ReadData
          DcmDspDataReadDataLengthFnc = dcom_Trust_Model_CSR_Supplier_Signature_01A2_ReadDataLength
          DcmDspDataWriteFnc = dcom_Trust_Model_CSR_Supplier_Signature_01A2_WriteData
    DcmGeneral: DcmEnableSecurityEventReporting=false
      DcmRbGeneral: DcmRbRestoringEnabled=true, DcmRbRTEsupportsPRportFunctionality=true, DcmRbStoringEnabled=true
package /RB/UBK/Project/EcucValueCollections
  ecuc value collection EcucValueCollections: ecuc-values=Dcm
