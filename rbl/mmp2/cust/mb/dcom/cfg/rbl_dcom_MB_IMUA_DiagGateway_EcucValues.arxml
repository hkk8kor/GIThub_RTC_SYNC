AUTOSAR XML (schema 4-2-2)
package /RB/UBK/Project/EcucModuleConfigurationValuess
  module config Can
    CanConfigSet
      10 x CanHardwareObject, all with CanFdPaddingValue=0, CanHandleType=FULL, CanIdType=EXTENDED:
        DIAG_IMU_B_2F_ExtEth_RS_FD_ST3_DIAG_IMU_B_2F_ExtEth_RS_FD_ST3_256gi7icvs395ofy9hvrzd6fb_HAD_BACKUP_HAD_BACKUP_OUT: CanObjectType=TRANSMIT, CanControllerRef=CanIfControllerConfig_1
        DIAG_IMU_B_2F_IntEth_RS_FD_ST3_DIAG_IMU_B_2F_IntEth_RS_FD_ST3_h9mkcioirj2xwqs2u68hl08z_HAD_BACKUP_HAD_BACKUP_OUT: CanObjectType=TRANSMIT, CanControllerRef=CanIfControllerConfig_1
        DIAG_IMU_B_2F_ExtEth_RQ_FD_ST3_DIAG_IMU_B_2F_ExtEth_RQ_FD_ST3_b8vleekm3qeqor4bcb48kea7o_HAD_BACKUP_HAD_BACKUP_IN: CanObjectType=RECEIVE, CanControllerRef=CanIfControllerConfig_1
          CanHwFilter_417426312 (CanHwFilter): CanHwFilterCode=417426312, CanHwFilterMask=536870911
        DIAG_IMU_B_2F_IntEth_RQ_FD_ST3_DIAG_IMU_B_2F_IntEth_RQ_FD_ST3_3duz23zg3pkm5cgefm07bh31_HAD_BACKUP_HAD_BACKUP_IN: CanObjectType=RECEIVE, CanControllerRef=CanIfControllerConfig_1
          CanHwFilter_417426317 (CanHwFilter): CanHwFilterCode=417426317, CanHwFilterMask=536870911
        DIAG_IMU_B_2F_ExtEth_RS_FD_ST3_DIAG_IMU_B_2F_ExtEth_RS_FD_ST3_1h5e6ysxprtb26lqg8oub4kpe_IMU_INTERNAL_IMU_INTERNAL_IN: CanObjectType=RECEIVE, CanControllerRef=CanIfControllerConfig_0
          CanHwFilter_417426304 (CanHwFilter): CanHwFilterCode=417426304, CanHwFilterMask=536870911
        DIAG_IMU_B_2F_IntEth_RS_FD_ST3_DIAG_IMU_B_2F_IntEth_RS_FD_ST3_950founsvo2g2zm9h51gr26uz_IMU_INTERNAL_IMU_INTERNAL_IN: CanObjectType=RECEIVE, CanControllerRef=CanIfControllerConfig_0
          CanHwFilter_417426309 (CanHwFilter): CanHwFilterCode=417426309, CanHwFilterMask=536870911
        DIAG_IMU_B_2F_ExtEth_RQ_FD_ST3_DIAG_IMU_B_2F_ExtEth_RQ_FD_ST3_1xv547k1fgfi8ltc9elgjwfzs_IMU_INTERNAL_IMU_INTERNAL_OUT: CanObjectType=TRANSMIT, CanControllerRef=CanIfControllerConfig_0
        DIAG_IMU_B_2F_IntEth_RQ_FD_ST3_DIAG_IMU_B_2F_IntEth_RQ_FD_ST3_afqpvn3yru684o4w36wuwit32_IMU_INTERNAL_IMU_INTERNAL_OUT: CanObjectType=TRANSMIT, CanControllerRef=CanIfControllerConfig_0
        DIAG_IMU_B_FUNC_ExtEth_RQ_IMU_INTERNAL_OUT: CanObjectType=TRANSMIT, CanControllerRef=CanIfControllerConfig_0
        DIAG_IMU_B_FUNC_IntEth_RQ_IMU_INTERNAL_OUT: CanObjectType=TRANSMIT, CanControllerRef=CanIfControllerConfig_0
  module config CanIf
    CanIfInitCfg
      4 x CanIfBufferCfg, all with CanIfBufferSize=0:
        Bu_DIAG_IMU_B_2F_ExtEth_RS_FD_ST3_DIAG_IMU_B_2F_ExtEth_RS_FD_ST3_256gi7icvs395ofy9hvrzd6fb_HAD_BACKUP_HAD_BACKUP_OUT: CanIfBufferHthRef=CanIfInitHohCfg/DIAG_IMU_B_2F_ExtEth_RS_FD_ST3_DIAG_IMU_B_2F_ExtEth_RS_FD_ST3_256gi7icvs395ofy9hvrzd6fb_HAD_BACKUP_HAD_BACKUP_OUT
        Bu_DIAG_IMU_B_2F_IntEth_RS_FD_ST3_DIAG_IMU_B_2F_IntEth_RS_FD_ST3_h9mkcioirj2xwqs2u68hl08z_HAD_BACKUP_HAD_BACKUP_OUT: CanIfBufferHthRef=CanIfInitHohCfg/DIAG_IMU_B_2F_IntEth_RS_FD_ST3_DIAG_IMU_B_2F_IntEth_RS_FD_ST3_h9mkcioirj2xwqs2u68hl08z_HAD_BACKUP_HAD_BACKUP_OUT
        Bu_DIAG_IMU_B_2F_ExtEth_RQ_FD_ST3_DIAG_IMU_B_2F_ExtEth_RQ_FD_ST3_1xv547k1fgfi8ltc9elgjwfzs_IMU_INTERNAL_IMU_INTERNAL_OUT: CanIfBufferHthRef=CanIfInitHohCfg/DIAG_IMU_B_2F_ExtEth_RQ_FD_ST3_DIAG_IMU_B_2F_ExtEth_RQ_FD_ST3_1xv547k1fgfi8ltc9elgjwfzs_IMU_INTERNAL_IMU_INTERNAL_OUT
        Bu_DIAG_IMU_B_2F_IntEth_RQ_FD_ST3_DIAG_IMU_B_2F_IntEth_RQ_FD_ST3_afqpvn3yru684o4w36wuwit32_IMU_INTERNAL_IMU_INTERNAL_OUT: CanIfBufferHthRef=CanIfInitHohCfg/DIAG_IMU_B_2F_IntEth_RQ_FD_ST3_DIAG_IMU_B_2F_IntEth_RQ_FD_ST3_afqpvn3yru684o4w36wuwit32_IMU_INTERNAL_IMU_INTERNAL_OUT
      CanIfInitHohCfg
        4 x CanIfHrhCfg:
          DIAG_IMU_B_2F_ExtEth_RQ_FD_ST3_DIAG_IMU_B_2F_ExtEth_RQ_FD_ST3_b8vleekm3qeqor4bcb48kea7o_HAD_BACKUP_HAD_BACKUP_IN: CanIfHrhCanCtrlIdRef=CanIfControllerConfig_1, CanIfHrhIdSymRef=CanConfigSet/DIAG_IMU_B_2F_ExtEth_RQ_FD_ST3_DIAG_IMU_B_2F_ExtEth_RQ_FD_ST3_b8vleekm3qeqor4bcb48kea7o_HAD_BACKUP_HAD_BACKUP_IN
          DIAG_IMU_B_2F_IntEth_RQ_FD_ST3_DIAG_IMU_B_2F_IntEth_RQ_FD_ST3_3duz23zg3pkm5cgefm07bh31_HAD_BACKUP_HAD_BACKUP_IN: CanIfHrhCanCtrlIdRef=CanIfControllerConfig_1, CanIfHrhIdSymRef=CanConfigSet/DIAG_IMU_B_2F_IntEth_RQ_FD_ST3_DIAG_IMU_B_2F_IntEth_RQ_FD_ST3_3duz23zg3pkm5cgefm07bh31_HAD_BACKUP_HAD_BACKUP_IN
          DIAG_IMU_B_2F_ExtEth_RS_FD_ST3_DIAG_IMU_B_2F_ExtEth_RS_FD_ST3_1h5e6ysxprtb26lqg8oub4kpe_IMU_INTERNAL_IMU_INTERNAL_IN: CanIfHrhCanCtrlIdRef=CanIfControllerConfig_0, CanIfHrhIdSymRef=CanConfigSet/DIAG_IMU_B_2F_ExtEth_RS_FD_ST3_DIAG_IMU_B_2F_ExtEth_RS_FD_ST3_1h5e6ysxprtb26lqg8oub4kpe_IMU_INTERNAL_IMU_INTERNAL_IN
          DIAG_IMU_B_2F_IntEth_RS_FD_ST3_DIAG_IMU_B_2F_IntEth_RS_FD_ST3_950founsvo2g2zm9h51gr26uz_IMU_INTERNAL_IMU_INTERNAL_IN: CanIfHrhCanCtrlIdRef=CanIfControllerConfig_0, CanIfHrhIdSymRef=CanConfigSet/DIAG_IMU_B_2F_IntEth_RS_FD_ST3_DIAG_IMU_B_2F_IntEth_RS_FD_ST3_950founsvo2g2zm9h51gr26uz_IMU_INTERNAL_IMU_INTERNAL_IN
        6 x CanIfHthCfg:
          DIAG_IMU_B_2F_ExtEth_RS_FD_ST3_DIAG_IMU_B_2F_ExtEth_RS_FD_ST3_256gi7icvs395ofy9hvrzd6fb_HAD_BACKUP_HAD_BACKUP_OUT: CanIfHthCanCtrlIdRef=CanIfControllerConfig_1, CanIfHthIdSymRef=CanConfigSet/DIAG_IMU_B_2F_ExtEth_RS_FD_ST3_DIAG_IMU_B_2F_ExtEth_RS_FD_ST3_256gi7icvs395ofy9hvrzd6fb_HAD_BACKUP_HAD_BACKUP_OUT
          DIAG_IMU_B_2F_IntEth_RS_FD_ST3_DIAG_IMU_B_2F_IntEth_RS_FD_ST3_h9mkcioirj2xwqs2u68hl08z_HAD_BACKUP_HAD_BACKUP_OUT: CanIfHthCanCtrlIdRef=CanIfControllerConfig_1, CanIfHthIdSymRef=CanConfigSet/DIAG_IMU_B_2F_IntEth_RS_FD_ST3_DIAG_IMU_B_2F_IntEth_RS_FD_ST3_h9mkcioirj2xwqs2u68hl08z_HAD_BACKUP_HAD_BACKUP_OUT
          DIAG_IMU_B_2F_ExtEth_RQ_FD_ST3_DIAG_IMU_B_2F_ExtEth_RQ_FD_ST3_1xv547k1fgfi8ltc9elgjwfzs_IMU_INTERNAL_IMU_INTERNAL_OUT: CanIfHthCanCtrlIdRef=CanIfControllerConfig_0, CanIfHthIdSymRef=CanConfigSet/DIAG_IMU_B_2F_ExtEth_RQ_FD_ST3_DIAG_IMU_B_2F_ExtEth_RQ_FD_ST3_1xv547k1fgfi8ltc9elgjwfzs_IMU_INTERNAL_IMU_INTERNAL_OUT
          DIAG_IMU_B_2F_IntEth_RQ_FD_ST3_DIAG_IMU_B_2F_IntEth_RQ_FD_ST3_afqpvn3yru684o4w36wuwit32_IMU_INTERNAL_IMU_INTERNAL_OUT: CanIfHthCanCtrlIdRef=CanIfControllerConfig_0, CanIfHthIdSymRef=CanConfigSet/DIAG_IMU_B_2F_IntEth_RQ_FD_ST3_DIAG_IMU_B_2F_IntEth_RQ_FD_ST3_afqpvn3yru684o4w36wuwit32_IMU_INTERNAL_IMU_INTERNAL_OUT
          DIAG_IMU_B_FUNC_ExtEth_RQ_IMU_INTERNAL_OUT: CanIfHthCanCtrlIdRef=CanIfControllerConfig_0, CanIfHthIdSymRef=CanConfigSet/DIAG_IMU_B_FUNC_ExtEth_RQ_IMU_INTERNAL_OUT
          DIAG_IMU_B_FUNC_IntEth_RQ_IMU_INTERNAL_OUT: CanIfHthCanCtrlIdRef=CanIfControllerConfig_0, CanIfHthIdSymRef=CanConfigSet/DIAG_IMU_B_FUNC_IntEth_RQ_IMU_INTERNAL_OUT
      4 x CanIfRxPduCfg, all with CanIfRxPduCanIdType=EXTENDED_FD_CAN, CanIfRxPduReadData=false, CanIfRxPduReadNotifyStatus=false, CanIfRxPduUserRxIndicationName=CanTp_RxIndication, CanIfRxPduUserRxIndicationUL=CAN_TP, CanIfRxPduDataLength=0:
        DIAG_IMU_B_2F_ExtEth_RQ_FD_ST3_DIAG_IMU_B_2F_ExtEth_RQ_FD_ST3_b8vleekm3qeqor4bcb48kea7o_HAD_BACKUP_HAD_BACKUP_IN: CanIfRxPduCanId=417426312, CanIfRxPduHrhIdRef=CanIfInitHohCfg/DIAG_IMU_B_2F_ExtEth_RQ_FD_ST3_DIAG_IMU_B_2F_ExtEth_RQ_FD_ST3_b8vleekm3qeqor4bcb48kea7o_HAD_BACKUP_HAD_BACKUP_IN, CanIfRxPduRef=EcucPduCollection/DIAG_IMU_B_2F_ExtEth_RQ_FD_ST3_CanIf2CanTp_HAD_BACKUP_CAN
        DIAG_IMU_B_2F_IntEth_RQ_FD_ST3_DIAG_IMU_B_2F_IntEth_RQ_FD_ST3_3duz23zg3pkm5cgefm07bh31_HAD_BACKUP_HAD_BACKUP_IN: CanIfRxPduCanId=417426317, CanIfRxPduHrhIdRef=CanIfInitHohCfg/DIAG_IMU_B_2F_IntEth_RQ_FD_ST3_DIAG_IMU_B_2F_IntEth_RQ_FD_ST3_3duz23zg3pkm5cgefm07bh31_HAD_BACKUP_HAD_BACKUP_IN, CanIfRxPduRef=EcucPduCollection/DIAG_IMU_B_2F_IntEth_RQ_FD_ST3_CanIf2CanTp_HAD_BACKUP_CAN
        DIAG_IMU_B_2F_ExtEth_RS_FD_ST3_DIAG_IMU_B_2F_ExtEth_RS_FD_ST3_1h5e6ysxprtb26lqg8oub4kpe_IMU_INTERNAL_IMU_INTERNAL_IN: CanIfRxPduCanId=417426304, CanIfRxPduHrhIdRef=CanIfInitHohCfg/DIAG_IMU_B_2F_ExtEth_RS_FD_ST3_DIAG_IMU_B_2F_ExtEth_RS_FD_ST3_1h5e6ysxprtb26lqg8oub4kpe_IMU_INTERNAL_IMU_INTERNAL_IN, CanIfRxPduRef=EcucPduCollection/DIAG_IMU_B_2F_ExtEth_RS_FD_ST3_CanIf2CanTp_IMU_INTERNAL_CAN
        DIAG_IMU_B_2F_IntEth_RS_FD_ST3_DIAG_IMU_B_2F_IntEth_RS_FD_ST3_950founsvo2g2zm9h51gr26uz_IMU_INTERNAL_IMU_INTERNAL_IN: CanIfRxPduCanId=417426309, CanIfRxPduHrhIdRef=CanIfInitHohCfg/DIAG_IMU_B_2F_IntEth_RS_FD_ST3_DIAG_IMU_B_2F_IntEth_RS_FD_ST3_950founsvo2g2zm9h51gr26uz_IMU_INTERNAL_IMU_INTERNAL_IN, CanIfRxPduRef=EcucPduCollection/DIAG_IMU_B_2F_IntEth_RS_FD_ST3_CanIf2CanTp_IMU_INTERNAL_CAN
      5 x CanIfTxPduCfg, all with CanIfTxPduCanIdMask=536870911, CanIfTxPduCanIdType=EXTENDED_FD_CAN, CanIfTxPduType=STATIC, CanIfTxPduUserTxConfirmationName=CanTp_TxConfirmation, CanIfTxPduUserTxConfirmationUL=CAN_TP:
        DIAG_IMU_B_2F_ExtEth_RS_FD_ST3_DIAG_IMU_B_2F_ExtEth_RS_FD_ST3_256gi7icvs395ofy9hvrzd6fb_HAD_BACKUP_HAD_BACKUP_OUT: CanIfTxPduCanId=417426304, CanIfTxPduReadNotifyStatus=false, CanIfTxPduBufferRef=Bu_DIAG_IMU_B_2F_ExtEth_RS_FD_ST3_DIAG_IMU_B_2F_ExtEth_RS_FD_ST3_256gi7icvs395ofy9hvrzd6fb_HAD_BACKUP_HAD_BACKUP_OUT, CanIfTxPduRef=EcucPduCollection/DIAG_IMU_B_2F_ExtEth_RS_FD_ST3_CanTp2CanIf_HAD_BACKUP_CAN
        DIAG_IMU_B_2F_IntEth_RS_FD_ST3_DIAG_IMU_B_2F_IntEth_RS_FD_ST3_h9mkcioirj2xwqs2u68hl08z_HAD_BACKUP_HAD_BACKUP_OUT: CanIfTxPduCanId=417426309, CanIfTxPduReadNotifyStatus=false, CanIfTxPduBufferRef=Bu_DIAG_IMU_B_2F_IntEth_RS_FD_ST3_DIAG_IMU_B_2F_IntEth_RS_FD_ST3_h9mkcioirj2xwqs2u68hl08z_HAD_BACKUP_HAD_BACKUP_OUT, CanIfTxPduRef=EcucPduCollection/DIAG_IMU_B_2F_IntEth_RS_FD_ST3_CanTp2CanIf_HAD_BACKUP_CAN
        DIAG_IMU_B_2F_ExtEth_RQ_FD_ST3_DIAG_IMU_B_2F_ExtEth_RQ_FD_ST3_1xv547k1fgfi8ltc9elgjwfzs_IMU_INTERNAL_IMU_INTERNAL_OUT: CanIfTxPduCanId=417426312, CanIfTxPduReadNotifyStatus=false, CanIfTxPduBufferRef=Bu_DIAG_IMU_B_2F_ExtEth_RQ_FD_ST3_DIAG_IMU_B_2F_ExtEth_RQ_FD_ST3_1xv547k1fgfi8ltc9elgjwfzs_IMU_INTERNAL_IMU_INTERNAL_OUT, CanIfTxPduRef=EcucPduCollection/DIAG_IMU_B_2F_ExtEth_RQ_FD_ST3_CanTp2CanIf_IMU_INTERNAL_CAN
        DIAG_IMU_B_2F_IntEth_RQ_FD_ST3_DIAG_IMU_B_2F_IntEth_RQ_FD_ST3_afqpvn3yru684o4w36wuwit32_IMU_INTERNAL_IMU_INTERNAL_OUT: CanIfTxPduCanId=417426317, CanIfTxPduReadNotifyStatus=false, CanIfTxPduBufferRef=Bu_DIAG_IMU_B_2F_IntEth_RQ_FD_ST3_DIAG_IMU_B_2F_IntEth_RQ_FD_ST3_afqpvn3yru684o4w36wuwit32_IMU_INTERNAL_IMU_INTERNAL_OUT, CanIfTxPduRef=EcucPduCollection/DIAG_IMU_B_2F_IntEth_RQ_FD_ST3_CanTp2CanIf_IMU_INTERNAL_CAN
        DIAG_IMU_B_GLOBAL_ExtEth_RQ_FUNC_IMU_INTERNAL_ST3: CanIfTxPduReadNotifyStatus=0, CanIfTxPduCanId=418314376, CanIfTxPduRef=DIAG_RQ_GLOBAL_ExtEth_FD_ST3_CanTp2CanIf_IMU_INTERNAL_CAN, CanIfTxPduBufferRef=Bu_DIAG_IMU_B_Func_ExtEth_RQ_IMU_INTERNAL_OUT
      Bu_DIAG_IMU_B_Func_ExtEth_RQ_IMU_INTERNAL_OUT (CanIfBufferCfg): CanIfBufferSize=0, CanIfBufferHthRef=CanIfInitHohCfg/DIAG_IMU_B_FUNC_ExtEth_RQ_IMU_INTERNAL_OUT
      DIAG_IMU_B_GLOBAL_IntEth_RQ_FUNC_IMU_INTERNAL_ST3 (CanIfTxPduCfg):
        CanIfTxPduCanIdMask = 536870911
        CanIfTxPduReadNotifyStatus = 0
        CanIfTxPduCanIdType = EXTENDED_FD_CAN
        CanIfTxPduType = STATIC
        CanIfTxPduUserTxConfirmationUL = CAN_TP
        CanIfTxPduUserTxConfirmationName = CanTp_TxConfirmation
        CanIfTxPduCanId = 418319757
        CanIfTxPduBufferRef = Bu_DIAG_IMU_B_Func_IntEth_RQ_IMU_INTERNAL_OUT
        CanIfTxPduRef = DIAG_RQ_GLOBAL_IntEth_FD_ST3_CanTp2CanIf_IMU_INTERNAL_CAN
      Bu_DIAG_IMU_B_Func_IntEth_RQ_IMU_INTERNAL_OUT (CanIfBufferCfg): CanIfBufferSize=0, CanIfBufferHthRef=CanIfInitHohCfg/DIAG_IMU_B_FUNC_IntEth_RQ_IMU_INTERNAL_OUT
    CanIfPublicCfg: CanIfPublicHandleTypeEnum=UINT8
  module config CanTp
    CanTpConfig_0 (CanTpConfig)
      6 x CanTpChannel, all with CanTpRbHalfDuplexEnable=true:
        HAD_BACKUP_DIAG_IMU_B_2F_ExtEth_RQ_HAD_BACKUP_ST3_DIAG_IMU_B_2F_ExtEth_RS_HAD_BACKUP_ST3
          IMU_INTERNAL_DIAG_GLOBAL_FD_IntEth_RQ_IMU_INTERNAL_DIAG_GLOBAL_FD_ExtEth_RS_IMU_INTERNAL_ST3 (CanTpRxNSdu):
            CanTpBs = 5
            CanTpNar = 2.0
            CanTpNbr = 0.0
            CanTpRxAddressingFormat = CANTP_STANDARD
            CanTpRxPaddingActivation = CANTP_ON
            CanTpRxTaType = CANTP_PHYSICAL
            CanTpSTmin = 0.0
            CanTpNcr = 2.0
            CanTpRxWftMax = 30
            CanTpRxNSduRef = EcucPduCollection/SDU_DIAG_IMU_B_2F_ExtEth_RQ_HAD_BACKUP_ST3_CanTp2PduR_HAD_BACKUP_CAN
            DIAG_IMU_B_2F_ExtEth_RQ_FD_ST3_CanIf2CanTp_HAD_BACKUP_CAN (CanTpRxNPdu): CanTpRxNPduRef=EcucPduCollection/DIAG_IMU_B_2F_ExtEth_RQ_FD_ST3_CanIf2CanTp_HAD_BACKUP_CAN
            DIAG_IMU_B_2F_ExtEth_RS_FD_ST3_CanTp2CanIf_HAD_BACKUP_CAN (CanTpTxFcNPdu): CanTpTxFcNPduRef=EcucPduCollection/DIAG_IMU_B_2F_ExtEth_RS_FD_ST3_CanTp2CanIf_HAD_BACKUP_CAN
          TX_SDU_DIAG_IMU_B_2F_ExtEth_RS_HAD_BACKUP_ST3 (CanTpTxNSdu):
            CanTpNbs = 2.1
            CanTpNcs = 2.0
            CanTpTc = false
            CanTpTxAddressingFormat = CANTP_STANDARD
            CanTpTxPaddingActivation = CANTP_ON
            CanTpTxTaType = CANTP_PHYSICAL
            CanTpNas = 2.0
            CanTpTxNSduRef = EcucPduCollection/SDU_DIAG_IMU_B_2F_ExtEth_RS_HAD_BACKUP_ST3_PduR2CanTp_HAD_BACKUP_CAN
            DIAG_IMU_B_2F_ExtEth_RS_FD_ST3_CanTp2CanIf_HAD_BACKUP_CAN (CanTpTxNPdu): CanTpTxNPduRef=EcucPduCollection/DIAG_IMU_B_2F_ExtEth_RS_FD_ST3_CanTp2CanIf_HAD_BACKUP_CAN
            DIAG_IMU_B_2F_ExtEth_RQ_FD_ST3_CanIf2CanTp_HAD_BACKUP_CAN (CanTpRxFcNPdu): CanTpRxFcNPduRef=EcucPduCollection/DIAG_IMU_B_2F_ExtEth_RQ_FD_ST3_CanIf2CanTp_HAD_BACKUP_CAN
        HAD_BACKUP_DIAG_IMU_B_2F_IntEth_RQ_HAD_BACKUP_ST3_DIAG_IMU_B_2F_IntEth_RS_HAD_BACKUP_ST3
          RX_SDU_DIAG_IMU_B_2F_IntEth_RQ_HAD_BACKUP_ST3 (CanTpRxNSdu):
            CanTpBs = 5
            CanTpNar = 2.0
            CanTpNbr = 0.0
            CanTpRxAddressingFormat = CANTP_STANDARD
            CanTpRxPaddingActivation = CANTP_ON
            CanTpRxTaType = CANTP_PHYSICAL
            CanTpSTmin = 0.0
            CanTpRxWftMax = 30
            CanTpRxNSduRef = EcucPduCollection/SDU_DIAG_IMU_B_2F_IntEth_RQ_HAD_BACKUP_ST3_CanTp2PduR_HAD_BACKUP_CAN
            DIAG_IMU_B_2F_IntEth_RQ_FD_ST3_CanIf2CanTp_HAD_BACKUP_CAN (CanTpRxNPdu): CanTpRxNPduRef=EcucPduCollection/DIAG_IMU_B_2F_IntEth_RQ_FD_ST3_CanIf2CanTp_HAD_BACKUP_CAN
            DIAG_IMU_B_2F_IntEth_RS_FD_ST3_CanTp2CanIf_HAD_BACKUP_CAN (CanTpTxFcNPdu): CanTpTxFcNPduRef=EcucPduCollection/DIAG_IMU_B_2F_IntEth_RS_FD_ST3_CanTp2CanIf_HAD_BACKUP_CAN
          TX_SDU_DIAG_IMU_B_2F_IntEth_RS_HAD_BACKUP_ST3 (CanTpTxNSdu):
            CanTpNas = 2.0
            CanTpNbs = 2.1
            CanTpNcs = 2.0
            CanTpTc = false
            CanTpTxAddressingFormat = CANTP_STANDARD
            CanTpTxPaddingActivation = CANTP_ON
            CanTpTxTaType = CANTP_PHYSICAL
            CanTpTxNSduRef = EcucPduCollection/SDU_DIAG_IMU_B_2F_IntEth_RS_HAD_BACKUP_ST3_PduR2CanTp_HAD_BACKUP_CAN
            DIAG_IMU_B_2F_IntEth_RS_FD_ST3_CanTp2CanIf_HAD_BACKUP_CAN (CanTpTxNPdu): CanTpTxNPduRef=EcucPduCollection/DIAG_IMU_B_2F_IntEth_RS_FD_ST3_CanTp2CanIf_HAD_BACKUP_CAN
            DIAG_IMU_B_2F_IntEth_RQ_FD_ST3_CanIf2CanTp_HAD_BACKUP_CAN (CanTpRxFcNPdu): CanTpRxFcNPduRef=EcucPduCollection/DIAG_IMU_B_2F_IntEth_RQ_FD_ST3_CanIf2CanTp_HAD_BACKUP_CAN
        IMU_INTERNAL_DIAG_IMU_B_2F_ExtEth_RQ_IMU_INTERNAL_ST3_DIAG_IMU_B_2F_ExtEth_RS_IMU_INTERNAL_ST3
          RX_SDU_DIAG_IMU_B_2F_ExtEth_RS_IMU_INTERNAL_ST3 (CanTpRxNSdu):
            CanTpBs = 1
            CanTpNar = 2.0
            CanTpNbr = 0.01
            CanTpRxAddressingFormat = CANTP_STANDARD
            CanTpRxPaddingActivation = CANTP_ON
            CanTpRxTaType = CANTP_PHYSICAL
            CanTpRxWftMax = 30
            CanTpSTmin = 0.01
            CanTpNcr = 2.0
            CanTpRxNSduRef = EcucPduCollection/SDU_DIAG_IMU_B_2F_ExtEth_RS_IMU_INTERNAL_ST3_CanTp2PduR_IMU_INTERNAL_CAN
            DIAG_IMU_B_2F_ExtEth_RS_FD_ST3_CanIf2CanTp_IMU_INTERNAL_CAN (CanTpRxNPdu): CanTpRxNPduRef=EcucPduCollection/DIAG_IMU_B_2F_ExtEth_RS_FD_ST3_CanIf2CanTp_IMU_INTERNAL_CAN
            DIAG_IMU_B_2F_ExtEth_RQ_FD_ST3_CanTp2CanIf_IMU_INTERNAL_CAN (CanTpTxFcNPdu): CanTpTxFcNPduRef=EcucPduCollection/DIAG_IMU_B_2F_ExtEth_RQ_FD_ST3_CanTp2CanIf_IMU_INTERNAL_CAN
          TX_SDU_DIAG_IMU_B_2F_ExtEth_RQ_IMU_INTERNAL_ST3 (CanTpTxNSdu):
            CanTpNas = 2.0
            CanTpNbs = 2.1
            CanTpNcs = 2.0
            CanTpTc = false
            CanTpTxAddressingFormat = CANTP_STANDARD
            CanTpTxPaddingActivation = CANTP_ON
            CanTpTxTaType = CANTP_PHYSICAL
            CanTpTxNSduRef = EcucPduCollection/SDU_DIAG_IMU_B_2F_ExtEth_RQ_IMU_INTERNAL_ST3_PduR2CanTp_IMU_INTERNAL_CAN
            DIAG_IMU_B_2F_ExtEth_RQ_FD_ST3_CanTp2CanIf_IMU_INTERNAL_CAN (CanTpTxNPdu): CanTpTxNPduRef=EcucPduCollection/DIAG_IMU_B_2F_ExtEth_RQ_FD_ST3_CanTp2CanIf_IMU_INTERNAL_CAN
            DIAG_IMU_B_2F_ExtEth_RS_FD_ST3_CanIf2CanTp_IMU_INTERNAL_CAN (CanTpRxFcNPdu): CanTpRxFcNPduRef=EcucPduCollection/DIAG_IMU_B_2F_ExtEth_RS_FD_ST3_CanIf2CanTp_IMU_INTERNAL_CAN
        IMU_INTERNAL_DIAG_IMU_B_2F_IntEth_RQ_IMU_INTERNAL_ST3_DIAG_IMU_B_2F_IntEth_RS_IMU_INTERNAL_ST3
          RX_SDU_DIAG_IMU_B_2F_IntEth_RS_IMU_INTERNAL_ST3 (CanTpRxNSdu):
            CanTpBs = 1
            CanTpNar = 2.0
            CanTpNbr = 0.01
            CanTpNcr = 2.0
            CanTpRxAddressingFormat = CANTP_STANDARD
            CanTpRxPaddingActivation = CANTP_ON
            CanTpRxTaType = CANTP_PHYSICAL
            CanTpRxWftMax = 30
            CanTpSTmin = 0.01
            CanTpRxNSduRef = EcucPduCollection/SDU_DIAG_IMU_B_2F_IntEth_RS_IMU_INTERNAL_ST3_CanTp2PduR_IMU_INTERNAL_CAN
            DIAG_IMU_B_2F_IntEth_RS_FD_ST3_CanIf2CanTp_IMU_INTERNAL_CAN (CanTpRxNPdu): CanTpRxNPduRef=EcucPduCollection/DIAG_IMU_B_2F_IntEth_RS_FD_ST3_CanIf2CanTp_IMU_INTERNAL_CAN
            DIAG_IMU_B_2F_IntEth_RQ_FD_ST3_CanTp2CanIf_IMU_INTERNAL_CAN (CanTpTxFcNPdu): CanTpTxFcNPduRef=EcucPduCollection/DIAG_IMU_B_2F_IntEth_RQ_FD_ST3_CanTp2CanIf_IMU_INTERNAL_CAN
          TX_SDU_DIAG_IMU_B_2F_IntEth_RQ_IMU_INTERNAL_ST3 (CanTpTxNSdu):
            CanTpNas = 2.0
            CanTpNbs = 2.1
            CanTpNcs = 2.0
            CanTpTc = false
            CanTpTxAddressingFormat = CANTP_STANDARD
            CanTpTxPaddingActivation = CANTP_ON
            CanTpTxTaType = CANTP_PHYSICAL
            CanTpTxNSduRef = EcucPduCollection/SDU_DIAG_IMU_B_2F_IntEth_RQ_IMU_INTERNAL_ST3_PduR2CanTp_IMU_INTERNAL_CAN
            DIAG_IMU_B_2F_IntEth_RQ_FD_ST3_CanTp2CanIf_IMU_INTERNAL_CAN (CanTpTxNPdu): CanTpTxNPduRef=EcucPduCollection/DIAG_IMU_B_2F_IntEth_RQ_FD_ST3_CanTp2CanIf_IMU_INTERNAL_CAN
            DIAG_IMU_B_2F_IntEth_RS_FD_ST3_CanIf2CanTp_IMU_INTERNAL_CAN (CanTpRxFcNPdu): CanTpRxFcNPduRef=EcucPduCollection/DIAG_IMU_B_2F_IntEth_RS_FD_ST3_CanIf2CanTp_IMU_INTERNAL_CAN
        HAD_BACKUP_DIAG_GLOBAL_FD_ExtEth_RQ_HAD_BACKUP_ST3_DIAG_GLOBAL_FD_ExtEth_RS_IMU_INTERNAL_ST3
          TX_SDU_DIAG_IMU_B_GLOBAL_ExtEth_Func_RQ_IMU_INTERNAL_ST3 (CanTpTxNSdu):
            CanTpNas = 0.025
            CanTpNbs = 2.1
            CanTpTc = false
            CanTpTxAddressingFormat = CANTP_STANDARD
            CanTpTxPaddingActivation = CANTP_ON
            CanTpTxTaType = CANTP_FUNCTIONAL
            CanTpNcs = 2.0
            CanTpTxNSduRef = SDU_DIAG_RQ_GLOBAL_ExtEth_FD_ST3_PduR2CanTp_IMU_INTERNAL_CAN
            TXNPdu_SDU_DIAG_IMU_B_GLOBAL_ExtEth_Func_RQ_IMU_INTERNAL_ST3 (CanTpTxNPdu): CanTpTxNPduRef=DIAG_RQ_GLOBAL_ExtEth_FD_ST3_CanTp2CanIf_IMU_INTERNAL_CAN
        IMU_INTERNAL_DIAG_GLOBAL_FD_IntEth_RQ_IMU_INTERNAL_DIAG_GLOBAL_FD_ExtEth_RS_IMU_INTERNAL_ST3
          TX_SDU_DIAG_IMU_B_GLOBAL_IntEth_Func_RQ_IMU_INTERNAL_ST3 (CanTpTxNSdu):
            CanTpNas = 0.025
            CanTpNbs = 2.1
            CanTpTc = false
            CanTpTxAddressingFormat = CANTP_STANDARD
            CanTpTxPaddingActivation = CANTP_ON
            CanTpTxTaType = CANTP_FUNCTIONAL
            CanTpNcs = 2.0
            CanTpTxNSduRef = SDU_DIAG_RQ_GLOBAL_IntEth_FD_ST3_PduR2CanTp_IMU_INTERNAL_CAN
            TXNPdu_SDU_DIAG_IMU_B_GLOBAL_IntEth_Func_RQ_IMU_INTERNAL_ST3 (CanTpTxNPdu): CanTpTxNPduRef=DIAG_RQ_GLOBAL_IntEth_FD_ST3_CanTp2CanIf_IMU_INTERNAL_CAN
  module config EcuC
    EcucConfigSet
      EcucPduCollection
        22 x Pdu:
          DIAG_IMU_B_2F_ExtEth_RS_FD_ST3_CanTp2CanIf_HAD_BACKUP_CAN: PduLength=64, SysTPduToFrameTriggeringRef=DIAG_IMU_B_2F_ExtEth_RS_FD_ST3_256gi7icvs395ofy9hvrzd6fb
          DIAG_IMU_B_2F_IntEth_RS_FD_ST3_CanTp2CanIf_HAD_BACKUP_CAN: PduLength=64, SysTPduToFrameTriggeringRef=DIAG_IMU_B_2F_IntEth_RS_FD_ST3_h9mkcioirj2xwqs2u68hl08z
          DIAG_IMU_B_2F_ExtEth_RQ_FD_ST3_CanIf2CanTp_HAD_BACKUP_CAN: PduLength=64, SysTPduToFrameTriggeringRef=DIAG_IMU_B_2F_ExtEth_RQ_FD_ST3_b8vleekm3qeqor4bcb48kea7o
          DIAG_IMU_B_2F_IntEth_RQ_FD_ST3_CanIf2CanTp_HAD_BACKUP_CAN: PduLength=64, SysTPduToFrameTriggeringRef=DIAG_IMU_B_2F_IntEth_RQ_FD_ST3_3duz23zg3pkm5cgefm07bh31
          SDU_DIAG_RQ_GLOBAL_ExtEth_FD_ST3_CanTp2PduR_IMU_HADBACKUP_CAN: PduLength=64, SysTPduToPduTriggeringRef=SDU_DIAG_IMU_B_2F_ExtEth_RQ_HAD_BACKUP_ST3_2n6jjkr6gcqwx1zzfmy7woru4
          SDU_DIAG_RQ_GLOBAL_IntEth_FD_ST3_CanTp2PduR_IMU_HADBACKUP_CAN: PduLength=64, SysTPduToPduTriggeringRef=SDU_DIAG_IMU_B_2F_ExtEth_RQ_HAD_BACKUP_ST3_2n6jjkr6gcqwx1zzfmy7woru4
          SDU_DIAG_RQ_GLOBAL_ExtEth_FD_ST3_PduR2CanTp_IMU_INTERNAL_CAN: PduLength=64, SysTPduToPduTriggeringRef=SDU_DIAG_IMU_B_2F_ExtEth_RQ_HAD_BACKUP_ST3_2n6jjkr6gcqwx1zzfmy7woru4
          SDU_DIAG_RQ_GLOBAL_IntEth_FD_ST3_PduR2CanTp_IMU_INTERNAL_CAN: PduLength=64, SysTPduToPduTriggeringRef=SDU_DIAG_IMU_B_2F_ExtEth_RQ_HAD_BACKUP_ST3_2n6jjkr6gcqwx1zzfmy7woru4
          SDU_DIAG_IMU_B_2F_ExtEth_RQ_HAD_BACKUP_ST3_CanTp2PduR_HAD_BACKUP_CAN: PduLength=4095, SysTPduToPduTriggeringRef=SDU_DIAG_IMU_B_2F_ExtEth_RQ_HAD_BACKUP_ST3_2n6jjkr6gcqwx1zzfmy7woru4
          SDU_DIAG_IMU_B_2F_ExtEth_RS_HAD_BACKUP_ST3_PduR2CanTp_HAD_BACKUP_CAN: PduLength=4095, SysTPduToPduTriggeringRef=SDU_DIAG_IMU_B_2F_ExtEth_RS_HAD_BACKUP_ST3_9fxks67m6ctclr3m0m184py2q
          SDU_DIAG_IMU_B_2F_IntEth_RQ_HAD_BACKUP_ST3_CanTp2PduR_HAD_BACKUP_CAN: PduLength=4095, SysTPduToPduTriggeringRef=SDU_DIAG_IMU_B_2F_IntEth_RQ_HAD_BACKUP_ST3_bub6m1fvqqj2jfvpjx16sfqco
          SDU_DIAG_IMU_B_2F_IntEth_RS_HAD_BACKUP_ST3_PduR2CanTp_HAD_BACKUP_CAN: PduLength=4095, SysTPduToPduTriggeringRef=SDU_DIAG_IMU_B_2F_IntEth_RS_HAD_BACKUP_ST3_enrimsc4nfc8cqsvlb01bo41l
          DIAG_IMU_B_2F_ExtEth_RS_FD_ST3_CanIf2CanTp_IMU_INTERNAL_CAN: PduLength=64, SysTPduToFrameTriggeringRef=DIAG_IMU_B_2F_ExtEth_RS_FD_ST3_1h5e6ysxprtb26lqg8oub4kpe
          DIAG_IMU_B_2F_IntEth_RS_FD_ST3_CanIf2CanTp_IMU_INTERNAL_CAN: PduLength=64, SysTPduToFrameTriggeringRef=DIAG_IMU_B_2F_IntEth_RS_FD_ST3_950founsvo2g2zm9h51gr26uz
          DIAG_IMU_B_2F_ExtEth_RQ_FD_ST3_CanTp2CanIf_IMU_INTERNAL_CAN: PduLength=64, SysTPduToFrameTriggeringRef=DIAG_IMU_B_2F_ExtEth_RQ_FD_ST3_1xv547k1fgfi8ltc9elgjwfzs
          DIAG_IMU_B_2F_IntEth_RQ_FD_ST3_CanTp2CanIf_IMU_INTERNAL_CAN: PduLength=64, SysTPduToFrameTriggeringRef=DIAG_IMU_B_2F_IntEth_RQ_FD_ST3_afqpvn3yru684o4w36wuwit32
          DIAG_RQ_GLOBAL_ExtEth_FD_ST3_CanTp2CanIf_IMU_INTERNAL_CAN: PduLength=64, SysTPduToFrameTriggeringRef=DIAG_RQ_GLOBAL_ExtEth_FD_ST3_4br696uieeb8u19kyrf6457yn
          DIAG_RQ_GLOBAL_IntEth_FD_ST3_CanTp2CanIf_IMU_INTERNAL_CAN: PduLength=64, SysTPduToFrameTriggeringRef=DIAG_RQ_GLOBAL_IntEth_FD_ST3_8bgirc7wp02v6n9kxgswj692l
          SDU_DIAG_IMU_B_2F_ExtEth_RS_IMU_INTERNAL_ST3_CanTp2PduR_IMU_INTERNAL_CAN: PduLength=4095, SysTPduToPduTriggeringRef=SDU_DIAG_IMU_B_2F_ExtEth_RS_IMU_INTERNAL_ST3_aj2z7r7k9dlwvjrbkwnnfkar5
          SDU_DIAG_IMU_B_2F_ExtEth_RQ_IMU_INTERNAL_ST3_PduR2CanTp_IMU_INTERNAL_CAN: PduLength=4095, SysTPduToPduTriggeringRef=SDU_DIAG_IMU_B_2F_ExtEth_RQ_IMU_INTERNAL_ST3_8p1t5axok0gymf7lxvm0d86r4
          SDU_DIAG_IMU_B_2F_IntEth_RS_IMU_INTERNAL_ST3_CanTp2PduR_IMU_INTERNAL_CAN: PduLength=4095, SysTPduToPduTriggeringRef=SDU_DIAG_IMU_B_2F_IntEth_RS_IMU_INTERNAL_ST3_aim5b9uh4cxdhsdi0njtzfqhq
          SDU_DIAG_IMU_B_2F_IntEth_RQ_IMU_INTERNAL_ST3_PduR2CanTp_IMU_INTERNAL_CAN: PduLength=4095, SysTPduToPduTriggeringRef=SDU_DIAG_IMU_B_2F_IntEth_RQ_IMU_INTERNAL_ST3_23a5ju54dx0yv2u8skz5uwmio
  module config PduR
    PduRRoutingPaths
      SDU_DIAG_IMU_B_2F_ExtEth_RQ_HAD_BACKUP_ST3_CanTp2PduR_HAD_BACKUP_CAN (PduRSrcPdu): PduRSrcPduRef=EcucPduCollection/SDU_DIAG_IMU_B_2F_ExtEth_RQ_HAD_BACKUP_ST3_CanTp2PduR_HAD_BACKUP_CAN
      SDU_DIAG_IMU_B_2F_ExtEth_RQ_IMU_INTERNAL_ST3_PduR2CanTp_IMU_INTERNAL_CAN (PduRDestPdu): PduRDestPduRef=EcucPduCollection/SDU_DIAG_IMU_B_2F_ExtEth_RQ_IMU_INTERNAL_ST3_PduR2CanTp_IMU_INTERNAL_CAN
      5 x PduRRoutingPath, all with PduRDestTxBufferRef=PduRTxBufferPool_GW_0:
        SDU_DIAG_IMU_B_2F_ExtEth_RQ_HAD_BACKUP_ST3_GATEWAY_HAD_BACKUP_CAN: PduRTpThreshold=315, PduRDestPduRRef=PduRRoutingPaths/SDU_DIAG_IMU_B_2F_ExtEth_RQ_IMU_INTERNAL_ST3_PduR2CanTp_IMU_INTERNAL_CAN, PduRSrcPduRRef=PduRRoutingPaths/SDU_DIAG_IMU_B_2F_ExtEth_RQ_HAD_BACKUP_ST3_CanTp2PduR_HAD_BACKUP_CAN
        SDU_DIAG_IMU_B_2F_ExtEth_RS_IMU_INTERNAL_ST3_GATEWAY_IMU_INTERNAL_CAN: PduRTpThreshold=63, PduRDestPduRRef=PduRRoutingPaths/SDU_DIAG_IMU_B_2F_ExtEth_RS_HAD_BACKUP_ST3_PduR2CanTp_HAD_BACKUP_CAN, PduRSrcPduRRef=PduRRoutingPaths/SDU_DIAG_IMU_B_2F_ExtEth_RS_IMU_INTERNAL_ST3_CanTp2PduR_IMU_INTERNAL_CAN
        SDU_DIAG_IMU_B_2F_IntEth_RQ_HAD_BACKUP_ST3_GATEWAY_HAD_BACKUP_CAN: PduRTpThreshold=315, PduRDestPduRRef=PduRRoutingPaths/SDU_DIAG_IMU_B_2F_IntEth_RQ_IMU_INTERNAL_ST3_PduR2CanTp_IMU_INTERNAL_CAN, PduRSrcPduRRef=PduRRoutingPaths/SDU_DIAG_IMU_B_2F_IntEth_RQ_HAD_BACKUP_ST3_CanTp2PduR_HAD_BACKUP_CAN
        SDU_DIAG_IMU_B_2F_IntEth_RS_IMU_INTERNAL_ST3_GATEWAY_IMU_INTERNAL_CAN: PduRTpThreshold=63, PduRDestPduRRef=PduRRoutingPaths/SDU_DIAG_IMU_B_2F_IntEth_RS_HAD_BACKUP_ST3_PduR2CanTp_HAD_BACKUP_CAN, PduRSrcPduRRef=PduRRoutingPaths/SDU_DIAG_IMU_B_2F_IntEth_RS_IMU_INTERNAL_ST3_CanTp2PduR_IMU_INTERNAL_CAN
        UDS_DIAG_REQ_MB_DiagExt_Func_Gateway_Can_Network_Internal_Channel: PduRSrcPduRRef=UDS_DIAG_REQ_MB_DiagExt_Func_CanTp2PduR_Can_Network_Internal_Channel, PduRDestPduRRef=SDU_DIAG_REQ_MB_DiagExt_Func_PduR2CanTp_IMU_INTERNAL_CAN
      SDU_DIAG_IMU_B_2F_ExtEth_RS_HAD_BACKUP_ST3_PduR2CanTp_HAD_BACKUP_CAN (PduRDestPdu): PduRDestPduRef=EcucPduCollection/SDU_DIAG_IMU_B_2F_ExtEth_RS_HAD_BACKUP_ST3_PduR2CanTp_HAD_BACKUP_CAN
      SDU_DIAG_IMU_B_2F_ExtEth_RS_IMU_INTERNAL_ST3_CanTp2PduR_IMU_INTERNAL_CAN (PduRSrcPdu): PduRSrcPduRef=EcucPduCollection/SDU_DIAG_IMU_B_2F_ExtEth_RS_IMU_INTERNAL_ST3_CanTp2PduR_IMU_INTERNAL_CAN
      SDU_DIAG_IMU_B_2F_IntEth_RQ_IMU_INTERNAL_ST3_PduR2CanTp_IMU_INTERNAL_CAN (PduRDestPdu): PduRDestPduRef=EcucPduCollection/SDU_DIAG_IMU_B_2F_IntEth_RQ_IMU_INTERNAL_ST3_PduR2CanTp_IMU_INTERNAL_CAN
      SDU_DIAG_IMU_B_2F_IntEth_RQ_HAD_BACKUP_ST3_CanTp2PduR_HAD_BACKUP_CAN (PduRSrcPdu): PduRSrcPduRef=EcucPduCollection/SDU_DIAG_IMU_B_2F_IntEth_RQ_HAD_BACKUP_ST3_CanTp2PduR_HAD_BACKUP_CAN
      SDU_DIAG_IMU_B_2F_IntEth_RS_HAD_BACKUP_ST3_PduR2CanTp_HAD_BACKUP_CAN (PduRDestPdu): PduRDestPduRef=EcucPduCollection/SDU_DIAG_IMU_B_2F_IntEth_RS_HAD_BACKUP_ST3_PduR2CanTp_HAD_BACKUP_CAN
      SDU_DIAG_IMU_B_2F_IntEth_RS_IMU_INTERNAL_ST3_CanTp2PduR_IMU_INTERNAL_CAN (PduRSrcPdu): PduRSrcPduRef=EcucPduCollection/SDU_DIAG_IMU_B_2F_IntEth_RS_IMU_INTERNAL_ST3_CanTp2PduR_IMU_INTERNAL_CAN
      SDU_DIAG_REQ_MB_DiagExt_Func_PduR2CanTp_IMU_INTERNAL_CAN (PduRDestPdu): PduRDestPduRef=SDU_DIAG_RQ_GLOBAL_ExtEth_FD_ST3_PduR2CanTp_IMU_INTERNAL_CAN
      UDS_DIAG_REQ_MB_DiagExt_Func_CanTp2PduR_Can_Network_Internal_Channel (PduRSrcPdu): PduRSrcPduRef=UDS_DIAG_REQ_MB_DiagExt_Func_CanTp2PduR_Can_Network_Channel_CAN
      UDS_DIAG_REQ_MB_DiagExt_Func_PduR2Dcm_Can_Network_Channel_CAN (PduRDestPdu): PduRDestPduRef=UDS_DIAG_REQ_MB_DiagExt_Func_PduR2Dcm_Can_Network_Channel_CAN
      UDS_DIAG_REQ_MB_DiagInt_Func_Gateway_Can_Network_Internal_Channel (PduRRoutingPath):
        PduRDestPduRRef = SDU_DIAG_REQ_MB_DiagInt_Func_PduR2CanTp_IMU_INTERNAL_CAN
        PduRSrcPduRRef = UDS_DIAG_REQ_MB_DiagInt_Func_CanTp2PduR_Can_Network_Internal_Channel
        PduRDestTxBufferRef = PduRTxBufferPool_GW_0
      SDU_DIAG_REQ_MB_DiagInt_Func_PduR2CanTp_IMU_INTERNAL_CAN (PduRDestPdu): PduRDestPduRef=SDU_DIAG_RQ_GLOBAL_IntEth_FD_ST3_PduR2CanTp_IMU_INTERNAL_CAN
      UDS_DIAG_REQ_MB_DiagInt_Func_PduR2Dcm_Can_Network_Channel_CAN (PduRDestPdu): PduRDestPduRef=UDS_DIAG_REQ_MB_DiagInt_Func_PduR2Dcm_Can_Network_Channel_CAN
      UDS_DIAG_REQ_MB_DiagInt_Func_CanTp2PduR_Can_Network_Internal_Channel (PduRSrcPdu): PduRSrcPduRef=UDS_DIAG_REQ_MB_DiagInt_Func_CanTp2PduR_Can_Network_Channel_CAN
      PduRTxBufferPool_GW_0 (PduRTxBuffer): PduRPduMaxLength=4095
      UDS_DIAG_REQ_MB_DiagExt_Func_Gateway_Can_Network_Internal_Channel_IMUA (PduRRoutingPath):
        PduRSrcPduRRef = UDS_DIAG_REQ_MB_DiagExt_Func_CanTp2PduR_Can_Network_Internal_Channel
        PduRDestPduRRef = UDS_DIAG_REQ_MB_DiagExt_Func_PduR2Dcm_Can_Network_Channel_CAN
      UDS_DIAG_REQ_MB_DiagInt_Func_Gateway_Can_Network_Internal_Channel_IMUA (PduRRoutingPath):
        PduRSrcPduRRef = UDS_DIAG_REQ_MB_DiagInt_Func_CanTp2PduR_Can_Network_Internal_Channel
        PduRDestPduRRef = UDS_DIAG_REQ_MB_DiagInt_Func_PduR2Dcm_Can_Network_Channel_CAN
    3 x PduRBswModules:
      Com: PduRCommunicationInterface=true, PduRLowerModule=false, PduRUpperModule=true, PduRBswModuleRef=Com
      CanTp: PduRCommunicationInterface=false, PduRLowerModule=true, PduRTransportProtocol=true, PduRUpperModule=false, PduRBswModuleRef=CanTp
      Dcm: PduRCommunicationInterface=false, PduRLowerModule=false, PduRTransportProtocol=true, PduRUpperModule=true, PduRBswModuleRef=Dcm
    PduRGeneral: PduRRbTPGatewayOperation=true, PduRRbMulticastToTpSupport=true, PduRRbMulticastFromTpSupport=true
