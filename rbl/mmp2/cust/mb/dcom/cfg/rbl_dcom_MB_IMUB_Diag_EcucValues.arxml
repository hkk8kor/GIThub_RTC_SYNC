AUTOSAR XML (schema 4-2-2)
package /RB/UBK/Project/EcucModuleConfigurationValuess
  module config Can
    CanConfigSet
      6 x CanHardwareObject, all with CanHandleType=FULL, CanIdType=EXTENDED, CanControllerRef=CanIfControllerConfig_0:
        UDS_DIAG_REQ_MB_DiagExt_Can_Network_Channel_Can_Network_IN: CanObjectType=RECEIVE
          CanHwFilter: CanHwFilterCode=417426312, CanHwFilterMask=536870911
        UDS_DIAG_REQ_MB_DiagExt_Func_Can_Network_Channel_Can_Network_IN: CanObjectType=RECEIVE
          CanHwFilter: CanHwFilterCode=418314376, CanHwFilterMask=536870911
        UDS_DIAG_RES_MB_DiagExt_Can_Network_Channel_Can_Network_OUT: CanObjectType=TRANSMIT
          CanHwFilter: CanHwFilterCode=417426304, CanHwFilterMask=536870911
        UDS_DIAG_REQ_MB_DiagInt_Can_Network_Channel_Can_Network_IN: CanObjectType=RECEIVE
          CanHwFilter: CanHwFilterCode=417426317, CanHwFilterMask=536870911
        UDS_DIAG_REQ_MB_DiagInt_Func_Can_Network_Channel_Can_Network_IN: CanObjectType=RECEIVE
          CanHwFilter: CanHwFilterCode=418319757, CanHwFilterMask=536870911
        UDS_DIAG_RES_MB_DiagInt_Can_Network_Channel_Can_Network_OUT: CanObjectType=TRANSMIT
          CanHwFilter: CanHwFilterCode=417426309, CanHwFilterMask=536870911
  module config CanIf
    CanIfInitCfg: CanIfInitCfgSet=not_supported
      Bu_UDS_DIAG_RES_MB_DiagExt_Can_Network_Channel_Can_Network_OUT (CanIfBufferCfg): CanIfBufferSize=0, CanIfBufferHthRef=CanIfInitHohCfg/UDS_DIAG_RES_MB_DiagExt_Can_Network_Channel_Can_Network_OUT
      Bu_UDS_DIAG_RES_MB_DiagInt_Can_Network_Channel_Can_Network_OUT (CanIfBufferCfg): CanIfBufferSize=0, CanIfBufferHthRef=CanIfInitHohCfg/UDS_DIAG_RES_MB_DiagInt_Can_Network_Channel_Can_Network_OUT
      CanIfInitHohCfg
        4 x CanIfHrhCfg, all with CanIfHrhCanCtrlIdRef=CanIfControllerConfig_0:
          UDS_DIAG_REQ_MB_DiagExt_Can_Network_Channel_Can_Network_IN: CanIfHrhIdSymRef=CanConfigSet/UDS_DIAG_REQ_MB_DiagExt_Can_Network_Channel_Can_Network_IN
          UDS_DIAG_REQ_MB_DiagExt_Func_Can_Network_Channel_Can_Network_IN: CanIfHrhIdSymRef=CanConfigSet/UDS_DIAG_REQ_MB_DiagExt_Func_Can_Network_Channel_Can_Network_IN
          UDS_DIAG_REQ_MB_DiagInt_Can_Network_Channel_Can_Network_IN: CanIfHrhIdSymRef=CanConfigSet/UDS_DIAG_REQ_MB_DiagInt_Can_Network_Channel_Can_Network_IN
          UDS_DIAG_REQ_MB_DiagInt_Func_Can_Network_Channel_Can_Network_IN: CanIfHrhIdSymRef=CanConfigSet/UDS_DIAG_REQ_MB_DiagInt_Func_Can_Network_Channel_Can_Network_IN
        UDS_DIAG_RES_MB_DiagExt_Can_Network_Channel_Can_Network_OUT (CanIfHthCfg): CanIfHthCanCtrlIdRef=CanIfControllerConfig_0, CanIfHthIdSymRef=CanConfigSet/UDS_DIAG_RES_MB_DiagExt_Can_Network_Channel_Can_Network_OUT
        UDS_DIAG_RES_MB_DiagInt_Can_Network_Channel_Can_Network_OUT (CanIfHthCfg): CanIfHthCanCtrlIdRef=CanIfControllerConfig_0, CanIfHthIdSymRef=CanConfigSet/UDS_DIAG_RES_MB_DiagInt_Can_Network_Channel_Can_Network_OUT
      4 x CanIfRxPduCfg, all with CanIfRxPduCanIdType=EXTENDED_FD_CAN, CanIfRxPduReadData=false, CanIfRxPduReadNotifyStatus=false, CanIfRxPduUserRxIndicationUL=CAN_TP, CanIfRxPduDataLength=64:
        UDS_DIAG_REQ_MB_DiagExt_Can_Network_Channel_Can_Network_IN: CanIfRxPduCanId=417426312, CanIfRxPduHrhIdRef=CanIfInitHohCfg/UDS_DIAG_REQ_MB_DiagExt_Can_Network_Channel_Can_Network_IN, CanIfRxPduRef=UDS_DIAG_REQ_MB_DiagExt_CanIf2CanTp_Can_Network_Channel_CAN
        UDS_DIAG_REQ_MB_DiagExt_Func_Can_Network_Channel_Can_Network_IN: CanIfRxPduCanId=418314376, CanIfRxPduHrhIdRef=CanIfInitHohCfg/UDS_DIAG_REQ_MB_DiagExt_Func_Can_Network_Channel_Can_Network_IN, CanIfRxPduRef=UDS_DIAG_REQ_MB_DiagExt_Func_CanIf2CanTp_Can_Network_Channel_CAN
        UDS_DIAG_REQ_MB_DiagInt_Can_Network_Channel_Can_Network_IN: CanIfRxPduCanId=417426317, CanIfRxPduHrhIdRef=CanIfInitHohCfg/UDS_DIAG_REQ_MB_DiagInt_Can_Network_Channel_Can_Network_IN, CanIfRxPduRef=UDS_DIAG_REQ_MB_DiagInt_CanIf2CanTp_Can_Network_Channel_CAN
        UDS_DIAG_REQ_MB_DiagInt_Func_Can_Network_Channel_Can_Network_IN: CanIfRxPduCanId=418319757, CanIfRxPduHrhIdRef=CanIfInitHohCfg/UDS_DIAG_REQ_MB_DiagInt_Func_Can_Network_Channel_Can_Network_IN, CanIfRxPduRef=UDS_DIAG_REQ_MB_DiagInt_Func_CanIf2CanTp_Can_Network_Channel_CAN
      UDS_DIAG_RES_MB_DiagExt_Can_Network_Channel_Can_Network_OUT (CanIfTxPduCfg):
        CanIfTxPduCanId = 417426304
        CanIfTxPduCanIdType = EXTENDED_FD_CAN
        CanIfTxPduReadNotifyStatus = false
        CanIfTxPduTruncation = false
        CanIfTxPduType = STATIC
        CanIfTxPduUserTxConfirmationUL = CAN_TP
        CanIfTxPduBufferRef = Bu_UDS_DIAG_RES_MB_DiagExt_Can_Network_Channel_Can_Network_OUT
        CanIfTxPduRef = UDS_DIAG_RES_MB_DiagExt_CanTp2CanIf_Can_Network_Channel_CAN
      UDS_DIAG_RES_MB_DiagInt_Can_Network_Channel_Can_Network_OUT (CanIfTxPduCfg):
        CanIfTxPduCanId = 417426309
        CanIfTxPduCanIdType = EXTENDED_FD_CAN
        CanIfTxPduReadNotifyStatus = false
        CanIfTxPduTruncation = false
        CanIfTxPduType = STATIC
        CanIfTxPduUserTxConfirmationUL = CAN_TP
        CanIfTxPduBufferRef = Bu_UDS_DIAG_RES_MB_DiagInt_Can_Network_Channel_Can_Network_OUT
        CanIfTxPduRef = UDS_DIAG_RES_MB_DiagInt_CanTp2CanIf_Can_Network_Channel_CAN
    CanIfPublicCfg: CanIfMetaDataSupport=false
  module config CanTp: implementation-config-variant=VARIANT-PRE-COMPILE
    CanTpConfig_0 (CanTpConfig)
      CanTpChannel_MB_Diag_Ext (CanTpChannel): CanTpRbHalfDuplexEnable=true
        CanTpRxNSdu_MB_DiagExt_PHY (CanTpRxNSdu):
          CanTpBs = 0
          CanTpNar = 0.025
          CanTpNbr = 0
          CanTpNcr = 2
          CanTpRxAddressingFormat = CANTP_STANDARD
          CanTpRxPaddingActivation = CANTP_ON
          CanTpRxTaType = CANTP_PHYSICAL
          CanTpSTmin = 0.01
          CanTpRxWftMax = 30
          CanTpRxNSduRef = UDS_DIAG_REQ_MB_DiagExt_CanTp2PduR_Can_Network_Channel_CAN
          CanTpRxNPdu_MB_DiagExt_PHY (CanTpRxNPdu): CanTpRxNPduRef=UDS_DIAG_REQ_MB_DiagExt_CanIf2CanTp_Can_Network_Channel_CAN
          CanTpTxFcNPdu_MB_DiagExt_PHY (CanTpTxFcNPdu): CanTpTxFcNPduRef=UDS_DIAG_RES_MB_DiagExt_CanTp2CanIf_Can_Network_Channel_CAN
        CanTpRxNSdu_MB_DiagExt_FUNC (CanTpRxNSdu):
          CanTpBs = 0
          CanTpNar = 0.025
          CanTpNbr = 0
          CanTpNcr = 2
          CanTpRxAddressingFormat = CANTP_STANDARD
          CanTpRxPaddingActivation = CANTP_ON
          CanTpRxTaType = CANTP_FUNCTIONAL
          CanTpRxWftMax = 30
          CanTpRxNSduRef = UDS_DIAG_REQ_MB_DiagExt_Func_CanTp2PduR_Can_Network_Channel_CAN
          CanTpRxNPdu_MB_DiagExt_FUNC (CanTpRxNPdu): CanTpRxNPduRef=UDS_DIAG_REQ_MB_DiagExt_Func_CanIf2CanTp_Can_Network_Channel_CAN
        CanTpTxNSdu_MB_DiagExt_PHY (CanTpTxNSdu):
          CanTpNas = 0.025
          CanTpNbs = 2.1
          CanTpNcs = 2.0
          CanTpTc = true
          CanTpTxAddressingFormat = CANTP_STANDARD
          CanTpTxPaddingActivation = CANTP_ON
          CanTpTxTaType = CANTP_PHYSICAL
          CanTpTxNSduRef = UDS_DIAG_RES_MB_DiagExt_PduR2CanTp_Can_Network_Channel_CAN
          CanTpRxFcNPdu_MB_DiagExt_PHY (CanTpRxFcNPdu): CanTpRxFcNPduRef=UDS_DIAG_REQ_MB_DiagExt_CanIf2CanTp_Can_Network_Channel_CAN
          CanTpTxNPdu_MB_DiagExt_PHY (CanTpTxNPdu): CanTpTxNPduRef=UDS_DIAG_RES_MB_DiagExt_CanTp2CanIf_Can_Network_Channel_CAN
      CanTpChannel_MB_Diag_Int (CanTpChannel): CanTpRbHalfDuplexEnable=true
        CanTpRxNSdu_MB_DiagInt_PHY (CanTpRxNSdu):
          CanTpBs = 0
          CanTpNar = 0.025
          CanTpNbr = 0
          CanTpNcr = 2
          CanTpRxAddressingFormat = CANTP_STANDARD
          CanTpRxPaddingActivation = CANTP_ON
          CanTpRxTaType = CANTP_PHYSICAL
          CanTpSTmin = 0.01
          CanTpRxWftMax = 30
          CanTpRxNSduRef = UDS_DIAG_REQ_MB_DiagInt_CanTp2PduR_Can_Network_Channel_CAN
          CanTpRxNPdu_MB_DiagInt_PHY (CanTpRxNPdu): CanTpRxNPduRef=UDS_DIAG_REQ_MB_DiagInt_CanIf2CanTp_Can_Network_Channel_CAN
          CanTpTxFcNPdu_MB_DiagInt_PHY (CanTpTxFcNPdu): CanTpTxFcNPduRef=UDS_DIAG_RES_MB_DiagInt_CanTp2CanIf_Can_Network_Channel_CAN
        CanTpRxNSdu_MB_DiagInt_FUNC (CanTpRxNSdu):
          CanTpBs = 0
          CanTpNar = 0.025
          CanTpNbr = 0
          CanTpNcr = 2
          CanTpRxAddressingFormat = CANTP_STANDARD
          CanTpRxPaddingActivation = CANTP_ON
          CanTpRxTaType = CANTP_FUNCTIONAL
          CanTpRxWftMax = 30
          CanTpRxNSduRef = UDS_DIAG_REQ_MB_DiagInt_Func_CanTp2PduR_Can_Network_Channel_CAN
          CanTpRxNPdu_MB_DiagInt_FUNC (CanTpRxNPdu): CanTpRxNPduRef=UDS_DIAG_REQ_MB_DiagInt_Func_CanIf2CanTp_Can_Network_Channel_CAN
        CanTpTxNSdu_MB_DiagInt_PHY (CanTpTxNSdu):
          CanTpNas = 0.025
          CanTpNbs = 2.1
          CanTpNcs = 2.0
          CanTpTc = true
          CanTpTxAddressingFormat = CANTP_STANDARD
          CanTpTxPaddingActivation = CANTP_ON
          CanTpTxTaType = CANTP_PHYSICAL
          CanTpTxNSduRef = UDS_DIAG_RES_MB_DiagInt_PduR2CanTp_Can_Network_Channel_CAN
          CanTpRxFcNPdu_MB_DiagInt_PHY (CanTpRxFcNPdu): CanTpRxFcNPduRef=UDS_DIAG_REQ_MB_DiagInt_CanIf2CanTp_Can_Network_Channel_CAN
          CanTpTxNPdu_MB_DiagInt_PHY (CanTpTxNPdu): CanTpTxNPduRef=UDS_DIAG_RES_MB_DiagInt_CanTp2CanIf_Can_Network_Channel_CAN
  module config Dcm
    DcmConfigSet
      DcmDsl
        DcmDslProtocol
          DcmDslProtocol_MB_DiagExt_UDSOnCAN (DcmDslProtocolRow):
            DcmDslProtocolMaximumResponseSize = 4095
            DcmDslProtocolPriority = 3
            DcmRbDslProtocolNRC21OnPriorityAssessmentReject = true
            DcmTimStrP2ServerAdjust = 0.01
            DcmTimStrP2StarServerAdjust = 0.01
            DcmDslProtocolType = DCM_SUPPLIER_1
            DcmSendRespPendOnRestart = true
            DcmDemClientRef = DemClient
            DcmDslProtocolRxBufferRef = DcmDslBufferRx
            DcmDslProtocolSIDTable = DcmDsdServiceTableUDS
            DcmDslProtocolTxBufferRef = DcmDslBufferTx
            DcmDslConnection_MB_DiagExt (DcmDslConnection)
              DcmDslMainConnection: DcmDslProtocolRxTesterSourceAddr=3832, DcmDslProtocolRxConnectionId=0, DcmDslProtocolComMChannelRef=ComMChannel_Can
                UDS_DIAG_REQ_MB_DiagExt_Func_PduR2Dcm_Can_Network_Channel_CAN (DcmDslProtocolRx):
                  DcmDslProtocolRxAddrType = DCM_FUNCTIONAL_TYPE
                  DcmDslProtocolRxPduRef = EcucPduCollection/UDS_DIAG_REQ_MB_DiagExt_Func_PduR2Dcm_Can_Network_Channel_CAN
                UDS_DIAG_REQ_MB_DiagExt_PduR2Dcm_Can_Network_Channel_CAN (DcmDslProtocolRx): DcmDslProtocolRxAddrType=DCM_PHYSICAL_TYPE, DcmDslProtocolRxPduRef=EcucPduCollection/UDS_DIAG_REQ_MB_DiagExt_PduR2Dcm_Can_Network_Channel_CAN
                UDS_DIAG_RES_MB_DiagExt_Dcm2PduR_Can_Network_Channel_CAN (DcmDslProtocolTx): DcmDslProtocolTxPduRef=EcucPduCollection/UDS_DIAG_RES_MB_DiagExt_Dcm2PduR_Can_Network_Channel_CAN
          DcmDslProtocol_MB_DiagInt_UDSOnCAN (DcmDslProtocolRow):
            DcmDslProtocolMaximumResponseSize = 4095
            DcmDslProtocolPriority = 5
            DcmRbDslProtocolNRC21OnPriorityAssessmentReject = true
            DcmTimStrP2ServerAdjust = 0.01
            DcmTimStrP2StarServerAdjust = 0.01
            DcmDslProtocolType = DCM_SUPPLIER_2
            DcmSendRespPendOnRestart = true
            DcmDemClientRef = DemClient
            DcmDslProtocolRxBufferRef = DcmDslBufferRx
            DcmDslProtocolSIDTable = DcmDsdServiceTableUDS
            DcmDslProtocolTxBufferRef = DcmDslBufferTx
            DcmDslConnection_MB_DiagInt (DcmDslConnection)
              DcmDslMainConnection: DcmDslProtocolRxTesterSourceAddr=3853, DcmDslProtocolRxConnectionId=0, DcmDslProtocolComMChannelRef=ComMChannel_Can
                UDS_DIAG_REQ_MB_DiagInt_Func_PduR2Dcm_Can_Network_Channel_CAN (DcmDslProtocolRx):
                  DcmDslProtocolRxAddrType = DCM_FUNCTIONAL_TYPE
                  DcmDslProtocolRxPduRef = EcucPduCollection/UDS_DIAG_REQ_MB_DiagInt_Func_PduR2Dcm_Can_Network_Channel_CAN
                UDS_DIAG_REQ_MB_DiagInt_PduR2Dcm_Can_Network_Channel_CAN (DcmDslProtocolRx): DcmDslProtocolRxAddrType=DCM_PHYSICAL_TYPE, DcmDslProtocolRxPduRef=EcucPduCollection/UDS_DIAG_REQ_MB_DiagInt_PduR2Dcm_Can_Network_Channel_CAN
                UDS_DIAG_RES_MB_DiagInt_Dcm2PduR_Can_Network_Channel_CAN (DcmDslProtocolTx): DcmDslProtocolTxPduRef=EcucPduCollection/UDS_DIAG_RES_MB_DiagInt_Dcm2PduR_Can_Network_Channel_CAN
      DcmDsp:
        DcmDspEnableObdMirror = 0
        DcmRbDspAutoConfigureDEMOBDPIDs = 0
        DcmRbDspLimitRDBIRespToBufSize = 0
        DcmRbDspRdbiPagedBufferEnabled = 0
        DcmRbDspRmbaPagedBufferEnabled = 0
        DcmRbDspRdtcPagedBufferEnabled = 0
        DcmRbDspSequenceCheckRequestDownloadDisabled = 0
        DcmRbDspSequenceCheckRequestUploadDisabled = 0
        DcmRbDspSesSecUsedInProtocol = UDS
        DcmRbDspTransferDataMaxLenChkRequired = 1
        DCOM_AMG_SWITCH (DcmDspData):
          DcmDspDataByteSize = 1
          DcmDspDataConditionCheckReadFncUsed = false
          DcmDspDataEndianness = BIG_ENDIAN
          DcmDspDataReadFnc = dcom_AMG_SWITCH_0400_ReadData
          DcmDspDataType = UINT8
          DcmDspDataUsePort = USE_DATA_SYNCH_FNC
          DcmDspDataWriteFnc = dcom_AMG_SWITCH_0400_WriteData
        AMG_SWITCH_info (DcmDspDidInfo): DcmDspDidDynamicallyDefined=false
          DcmDspDidWrite: DcmDspDidWriteSessionRef=EXTENDED_DIAGNOSTIC_SESSION
          DcmDspDidRead
        3 x DcmDspDid, all with DcmDspDidUsePort=USE_DATA_ELEMENT_SPECIFIC_INTERFACES, DcmRbAtomicSenderReceiverCommunication=0:
          AMG_Switch_DID: DcmDspDidIdentifier=1024, DcmDspDidInfoRef=AMG_SWITCH_info
            AMGSwitchVarintcoding (DcmDspDidSignal): DcmDspDidByteOffset=0, DcmDspDidDataRef=DCOM_AMG_SWITCH
          Calibration_Identification_read: DcmDspDidIdentifier=57604, DcmDspDidInfoRef=Calibration_Identifications_read_info
            Calibration_Identification (DcmDspDidSignal): DcmDspDidByteOffset=0, DcmDspDidDataRef=Calibration_IdentificationRead
          Calibration_Identifications_Write: DcmDspDidIdentifier=63492, DcmDspDidInfoRef=Calibration_Identifications_Write_info
            Number_of_data_items_and_CALID_Write (DcmDspDidSignal): DcmDspDidByteOffset=0, DcmDspDidDataRef=DcmDsp/Number_of_data_items_and_CALID_Write
        Number_of_data_items_and_CALID_Write (DcmDspData):
          DcmDspDataByteSize = 17
          DcmDspDataConditionCheckReadFncUsed = false
          DcmDspDataEndianness = BIG_ENDIAN
          DcmDspDataType = UINT8_N
          DcmDspDataUsePort = USE_DATA_SYNCH_FNC
          DcmDspDataWriteFnc = dcom_Calibration_Identifications_F804_WriteData
        Calibration_IdentificationRead (DcmDspData):
          DcmDspDataByteSize = 16
          DcmDspDataType = UINT8_N
          DcmDspDataConditionCheckReadFncUsed = false
          DcmDspDataEndianness = BIG_ENDIAN
          DcmDspDataReadFnc = dcom_Calibration_Identifications_E104_ReadData
          DcmDspDataUsePort = USE_DATA_SYNCH_FNC
        Calibration_Identifications_Write_info (DcmDspDidInfo): DcmDspDidDynamicallyDefined=false
          DcmDspDidWrite: DcmDspDidWriteSessionRef=EXTENDED_DIAGNOSTIC_SESSION
        Calibration_Identifications_read_info (DcmDspDidInfo): DcmDspDidDynamicallyDefined=false
          DcmDspDidRead
    DcmGeneral
  module config EcuC
    EcucConfigSet
      EcucPduCollection
        18 x Pdu, all with PduLength=64:
          UDS_DIAG_REQ_MB_DiagInt_CanIf2CanTp_Can_Network_Channel_CAN
          UDS_DIAG_REQ_MB_DiagInt_CanTp2PduR_Can_Network_Channel_CAN
          UDS_DIAG_REQ_MB_DiagInt_PduR2Dcm_Can_Network_Channel_CAN
          UDS_DIAG_REQ_MB_DiagInt_Func_CanIf2CanTp_Can_Network_Channel_CAN
          UDS_DIAG_REQ_MB_DiagInt_Func_CanTp2PduR_Can_Network_Channel_CAN
          UDS_DIAG_REQ_MB_DiagInt_Func_PduR2Dcm_Can_Network_Channel_CAN
          UDS_DIAG_RES_MB_DiagInt_Dcm2PduR_Can_Network_Channel_CAN
          UDS_DIAG_RES_MB_DiagInt_PduR2CanTp_Can_Network_Channel_CAN
          UDS_DIAG_RES_MB_DiagInt_CanTp2CanIf_Can_Network_Channel_CAN
          UDS_DIAG_REQ_MB_DiagExt_CanIf2CanTp_Can_Network_Channel_CAN
          UDS_DIAG_REQ_MB_DiagExt_CanTp2PduR_Can_Network_Channel_CAN
          UDS_DIAG_REQ_MB_DiagExt_PduR2Dcm_Can_Network_Channel_CAN
          UDS_DIAG_REQ_MB_DiagExt_Func_CanIf2CanTp_Can_Network_Channel_CAN
          UDS_DIAG_REQ_MB_DiagExt_Func_CanTp2PduR_Can_Network_Channel_CAN
          UDS_DIAG_REQ_MB_DiagExt_Func_PduR2Dcm_Can_Network_Channel_CAN
          UDS_DIAG_RES_MB_DiagExt_Dcm2PduR_Can_Network_Channel_CAN
          UDS_DIAG_RES_MB_DiagExt_PduR2CanTp_Can_Network_Channel_CAN
          UDS_DIAG_RES_MB_DiagExt_CanTp2CanIf_Can_Network_Channel_CAN
  module config PduR
    PduRRoutingPaths
      4 x PduRRoutingPath:
        DiagExt_CanTp2Dcm: PduRDestPduRRef=DiagExt_PduR2Dcm_Can_Network, PduRSrcPduRRef=DiagExt_CanTp2PduR_Can_Network
        DiagExt_Dcm2CanTp: PduRDestPduRRef=DiagExt_PduR2CanIf_Can_Network, PduRSrcPduRRef=DiagExt_Dcm2PduR_Can_Network
        DiagInt_CanTp2Dcm: PduRDestPduRRef=DiagInt_PduR2Dcm_Can_Network, PduRSrcPduRRef=DiagInt_CanTp2PduR_Can_Network
        DiagInt_Dcm2CanTp: PduRSrcPduRRef=DiagInt_Dcm2PduR_Can_Network, PduRDestPduRRef=DiagInt_PduR2CanIf_Can_Network
      DiagExt_PduR2Dcm_Can_Network (PduRDestPdu): PduRDestPduRef=EcucPduCollection/UDS_DIAG_REQ_MB_DiagExt_PduR2Dcm_Can_Network_Channel_CAN
      DiagExt_CanTp2PduR_Can_Network (PduRSrcPdu): PduRSrcPduRef=UDS_DIAG_REQ_MB_DiagExt_CanTp2PduR_Can_Network_Channel_CAN
      DiagExt_PduR2CanIf_Can_Network (PduRDestPdu): PduRDestPduRef=UDS_DIAG_RES_MB_DiagExt_PduR2CanTp_Can_Network_Channel_CAN
      DiagExt_Dcm2PduR_Can_Network (PduRSrcPdu): PduRSrcPduRef=EcucPduCollection/UDS_DIAG_RES_MB_DiagExt_Dcm2PduR_Can_Network_Channel_CAN
      DiagInt_PduR2Dcm_Can_Network (PduRDestPdu): PduRDestPduRef=EcucPduCollection/UDS_DIAG_REQ_MB_DiagInt_PduR2Dcm_Can_Network_Channel_CAN
      DiagInt_CanTp2PduR_Can_Network (PduRSrcPdu): PduRSrcPduRef=UDS_DIAG_REQ_MB_DiagInt_CanTp2PduR_Can_Network_Channel_CAN
      DiagInt_Dcm2PduR_Can_Network (PduRSrcPdu): PduRSrcPduRef=EcucPduCollection/UDS_DIAG_RES_MB_DiagInt_Dcm2PduR_Can_Network_Channel_CAN
      DiagInt_PduR2CanIf_Can_Network (PduRDestPdu): PduRDestPduRef=UDS_DIAG_RES_MB_DiagInt_PduR2CanTp_Can_Network_Channel_CAN
    PduRGeneral: PduRMulticastFromTpSupport=false, PduRMulticastToTpSupport=false, PduRTPGatewayOperation=false
package /RB/UBK/Project/EcucValueCollections
  ecuc value collection EcucValueCollections: ecuc-values=Dcm
