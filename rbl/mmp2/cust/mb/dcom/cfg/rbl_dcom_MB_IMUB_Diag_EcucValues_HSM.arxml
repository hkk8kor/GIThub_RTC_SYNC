AUTOSAR XML (schema 4-2-2)
package /RB/UBK/Project/EcucModuleConfigurationValuess
  module config Can
    CanConfigSet
      6 x CanHardwareObject, all with CanHandleType=FULL, CanIdType=EXTENDED, CanControllerRef=CanIfControllerConfig_0:
        UDS_DIAG_REQ_MB_DiagExt_Can_Network_Channel_Can_Network_IN: CanObjectType=RECEIVE
          CanHwFilter: CanHwFilterCode=417426312, CanHwFilterMask=536870911
        UDS_DIAG_REQ_MB_DiagExt_Func_Can_Network_Channel_Can_Network_IN: CanObjectType=RECEIVE
          CanHwFilter: CanHwFilterCode=418314376, CanHwFilterMask=536870911
        UDS_DIAG_RES_MB_DiagExt_Can_Network_Channel_Can_Network_OUT: CanObjectType=TRANSMIT
          CanHwFilter: CanHwFilterCode=417426304, CanHwFilterMask=536870911
        UDS_DIAG_REQ_MB_DiagInt_Can_Network_Channel_Can_Network_IN: CanObjectType=RECEIVE
          CanHwFilter: CanHwFilterCode=417426317, CanHwFilterMask=536870911
        UDS_DIAG_REQ_MB_DiagInt_Func_Can_Network_Channel_Can_Network_IN: CanObjectType=RECEIVE
          CanHwFilter: CanHwFilterCode=418319757, CanHwFilterMask=536870911
        UDS_DIAG_RES_MB_DiagInt_Can_Network_Channel_Can_Network_OUT: CanObjectType=TRANSMIT
          CanHwFilter: CanHwFilterCode=417426309, CanHwFilterMask=536870911
  module config CanIf
    CanIfInitCfg: CanIfInitCfgSet=not_supported
      Bu_UDS_DIAG_RES_MB_DiagExt_Can_Network_Channel_Can_Network_OUT (CanIfBufferCfg): CanIfBufferSize=0, CanIfBufferHthRef=CanIfInitHohCfg/UDS_DIAG_RES_MB_DiagExt_Can_Network_Channel_Can_Network_OUT
      Bu_UDS_DIAG_RES_MB_DiagInt_Can_Network_Channel_Can_Network_OUT (CanIfBufferCfg): CanIfBufferSize=0, CanIfBufferHthRef=CanIfInitHohCfg/UDS_DIAG_RES_MB_DiagInt_Can_Network_Channel_Can_Network_OUT
      CanIfInitHohCfg
        4 x CanIfHrhCfg, all with CanIfHrhCanCtrlIdRef=CanIfControllerConfig_0:
          UDS_DIAG_REQ_MB_DiagExt_Can_Network_Channel_Can_Network_IN: CanIfHrhIdSymRef=CanConfigSet/UDS_DIAG_REQ_MB_DiagExt_Can_Network_Channel_Can_Network_IN
          UDS_DIAG_REQ_MB_DiagExt_Func_Can_Network_Channel_Can_Network_IN: CanIfHrhIdSymRef=CanConfigSet/UDS_DIAG_REQ_MB_DiagExt_Func_Can_Network_Channel_Can_Network_IN
          UDS_DIAG_REQ_MB_DiagInt_Can_Network_Channel_Can_Network_IN: CanIfHrhIdSymRef=CanConfigSet/UDS_DIAG_REQ_MB_DiagInt_Can_Network_Channel_Can_Network_IN
          UDS_DIAG_REQ_MB_DiagInt_Func_Can_Network_Channel_Can_Network_IN: CanIfHrhIdSymRef=CanConfigSet/UDS_DIAG_REQ_MB_DiagInt_Func_Can_Network_Channel_Can_Network_IN
        UDS_DIAG_RES_MB_DiagExt_Can_Network_Channel_Can_Network_OUT (CanIfHthCfg): CanIfHthCanCtrlIdRef=CanIfControllerConfig_0, CanIfHthIdSymRef=CanConfigSet/UDS_DIAG_RES_MB_DiagExt_Can_Network_Channel_Can_Network_OUT
        UDS_DIAG_RES_MB_DiagInt_Can_Network_Channel_Can_Network_OUT (CanIfHthCfg): CanIfHthCanCtrlIdRef=CanIfControllerConfig_0, CanIfHthIdSymRef=CanConfigSet/UDS_DIAG_RES_MB_DiagInt_Can_Network_Channel_Can_Network_OUT
      4 x CanIfRxPduCfg, all with CanIfRxPduCanIdType=EXTENDED_FD_CAN, CanIfRxPduReadData=false, CanIfRxPduReadNotifyStatus=false, CanIfRxPduUserRxIndicationUL=CAN_TP, CanIfRxPduDataLength=64:
        UDS_DIAG_REQ_MB_DiagExt_Can_Network_Channel_Can_Network_IN: CanIfRxPduCanId=417426312, CanIfRxPduHrhIdRef=CanIfInitHohCfg/UDS_DIAG_REQ_MB_DiagExt_Can_Network_Channel_Can_Network_IN, CanIfRxPduRef=UDS_DIAG_REQ_MB_DiagExt_CanIf2CanTp_Can_Network_Channel_CAN
        UDS_DIAG_REQ_MB_DiagExt_Func_Can_Network_Channel_Can_Network_IN: CanIfRxPduCanId=418314376, CanIfRxPduHrhIdRef=CanIfInitHohCfg/UDS_DIAG_REQ_MB_DiagExt_Func_Can_Network_Channel_Can_Network_IN, CanIfRxPduRef=UDS_DIAG_REQ_MB_DiagExt_Func_CanIf2CanTp_Can_Network_Channel_CAN
        UDS_DIAG_REQ_MB_DiagInt_Can_Network_Channel_Can_Network_IN: CanIfRxPduCanId=417426317, CanIfRxPduHrhIdRef=CanIfInitHohCfg/UDS_DIAG_REQ_MB_DiagInt_Can_Network_Channel_Can_Network_IN, CanIfRxPduRef=UDS_DIAG_REQ_MB_DiagInt_CanIf2CanTp_Can_Network_Channel_CAN
        UDS_DIAG_REQ_MB_DiagInt_Func_Can_Network_Channel_Can_Network_IN: CanIfRxPduCanId=418319757, CanIfRxPduHrhIdRef=CanIfInitHohCfg/UDS_DIAG_REQ_MB_DiagInt_Func_Can_Network_Channel_Can_Network_IN, CanIfRxPduRef=UDS_DIAG_REQ_MB_DiagInt_Func_CanIf2CanTp_Can_Network_Channel_CAN
      UDS_DIAG_RES_MB_DiagExt_Can_Network_Channel_Can_Network_OUT (CanIfTxPduCfg):
        CanIfTxPduCanId = 417426304
        CanIfTxPduCanIdType = EXTENDED_FD_CAN
        CanIfTxPduReadNotifyStatus = false
        CanIfTxPduTruncation = false
        CanIfTxPduType = STATIC
        CanIfTxPduUserTxConfirmationUL = CAN_TP
        CanIfTxPduBufferRef = Bu_UDS_DIAG_RES_MB_DiagExt_Can_Network_Channel_Can_Network_OUT
        CanIfTxPduRef = UDS_DIAG_RES_MB_DiagExt_CanTp2CanIf_Can_Network_Channel_CAN
      UDS_DIAG_RES_MB_DiagInt_Can_Network_Channel_Can_Network_OUT (CanIfTxPduCfg):
        CanIfTxPduCanId = 417426309
        CanIfTxPduCanIdType = EXTENDED_FD_CAN
        CanIfTxPduReadNotifyStatus = false
        CanIfTxPduTruncation = false
        CanIfTxPduType = STATIC
        CanIfTxPduUserTxConfirmationUL = CAN_TP
        CanIfTxPduBufferRef = Bu_UDS_DIAG_RES_MB_DiagInt_Can_Network_Channel_Can_Network_OUT
        CanIfTxPduRef = UDS_DIAG_RES_MB_DiagInt_CanTp2CanIf_Can_Network_Channel_CAN
    CanIfPublicCfg: CanIfMetaDataSupport=false
  module config CanTp: implementation-config-variant=VARIANT-PRE-COMPILE
    CanTpConfig
      CanTpChannel_MB_Diag_Ext (CanTpChannel): CanTpRbHalfDuplexEnable=true
        CanTpRxNSdu_MB_DiagExt_PHY (CanTpRxNSdu):
          CanTpBs = 0
          CanTpNar = 2.0
          CanTpNbr = 0
          CanTpNcr = 2
          CanTpRxAddressingFormat = CANTP_STANDARD
          CanTpRxPaddingActivation = CANTP_ON
          CanTpRxTaType = CANTP_PHYSICAL
          CanTpSTmin = 0.0
          CanTpRxNSduRef = EcucPduCollection/UDS_DIAG_REQ_MB_DiagExt_CanTp2PduR_Can_Network_Channel_CAN
          CanTpRxNPdu_MB_DiagExt_PHY (CanTpRxNPdu): CanTpRxNPduRef=UDS_DIAG_REQ_MB_DiagExt_CanIf2CanTp_Can_Network_Channel_CAN
          CanTpTxFcNPdu_MB_DiagExt_PHY (CanTpTxFcNPdu): CanTpTxFcNPduRef=UDS_DIAG_RES_MB_DiagExt_CanTp2CanIf_Can_Network_Channel_CAN
        CanTpRxNSdu_MB_DiagExt_FUNC (CanTpRxNSdu):
          CanTpBs = 0
          CanTpNar = 0.025
          CanTpNbr = 0
          CanTpNcr = 2
          CanTpRxAddressingFormat = CANTP_STANDARD
          CanTpRxPaddingActivation = CANTP_ON
          CanTpRxTaType = CANTP_FUNCTIONAL
          CanTpRxNSduRef = EcucPduCollection/UDS_DIAG_REQ_MB_DiagExt_Func_CanTp2PduR_Can_Network_Channel_CAN
          CanTpRxNPdu_MB_DiagExt_FUNC (CanTpRxNPdu): CanTpRxNPduRef=UDS_DIAG_REQ_MB_DiagExt_Func_CanIf2CanTp_Can_Network_Channel_CAN
        CanTpTxNSdu_MB_DiagExt_PHY (CanTpTxNSdu):
          CanTpNas = 2.0
          CanTpNbs = 2.1
          CanTpNcs = 2.0
          CanTpTc = true
          CanTpTxAddressingFormat = CANTP_STANDARD
          CanTpTxPaddingActivation = CANTP_ON
          CanTpTxTaType = CANTP_PHYSICAL
          CanTpTxNSduRef = UDS_DIAG_RES_MB_DiagExt_PduR2CanTp_Can_Network_Channel_CAN
          CanTpRxFcNPdu_MB_DiagExt_PHY (CanTpRxFcNPdu): CanTpRxFcNPduRef=UDS_DIAG_REQ_MB_DiagExt_CanIf2CanTp_Can_Network_Channel_CAN
          CanTpTxNPdu_MB_DiagExt_PHY (CanTpTxNPdu): CanTpTxNPduRef=UDS_DIAG_RES_MB_DiagExt_CanTp2CanIf_Can_Network_Channel_CAN
      CanTpChannel_MB_Diag_Int (CanTpChannel): CanTpRbHalfDuplexEnable=true
        CanTpRxNSdu_MB_DiagInt_PHY (CanTpRxNSdu):
          CanTpBs = 0
          CanTpNar = 2.0
          CanTpNbr = 0
          CanTpNcr = 2
          CanTpRxAddressingFormat = CANTP_STANDARD
          CanTpRxPaddingActivation = CANTP_ON
          CanTpRxTaType = CANTP_PHYSICAL
          CanTpSTmin = 0.0
          CanTpRxNSduRef = EcucPduCollection/UDS_DIAG_REQ_MB_DiagInt_CanTp2PduR_Can_Network_Channel_CAN
          CanTpRxNPdu_MB_DiagInt_PHY (CanTpRxNPdu): CanTpRxNPduRef=UDS_DIAG_REQ_MB_DiagInt_CanIf2CanTp_Can_Network_Channel_CAN
          CanTpTxFcNPdu_MB_DiagInt_PHY (CanTpTxFcNPdu): CanTpTxFcNPduRef=UDS_DIAG_RES_MB_DiagInt_CanTp2CanIf_Can_Network_Channel_CAN
        CanTpRxNSdu_MB_DiagInt_FUNC (CanTpRxNSdu):
          CanTpBs = 0
          CanTpNar = 0.025
          CanTpNbr = 0
          CanTpNcr = 2
          CanTpRxAddressingFormat = CANTP_STANDARD
          CanTpRxPaddingActivation = CANTP_ON
          CanTpRxTaType = CANTP_FUNCTIONAL
          CanTpRxNSduRef = EcucPduCollection/UDS_DIAG_REQ_MB_DiagInt_Func_CanTp2PduR_Can_Network_Channel_CAN
          CanTpRxNPdu_MB_DiagInt_FUNC (CanTpRxNPdu): CanTpRxNPduRef=UDS_DIAG_REQ_MB_DiagInt_Func_CanIf2CanTp_Can_Network_Channel_CAN
        CanTpTxNSdu_MB_DiagInt_PHY (CanTpTxNSdu):
          CanTpNas = 2.0
          CanTpNbs = 2.1
          CanTpNcs = 2.0
          CanTpTc = true
          CanTpTxAddressingFormat = CANTP_STANDARD
          CanTpTxPaddingActivation = CANTP_ON
          CanTpTxTaType = CANTP_PHYSICAL
          CanTpTxNSduRef = UDS_DIAG_RES_MB_DiagInt_PduR2CanTp_Can_Network_Channel_CAN
          CanTpRxFcNPdu_MB_DiagInt_PHY (CanTpRxFcNPdu): CanTpRxFcNPduRef=UDS_DIAG_REQ_MB_DiagInt_CanIf2CanTp_Can_Network_Channel_CAN
          CanTpTxNPdu_MB_DiagInt_PHY (CanTpTxNPdu): CanTpTxNPduRef=UDS_DIAG_RES_MB_DiagInt_CanTp2CanIf_Can_Network_Channel_CAN
  module config Dcm
    DcmConfigSet
      DcmDsl
        DcmDslProtocol
          DcmDslProtocol_MB_DiagExt_UDSOnCAN (DcmDslProtocolRow):
            DcmDslProtocolMaximumResponseSize = 4095
            DcmSendRespPendOnRestart = true
            DcmDslProtocolPriority = 3
            DcmTimStrP2ServerAdjust = 0.01
            DcmTimStrP2StarServerAdjust = 0.01
            DcmRbDslProtocolNRC21OnPriorityAssessmentReject = true
            DcmDslProtocolType = DCM_SUPPLIER_1
            DcmDslProtocolTxBufferRef = DcmDslBufferTx
            DcmDslProtocolSIDTable = DcmDsdServiceTableUDS
            DcmDslProtocolRxBufferRef = DcmDslBufferRx
            DcmDemClientRef = DemClient
            DcmDslConnection_MB_DiagExt (DcmDslConnection)
              DcmDslMainConnection: DcmDslProtocolRxConnectionId=0, DcmDslProtocolRxTesterSourceAddr=3832, DcmDslProtocolComMChannelRef=ComMChannel_Can
                UDS_DIAG_RES_MB_DiagExt_Dcm2PduR_Can_Network_Channel_CAN (DcmDslProtocolTx): DcmDslProtocolTxPduRef=EcucPduCollection/UDS_DIAG_RES_MB_DiagExt_Dcm2PduR_Can_Network_Channel_CAN
                UDS_DIAG_REQ_MB_DiagExt_Func_PduR2Dcm_Can_Network_Channel_CAN (DcmDslProtocolRx):
                  DcmDslProtocolRxAddrType = DCM_FUNCTIONAL_TYPE
                  DcmDslProtocolRxPduRef = EcucPduCollection/UDS_DIAG_REQ_MB_DiagExt_Func_PduR2Dcm_Can_Network_Channel_CAN
                UDS_DIAG_REQ_MB_DiagExt_PduR2Dcm_Can_Network_Channel_CAN (DcmDslProtocolRx): DcmDslProtocolRxAddrType=DCM_PHYSICAL_TYPE, DcmDslProtocolRxPduRef=EcucPduCollection/UDS_DIAG_REQ_MB_DiagExt_PduR2Dcm_Can_Network_Channel_CAN
          DcmDslProtocol_MB_DiagInt_UDSOnCAN (DcmDslProtocolRow):
            DcmDslProtocolMaximumResponseSize = 4095
            DcmSendRespPendOnRestart = true
            DcmDslProtocolPriority = 5
            DcmDslProtocolType = DCM_SUPPLIER_2
            DcmRbDslProtocolNRC21OnPriorityAssessmentReject = true
            DcmTimStrP2ServerAdjust = 0.01
            DcmTimStrP2StarServerAdjust = 0.01
            DcmDemClientRef = DemClient
            DcmDslProtocolRxBufferRef = DcmDslBufferRx
            DcmDslProtocolSIDTable = DcmDsdServiceTableUDS
            DcmDslProtocolTxBufferRef = DcmDslBufferTx
            DcmDslProtocol_MB_DiagInt_UDSOnCAN (DcmDslConnection)
              DcmDslMainConnection: DcmDslProtocolRxConnectionId=0, DcmDslProtocolRxTesterSourceAddr=3853, DcmDslProtocolComMChannelRef=ComMChannel_Can
                UDS_DIAG_REQ_MB_DiagInt_Func_PduR2Dcm_Can_Network_Channel_CAN (DcmDslProtocolRx):
                  DcmDslProtocolRxAddrType = DCM_FUNCTIONAL_TYPE
                  DcmDslProtocolRxPduRef = EcucPduCollection/UDS_DIAG_REQ_MB_DiagInt_Func_PduR2Dcm_Can_Network_Channel_CAN
                UDS_DIAG_RES_MB_DiagInt_Dcm2PduR_Can_Network_Channel_CAN (DcmDslProtocolTx): DcmDslProtocolTxPduRef=EcucPduCollection/UDS_DIAG_RES_MB_DiagInt_Dcm2PduR_Can_Network_Channel_CAN
                UDS_DIAG_REQ_MB_DiagInt_PduR2Dcm_Can_Network_Channel_CAN (DcmDslProtocolRx): DcmDslProtocolRxAddrType=DCM_PHYSICAL_TYPE, DcmDslProtocolRxPduRef=EcucPduCollection/UDS_DIAG_REQ_MB_DiagInt_PduR2Dcm_Can_Network_Channel_CAN
      DcmDsp:
        DcmDspEnableObdMirror = false
        DcmRbDspAutoConfigureDEMOBDPIDs = 0
        DcmRbDspLimitRDBIRespToBufSize = 0
        DcmRbDspRdbiPagedBufferEnabled = 0
        DcmRbDspSequenceCheckRequestDownloadDisabled = 0
        DcmRbDspSequenceCheckRequestUploadDisabled = 0
        DcmRbDspSesSecUsedInProtocol = UDS
        DcmRbDspTransferDataMaxLenChkRequired = 1
        3 x DcmDspData, all with DcmDspDataConditionCheckReadFncUsed=false, DcmDspDataEndianness=BIG_ENDIAN, DcmDspDataType=UINT8_N, DcmDspDataUsePort=USE_DATA_SYNCH_FNC:
          DCOM_AMG_SWITCH: DcmRbDspDataUseAsynchronousServerCallPoint=0, DcmDspDataByteSize=1, DcmDspDataReadFnc=dcom_AMG_SWITCH_0400_ReadData, DcmDspDataWriteFnc=dcom_AMG_SWITCH_0400_WriteData
          Number_of_data_items_and_CALID_Write: DcmDspDataByteSize=17, DcmDspDataWriteFnc=dcom_Calibration_Identifications_F804_WriteData
          Calibration_IdentificationRead: DcmDspDataByteSize=16, DcmDspDataReadFnc=dcom_Calibration_Identifications_E104_ReadData
        3 x DcmDspDidInfo, all with DcmDspDidDynamicallyDefined=false:
          AMG_SWITCH_info
            DcmDspDidWrite: DcmDspDidWriteSessionRef=EXTENDED_DIAGNOSTIC_SESSION
            DcmDspDidRead: DcmDspDidReadSessionRef=EXTENDED_DIAGNOSTIC_SESSION, DcmDspDidReadSessionRef=DEFAULT_SESSION
          Calibration_Identifications_Write_info
            DcmDspDidWrite: DcmDspDidWriteSessionRef=EXTENDED_DIAGNOSTIC_SESSION, DcmDspDidWriteSessionRef=PROGRAMMING_SESSION
          Calibration_Identifications_read_info
            DcmDspDidRead: DcmDspDidReadSessionRef=EXTENDED_DIAGNOSTIC_SESSION, DcmDspDidReadSessionRef=DEFAULT_SESSION, DcmDspDidReadSessionRef=PROGRAMMING_SESSION
        3 x DcmDspDid, all with DcmDspDidUsePort=USE_DATA_ELEMENT_SPECIFIC_INTERFACES, DcmRbAtomicSenderReceiverCommunication=0:
          AMG_Switch_DID: DcmDspDidIdentifier=1024, DcmDspDidSize=1, DcmDspDidInfoRef=AMG_SWITCH_info
            AMGSwitchVarintcoding (DcmDspDidSignal): DcmDspDidByteOffset=0, DcmDspDidDataRef=DCOM_AMG_SWITCH
          Calibration_Identification_read: DcmDspDidIdentifier=57604, DcmDspDidSize=16, DcmDspDidInfoRef=Calibration_Identifications_read_info
            Calibration_Identification (DcmDspDidSignal): DcmDspDidByteOffset=0, DcmDspDidDataRef=Calibration_IdentificationRead
          Calibration_Identifications_Write: DcmDspDidIdentifier=63492, DcmDspDidSize=17, DcmDspDidInfoRef=Calibration_Identifications_Write_info
            Number_of_data_items_and_CALID_Write (DcmDspDidSignal): DcmDspDidByteOffset=0, DcmDspDidDataRef=DcmDsp/Number_of_data_items_and_CALID_Write
        Routine_Evaluate_Data_Verification_Certificate (DcmDspRoutine): DcmDspRoutineIdentifier=610, DcmDspRoutineUsePort=true
          DcmDspStartRoutine: DcmDspStartRoutineCommonAuthorizationRef=AP_Comb_0023
            DcmDspStartRoutineIn
              DcmDspStartRoutineInSignal: DcmDspRoutineSignalEndianness=BIG_ENDIAN, DcmDspRoutineSignalLength=16016, DcmDspRoutineSignalPos=0, DcmDspRoutineSignalType=VARIABLE_LENGTH
            DcmDspStartRoutineOut
              DcmDspStartRoutineOutSignal_0 (DcmDspStartRoutineOutSignal): DcmDspRoutineSignalEndianness=BIG_ENDIAN, DcmDspRoutineSignalLength=8, DcmDspRoutineSignalPos=0, DcmDspRoutineSignalType=UINT8
              DcmDspStartRoutineOutSignal_1 (DcmDspStartRoutineOutSignal): DcmDspRoutineSignalEndianness=BIG_ENDIAN, DcmDspRoutineSignalLength=8, DcmDspRoutineSignalPos=8, DcmDspRoutineSignalType=UINT8
        Routine_Verify_Signature (DcmDspRoutine): DcmDspRoutineIdentifier=611, DcmDspRoutineUsePort=true
          DcmDspStartRoutine: DcmDspRoutineInterfaceArgumentIntegrity=1
            DcmDspStartRoutineIn
              DcmDspStartRoutineInSignal_0 (DcmDspStartRoutineInSignal): DcmDspRoutineSignalEndianness=BIG_ENDIAN, DcmDspRoutineSignalLength=8, DcmDspRoutineSignalPos=0, DcmDspRoutineSignalType=UINT8
              DcmDspStartRoutineInSignal_1 (DcmDspStartRoutineInSignal): DcmDspRoutineSignalEndianness=BIG_ENDIAN, DcmDspRoutineSignalLength=512, DcmDspRoutineSignalPos=8, DcmDspRoutineSignalType=UINT8_N
            DcmDspStartRoutineOut
              DcmDspStartRoutineOutSignal_0 (DcmDspStartRoutineOutSignal): DcmDspRoutineSignalEndianness=BIG_ENDIAN, DcmDspRoutineSignalLength=8, DcmDspRoutineSignalPos=0, DcmDspRoutineSignalType=UINT8
              DcmDspStartRoutineOutSignal_1 (DcmDspStartRoutineOutSignal): DcmDspRoutineSignalEndianness=BIG_ENDIAN, DcmDspRoutineSignalLength=8, DcmDspRoutineSignalPos=8, DcmDspRoutineSignalType=UINT8
  module config EcuC
    EcucConfigSet
      EcucPduCollection
        18 x Pdu, all with PduLength=64:
          UDS_DIAG_REQ_MB_DiagInt_CanIf2CanTp_Can_Network_Channel_CAN
          UDS_DIAG_REQ_MB_DiagInt_CanTp2PduR_Can_Network_Channel_CAN
          UDS_DIAG_REQ_MB_DiagInt_PduR2Dcm_Can_Network_Channel_CAN
          UDS_DIAG_REQ_MB_DiagInt_Func_CanIf2CanTp_Can_Network_Channel_CAN
          UDS_DIAG_REQ_MB_DiagInt_Func_CanTp2PduR_Can_Network_Channel_CAN
          UDS_DIAG_REQ_MB_DiagInt_Func_PduR2Dcm_Can_Network_Channel_CAN
          UDS_DIAG_RES_MB_DiagInt_Dcm2PduR_Can_Network_Channel_CAN
          UDS_DIAG_RES_MB_DiagInt_PduR2CanTp_Can_Network_Channel_CAN
          UDS_DIAG_RES_MB_DiagInt_CanTp2CanIf_Can_Network_Channel_CAN
          UDS_DIAG_REQ_MB_DiagExt_CanIf2CanTp_Can_Network_Channel_CAN
          UDS_DIAG_REQ_MB_DiagExt_CanTp2PduR_Can_Network_Channel_CAN
          UDS_DIAG_REQ_MB_DiagExt_PduR2Dcm_Can_Network_Channel_CAN
          UDS_DIAG_REQ_MB_DiagExt_Func_CanIf2CanTp_Can_Network_Channel_CAN
          UDS_DIAG_REQ_MB_DiagExt_Func_CanTp2PduR_Can_Network_Channel_CAN
          UDS_DIAG_REQ_MB_DiagExt_Func_PduR2Dcm_Can_Network_Channel_CAN
          UDS_DIAG_RES_MB_DiagExt_Dcm2PduR_Can_Network_Channel_CAN
          UDS_DIAG_RES_MB_DiagExt_PduR2CanTp_Can_Network_Channel_CAN
          UDS_DIAG_RES_MB_DiagExt_CanTp2CanIf_Can_Network_Channel_CAN
  module config PduR
    PduRRoutingPaths
      UDS_DIAG_REQ_MB_DiagExt_PduR2Dcm_Can_Network_Channel_CAN (PduRDestPdu): PduRDestPduRef=EcucPduCollection/UDS_DIAG_REQ_MB_DiagExt_PduR2Dcm_Can_Network_Channel_CAN
      UDS_DIAG_REQ_MB_DiagExt_CanTp2PduR_Can_Network_Channel_CAN (PduRSrcPdu): PduRSrcPduRef=EcucPduCollection/UDS_DIAG_REQ_MB_DiagExt_CanTp2PduR_Can_Network_Channel_CAN
      6 x PduRRoutingPath, all with PduRQueueDepth=1:
        UDS_DIAG_REQ_MB_DiagExt_CanTp2Dcm_Can_Network_Channel_CAN: PduRDestPduRRef=PduRRoutingPaths/UDS_DIAG_REQ_MB_DiagExt_PduR2Dcm_Can_Network_Channel_CAN, PduRSrcPduRRef=PduRRoutingPaths/UDS_DIAG_REQ_MB_DiagExt_CanTp2PduR_Can_Network_Channel_CAN
        UDS_DIAG_REQ_MB_DiagExt_Func_CanTp2Dcm_Can_Network_Channel_CAN: PduRDestPduRRef=PduRRoutingPaths/UDS_DIAG_REQ_MB_DiagExt_Func_PduR2Dcm_Can_Network_Channel_CAN, PduRSrcPduRRef=PduRRoutingPaths/UDS_DIAG_REQ_MB_DiagExt_Func_CanTp2PduR_Can_Network_Channel_CAN
        UDS_DIAG_RES_MB_DiagExt_Dcm2CanTp_Can_Network_Channel_CAN: PduRDestPduRRef=UDS_DIAG_RES_MB_DiagExt_PduR2CanIf_Can_Network_Channel_CAN, PduRSrcPduRRef=PduRRoutingPaths/UDS_DIAG_RES_MB_DiagExt_Dcm2PduR_Can_Network_Channel_CAN
        UDS_DIAG_REQ_MB_DiagInt_CanTp2Dcm_Can_Network_Channel_CAN: PduRDestPduRRef=PduRRoutingPaths/UDS_DIAG_REQ_MB_DiagInt_PduR2Dcm_Can_Network_Channel_CAN, PduRSrcPduRRef=PduRRoutingPaths/UDS_DIAG_REQ_MB_DiagInt_CanTp2PduR_Can_Network_Channel_CAN
        UDS_DIAG_REQ_MB_DiagInt_Func_CanTp2Dcm_Can_Network_Channel_CAN: PduRDestPduRRef=PduRRoutingPaths/UDS_DIAG_REQ_MB_DiagInt_Func_PduR2Dcm_Can_Network_Channel_CAN, PduRSrcPduRRef=PduRRoutingPaths/UDS_DIAG_REQ_MB_DiagInt_Func_CanTp2PduR_Can_Network_Channel_CAN
        UDS_DIAG_RES_MB_DiagInt_Dcm2CanTp_Can_Network_Channel_CAN: PduRDestPduRRef=UDS_DIAG_RES_MB_DiagInt_PduR2CanIf_Can_Network_Channel_CAN, PduRSrcPduRRef=PduRRoutingPaths/UDS_DIAG_RES_MB_DiagInt_Dcm2PduR_Can_Network_Channel_CAN
      UDS_DIAG_REQ_MB_DiagExt_Func_PduR2Dcm_Can_Network_Channel_CAN (PduRDestPdu): PduRDestPduRef=EcucPduCollection/UDS_DIAG_REQ_MB_DiagExt_Func_PduR2Dcm_Can_Network_Channel_CAN
      UDS_DIAG_REQ_MB_DiagExt_Func_CanTp2PduR_Can_Network_Channel_CAN (PduRSrcPdu): PduRSrcPduRef=EcucPduCollection/UDS_DIAG_REQ_MB_DiagExt_Func_CanTp2PduR_Can_Network_Channel_CAN
      UDS_DIAG_RES_MB_DiagExt_PduR2CanIf_Can_Network_Channel_CAN (PduRDestPdu): PduRDestPduRef=UDS_DIAG_RES_MB_DiagExt_PduR2CanTp_Can_Network_Channel_CAN
      UDS_DIAG_RES_MB_DiagExt_Dcm2PduR_Can_Network_Channel_CAN (PduRSrcPdu): PduRSrcPduRef=EcucPduCollection/UDS_DIAG_RES_MB_DiagExt_Dcm2PduR_Can_Network_Channel_CAN
      UDS_DIAG_REQ_MB_DiagInt_PduR2Dcm_Can_Network_Channel_CAN (PduRDestPdu): PduRDestPduRef=EcucPduCollection/UDS_DIAG_REQ_MB_DiagInt_PduR2Dcm_Can_Network_Channel_CAN
      UDS_DIAG_REQ_MB_DiagInt_CanTp2PduR_Can_Network_Channel_CAN (PduRSrcPdu): PduRSrcPduRef=EcucPduCollection/UDS_DIAG_REQ_MB_DiagInt_CanTp2PduR_Can_Network_Channel_CAN
      UDS_DIAG_REQ_MB_DiagInt_Func_PduR2Dcm_Can_Network_Channel_CAN (PduRDestPdu): PduRDestPduRef=EcucPduCollection/UDS_DIAG_REQ_MB_DiagInt_Func_PduR2Dcm_Can_Network_Channel_CAN
      UDS_DIAG_RES_MB_DiagInt_PduR2CanIf_Can_Network_Channel_CAN (PduRDestPdu): PduRDestPduRef=UDS_DIAG_RES_MB_DiagInt_PduR2CanTp_Can_Network_Channel_CAN
      UDS_DIAG_REQ_MB_DiagInt_Func_CanTp2PduR_Can_Network_Channel_CAN (PduRSrcPdu): PduRSrcPduRef=EcucPduCollection/UDS_DIAG_REQ_MB_DiagInt_Func_CanTp2PduR_Can_Network_Channel_CAN
      UDS_DIAG_RES_MB_DiagInt_Dcm2PduR_Can_Network_Channel_CAN (PduRSrcPdu): PduRSrcPduRef=EcucPduCollection/UDS_DIAG_RES_MB_DiagInt_Dcm2PduR_Can_Network_Channel_CAN
    PduRGeneral:
      PduRDevErrorDetect = 0
      PduRRbDsmReInitEnabled = 0
      PduRRbGwTpWithLimitedBuffer = 0
      PduRRbDisablePostBuildSelectableVariants = 0
      PduRVersionInfoApi = 0
      PduRRbMulticastFromTpSupport = false
      PduRRbMulticastToTpSupport = false
      PduRRbTPGatewayOperation = false
      PduRRbQueueingSupport = false
      PduRRbMulticastToIfSupport = true
package /RB/UBK/Project/EcucValueCollections
  ecuc value collection EcucValueCollections: ecuc-values=Dcm
