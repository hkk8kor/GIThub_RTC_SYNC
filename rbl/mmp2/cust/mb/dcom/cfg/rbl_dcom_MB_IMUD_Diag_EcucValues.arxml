AUTOSAR XML (schema 4-2-2)
package /RB/UBK/Project/EcucModuleConfigurationValuess
  module config Can
    CanConfigSet
      6 x CanHardwareObject, all with CanHandleType=FULL, CanIdType=EXTENDED, CanControllerRef=CanIfControllerConfig_0:
        UDS_DIAG_REQ_MB_DiagExt_Can_Network_Channel_Can_Network_IN: CanObjectType=RECEIVE
          CanHwFilter: CanHwFilterCode=417426568, CanHwFilterMask=536870911
        UDS_DIAG_REQ_MB_DiagExt_Func_Can_Network_Channel_Can_Network_IN: CanObjectType=RECEIVE
          CanHwFilter: CanHwFilterCode=418314376, CanHwFilterMask=536870911
        UDS_DIAG_RES_MB_DiagExt_Can_Network_Channel_Can_Network_OUT: CanObjectType=TRANSMIT
          CanHwFilter: CanHwFilterCode=417426560, CanHwFilterMask=536870911
        UDS_DIAG_REQ_MB_DiagInt_Can_Network_Channel_Can_Network_IN: CanObjectType=RECEIVE
          CanHwFilter: CanHwFilterCode=417426573, CanHwFilterMask=536870911
        UDS_DIAG_REQ_MB_DiagInt_Func_Can_Network_Channel_Can_Network_IN: CanObjectType=RECEIVE
          CanHwFilter: CanHwFilterCode=418319757, CanHwFilterMask=536870911
        UDS_DIAG_RES_MB_DiagInt_Can_Network_Channel_Can_Network_OUT: CanObjectType=TRANSMIT
          CanHwFilter: CanHwFilterCode=417426565, CanHwFilterMask=536870911
  module config CanIf
    CanIfInitCfg: CanIfInitCfgSet=not_supported
      Bu_UDS_DIAG_RES_MB_DiagExt_Can_Network_Channel_Can_Network_OUT (CanIfBufferCfg): CanIfBufferSize=0, CanIfBufferHthRef=CanIfInitHohCfg/UDS_DIAG_RES_MB_DiagExt_Can_Network_Channel_Can_Network_OUT
      Bu_UDS_DIAG_RES_MB_DiagInt_Can_Network_Channel_Can_Network_OUT (CanIfBufferCfg): CanIfBufferSize=0, CanIfBufferHthRef=CanIfInitHohCfg/UDS_DIAG_RES_MB_DiagInt_Can_Network_Channel_Can_Network_OUT
      CanIfInitHohCfg
        4 x CanIfHrhCfg, all with CanIfHrhCanCtrlIdRef=CanIfControllerConfig_0:
          UDS_DIAG_REQ_MB_DiagExt_Can_Network_Channel_Can_Network_IN: CanIfHrhIdSymRef=CanConfigSet/UDS_DIAG_REQ_MB_DiagExt_Can_Network_Channel_Can_Network_IN
          UDS_DIAG_REQ_MB_DiagExt_Func_Can_Network_Channel_Can_Network_IN: CanIfHrhIdSymRef=CanConfigSet/UDS_DIAG_REQ_MB_DiagExt_Func_Can_Network_Channel_Can_Network_IN
          UDS_DIAG_REQ_MB_DiagInt_Can_Network_Channel_Can_Network_IN: CanIfHrhIdSymRef=CanConfigSet/UDS_DIAG_REQ_MB_DiagInt_Can_Network_Channel_Can_Network_IN
          UDS_DIAG_REQ_MB_DiagInt_Func_Can_Network_Channel_Can_Network_IN: CanIfHrhIdSymRef=CanConfigSet/UDS_DIAG_REQ_MB_DiagInt_Func_Can_Network_Channel_Can_Network_IN
        UDS_DIAG_RES_MB_DiagExt_Can_Network_Channel_Can_Network_OUT (CanIfHthCfg): CanIfHthCanCtrlIdRef=CanIfControllerConfig_0, CanIfHthIdSymRef=CanConfigSet/UDS_DIAG_RES_MB_DiagExt_Can_Network_Channel_Can_Network_OUT
        UDS_DIAG_RES_MB_DiagInt_Can_Network_Channel_Can_Network_OUT (CanIfHthCfg): CanIfHthCanCtrlIdRef=CanIfControllerConfig_0, CanIfHthIdSymRef=CanConfigSet/UDS_DIAG_RES_MB_DiagInt_Can_Network_Channel_Can_Network_OUT
      4 x CanIfRxPduCfg, all with CanIfRxPduCanIdType=EXTENDED_FD_CAN, CanIfRxPduDlc=64, CanIfRxPduReadData=false, CanIfRxPduReadNotifyStatus=false, CanIfRxPduUserRxIndicationUL=CAN_TP:
        UDS_DIAG_REQ_MB_DiagExt_Can_Network_Channel_Can_Network_IN: CanIfRxPduCanId=417426568, CanIfRxPduHrhIdRef=CanIfInitHohCfg/UDS_DIAG_REQ_MB_DiagExt_Can_Network_Channel_Can_Network_IN, CanIfRxPduRef=UDS_DIAG_REQ_MB_DiagExt_CanIf2CanTp_Can_Network_Channel_CAN
        UDS_DIAG_REQ_MB_DiagExt_Func_Can_Network_Channel_Can_Network_IN: CanIfRxPduCanId=418314376, CanIfRxPduHrhIdRef=CanIfInitHohCfg/UDS_DIAG_REQ_MB_DiagExt_Func_Can_Network_Channel_Can_Network_IN, CanIfRxPduRef=UDS_DIAG_REQ_MB_DiagExt_Func_CanIf2CanTp_Can_Network_Channel_CAN
        UDS_DIAG_REQ_MB_DiagInt_Can_Network_Channel_Can_Network_IN: CanIfRxPduCanId=417426573, CanIfRxPduHrhIdRef=CanIfInitHohCfg/UDS_DIAG_REQ_MB_DiagInt_Can_Network_Channel_Can_Network_IN, CanIfRxPduRef=UDS_DIAG_REQ_MB_DiagInt_CanIf2CanTp_Can_Network_Channel_CAN
        UDS_DIAG_REQ_MB_DiagInt_Func_Can_Network_Channel_Can_Network_IN: CanIfRxPduCanId=418319757, CanIfRxPduHrhIdRef=CanIfInitHohCfg/UDS_DIAG_REQ_MB_DiagInt_Func_Can_Network_Channel_Can_Network_IN, CanIfRxPduRef=UDS_DIAG_REQ_MB_DiagInt_Func_CanIf2CanTp_Can_Network_Channel_CAN
      UDS_DIAG_RES_MB_DiagExt_Can_Network_Channel_Can_Network_OUT (CanIfTxPduCfg):
        CanIfTxPduCanId = 417426560
        CanIfTxPduCanIdType = EXTENDED_FD_CAN
        CanIfTxPduReadNotifyStatus = false
        CanIfTxPduTruncation = false
        CanIfTxPduType = STATIC
        CanIfTxPduUserTxConfirmationUL = CAN_TP
        CanIfTxPduBufferRef = Bu_UDS_DIAG_RES_MB_DiagExt_Can_Network_Channel_Can_Network_OUT
        CanIfTxPduRef = UDS_DIAG_RES_MB_DiagExt_CanTp2CanIf_Can_Network_Channel_CAN
      UDS_DIAG_RES_MB_DiagInt_Can_Network_Channel_Can_Network_OUT (CanIfTxPduCfg):
        CanIfTxPduCanId = 417426565
        CanIfTxPduCanIdType = EXTENDED_FD_CAN
        CanIfTxPduReadNotifyStatus = false
        CanIfTxPduTruncation = false
        CanIfTxPduType = STATIC
        CanIfTxPduUserTxConfirmationUL = CAN_TP
        CanIfTxPduBufferRef = Bu_UDS_DIAG_RES_MB_DiagInt_Can_Network_Channel_Can_Network_OUT
        CanIfTxPduRef = UDS_DIAG_RES_MB_DiagInt_CanTp2CanIf_Can_Network_Channel_CAN
    CanIfPublicCfg: CanIfMetaDataSupport=false
  module config CanTp: implementation-config-variant=VARIANT-PRE-COMPILE
    CanTpConfig_0 (CanTpConfig)
      CanTpChannel_MB_Diag_Ext (CanTpChannel): CanTpChannelMode=CANTP_MODE_HALF_DUPLEX
        CanTpRxNSdu_MB_DiagExt_PHY (CanTpRxNSdu):
          CanTpBs = 8
          CanTpNar = 0.025
          CanTpNbr = 0
          CanTpNcr = 2
          CanTpRxAddressingFormat = CANTP_STANDARD
          CanTpRxPaddingActivation = CANTP_ON
          CanTpRxTaType = CANTP_PHYSICAL
          CanTpSTmin = 0
          CanTpRxNSduRef = EcucPduCollection/UDS_DIAG_REQ_MB_DiagExt_CanTp2PduR_Can_Network_Channel_CAN
          CanTpRxNPdu_MB_DiagExt_PHY (CanTpRxNPdu): CanTpRxNPduRef=UDS_DIAG_REQ_MB_DiagExt_CanIf2CanTp_Can_Network_Channel_CAN
          CanTpTxFcNPdu_MB_DiagExt_PHY (CanTpTxFcNPdu): CanTpTxFcNPduRef=UDS_DIAG_RES_MB_DiagExt_CanTp2CanIf_Can_Network_Channel_CAN
        CanTpRxNSdu_MB_DiagExt_FUNC (CanTpRxNSdu):
          CanTpBs = 8
          CanTpNar = 0.025
          CanTpNbr = 0
          CanTpNcr = 2
          CanTpRxAddressingFormat = CANTP_STANDARD
          CanTpRxPaddingActivation = CANTP_ON
          CanTpRxTaType = CANTP_FUNCTIONAL
          CanTpSTmin = 0
          CanTpRxNSduRef = EcucPduCollection/UDS_DIAG_REQ_MB_DiagExt_Func_CanTp2PduR_Can_Network_Channel_CAN
          CanTpRxNPdu_MB_DiagExt_FUNC (CanTpRxNPdu): CanTpRxNPduRef=UDS_DIAG_REQ_MB_DiagExt_Func_CanIf2CanTp_Can_Network_Channel_CAN
        CanTpTxNSdu_MB_DiagExt_PHY (CanTpTxNSdu):
          CanTpNas = 0.025
          CanTpNbs = 2.1
          CanTpNcs = 0.8
          CanTpTc = true
          CanTpTxAddressingFormat = CANTP_STANDARD
          CanTpTxPaddingActivation = CANTP_ON
          CanTpTxTaType = CANTP_PHYSICAL
          CanTpTxNSduRef = UDS_DIAG_RES_MB_DiagExt_PduR2CanTp_Can_Network_Channel_CAN
          CanTpRxFcNPdu_MB_DiagExt_PHY (CanTpRxFcNPdu): CanTpRxFcNPduRef=UDS_DIAG_REQ_MB_DiagExt_CanIf2CanTp_Can_Network_Channel_CAN
          CanTpTxNPdu_MB_DiagExt_PHY (CanTpTxNPdu): CanTpTxNPduRef=UDS_DIAG_RES_MB_DiagExt_CanTp2CanIf_Can_Network_Channel_CAN
      CanTpChannel_MB_Diag_Int (CanTpChannel): CanTpChannelMode=CANTP_MODE_HALF_DUPLEX
        CanTpRxNSdu_MB_DiagInt_PHY (CanTpRxNSdu):
          CanTpBs = 8
          CanTpNar = 0.025
          CanTpNbr = 0
          CanTpNcr = 2
          CanTpRxAddressingFormat = CANTP_STANDARD
          CanTpRxPaddingActivation = CANTP_ON
          CanTpRxTaType = CANTP_PHYSICAL
          CanTpSTmin = 0
          CanTpRxNSduRef = EcucPduCollection/UDS_DIAG_REQ_MB_DiagInt_CanTp2PduR_Can_Network_Channel_CAN
          CanTpRxNPdu_MB_DiagInt_PHY (CanTpRxNPdu): CanTpRxNPduRef=UDS_DIAG_REQ_MB_DiagInt_CanIf2CanTp_Can_Network_Channel_CAN
          CanTpTxFcNPdu_MB_DiagInt_PHY (CanTpTxFcNPdu): CanTpTxFcNPduRef=UDS_DIAG_RES_MB_DiagInt_CanTp2CanIf_Can_Network_Channel_CAN
        CanTpRxNSdu_MB_DiagInt_FUNC (CanTpRxNSdu):
          CanTpBs = 8
          CanTpNar = 0.025
          CanTpNbr = 0
          CanTpNcr = 2
          CanTpRxAddressingFormat = CANTP_STANDARD
          CanTpRxPaddingActivation = CANTP_ON
          CanTpRxTaType = CANTP_FUNCTIONAL
          CanTpSTmin = 0
          CanTpRxNSduRef = EcucPduCollection/UDS_DIAG_REQ_MB_DiagInt_Func_CanTp2PduR_Can_Network_Channel_CAN
          CanTpRxNPdu_MB_DiagInt_FUNC (CanTpRxNPdu): CanTpRxNPduRef=UDS_DIAG_REQ_MB_DiagInt_Func_CanIf2CanTp_Can_Network_Channel_CAN
        CanTpTxNSdu_MB_DiagInt_PHY (CanTpTxNSdu):
          CanTpNas = 0.025
          CanTpNbs = 2.1
          CanTpNcs = 0.8
          CanTpTc = true
          CanTpTxAddressingFormat = CANTP_STANDARD
          CanTpTxPaddingActivation = CANTP_ON
          CanTpTxTaType = CANTP_PHYSICAL
          CanTpTxNSduRef = UDS_DIAG_RES_MB_DiagInt_PduR2CanTp_Can_Network_Channel_CAN
          CanTpRxFcNPdu_MB_DiagInt_PHY (CanTpRxFcNPdu): CanTpRxFcNPduRef=UDS_DIAG_REQ_MB_DiagInt_CanIf2CanTp_Can_Network_Channel_CAN
          CanTpTxNPdu_MB_DiagInt_PHY (CanTpTxNPdu): CanTpTxNPduRef=UDS_DIAG_RES_MB_DiagInt_CanTp2CanIf_Can_Network_Channel_CAN
  module config Dcm
    DcmConfigSet
      DcmDsl
        DcmDslProtocol
          DcmDslProtocol_MB_DiagExt_UDSOnCAN (DcmDslProtocolRow):
            DcmDslProtocolID = DCM_SUPPLIER_1
            DcmDslProtocolMaximumResponseSize = 4095
            DcmDslProtocolPriority = 3
            DcmRbDslProtocolNRC21OnPriorityAssessmentReject = true
            DcmSendRespPendOnTransToBoot = true
            DcmTimStrP2ServerAdjust = 0.01
            DcmTimStrP2StarServerAdjust = 0.01
            DcmDemClientRef = DemClient
            DcmDslProtocolRxBufferRef = DcmDslBufferRx
            DcmDslProtocolSIDTable = DcmDsdServiceTableUDS
            DcmDslProtocolTxBufferRef = DcmDslBufferTx
            DcmDslConnection_MB_DiagExt (DcmDslConnection)
              DcmDslMainConnection: DcmDslProtocolRxTesterSourceAddr=3832, DcmDslProtocolComMChannelRef=ComMChannel_Can
                UDS_DIAG_REQ_MB_DiagExt_Func_PduR2Dcm_Can_Network_Channel_CAN (DcmDslProtocolRx):
                  DcmDslProtocolRxAddrType = DCM_FUNCTIONAL_TYPE
                  DcmDslProtocolRxPduRef = EcucPduCollection/UDS_DIAG_REQ_MB_DiagExt_Func_PduR2Dcm_Can_Network_Channel_CAN
                UDS_DIAG_REQ_MB_DiagExt_PduR2Dcm_Can_Network_Channel_CAN (DcmDslProtocolRx): DcmDslProtocolRxAddrType=DCM_PHYSICAL_TYPE, DcmDslProtocolRxPduRef=EcucPduCollection/UDS_DIAG_REQ_MB_DiagExt_PduR2Dcm_Can_Network_Channel_CAN
                UDS_DIAG_RES_MB_DiagExt_Dcm2PduR_Can_Network_Channel_CAN (DcmDslProtocolTx): DcmDslProtocolTxPduRef=EcucPduCollection/UDS_DIAG_RES_MB_DiagExt_Dcm2PduR_Can_Network_Channel_CAN
          DcmDslProtocol_MB_DiagInt_UDSOnCAN (DcmDslProtocolRow):
            DcmDslProtocolID = DCM_SUPPLIER_2
            DcmDslProtocolMaximumResponseSize = 4095
            DcmDslProtocolPriority = 5
            DcmRbDslProtocolNRC21OnPriorityAssessmentReject = true
            DcmSendRespPendOnTransToBoot = true
            DcmTimStrP2ServerAdjust = 0.01
            DcmTimStrP2StarServerAdjust = 0.01
            DcmDemClientRef = DemClient
            DcmDslProtocolRxBufferRef = DcmDslBufferRx
            DcmDslProtocolSIDTable = DcmDsdServiceTableUDS
            DcmDslProtocolTxBufferRef = DcmDslBufferTx
            DcmDslConnection_MB_DiagInt (DcmDslConnection)
              DcmDslMainConnection: DcmDslProtocolRxTesterSourceAddr=3853, DcmDslProtocolComMChannelRef=ComMChannel_Can
                UDS_DIAG_REQ_MB_DiagInt_Func_PduR2Dcm_Can_Network_Channel_CAN (DcmDslProtocolRx):
                  DcmDslProtocolRxAddrType = DCM_FUNCTIONAL_TYPE
                  DcmDslProtocolRxPduRef = EcucPduCollection/UDS_DIAG_REQ_MB_DiagInt_Func_PduR2Dcm_Can_Network_Channel_CAN
                UDS_DIAG_REQ_MB_DiagInt_PduR2Dcm_Can_Network_Channel_CAN (DcmDslProtocolRx): DcmDslProtocolRxAddrType=DCM_PHYSICAL_TYPE, DcmDslProtocolRxPduRef=EcucPduCollection/UDS_DIAG_REQ_MB_DiagInt_PduR2Dcm_Can_Network_Channel_CAN
                UDS_DIAG_RES_MB_DiagInt_Dcm2PduR_Can_Network_Channel_CAN (DcmDslProtocolTx): DcmDslProtocolTxPduRef=EcucPduCollection/UDS_DIAG_RES_MB_DiagInt_Dcm2PduR_Can_Network_Channel_CAN
    DcmGeneral
  module config EcuC
    EcucConfigSet
      EcucPduCollection
        18 x Pdu, all with PduLength=64:
          UDS_DIAG_REQ_MB_DiagInt_CanIf2CanTp_Can_Network_Channel_CAN
          UDS_DIAG_REQ_MB_DiagInt_CanTp2PduR_Can_Network_Channel_CAN
          UDS_DIAG_REQ_MB_DiagInt_PduR2Dcm_Can_Network_Channel_CAN
          UDS_DIAG_REQ_MB_DiagInt_Func_CanIf2CanTp_Can_Network_Channel_CAN
          UDS_DIAG_REQ_MB_DiagInt_Func_CanTp2PduR_Can_Network_Channel_CAN
          UDS_DIAG_REQ_MB_DiagInt_Func_PduR2Dcm_Can_Network_Channel_CAN
          UDS_DIAG_RES_MB_DiagInt_Dcm2PduR_Can_Network_Channel_CAN
          UDS_DIAG_RES_MB_DiagInt_PduR2CanTp_Can_Network_Channel_CAN
          UDS_DIAG_RES_MB_DiagInt_CanTp2CanIf_Can_Network_Channel_CAN
          UDS_DIAG_REQ_MB_DiagExt_CanIf2CanTp_Can_Network_Channel_CAN
          UDS_DIAG_REQ_MB_DiagExt_CanTp2PduR_Can_Network_Channel_CAN
          UDS_DIAG_REQ_MB_DiagExt_PduR2Dcm_Can_Network_Channel_CAN
          UDS_DIAG_REQ_MB_DiagExt_Func_CanIf2CanTp_Can_Network_Channel_CAN
          UDS_DIAG_REQ_MB_DiagExt_Func_CanTp2PduR_Can_Network_Channel_CAN
          UDS_DIAG_REQ_MB_DiagExt_Func_PduR2Dcm_Can_Network_Channel_CAN
          UDS_DIAG_RES_MB_DiagExt_Dcm2PduR_Can_Network_Channel_CAN
          UDS_DIAG_RES_MB_DiagExt_PduR2CanTp_Can_Network_Channel_CAN
          UDS_DIAG_RES_MB_DiagExt_CanTp2CanIf_Can_Network_Channel_CAN
  module config PduR
    PduRRoutingTables
      PduRRoutingTable
        6 x PduRRoutingPath:
          UDS_DIAG_REQ_MB_DiagExt_CanTp2Dcm_Can_Network_Channel_CAN
            UDS_DIAG_REQ_MB_DiagExt_PduR2Dcm_Can_Network_Channel_CAN (PduRDestPdu): PduRDestPduRef=EcucPduCollection/UDS_DIAG_REQ_MB_DiagExt_PduR2Dcm_Can_Network_Channel_CAN
            UDS_DIAG_REQ_MB_DiagExt_CanTp2PduR_Can_Network_Channel_CAN (PduRSrcPdu): PduRSrcPduRef=EcucPduCollection/UDS_DIAG_REQ_MB_DiagExt_CanTp2PduR_Can_Network_Channel_CAN
          UDS_DIAG_REQ_MB_DiagExt_Func_CanTp2Dcm_Can_Network_Channel_CAN
            UDS_DIAG_REQ_MB_DiagExt_Func_PduR2Dcm_Can_Network_Channel_CAN (PduRDestPdu): PduRDestPduRef=EcucPduCollection/UDS_DIAG_REQ_MB_DiagExt_Func_PduR2Dcm_Can_Network_Channel_CAN
            UDS_DIAG_REQ_MB_DiagExt_Func_CanTp2PduR_Can_Network_Channel_CAN (PduRSrcPdu): PduRSrcPduRef=EcucPduCollection/UDS_DIAG_REQ_MB_DiagExt_Func_CanTp2PduR_Can_Network_Channel_CAN
          UDS_DIAG_RES_MB_DiagExt_Dcm2CanTp_Can_Network_Channel_CAN
            UDS_DIAG_RES_MB_DiagExt_PduR2CanIf_Can_Network_Channel_CAN (PduRDestPdu): PduRDestPduRef=UDS_DIAG_RES_MB_DiagExt_PduR2CanTp_Can_Network_Channel_CAN
            UDS_DIAG_RES_MB_DiagExt_Dcm2PduR_Can_Network_Channel_CAN (PduRSrcPdu): PduRSrcPduRef=EcucPduCollection/UDS_DIAG_RES_MB_DiagExt_Dcm2PduR_Can_Network_Channel_CAN
          UDS_DIAG_REQ_MB_DiagInt_CanTp2Dcm_Can_Network_Channel_CAN
            UDS_DIAG_REQ_MB_DiagInt_PduR2Dcm_Can_Network_Channel_CAN (PduRDestPdu): PduRDestPduRef=EcucPduCollection/UDS_DIAG_REQ_MB_DiagInt_PduR2Dcm_Can_Network_Channel_CAN
            UDS_DIAG_REQ_MB_DiagInt_CanTp2PduR_Can_Network_Channel_CAN (PduRSrcPdu): PduRSrcPduRef=EcucPduCollection/UDS_DIAG_REQ_MB_DiagInt_CanTp2PduR_Can_Network_Channel_CAN
          UDS_DIAG_REQ_MB_DiagInt_Func_CanTp2Dcm_Can_Network_Channel_CAN
            UDS_DIAG_REQ_MB_DiagInt_Func_PduR2Dcm_Can_Network_Channel_CAN (PduRDestPdu): PduRDestPduRef=EcucPduCollection/UDS_DIAG_REQ_MB_DiagInt_Func_PduR2Dcm_Can_Network_Channel_CAN
            UDS_DIAG_REQ_MB_DiagInt_Func_CanTp2PduR_Can_Network_Channel_CAN (PduRSrcPdu): PduRSrcPduRef=EcucPduCollection/UDS_DIAG_REQ_MB_DiagInt_Func_CanTp2PduR_Can_Network_Channel_CAN
          UDS_DIAG_RES_MB_DiagInt_Dcm2CanTp_Can_Network_Channel_CAN
            UDS_DIAG_RES_MB_DiagInt_PduR2CanIf_Can_Network_Channel_CAN (PduRDestPdu): PduRDestPduRef=UDS_DIAG_RES_MB_DiagInt_PduR2CanTp_Can_Network_Channel_CAN
            UDS_DIAG_RES_MB_DiagInt_Dcm2PduR_Can_Network_Channel_CAN (PduRSrcPdu): PduRSrcPduRef=EcucPduCollection/UDS_DIAG_RES_MB_DiagInt_Dcm2PduR_Can_Network_Channel_CAN
    PduRGeneral:
      PduRMulticastFromTpSupport = false
      PduRMulticastToTpSupport = false
      PduRTPGatewayOperation = false
      PduRMulticastToIfSupport = false
      PduRVersionInfoApi = true
      PduRZeroCostOperation = false
      PduRQueueingSupport = false
      PduRMetaDataSupport = false
      PduRIFGatewayOperation = true
      PduRGwTpWithLimitedBuffer = false
      PduRDSMReInitEnabled = false
      PduRDevErrorDetect = false
package /RB/UBK/Project/EcucValueCollections
  ecuc value collection EcucValueCollections: ecuc-values=Dcm
