AUTOSAR XML (schema 4-2-2)
package /RB/UBK/Project/EcucModuleConfigurationValuess
  module config Dcm
    DcmConfigSet
      DcmDsd
        DcmDsdServiceRequestManufacturerNotification_RightsM (DcmDsdServiceRequestManufacturerNotification)
        DcmDsdServiceRequestManufacturerNotification_Coding (DcmDsdServiceRequestManufacturerNotification)
        IMU_A_GEN6_ServiceTable (DcmDsdServiceTable)
          9 x DcmDsdService:
            SessionControlClass: DcmDsdSidTabServiceId=16, DcmDsdSidTabSubfuncAvail=true
              3 x DcmDsdSubService:
                Default_SessionControl: DcmDsdSubServiceId=1
                Extended_SessionControl: DcmDsdSubServiceId=3
                Programming_SessionControl: DcmDsdSubServiceId=2
            EcuResetClass: DcmDsdSidTabServiceId=17, DcmDsdSidTabSubfuncAvail=true
              Hard (DcmDsdSubService): DcmDsdSubServiceId=1
              Soft (DcmDsdSubService): DcmDsdSubServiceId=3
            ReadDtcInformationClass: DcmDsdSidTabServiceId=25, DcmDsdSidTabSubfuncAvail=true, DcmDsdSidTabSessionLevelRef=DEFAULT_SESSION, DcmDsdSidTabSessionLevelRef=EXTENDED_DIAGNOSTIC_SESSION
              6 x DcmDsdSubService, all with DcmDsdSubServiceSessionLevelRef=DEFAULT_SESSION, DcmDsdSubServiceSessionLevelRef=EXTENDED_DIAGNOSTIC_SESSION:
                RDTCBSM: DcmDsdSubServiceId=2
                RDTCEDRBDN: DcmDsdSubServiceId=6
                RDTCFDC: DcmDsdSubServiceId=20
                RDTCSSBDTC: DcmDsdSubServiceId=4
                RNODTCBSM: DcmDsdSubServiceId=1
                RSUPDTC: DcmDsdSubServiceId=10
            ControlDtcSettingClass: DcmDsdSidTabServiceId=133, DcmDsdSidTabSubfuncAvail=true, DcmDsdSidTabSessionLevelRef=EXTENDED_DIAGNOSTIC_SESSION
              Disable (DcmDsdSubService): DcmDsdSubServiceId=2, DcmDsdSubServiceSessionLevelRef=EXTENDED_DIAGNOSTIC_SESSION
              Enable (DcmDsdSubService): DcmDsdSubServiceId=1, DcmDsdSubServiceSessionLevelRef=EXTENDED_DIAGNOSTIC_SESSION
            ClearDiagnosticInformationClass: DcmDsdSidTabServiceId=20, DcmDsdSidTabSubfuncAvail=false, DcmDsdSidTabSessionLevelRef=DEFAULT_SESSION, DcmDsdSidTabSessionLevelRef=EXTENDED_DIAGNOSTIC_SESSION
            ReadDataByIdentifierClass: DcmDsdSidTabServiceId=34, DcmDsdSidTabSubfuncAvail=false, DcmDsdSidTabSessionLevelRef=DEFAULT_SESSION, DcmDsdSidTabSessionLevelRef=EXTENDED_DIAGNOSTIC_SESSION
            WriteDataByIdentifierClass: DcmDsdSidTabServiceId=46, DcmDsdSidTabSubfuncAvail=false, DcmDsdSidTabSessionLevelRef=EXTENDED_DIAGNOSTIC_SESSION, DcmDsdSidTabSessionLevelRef=PROGRAMMING_SESSION
            ComControlClass: DcmDsdSidTabServiceId=40, DcmDsdSidTabSubfuncAvail=true, DcmDsdSidTabSessionLevelRef=EXTENDED_DIAGNOSTIC_SESSION
              EnableRxAndDisableTx (DcmDsdSubService): DcmDsdSubServiceId=1, DcmDsdSubServiceSessionLevelRef=EXTENDED_DIAGNOSTIC_SESSION
              EnableRxAndTx (DcmDsdSubService): DcmDsdSubServiceId=0, DcmDsdSubServiceSessionLevelRef=EXTENDED_DIAGNOSTIC_SESSION
            RoutineControlClass: DcmDsdSidTabServiceId=49, DcmDsdSidTabSubfuncAvail=true, DcmDsdSidTabSessionLevelRef=EXTENDED_DIAGNOSTIC_SESSION, DcmDsdSidTabSessionLevelRef=PROGRAMMING_SESSION, DcmDsdSidTabSessionLevelRef=DEFAULT_SESSION
      DcmDsp: DcmDspMaxDidToRead=1
        DcmDspComControl
        DcmDspControlDTCSetting: DcmSupportDTCSettingControlOptionRecord=false
        45 x DcmDspData, all with DcmDspDataConditionCheckReadFncUsed=true, DcmDspDataEndianness=opaque, DcmDspDataUsePort=USE_DATA_ASYNCH_CLIENT_SERVER, DcmRbDspDataUseAsynchronousServerCallPoint=false:
          Basic_ACL_Version_Generation_Time_GTC: DcmDspDataSize=120, DcmDspDataType=UINT8_N
            DcmDspDiagnosisScaling
              DcmDspAlternativeDataType: DcmApplicationDataType=Dcm_ArrDataType_0x185_Basic_ACL_Version_Generation_Time_GTC
          Basic_ACL_Version_Candela_File_Version_Major: DcmDspDataSize=8, DcmDspDataType=UINT8_N
            DcmDspDiagnosisScaling
              DcmDspAlternativeDataType: DcmApplicationDataType=Dcm_DataType_0x185_Basic_ACL_Version_Candela_File_Version_Major
          Basic_ACL_Version_Candela_File_Version_Minor: DcmDspDataSize=8, DcmDspDataType=UINT8_N
            DcmDspDiagnosisScaling
              DcmDspAlternativeDataType: DcmApplicationDataType=Dcm_DataType_0x185_Basic_ACL_Version_Candela_File_Version_Minor
          Basic_ACL_Version_Candela_File_Version_Patch: DcmDspDataSize=8, DcmDspDataType=UINT8_N
            DcmDspDiagnosisScaling
              DcmDspAlternativeDataType: DcmApplicationDataType=Dcm_DataType_0x185_Basic_ACL_Version_Candela_File_Version_Patch
          Basic_ACL_Hash: DcmDspDataSize=512, DcmDspDataType=UINT8_N
            DcmDspDiagnosisScaling
              DcmDspAlternativeDataType: DcmApplicationDataType=Dcm_ArrDataType_0x185_Basic_ACL_Hash
          ECU_indvidual_ACL_Version_Generation_Time_GTC: DcmDspDataSize=120, DcmDspDataType=UINT8_N
            DcmDspDiagnosisScaling
              DcmDspAlternativeDataType: DcmApplicationDataType=Dcm_ArrDataType_0x185_ECU_indvidual_ACL_Version_Generation_Time_GTC
          ECU_indvidual_ACL_Version_Candela_File_Version_Major: DcmDspDataSize=8, DcmDspDataType=UINT8_N
            DcmDspDiagnosisScaling
              DcmDspAlternativeDataType: DcmApplicationDataType=Dcm_DataType_0x185_ECU_indvidual_ACL_Version_Candela_File_Version_Major
          ECU_indvidual_ACL_Version_Candela_File_Version_Minor: DcmDspDataSize=8, DcmDspDataType=UINT8_N
            DcmDspDiagnosisScaling
              DcmDspAlternativeDataType: DcmApplicationDataType=Dcm_DataType_0x185_ECU_indvidual_ACL_Version_Candela_File_Version_Minor
          ECU_indvidual_ACL_Version_Candela_File_Version_Patch: DcmDspDataSize=8, DcmDspDataType=UINT8_N
            DcmDspDiagnosisScaling
              DcmDspAlternativeDataType: DcmApplicationDataType=Dcm_DataType_0x185_ECU_indvidual_ACL_Version_Candela_File_Version_Patch
          ECU_indvidual_ACL_Hash: DcmDspDataSize=512, DcmDspDataType=UINT8_N
            DcmDspDiagnosisScaling
              DcmDspAlternativeDataType: DcmApplicationDataType=Dcm_ArrDataType_0x185_ECU_indvidual_ACL_Hash
          Backend_CA_SubjectKeyIdentifier: DcmDspDataSize=160, DcmDspDataType=UINT8_N
            DcmDspDiagnosisScaling
              DcmDspAlternativeDataType: DcmApplicationDataType=Dcm_ArrDataType_0x182_Backend_CA_SubjectKeyIdentifier
          Backend_CACertificate: DcmDspDataSize=8016, DcmDspDataType=UINT8_DYN
            DcmDspDiagnosisScaling
              DcmDspAlternativeDataType: DcmApplicationDataType=Dcm_ArrDataType_0x181_Backend_CA_Certificate
          Diagnostic_Authentication_Certificate_Issuer: DcmDspDataSize=120, DcmDspDataType=UINT8_N
            DcmDspDiagnosisScaling
              DcmDspAlternativeDataType: DcmApplicationDataType=Dcm_ArrDataType_0x184_Diagnostic_Authentication_Certificate_Issuer
          Diagnostic_Authentication_Certificate_Serial_Number: DcmDspDataSize=128, DcmDspDataType=UINT8_DYN
            DcmDspDiagnosisScaling
              DcmDspAlternativeDataType: DcmApplicationDataType=Dcm_ArrDataType_0x184_Diagnostic_Authentication_Certificate_Serial_Number
          Diagnostic_User_Role_Cebas_UserRole: DcmDspDataSize=8, DcmDspDataType=UINT8_N
            DcmDspDiagnosisScaling
              DcmDspAlternativeDataType: DcmApplicationDataType=Dcm_DataType_0x18C_Cebas_UserRole
          Generated_Random_Number_Result: DcmDspDataSize=8, DcmDspDataType=UINT8_N
            DcmDspDiagnosisScaling
              DcmDspAlternativeDataType: DcmApplicationDataType=Dcm_DataType_0x191_Generated_Random_Number_Result
          Generated_Random_Number: DcmDspDataSize=256, DcmDspDataType=UINT8_N
            DcmDspDiagnosisScaling
              DcmDspAlternativeDataType: DcmApplicationDataType=Dcm_ArrDataType_0x191_Generated_Random_Number
          Real_Time_Offset_Real_Time_Offset: DcmDspDataSize=120, DcmDspDataType=UINT8_N
            DcmDspDiagnosisScaling
              DcmDspAlternativeDataType: DcmApplicationDataType=Dcm_ArrDataType_0x18D_Real_Time_Offset
          Real_Time_Offset_TickCount: DcmDspDataSize=40, DcmDspDataType=UINT8_N
            DcmDspDiagnosisScaling
              DcmDspAlternativeDataType: DcmApplicationDataType=Dcm_ArrDataType_0x18D_TickCount
          Root_CACertificate: DcmDspDataSize=8016, DcmDspDataType=UINT8_DYN
            DcmDspDiagnosisScaling
              DcmDspAlternativeDataType: DcmApplicationDataType=Dcm_ArrDataType_0x180_Root_CA_Certificate
          SecOC_Local_Tick_Count: DcmDspDataSize=48, DcmDspDataType=UINT8_N
            DcmDspDiagnosisScaling
              DcmDspAlternativeDataType: DcmApplicationDataType=Dcm_ArrDataType_0x18A_TickCount
          SecOC_PDU_Data_IDs_and_Key_Checksums: DcmDspDataSize=32736, DcmDspDataType=UINT8_DYN
            DcmDspDiagnosisScaling
              DcmDspAlternativeDataType: DcmApplicationDataType=Dcm_ArrDataType_0x188_Secured_PDU_Data_IDs_and_Key_Checksum
          SecOC_PDU_Data_ID_and_Key_CMAC: DcmDspDataSize=32736, DcmDspDataType=UINT8_DYN
            DcmDspDiagnosisScaling
              DcmDspAlternativeDataType: DcmApplicationDataType=Dcm_ArrDataType_0x18F_Secured_PDU_Data_IDs_and_Key_CMACs
          SecOC_Vehicle_Shared_SecretHash: DcmDspDataSize=32, DcmDspDataType=UINT8_N
            DcmDspDiagnosisScaling
              DcmDspAlternativeDataType: DcmApplicationDataType=Dcm_ArrDataType_0x189_SecOC_Vehicle_Shared_Secret_Hash
          SecuredSystem_Date_and_Time: DcmDspDataSize=120, DcmDspDataType=UINT8_N
            DcmDspDiagnosisScaling
              DcmDspAlternativeDataType: DcmApplicationDataType=Dcm_ArrDataType_0x186_GeneralizedTime
          Security_EventLog_Current_Counter_Values: DcmDspDataSize=8192, DcmDspDataType=UINT8_DYN
            DcmDspDiagnosisScaling
              DcmDspAlternativeDataType: DcmApplicationDataType=Dcm_ArrDataType_0x190_Security_Event_Log_Current_Counter_Values
          Security_EventLog: DcmDspDataSize=32736, DcmDspDataType=UINT8_DYN
            DcmDspDiagnosisScaling
              DcmDspAlternativeDataType: DcmApplicationDataType=Dcm_ArrDataType_0x187_Security_Event_Log
          Status_SSA_PreCompile_Switches: DcmDspDataSize=32, DcmDspDataType=UINT8_N
            DcmDspDiagnosisScaling
              DcmDspAlternativeDataType: DcmApplicationDataType=Dcm_ArrDataType_0x197_Precompile_switch
          Trust_model_Backend_CAcertificate: DcmDspDataSize=8016, DcmDspDataType=UINT8_DYN
            DcmDspDiagnosisScaling
              DcmDspAlternativeDataType: DcmApplicationDataType=Dcm_ArrDataType_0x19D_Trust_model_Backend_CA_certificate
          Trust_model_ECUcertificate: DcmDspDataSize=8016, DcmDspDataType=UINT8_DYN
            DcmDspDiagnosisScaling
              DcmDspAlternativeDataType: DcmApplicationDataType=Dcm_ArrDataType_0x19B_Trust_model_ECU_Certificate
          Trust_model_ECU_CSR_check: DcmDspDataSize=8016, DcmDspDataType=UINT8_DYN
            DcmDspDiagnosisScaling
              DcmDspAlternativeDataType: DcmApplicationDataType=Dcm_ArrDataType_0x19A_Trust_model_ECU_CSR
          Trust_model_full_chain_of_trustcertificates: DcmDspDataSize=32064, DcmDspDataType=UINT8_DYN
            DcmDspDiagnosisScaling
              DcmDspAlternativeDataType: DcmApplicationDataType=Dcm_ArrDataType_0x19F_Trust_model_certificates
          Trust_model_Intermediate_CAcertificate: DcmDspDataSize=8016, DcmDspDataType=UINT8_DYN
            DcmDspDiagnosisScaling
              DcmDspAlternativeDataType: DcmApplicationDataType=Dcm_ArrDataType_0x19C_Trust_model_Intermediate_CA_Certificate
          Trust_Model_public_key_Nonce: DcmDspDataSize=256, DcmDspDataType=UINT8_N
            DcmDspDiagnosisScaling
              DcmDspAlternativeDataType: DcmApplicationDataType=Dcm_ArrDataType_0x199_Nonce
          Trust_Model_public_key_Ephemeral_ECU_Public_Key: DcmDspDataSize=256, DcmDspDataType=UINT8_N
            DcmDspDiagnosisScaling
              DcmDspAlternativeDataType: DcmApplicationDataType=Dcm_ArrDataType_0x199_Ephemeral_ECU_Public_Key
          Trust_Model_public_key_Data_Signature: DcmDspDataSize=512, DcmDspDataType=UINT8_N
            DcmDspDiagnosisScaling
              DcmDspAlternativeDataType: DcmApplicationDataType=Dcm_ArrDataType_0x199_Data_Signature
          Trust_Model_public_key_Certificates: DcmDspDataSize=24048, DcmDspDataType=UINT8_DYN
            DcmDspDiagnosisScaling
              DcmDspAlternativeDataType: DcmApplicationDataType=Dcm_ArrDataType_0x199_Certificates
          Trust_model_Root_CAcertificate: DcmDspDataSize=8016, DcmDspDataType=UINT8_DYN
            DcmDspDiagnosisScaling
              DcmDspAlternativeDataType: DcmApplicationDataType=Dcm_ArrDataType_0x19E_Trust_model_Root_CA_certificate
          Trust_Model_Root_ReplacementKey: DcmDspDataSize=256, DcmDspDataType=UINT8_N
            DcmDspDiagnosisScaling
              DcmDspAlternativeDataType: DcmApplicationDataType=Dcm_ArrDataType_0x198_Root_Replacement_Key
          VINStatus: DcmDspDataSize=8, DcmDspDataType=UINT8_N
            DcmDspDiagnosisScaling
              DcmDspAlternativeDataType: DcmApplicationDataType=Dcm_DataType_0x18E_VIN_Status
          VIN_Lock_Status: DcmDspDataSize=8, DcmDspDataType=UINT8_N
            DcmDspDiagnosisScaling
              DcmDspAlternativeDataType: DcmApplicationDataType=Dcm_DataType_0x18E_VIN_Lock_Status
          SSA_Version_Information_SSA_Major_Version: DcmDspDataSize=8, DcmDspDataType=UINT8_N
            DcmDspDiagnosisScaling
              DcmDspAlternativeDataType: DcmApplicationDataType=Dcm_DataType_0xEF04_SSA_Major_Version
          SSA_Version_Information_SSA_Minor_Version: DcmDspDataSize=8, DcmDspDataType=UINT8_N
            DcmDspDiagnosisScaling
              DcmDspAlternativeDataType: DcmApplicationDataType=Dcm_DataType_0xEF04_SSA_Minor_Version
          SSA_Version_Information_SSA_Patch_Level: DcmDspDataSize=8, DcmDspDataType=UINT8_N
            DcmDspDiagnosisScaling
              DcmDspAlternativeDataType: DcmApplicationDataType=Dcm_DataType_0xEF04_SSA_Patch_Level
          VIN_DataIdentifier: DcmDspDataSize=136, DcmDspDataType=UINT8_N
            DcmDspDiagnosisScaling
              DcmDspAlternativeDataType: DcmApplicationDataType=Dcm_ArrDataType_0xF190_VINDataIdentifier
        27 x DcmDspDid, all with DcmDspDidUsePort=USE_DATA_ELEMENT_SPECIFIC_INTERFACES, DcmRbAtomicSenderReceiverCommunication=false:
          Access_Control_List_Version: DcmDspDidIdentifier=389, DcmDspDidInfoRef=Access_Control_List_Version_info
            10 x DcmDspDidSignal:
              Basic_ACL_Version_Generation_Time_GTC: DcmDspDidDataPos=0, DcmDspDidDataRef=DcmDsp/Basic_ACL_Version_Generation_Time_GTC
              Basic_ACL_Version_Candela_File_Version_Major: DcmDspDidDataPos=120, DcmDspDidDataRef=DcmDsp/Basic_ACL_Version_Candela_File_Version_Major
              Basic_ACL_Version_Candela_File_Version_Minor: DcmDspDidDataPos=128, DcmDspDidDataRef=DcmDsp/Basic_ACL_Version_Candela_File_Version_Minor
              Basic_ACL_Version_Candela_File_Version_Patch: DcmDspDidDataPos=136, DcmDspDidDataRef=DcmDsp/Basic_ACL_Version_Candela_File_Version_Patch
              Basic_ACL_Hash: DcmDspDidDataPos=144, DcmDspDidDataRef=DcmDsp/Basic_ACL_Hash
              ECU_indvidual_ACL_Version_Generation_Time_GTC: DcmDspDidDataPos=656, DcmDspDidDataRef=DcmDsp/ECU_indvidual_ACL_Version_Generation_Time_GTC
              ECU_indvidual_ACL_Version_Candela_File_Version_Major: DcmDspDidDataPos=776, DcmDspDidDataRef=DcmDsp/ECU_indvidual_ACL_Version_Candela_File_Version_Major
              ECU_indvidual_ACL_Version_Candela_File_Version_Minor: DcmDspDidDataPos=784, DcmDspDidDataRef=DcmDsp/ECU_indvidual_ACL_Version_Candela_File_Version_Minor
              ECU_indvidual_ACL_Version_Candela_File_Version_Patch: DcmDspDidDataPos=792, DcmDspDidDataRef=DcmDsp/ECU_indvidual_ACL_Version_Candela_File_Version_Patch
              ECU_indvidual_ACL_Hash: DcmDspDidDataPos=800, DcmDspDidDataRef=DcmDsp/ECU_indvidual_ACL_Hash
          Backend_CA_Certificate_Identification: DcmDspDidIdentifier=386, DcmDspDidInfoRef=Backend_CA_Certificate_Identification_info
            Backend_CA_SubjectKeyIdentifier (DcmDspDidSignal): DcmDspDidDataPos=0, DcmDspDidDataRef=DcmDsp/Backend_CA_SubjectKeyIdentifier
          Backend_CA_Certificate: DcmDspDidIdentifier=385, DcmDspDidInfoRef=Backend_CA_Certificate_info
            Backend_CA_Certificate (DcmDspDidSignal): DcmDspDidDataPos=0, DcmDspDidDataRef=Backend_CACertificate
          Diagnostic_Authentication_Certificate_Identification: DcmDspDidIdentifier=388, DcmDspDidInfoRef=Diagnostic_Authentication_Certificate_Identification_info
            Diagnostic_Authentication_Certificate_Issuer (DcmDspDidSignal): DcmDspDidDataPos=0, DcmDspDidDataRef=DcmDsp/Diagnostic_Authentication_Certificate_Issuer
            Diagnostic_Authentication_Certificate_Serial_Number (DcmDspDidSignal): DcmDspDidDataPos=120, DcmDspDidDataRef=DcmDsp/Diagnostic_Authentication_Certificate_Serial_Number
          Diagnostic_User_Role: DcmDspDidIdentifier=396, DcmDspDidInfoRef=Diagnostic_User_Role_info
            Cebas_UserRole (DcmDspDidSignal): DcmDspDidDataPos=0, DcmDspDidDataRef=Diagnostic_User_Role_Cebas_UserRole
          RandomNumber: DcmDspDidIdentifier=401, DcmDspDidInfoRef=RandomNumber_info
            Generated_Random_Number_Result (DcmDspDidSignal): DcmDspDidDataPos=0, DcmDspDidDataRef=DcmDsp/Generated_Random_Number_Result
            Generated_Random_Number (DcmDspDidSignal): DcmDspDidDataPos=8, DcmDspDidDataRef=DcmDsp/Generated_Random_Number
          Real_Time_Offset: DcmDspDidIdentifier=397, DcmDspDidInfoRef=Real_Time_Offset_info
            Real_Time_Offset (DcmDspDidSignal): DcmDspDidDataPos=0, DcmDspDidDataRef=Real_Time_Offset_Real_Time_Offset
            TickCount (DcmDspDidSignal): DcmDspDidDataPos=120, DcmDspDidDataRef=Real_Time_Offset_TickCount
          Root_CA_Certificate: DcmDspDidIdentifier=384, DcmDspDidInfoRef=Root_CA_Certificate_info
            Root_CA_Certificate (DcmDspDidSignal): DcmDspDidDataPos=0, DcmDspDidDataRef=Root_CACertificate
          SecOC_Local_TickCount: DcmDspDidIdentifier=394, DcmDspDidInfoRef=SecOC_Local_TickCount_info
            TickCount (DcmDspDidSignal): DcmDspDidDataPos=0, DcmDspDidDataRef=SecOC_Local_Tick_Count
          SecOC_PDU_Data_IDs_and_Key_Checksum: DcmDspDidIdentifier=392, DcmDspDidInfoRef=SecOC_PDU_Data_IDs_and_Key_Checksum_info
            Secured_PDU_Data_IDs_and_Key_Checksum (DcmDspDidSignal): DcmDspDidDataPos=0, DcmDspDidDataRef=SecOC_PDU_Data_IDs_and_Key_Checksums
          SecOC_PDU_Data_IDs_and_Key_CMACs: DcmDspDidIdentifier=399, DcmDspDidInfoRef=SecOC_PDU_Data_IDs_and_Key_CMACs_info
            Secured_PDU_Data_IDs_and_Key_CMACs (DcmDspDidSignal): DcmDspDidDataPos=0, DcmDspDidDataRef=SecOC_PDU_Data_ID_and_Key_CMAC
          SecOC_Vehicle_Shared_Secret_Hash: DcmDspDidIdentifier=393, DcmDspDidInfoRef=SecOC_Vehicle_Shared_Secret_Hash_info
            SecOC_Vehicle_Shared_Secret_Hash (DcmDspDidSignal): DcmDspDidDataPos=0, DcmDspDidDataRef=SecOC_Vehicle_Shared_SecretHash
          Secured_System_Date_and_Time: DcmDspDidIdentifier=390, DcmDspDidInfoRef=Secured_System_Date_and_Time_info
            GeneralizedTime (DcmDspDidSignal): DcmDspDidDataPos=0, DcmDspDidDataRef=SecuredSystem_Date_and_Time
          Security_Event_Log_Current_Counter_Values: DcmDspDidIdentifier=400, DcmDspDidInfoRef=Security_Event_Log_Current_Counter_Values_info
            Security_Event_Log_Current_Counter_Values (DcmDspDidSignal): DcmDspDidDataPos=0, DcmDspDidDataRef=Security_EventLog_Current_Counter_Values
          Security_Event_Log: DcmDspDidIdentifier=391, DcmDspDidInfoRef=Security_Event_Log_info
            Security_Event_Log (DcmDspDidSignal): DcmDspDidDataPos=0, DcmDspDidDataRef=Security_EventLog
          Status_SSA_Pre_Compile_Switches: DcmDspDidIdentifier=407, DcmDspDidInfoRef=Status_SSA_Pre_Compile_Switches_info
            Precompile_switch (DcmDspDidSignal): DcmDspDidDataPos=0, DcmDspDidDataRef=Status_SSA_PreCompile_Switches
          Trust_model_Backend_CA_certificate: DcmDspDidIdentifier=413, DcmDspDidInfoRef=Trust_model_Backend_CA_certificate_info
            Trust_model_Backend_CA_certificate (DcmDspDidSignal): DcmDspDidDataPos=0, DcmDspDidDataRef=Trust_model_Backend_CAcertificate
          Trust_model_ECU_certificate: DcmDspDidIdentifier=411, DcmDspDidInfoRef=Trust_model_ECU_certificate_info
            Trust_model_ECU_Certificate (DcmDspDidSignal): DcmDspDidDataPos=0, DcmDspDidDataRef=Trust_model_ECUcertificate
          Trust_model_ECU_CSR: DcmDspDidIdentifier=410, DcmDspDidInfoRef=Trust_model_ECU_CSR_info
            Trust_model_ECU_CSR (DcmDspDidSignal): DcmDspDidDataPos=0, DcmDspDidDataRef=Trust_model_ECU_CSR_check
          Trust_model_full_chain_of_trust_certificates: DcmDspDidIdentifier=415, DcmDspDidInfoRef=Trust_model_full_chain_of_trust_certificates_info
            Trust_model_certificates (DcmDspDidSignal): DcmDspDidDataPos=0, DcmDspDidDataRef=Trust_model_full_chain_of_trustcertificates
          Trust_model_Intermediate_CA_certificate: DcmDspDidIdentifier=412, DcmDspDidInfoRef=Trust_model_Intermediate_CA_certificate_info
            Trust_model_Intermediate_CA_Certificate (DcmDspDidSignal): DcmDspDidDataPos=0, DcmDspDidDataRef=Trust_model_Intermediate_CAcertificate
          Trust_Model_Request_ephemeral_public_key: DcmDspDidIdentifier=409, DcmDspDidInfoRef=Trust_Model_Request_ephemeral_public_key_info
            4 x DcmDspDidSignal:
              Nonce: DcmDspDidDataPos=0, DcmDspDidDataRef=Trust_Model_public_key_Nonce
              Ephemeral_ECU_Public_Key: DcmDspDidDataPos=256, DcmDspDidDataRef=Trust_Model_public_key_Ephemeral_ECU_Public_Key
              Data_Signature: DcmDspDidDataPos=512, DcmDspDidDataRef=Trust_Model_public_key_Data_Signature
              Certificates: DcmDspDidDataPos=1024, DcmDspDidDataRef=Trust_Model_public_key_Certificates
          Trust_model_Root_CA_certificate: DcmDspDidIdentifier=414, DcmDspDidInfoRef=Trust_model_Root_CA_certificate_info
            Trust_model_Root_CA_certificate (DcmDspDidSignal): DcmDspDidDataPos=0, DcmDspDidDataRef=Trust_model_Root_CAcertificate
          Trust_Model_Root_Replacement_Key: DcmDspDidIdentifier=408, DcmDspDidInfoRef=Trust_Model_Root_Replacement_Key_info
            Root_Replacement_Key (DcmDspDidSignal): DcmDspDidDataPos=0, DcmDspDidDataRef=Trust_Model_Root_ReplacementKey
          VIN_Status: DcmDspDidIdentifier=398, DcmDspDidInfoRef=VIN_Status_info
            VIN_Status (DcmDspDidSignal): DcmDspDidDataPos=0, DcmDspDidDataRef=VINStatus
            VIN_Lock_Status (DcmDspDidSignal): DcmDspDidDataPos=8, DcmDspDidDataRef=DcmDsp/VIN_Lock_Status
          SSA_Version_Information: DcmDspDidIdentifier=61188, DcmDspDidInfoRef=SSA_Version_Information_info
            3 x DcmDspDidSignal:
              SSA_Major_Version: DcmDspDidDataPos=0, DcmDspDidDataRef=SSA_Version_Information_SSA_Major_Version
              SSA_Minor_Version: DcmDspDidDataPos=8, DcmDspDidDataRef=SSA_Version_Information_SSA_Minor_Version
              SSA_Patch_Level: DcmDspDidDataPos=16, DcmDspDidDataRef=SSA_Version_Information_SSA_Patch_Level
          VINDataIdentifier: DcmDspDidIdentifier=61840, DcmDspDidInfoRef=VINDataIdentifier_info
            VINDataIdentifier (DcmDspDidSignal): DcmDspDidDataPos=0, DcmDspDidDataRef=VIN_DataIdentifier
        27 x DcmDspDidInfo, all with DcmDspDidDynamicallyDefined=false:
          Access_Control_List_Version_info
            DcmDspDidRead
          Backend_CA_Certificate_Identification_info
            DcmDspDidRead
          Backend_CA_Certificate_info
            DcmDspDidRead
          Diagnostic_Authentication_Certificate_Identification_info
            DcmDspDidRead
          Diagnostic_User_Role_info
            DcmDspDidRead
          RandomNumber_info
            DcmDspDidRead: DcmDspDidReadSessionRef=DEFAULT_SESSION, DcmDspDidReadSessionRef=EXTENDED_DIAGNOSTIC_SESSION
          Real_Time_Offset_info
            DcmDspDidRead
          Root_CA_Certificate_info
            DcmDspDidRead
          SecOC_Local_TickCount_info
            DcmDspDidRead
          SecOC_PDU_Data_IDs_and_Key_Checksum_info
            DcmDspDidRead
          SecOC_PDU_Data_IDs_and_Key_CMACs_info
            DcmDspDidRead: DcmDspDidReadSessionRef=DEFAULT_SESSION, DcmDspDidReadSessionRef=EXTENDED_DIAGNOSTIC_SESSION
          SecOC_Vehicle_Shared_Secret_Hash_info
            DcmDspDidRead
          Secured_System_Date_and_Time_info
            DcmDspDidRead
          Security_Event_Log_Current_Counter_Values_info
            DcmDspDidRead
          Security_Event_Log_info
            DcmDspDidRead
          Status_SSA_Pre_Compile_Switches_info
            DcmDspDidRead: DcmDspDidReadSessionRef=DEFAULT_SESSION, DcmDspDidReadSessionRef=EXTENDED_DIAGNOSTIC_SESSION
          Trust_model_Backend_CA_certificate_info
            DcmDspDidRead: DcmDspDidReadSessionRef=DEFAULT_SESSION, DcmDspDidReadSessionRef=EXTENDED_DIAGNOSTIC_SESSION
          Trust_model_ECU_certificate_info
            DcmDspDidRead
          Trust_model_ECU_CSR_info
            DcmDspDidRead: DcmDspDidReadSessionRef=DEFAULT_SESSION, DcmDspDidReadSessionRef=EXTENDED_DIAGNOSTIC_SESSION
          Trust_model_full_chain_of_trust_certificates_info
            DcmDspDidRead: DcmDspDidReadSessionRef=DEFAULT_SESSION, DcmDspDidReadSessionRef=EXTENDED_DIAGNOSTIC_SESSION
          Trust_model_Intermediate_CA_certificate_info
            DcmDspDidRead: DcmDspDidReadSessionRef=DEFAULT_SESSION, DcmDspDidReadSessionRef=EXTENDED_DIAGNOSTIC_SESSION
          Trust_Model_Request_ephemeral_public_key_info
            DcmDspDidRead: DcmDspDidReadSessionRef=DEFAULT_SESSION, DcmDspDidReadSessionRef=EXTENDED_DIAGNOSTIC_SESSION
          Trust_model_Root_CA_certificate_info
            DcmDspDidRead: DcmDspDidReadSessionRef=DEFAULT_SESSION, DcmDspDidReadSessionRef=EXTENDED_DIAGNOSTIC_SESSION
          Trust_Model_Root_Replacement_Key_info
            DcmDspDidRead: DcmDspDidReadSessionRef=DEFAULT_SESSION, DcmDspDidReadSessionRef=EXTENDED_DIAGNOSTIC_SESSION
          VIN_Status_info
            DcmDspDidRead
          SSA_Version_Information_info
            DcmDspDidRead
          VINDataIdentifier_info
            DcmDspDidRead
            DcmDspDidWrite: DcmDspDidWriteSessionRef=EXTENDED_DIAGNOSTIC_SESSION, DcmDspDidWriteSessionRef=PROGRAMMING_SESSION
        13 x DcmDspRoutine, all with DcmDspRoutineUsePort=true:
          Authenticate_Diagnostic_User_or_Tester: DcmDspRoutineIdentifier=608
            DcmDspStartRoutine: DcmDspStartRoutineCommonAuthorizationRef=AP_All
              DcmDspStartRoutineIn
                3 x DcmDspStartRoutineInSignal, all with DcmDspRoutineSignalEndianness=opaque:
                  DcmDspStartRoutineInSignal_0: DcmDspRoutineSignalLength=8, DcmDspRoutineSignalPos=0, DcmDspRoutineSignalType=UINT8
                  DcmDspStartRoutineInSignal_1: DcmDspRoutineSignalLength=8, DcmDspRoutineSignalPos=8, DcmDspRoutineSignalType=UINT8
                  DcmDspStartRoutineInSignal_2: DcmDspRoutineSignalLength=32032, DcmDspRoutineSignalPos=16, DcmDspRoutineSignalType=VARIABLE_LENGTH
              DcmDspStartRoutineOut
                3 x DcmDspStartRoutineOutSignal, all with DcmDspRoutineSignalEndianness=opaque:
                  DcmDspStartRoutineOutSignal_0: DcmDspRoutineSignalLength=8, DcmDspRoutineSignalPos=0, DcmDspRoutineSignalType=UINT8
                  DcmDspStartRoutineOutSignal_1: DcmDspRoutineSignalLength=8, DcmDspRoutineSignalPos=8, DcmDspRoutineSignalType=UINT8
                  DcmDspStartRoutineOutSignal_2: DcmDspRoutineSignalLength=24048, DcmDspRoutineSignalPos=16, DcmDspRoutineSignalType=VARIABLE_LENGTH
          Certificate_Self_Check: DcmDspRoutineIdentifier=615
            DcmDspStartRoutine: DcmDspStartRoutineCommonAuthorizationRef=AP_All
              DcmDspStartRoutineOut
                DcmDspStartRoutineOutSignal_0 (DcmDspStartRoutineOutSignal): DcmDspRoutineSignalEndianness=opaque, DcmDspRoutineSignalLength=8, DcmDspRoutineSignalPos=0, DcmDspRoutineSignalType=UINT8
                DcmDspStartRoutineOutSignal_1 (DcmDspStartRoutineOutSignal): DcmDspRoutineSignalEndianness=opaque, DcmDspRoutineSignalLength=144, DcmDspRoutineSignalPos=8, DcmDspRoutineSignalType=VARIABLE_LENGTH
          Enhance_Access_Rights: DcmDspRoutineIdentifier=609
            DcmDspStartRoutine: DcmDspStartRoutineCommonAuthorizationRef=AP_All
              DcmDspStartRoutineIn
                DcmDspStartRoutineInSignal_0 (DcmDspStartRoutineInSignal): DcmDspRoutineSignalEndianness=opaque, DcmDspRoutineSignalLength=16016, DcmDspRoutineSignalPos=0, DcmDspRoutineSignalType=VARIABLE_LENGTH
              DcmDspStartRoutineOut
                DcmDspStartRoutineOutSignal_0 (DcmDspStartRoutineOutSignal): DcmDspRoutineSignalEndianness=opaque, DcmDspRoutineSignalLength=8, DcmDspRoutineSignalPos=0, DcmDspRoutineSignalType=UINT8
                DcmDspStartRoutineOutSignal_1 (DcmDspStartRoutineOutSignal): DcmDspRoutineSignalEndianness=opaque, DcmDspRoutineSignalLength=8, DcmDspRoutineSignalPos=8, DcmDspRoutineSignalType=UINT8
          Get_Certificate_Entry: DcmDspRoutineIdentifier=637
            DcmDspStartRoutine: DcmDspStartRoutineCommonAuthorizationRef=AP_Comb_0015
              DcmDspStartRoutineIn
                DcmDspStartRoutineInSignal_0 (DcmDspStartRoutineInSignal): DcmDspRoutineSignalEndianness=opaque, DcmDspRoutineSignalLength=8, DcmDspRoutineSignalPos=0, DcmDspRoutineSignalType=UINT8
                DcmDspStartRoutineInSignal_1 (DcmDspStartRoutineInSignal): DcmDspRoutineSignalEndianness=opaque, DcmDspRoutineSignalLength=8, DcmDspRoutineSignalPos=8, DcmDspRoutineSignalType=UINT8
              DcmDspStartRoutineOut
                5 x DcmDspStartRoutineOutSignal, all with DcmDspRoutineSignalEndianness=opaque:
                  DcmDspStartRoutineOutSignal_0: DcmDspRoutineSignalLength=8, DcmDspRoutineSignalPos=0, DcmDspRoutineSignalType=UINT8
                  DcmDspStartRoutineOutSignal_1: DcmDspRoutineSignalLength=8, DcmDspRoutineSignalPos=8, DcmDspRoutineSignalType=UINT8
                  DcmDspStartRoutineOutSignal_2: DcmDspRoutineSignalLength=8, DcmDspRoutineSignalPos=16, DcmDspRoutineSignalType=UINT8
                  DcmDspStartRoutineOutSignal_3: DcmDspRoutineSignalLength=8, DcmDspRoutineSignalPos=24, DcmDspRoutineSignalType=UINT8
                  DcmDspStartRoutineOutSignal_4: DcmDspRoutineSignalLength=512, DcmDspRoutineSignalPos=32, DcmDspRoutineSignalType=VARIABLE_LENGTH
          Inject_Seed: DcmDspRoutineIdentifier=636
            DcmDspStartRoutine: DcmDspStartRoutineCommonAuthorizationRef=AP_Comb_0001
              DcmDspStartRoutineIn
                3 x DcmDspStartRoutineInSignal, all with DcmDspRoutineSignalEndianness=opaque:
                  DcmDspStartRoutineInSignal_0: DcmDspRoutineSignalLength=256, DcmDspRoutineSignalPos=0, DcmDspRoutineSignalType=UINT8_N
                  DcmDspStartRoutineInSignal_1: DcmDspRoutineSignalLength=512, DcmDspRoutineSignalPos=256, DcmDspRoutineSignalType=UINT8_N
                  DcmDspStartRoutineInSignal_2: DcmDspRoutineSignalLength=8464, DcmDspRoutineSignalPos=768, DcmDspRoutineSignalType=VARIABLE_LENGTH
              DcmDspStartRoutineOut
                DcmDspStartRoutineOutSignal_0 (DcmDspStartRoutineOutSignal): DcmDspRoutineSignalEndianness=opaque, DcmDspRoutineSignalLength=8, DcmDspRoutineSignalPos=0, DcmDspRoutineSignalType=UINT8
                DcmDspStartRoutineOutSignal_1 (DcmDspStartRoutineOutSignal): DcmDspRoutineSignalEndianness=opaque, DcmDspRoutineSignalLength=8, DcmDspRoutineSignalPos=8, DcmDspRoutineSignalType=UINT8
          Replace_Certificates: DcmDspRoutineIdentifier=612
            DcmDspStartRoutine: DcmDspStartRoutineCommonAuthorizationRef=AP_Comb_0023
              DcmDspStartRoutineIn
                DcmDspStartRoutineInSignal_0 (DcmDspStartRoutineInSignal): DcmDspRoutineSignalEndianness=opaque, DcmDspRoutineSignalLength=32064, DcmDspRoutineSignalPos=0, DcmDspRoutineSignalType=VARIABLE_LENGTH
              DcmDspStartRoutineOut
                DcmDspStartRoutineOutSignal_0 (DcmDspStartRoutineOutSignal): DcmDspRoutineSignalEndianness=opaque, DcmDspRoutineSignalLength=8, DcmDspRoutineSignalPos=0, DcmDspRoutineSignalType=UINT8
                DcmDspStartRoutineOutSignal_1 (DcmDspStartRoutineOutSignal): DcmDspRoutineSignalEndianness=opaque, DcmDspRoutineSignalLength=8, DcmDspRoutineSignalPos=8, DcmDspRoutineSignalType=UINT8
          Replace_Trust_model_Certificates: DcmDspRoutineIdentifier=628
            DcmDspStartRoutine: DcmDspStartRoutineCommonAuthorizationRef=AP_Comb_0023
              DcmDspStartRoutineIn
                DcmDspStartRoutineInSignal_0 (DcmDspStartRoutineInSignal): DcmDspRoutineSignalEndianness=opaque, DcmDspRoutineSignalLength=24048, DcmDspRoutineSignalPos=0, DcmDspRoutineSignalType=VARIABLE_LENGTH
              DcmDspStartRoutineOut
                DcmDspStartRoutineOutSignal_0 (DcmDspStartRoutineOutSignal): DcmDspRoutineSignalEndianness=opaque, DcmDspRoutineSignalLength=8, DcmDspRoutineSignalPos=0, DcmDspRoutineSignalType=UINT8
                DcmDspStartRoutineOutSignal_1 (DcmDspStartRoutineOutSignal): DcmDspRoutineSignalEndianness=opaque, DcmDspRoutineSignalLength=8, DcmDspRoutineSignalPos=8, DcmDspRoutineSignalType=UINT8
          Replace_Trust_model_Root_Certificate: DcmDspRoutineIdentifier=631
            DcmDspStartRoutine: DcmDspStartRoutineCommonAuthorizationRef=AP_Comb_0001
              DcmDspStartRoutineIn
                3 x DcmDspStartRoutineInSignal, all with DcmDspRoutineSignalEndianness=opaque:
                  DcmDspStartRoutineInSignal_0: DcmDspRoutineSignalLength=512, DcmDspRoutineSignalPos=0, DcmDspRoutineSignalType=UINT8_N
                  DcmDspStartRoutineInSignal_1: DcmDspRoutineSignalLength=512, DcmDspRoutineSignalPos=512, DcmDspRoutineSignalType=UINT8_N
                  DcmDspStartRoutineInSignal_2: DcmDspRoutineSignalLength=16032, DcmDspRoutineSignalPos=1024, DcmDspRoutineSignalType=VARIABLE_LENGTH
              DcmDspStartRoutineOut
                DcmDspStartRoutineOutSignal_0 (DcmDspStartRoutineOutSignal): DcmDspRoutineSignalEndianness=opaque, DcmDspRoutineSignalLength=8, DcmDspRoutineSignalPos=0, DcmDspRoutineSignalType=UINT8
                DcmDspStartRoutineOutSignal_1 (DcmDspStartRoutineOutSignal): DcmDspRoutineSignalEndianness=opaque, DcmDspRoutineSignalLength=8, DcmDspRoutineSignalPos=8, DcmDspRoutineSignalType=UINT8
          Reset_VIN_Values: DcmDspRoutineIdentifier=530
            DcmDspStartRoutine: DcmDspStartRoutineCommonAuthorizationRef=AP_Comb_0015
              DcmDspStartRoutineOut
                DcmDspStartRoutineOutSignal_0 (DcmDspStartRoutineOutSignal): DcmDspRoutineSignalEndianness=opaque, DcmDspRoutineSignalLength=8, DcmDspRoutineSignalPos=0, DcmDspRoutineSignalType=UINT8
          Status_of_Post_Production_Flag: DcmDspRoutineIdentifier=616, DcmRbDspReqSequenceErrorEnabled=false
            DcmDspRequestRoutineResults: DcmDspRequestRoutineResultsCommonAuthorizationRef=AP_Comb_0001
              DcmDspRequestRoutineResultsOut
                DcmDspRequestRoutineResultsOutSignal_0 (DcmDspRequestRoutineResultsOutSignal): DcmDspRoutineSignalEndianness=opaque, DcmDspRoutineSignalLength=8, DcmDspRoutineSignalPos=0, DcmDspRoutineSignalType=UINT8
                DcmDspRequestRoutineResultsOutSignal_1 (DcmDspRequestRoutineResultsOutSignal): DcmDspRoutineSignalEndianness=opaque, DcmDspRoutineSignalLength=8, DcmDspRoutineSignalPos=8, DcmDspRoutineSignalType=UINT8
            DcmDspStartRoutine: DcmDspStartRoutineCommonAuthorizationRef=AP_Comb_0001
              DcmDspStartRoutineIn
                DcmDspStartRoutineInSignal_0 (DcmDspStartRoutineInSignal): DcmDspRoutineSignalEndianness=opaque, DcmDspRoutineSignalLength=8, DcmDspRoutineSignalPos=0, DcmDspRoutineSignalType=UINT8
              DcmDspStartRoutineOut
                DcmDspStartRoutineOutSignal_0 (DcmDspStartRoutineOutSignal): DcmDspRoutineSignalEndianness=opaque, DcmDspRoutineSignalLength=8, DcmDspRoutineSignalPos=0, DcmDspRoutineSignalType=UINT8
                DcmDspStartRoutineOutSignal_1 (DcmDspStartRoutineOutSignal): DcmDspRoutineSignalEndianness=opaque, DcmDspRoutineSignalLength=8, DcmDspRoutineSignalPos=8, DcmDspRoutineSignalType=UINT8
            DcmDspStopRoutine: DcmDspStopRoutineCommonAuthorizationRef=AP_Comb_0001
              DcmDspStopRoutineIn
                DcmDspStopRoutineInSignal_0 (DcmDspStopRoutineInSignal): DcmDspRoutineSignalEndianness=opaque, DcmDspRoutineSignalLength=8, DcmDspRoutineSignalPos=0, DcmDspRoutineSignalType=UINT8
              DcmDspStopRoutineOut
                DcmDspStopRoutineOutSignal_0 (DcmDspStopRoutineOutSignal): DcmDspRoutineSignalEndianness=opaque, DcmDspRoutineSignalLength=8, DcmDspRoutineSignalPos=0, DcmDspRoutineSignalType=UINT8
                DcmDspStopRoutineOutSignal_1 (DcmDspStopRoutineOutSignal): DcmDspRoutineSignalEndianness=opaque, DcmDspRoutineSignalLength=8, DcmDspRoutineSignalPos=8, DcmDspRoutineSignalType=UINT8
          Synchronize_Secured_System_Date_and_Time: DcmDspRoutineIdentifier=614
            DcmDspStartRoutine: DcmDspStartRoutineCommonAuthorizationRef=AP_All
              DcmDspStartRoutineOut
                DcmDspStartRoutineOutSignal_0 (DcmDspStartRoutineOutSignal): DcmDspRoutineSignalEndianness=opaque, DcmDspRoutineSignalLength=8, DcmDspRoutineSignalPos=0, DcmDspRoutineSignalType=UINT8
                DcmDspStartRoutineOutSignal_1 (DcmDspStartRoutineOutSignal): DcmDspRoutineSignalEndianness=opaque, DcmDspRoutineSignalLength=256, DcmDspRoutineSignalPos=8, DcmDspRoutineSignalType=UINT8_N
          Trust_Model_Generate_Key_Pair: DcmDspRoutineIdentifier=635
            DcmDspStartRoutine: DcmDspStartRoutineCommonAuthorizationRef=AP_Comb_0001
              DcmDspStartRoutineOut
                4 x DcmDspStartRoutineOutSignal, all with DcmDspRoutineSignalEndianness=opaque:
                  DcmDspStartRoutineOutSignal_0: DcmDspRoutineSignalLength=8, DcmDspRoutineSignalPos=0, DcmDspRoutineSignalType=UINT8
                  DcmDspStartRoutineOutSignal_1: DcmDspRoutineSignalLength=8, DcmDspRoutineSignalPos=8, DcmDspRoutineSignalType=UINT8
                  DcmDspStartRoutineOutSignal_2: DcmDspRoutineSignalLength=512, DcmDspRoutineSignalPos=16, DcmDspRoutineSignalType=UINT8_N
                  DcmDspStartRoutineOutSignal_3: DcmDspRoutineSignalLength=8016, DcmDspRoutineSignalPos=528, DcmDspRoutineSignalType=VARIABLE_LENGTH
          Trust_Model_SecOC_ECU_Shared_Secret_Distribution: DcmDspRoutineIdentifier=633
            DcmDspStartRoutine: DcmDspStartRoutineCommonAuthorizationRef=AP_Comb_0001
              DcmDspStartRoutineIn
                7 x DcmDspStartRoutineInSignal, all with DcmDspRoutineSignalEndianness=opaque:
                  DcmDspStartRoutineInSignal_0: DcmDspRoutineSignalLength=56, DcmDspRoutineSignalPos=0, DcmDspRoutineSignalType=UINT8_N
                  DcmDspStartRoutineInSignal_1: DcmDspRoutineSignalLength=40, DcmDspRoutineSignalPos=56, DcmDspRoutineSignalType=UINT8_N
                  DcmDspStartRoutineInSignal_2: DcmDspRoutineSignalLength=40, DcmDspRoutineSignalPos=96, DcmDspRoutineSignalType=UINT8_N
                  DcmDspStartRoutineInSignal_3: DcmDspRoutineSignalLength=640, DcmDspRoutineSignalPos=136, DcmDspRoutineSignalType=UINT8_N
                  DcmDspStartRoutineInSignal_4: DcmDspRoutineSignalLength=256, DcmDspRoutineSignalPos=776, DcmDspRoutineSignalType=UINT8_N
                  DcmDspStartRoutineInSignal_5: DcmDspRoutineSignalLength=512, DcmDspRoutineSignalPos=1032, DcmDspRoutineSignalType=UINT8_N
                  DcmDspStartRoutineInSignal_6: DcmDspRoutineSignalLength=24048, DcmDspRoutineSignalPos=1544, DcmDspRoutineSignalType=VARIABLE_LENGTH
              DcmDspStartRoutineOut
                DcmDspStartRoutineOutSignal_0 (DcmDspStartRoutineOutSignal): DcmDspRoutineSignalEndianness=opaque, DcmDspRoutineSignalLength=8, DcmDspRoutineSignalPos=0, DcmDspRoutineSignalType=UINT8
                DcmDspStartRoutineOutSignal_1 (DcmDspStartRoutineOutSignal): DcmDspRoutineSignalEndianness=opaque, DcmDspRoutineSignalLength=8, DcmDspRoutineSignalPos=8, DcmDspRoutineSignalType=UINT8
        DcmDspSession
          3 x DcmDspSessionRow, all with DcmDspSessionP2ServerMax=0.02, DcmDspSessionP2StarServerMax=2:
            DEFAULT_SESSION: DcmDspSessionForBoot=DCM_NO_BOOT, DcmDspSessionLevel=1
            EXTENDED_DIAGNOSTIC_SESSION: DcmDspSessionForBoot=DCM_NO_BOOT, DcmDspSessionLevel=3
            PROGRAMMING_SESSION: DcmDspSessionForBoot=DCM_SYS_BOOT, DcmDspSessionLevel=2
    DcmGeneral: DcmVinRef=DcmDsp/VINDataIdentifier
