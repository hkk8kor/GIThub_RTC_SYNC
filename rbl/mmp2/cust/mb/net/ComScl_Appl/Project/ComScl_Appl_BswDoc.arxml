AUTOSAR XML (schema 4-0-3)
package /RB/RBA/BswModuleDescriptions
  sw-component-documentation:
    sw feature def BswDocDef
      5 x chapter:
        BswDocDefPurpose: p=l-1=The Nds component provides a uniformed interaction platform to configure a network communication stack. Currently the network types CAN, LIN and Flexray are supported. Intention of the NDS is to abstract the AUTOSAR layered architecture and give an function overview to the involved stakeholder at project team and customer  # Purpose
        BswDocDefIntroduction: p=l-1=Nds enable BSW developers to provide specific adequate configuration concepts (esp. editors and importers) in BCT., p=l-1=Hotspot is to prepare the proper configuration of CAN, LIN or Flexray network stack. It incorporates a first abstraction model and performs a forwarding of configuration data to the underlying AUTOSAR components.  # Introduction
        BswDocDefInteraction  # Interaction
        BswDocDefFeatures:  # Features
          p=l-1=Prepare a easy identification of the network
          list=[p=l-1=Networks, p=l-1=Frames, p=l-1=Pdus]
          list=item=p=l-1=Signals, Signal groups
          p=l-1=Based on this network information the assigment to a dedicated Ecu and its variants can be choosen and configured. Additionally standard evaluations may be added
          list=[p=l-1=Network, p=l-1=Frame, Pdu, p=l-1=Signalgroup, Signal]
          p=l-1=To transfer the model parameters to the underlying AUTOSAR components the forwarding mechanism of the AUTOSAR workbench is utilized
        BswDocDefSubstructure  # Substructure
    sw feature desc BswDocDesc
      5 x chapter:
        BswDocDescBehaviorNormalMode: p=l-1=Refer to assigned information at the respective configuration elements  # Behavior in normal mode
        BswDocDescBehaviorInitialization: p=l-1=Refer to assigned information at the respective configuration elements  # Behavior in initialization
        BswDocDescBehaviorShutdown: p=l-1=Refer to assigned information at the respective configuration elements  # Behavior in shutdown
        BswDocDescBehaviorConfiguration: p=l-1=The definitions inside this document are automatically generated from the BCT network configuration toolchain. The definitions shall be regarded as the valid definition of the Ecu and so can be used for reviw an discussion with external and internal development partners.  # Network definition
        BswDocDescBehaviorAssignedComponentConfiguration: p=l-1=Currently the following component can be forwarded or directly generated based on the rba_Nds definition, list=[[l-1=AUTOSAR components:, l-1=CAN: CanDrv, CanIf, l-1=LIN: LinDrv. LinIf, l-1=Flexray: FrDrv, FrIf, l-1=Generic: PduR, Com, EcuC], [l-1=Legacy components:, l-1=DGS: ComScl, Scl]]  # Supported components
    sw calibration notes BswDocCalibration
      chapter BswDocCalibrationMeasurements  # Measurements
      chapter BswDocCalibrationParameters  # Calibration parameters
    9 x chapter:
      BswDocGlossary  # Glossary
      BswDocArDeviations  # Deviations from AUTOSAR specification
        chapter BswDocArDeviationsPermanent  # Permanent deviations
        chapter BswDocArDeviationsTemporary  # Temporary deviations
      BswDocInterfaces  # Interface reference
        5 x chapter:
          BswDocInterfaceEcuc  # Configuration interface
          BswDocInterfaceCalibration  # Calibration interface
            chapter BswDocInterfaceCalibrationMeasurements  # Measurements
            chapter BswDocInterfaceCalibrationParameters  # Calibration parameters
          BswDocInterfaceRte  # RTE interface
            6 x chapter:
              BswDocInterfaceRteClientServer  # Client/server interfaces
              BswDocInterfaceRteData  # Data interfaces
              BswDocInterfaceRteModeSwitch  # Mode switch interfaces
              BswDocInterfaceRteTrigger  # Trigger interfaces
              BswDocInterfaceRtePPorts  # Provided ports
              BswDocInterfaceRteRPorts  # Required ports
          BswDocInterfaceC  # C interface
            7 x chapter:
              BswDocInterfaceCProvidedFunctions  # Provided functions
              BswDocInterfaceCOutgoingCallbacks  # Outgoing callbacks
              BswDocInterfaceCMacros  # Macros
              BswDocInterfaceCPreproc  # Preprocessor constants
              BswDocInterfaceCDataTypes  # Data types
              BswDocInterfaceCConstants  # Constants
              BswDocInterfaceCVariables  # Variables
          BswDocInterfaceSched  # Scheduling interface
      BswDocEnvNeeds  # Environment needs
        5 x chapter:
          BswDocEnvNeedsDemEvents  # Dem events
          BswDocEnvNeedsDetEvents  # Det events
          BswDocEnvNeedsNvBlocks  # Non-volatile memory blocks
          BswDocEnvNeedsExclAreas  # Exclusive areas
          BswDocEnvNeedsMemMap  # Memory mapping
      BswDocDependencies  # Dependencies
        4 x chapter:
          BswDocDependenciesCompPac  # Other components/packages
          BswDocDependenciesSw  # Software environment
          BswDocDependenciesHw  # Hardware environment
          BswDocDependenciesTools: p=l-1=rba_Nds is highly dependent on AUTOSAR workbench. Function are only ensured if the following release is used, list=[p=l-1=AWB 2013.2.1, p=l-1=EcuWorks 2013.2.1]  # Tool environment
      BswDocVariants  # Variant handling
        chapter BswDocVariantsSysConst  # System constants
        chapter BswDocVariantsFileSelection  # File selection
        chapter BswDocVariantsTemplCust  # Template customization
      BswDocIntegration  # Integration
        4 x chapter:
          BswDocIntegrationEffort  # Estimated effort
          BswDocIntegrationHowTo  # How to integrate
          BswDocIntegrationSched  # Scheduling aspects
          BswDocIntegrationBuild  # Build aspects
      BswDocUseCases  # Use cases
      BswDocMisc  # Miscellaneous
