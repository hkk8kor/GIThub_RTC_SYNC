AUTOSAR XML (schema 4-2-2)
package /RB/RBC/rbc_XCoreDefaults/EcucModuleDefs
  module definition rbc_XCoreDefaults [0..1]: category=VENDOR_SPECIFIC_MODULE_DEFINITION, refined-module-def=Dio, variants pre-compile  # XCoreDefaults | Configuration of default Xcore assignement
    container rbc_XCoreDefaults_XCoreDefaultsFrameProcsessingAllocation [0..*]  # XCoreDefaultsFrameProcsessingAllocation | Allocation of Processing allocation to Frame
      enumeration rbc_XCoreDefaults_FrameProcessingType: {RECEIVE, TRANSMIT, TXCONFIRMATION}, multiplicity set at pre-compile, origin=RB:1.0.0:2021-03-01  # FrameProcessingType | Processing type based on the direction
      choice reference rbc_XCoreDefaults_rbaNdsConnectorRef: origin=RB:1.0.0:2021-03-01, destination=[rba_Nds_CanConnector, rba_Nds_FlexRayConnector]  # rbaNdsConnectorRef | Reference to the Connector containing the frames
      reference rbc_XCoreDefaults_rbaNdsProcessingAllocationRef: multiplicity set at pre-compile, origin=RB:1.0.0:2021-03-01, destination=rba_Nds_ProcessingAllocation  # rbaNdsProcessingAllocationRef | The processing allocation assigned to the frames
    container rbc_XCoreDefaults_XCoreDefaultsPduProcsessingAllocation [0..*]  # XCoreDefaultsPduProcsessingAllocation | Allocation of Processing allocation to PDU
      enumeration rbc_XCoreDefaults_PduProcessingType: {RECEIVE, TRANSMIT, TXCONFIRMATION}, multiplicity set at pre-compile, origin=RB:1.0.0:2021-03-01  # PduProcessingType | Processing type based on the direction
      enumeration rbc_XCoreDefaults_PduType: {CONTAINER_PDU, MULTIPLEXED_PDU, SECURED_PDU, SIGNAL_PDU}, multiplicity set at pre-compile, origin=RB:1.0.0:2021-03-01  # PduType | Type of the PDU
      choice reference rbc_XCoreDefaults_rbaNdsConnectorRef: origin=RB:1.0.0:2021-03-01, destination=[rba_Nds_CanConnector, rba_Nds_FlexRayConnector]  # rbaNdsConnectorRef | Reference to the Connector containing the pdus
      reference rbc_XCoreDefaults_rbaNdsProcessingAllocationRef: origin=RB:1.0.0:2021-03-01, set at published-information, destination=rba_Nds_ProcessingAllocation  # rbaNdsProcessingAllocationRef | The processing allocation assigned to the pdus
