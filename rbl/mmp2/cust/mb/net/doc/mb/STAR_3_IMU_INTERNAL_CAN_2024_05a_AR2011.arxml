[part 1 of 2: packages /Units to /ISignalGroups/IMU_INTERNAL/PKG_IMU_INTERNAL/IMU_B_Output_ST3]
AUTOSAR XML (schema 00049)
# Copyright (c) 2024 Mercedes-Benz AG
standard types defined: boolean, uint16, uint32, uint8
package /Units
  16 x unit:
    percent: display-name=%  # %
    A: display-name=A
    Impulses: display-name=Impulses
    km: display-name=km
    km_per_h: display-name=km/h  # km/h
    m_per_s_sq: display-name=m/s²  # m/s²
    ms: display-name=ms
    NoUnit: display-name=NoUnit
    ns: display-name=ns
    rpm: display-name=rpm
    s: display-name=s
    V: display-name=V
    deg: display-name=°  # °
    deg_per_s: display-name=°/s  # °/s
    deg_per_s_sq: display-name=°/s²  # °/s²
    deg_C: display-name=°C  # °C
package /ImplementationDataTypes
  52 x impl type, all with category=TYPE_REFERENCE:
    c02_GTS_ESP_Clk_Stat_ST3: data-constr=c02_GTS_ESP_Clk_Stat_ST3, implementation-data-type=uint8  # 02_GTS_ESP_Clk_Stat_ST3
    c02_Inact_Act_ST3: data-constr=c02_Inact_Act_ST3, implementation-data-type=uint8, invalid-value=3  # 02_Inact_Act_ST3
    c02_Ndef_False_True_ST3: data-constr=c02_Ndef_False_True_ST3, implementation-data-type=uint8, invalid-value=3  # 02_Ndef_False_True_ST3
    c02_PT_Rdy_V2: data-constr=c02_PT_Rdy_V2, implementation-data-type=uint8, invalid-value=3  # 02_PT_Rdy_V2
    c02_Signal_Qual: data-constr=c02_Signal_Qual, implementation-data-type=uint8  # 02_SignalQual
    c02_TmSync_Stat: data-constr=c02_TmSync_Stat, implementation-data-type=uint8, invalid-value=3  # 02_TmSync_Stat
    c02_TransMd_Stat: data-constr=c02_TransMd_Stat, implementation-data-type=uint8, invalid-value=3  # 02_TransMd_Stat
    c02_WhlDir: data-constr=c02_WhlDir, implementation-data-type=uint8, invalid-value=3  # 02_WhlDir
    c03_EngStartPN14_Stat: data-constr=c03_EngStartPN14_Stat, implementation-data-type=uint8, invalid-value=7  # 03_EngStartPN14_Stat_ST3
    c03_IMU_Force_Ang_Stat_ST3: data-constr=c03_IMU_Force_Ang_Stat_ST3, implementation-data-type=uint8  # 03_IMU_Force_Ang_Stat_ST3
    c03_IMU_Stat_ST3: data-constr=c03_IMU_Stat_ST3, implementation-data-type=uint8  # 03_IMU_Stat_ST3
    c03_ISw_Stat: data-constr=c03_ISw_Stat, implementation-data-type=uint8, invalid-value=7  # 03_ISw_Stat
    c03_PN14_ProdMd_Stat_ST3: data-constr=c03_PN14_ProdMd_Stat_ST3, implementation-data-type=uint8, invalid-value=7  # 03_PN14_ProdMd_Stat_ST3
    c03_PN14_TDP_Sw_Stat: data-constr=c03_PN14_TDP_Sw_Stat, implementation-data-type=uint8, invalid-value=7  # 03_PN14_TDP_Sw_Stat
    c04_VehOpMode: data-constr=c04_VehOpMode, implementation-data-type=uint8, invalid-value=15  # 04_VehOpMode
    c07_per_0to100_1_SNA: data-constr=c07_per_0to100_1_SNA, implementation-data-type=uint8, invalid-value=127  # 07_%_0-100_1_SNA
    c07_0_111_1_SNA: data-constr=c07_0_111_1_SNA, implementation-data-type=uint8, invalid-value=127  # 07_0-111_SNA
    c08_0_254_1_SNA_255: data-constr=c08_0_254_1_SNA_255, implementation-data-type=uint8, invalid-value=255  # 08_0-254_1_SNA=255
    c08_0_255_1_SNA_na: data-constr=c08_0_255_1_SNA_na, implementation-data-type=uint8  # 08_0-255_1_SNA=-
    c08_Platform_Stat: data-constr=c08_Platform_Stat, implementation-data-type=uint8, invalid-value=255  # 08_Platform_Stat
    c08_ROE_0: data-constr=c08_ROE_0, implementation-data-type=uint8  # 08_ROE_0
    c08_TmSync_Stat: implementation-data-type=uint8  # 08_TmSync_Stat
    c08_UInt_SNA_na: data-constr=c08_UInt_SNA_na, implementation-data-type=uint8  # 08_UInt_SNA=-
    c08_deg_m50_160_1: data-constr=c08_deg_m50_160_1, implementation-data-type=uint8, invalid-value=255  # 08_°_-50-+160_1
    c08_degC_m40_85_0k5: data-constr=c08_degC_m40_85_0k5, implementation-data-type=uint8, invalid-value=255  # 08_°C_-40-+85_0,5
    c10_Impulses_0_1022_1: data-constr=c10_Impulses_0_1022_1, implementation-data-type=uint16, invalid-value=1023  # 10_Impulses_0-1022_1
    c10_V_0_25k55_0k025: data-constr=c10_V_0_25k55_0k025, implementation-data-type=uint16, invalid-value=1023  # 10_V_0-25,55_0,025
    c10_WakeupRsn_ST3: data-constr=c10_WakeupRsn_ST3, implementation-data-type=uint16, invalid-value=1023  # 10_WakeupRsn_ST3
    c12_0_4094_1_SNA: data-constr=c12_0_4094_1_SNA, implementation-data-type=uint16, invalid-value=4095  # 12_0-4094_1_SNA
    c12_km_p_h_0_409k4_0k1: data-constr=c12_km_p_h_0_409k4_0k1, implementation-data-type=uint16, invalid-value=4095  # 12_km/h_0-409,4_0,1
    c13_A_m409k6_409k4_0k1: data-constr=c13_A_m409k6_409k4_0k1, implementation-data-type=uint16, invalid-value=8191  # 13_A_-409,6-409,4_0,1
    c14_rpm_0_8191_0k5: data-constr=c14_rpm_0_8191_0k5, implementation-data-type=uint16, invalid-value=16383  # 14_rpm_0-8191_0,5
    c16_CRC_woSNA: data-constr=c16_CRC_woSNA, implementation-data-type=uint16  # 16_CRC_w/oSNA
    c16_m_pro_s_sq_m50_50_0d002: data-constr=c16_m_pro_s_sq_m50_50_0d002, implementation-data-type=uint16, invalid-value=65535  # 16_m/s²_-50_+50_0.002
    c16_ms_0_6553d5_0d1_noSNA: data-constr=c16_ms_0_6553d5_0d1_noSNA, implementation-data-type=uint16  # 16_ms_0-6553,5_0,1_w/o_SNA
    c16_deg_per_sec_m300_300_0d01: data-constr=c16_deg_per_sec_m300_300_0d01, implementation-data-type=uint16, invalid-value=65535  # 16_°/s_-300-+300_0,01
    c16_deg_per_s_sq_m1200_1200_0d04: data-constr=c16_deg_per_s_sq_m1200_1200_0d04, implementation-data-type=uint16, invalid-value=65535  # 16_°/s²_-1200-+1200_0,04
    c24_km_0_999999k9_0k1_Invld_SNA: data-constr=c24_km_0_999999k9_0k1_Invld_SNA, implementation-data-type=uint32, invalid-value=16777215  # 24_km_0-999999,9_0,1_Invld_SNA
    c32_ns_0_4294967295_1_noSNA: data-constr=c32_ns_0_4294967295_1_noSNA, implementation-data-type=uint32  # 32_ns_0-4294967295_1_noSNA
    c32_s_0_4294967295_1_noSNA: data-constr=c32_s_0_4294967295_1_noSNA, implementation-data-type=uint32  # 32_s_0-4294967295_1_noSNA
    DC_BOOL: implementation-data-type=boolean
    NM_ActvWakeup: implementation-data-type=boolean
    NM_Coord_Id: range raw 0..3, implementation-data-type=uint8
    NM_Coord_SleepRdy: implementation-data-type=boolean
    NM_PartNw_Info: implementation-data-type=boolean
    NM_RepeatMsg_Rq: implementation-data-type=boolean
    Rsrv01: range raw 0..1, implementation-data-type=uint8, invalid-value=1
    Rsrv03: range raw 0..7, implementation-data-type=uint8, invalid-value=7
    Rsrv04: range raw 0..15, implementation-data-type=uint8, invalid-value=15
    Rsrv08: range raw 0..255, implementation-data-type=uint8, invalid-value=255
    Rsrv09: range raw 0..511, implementation-data-type=uint16, invalid-value=511
    Rsrv16: range raw 0..65535, implementation-data-type=uint16, invalid-value=65535
package /DataConstraints
  range c02_GTS_ESP_Clk_Stat_ST3: raw 0..2  # 02_GTS_ESP_Clk_Stat_ST3
  range c02_Inact_Act_ST3: raw 0..3  # 02_Inact_Act_ST3
  range c02_Ndef_False_True_ST3: raw 1..3  # 02_Ndef_False_True_ST3
  range c02_PT_Rdy_V2: raw 0..3  # 02_PT_Rdy_V2
  range c02_Signal_Qual: raw 0..3  # 02_SignalQual
  range c02_TmSync_Stat: raw 0..3  # 02_TmSync_Stat
  range c02_TransMd_Stat: raw 0..3  # 02_TransMd_Stat
  range c02_WhlDir: raw 0..3  # 02_WhlDir
  range c03_EngStartPN14_Stat: raw 0..7  # 03_EngStartPN14_Stat_ST3
  range c03_IMU_Force_Ang_Stat_ST3: raw 0..6  # 03_IMU_Force_Ang_Stat_ST3
  range c03_IMU_Stat_ST3: raw 0..4  # 03_IMU_Stat_ST3
  range c03_ISw_Stat: raw 0..7  # 03_ISw_Stat
  range c03_PN14_ProdMd_Stat_ST3: raw 0..7  # 03_PN14_ProdMd_Stat_ST3
  range c03_PN14_TDP_Sw_Stat: raw 0..7  # 03_PN14_TDP_Sw_Stat
  range c04_VehOpMode: raw 0..15  # 04_VehOpMode
  range c07_per_0to100_1_SNA: phys 0..127, raw 0..127  # 07_%_0-100_1_SNA
  range c07_0_111_1_SNA: phys 0..127, raw 0..127  # 07_0-111_SNA
  range c08_0_254_1_SNA_255: phys 0..255, raw 0..255  # 08_0-254_1_SNA=255
  range c08_0_255_1_SNA_na: phys 0..255, raw 0..255  # 08_0-255_1_SNA=-
  range c08_Platform_Stat: raw 0..255  # 08_Platform_Stat
  range c08_ROE_0: raw 0..6  # 08_ROE_0
  range c08_UInt_SNA_na: raw 0..255  # 08_UInt_SNA=-
  range c08_deg_m50_160_1: phys -50..205, raw 0..255  # 08_°_-50-+160_1
  range c08_degC_m40_85_0k5: phys -40..87.5, raw 0..255  # 08_°C_-40-+85_0,5
  range c10_Impulses_0_1022_1: phys 0..1023, raw 0..1023  # 10_Impulses_0-1022_1
  range c10_V_0_25k55_0k025: phys 0..25.575, raw 0..1023  # 10_V_0-25,55_0,025
  range c10_WakeupRsn_ST3: raw 0..1023  # 10_WakeupRsn_ST3
  range c12_0_4094_1_SNA: phys 0..4095, raw 0..4095  # 12_0-4094_1_SNA
  range c12_km_p_h_0_409k4_0k1: phys 0..409.5, raw 0..4095  # 12_km/h_0-409,4_0,1
  range c13_A_m409k6_409k4_0k1: phys -409.6..409.5, raw 0..8191  # 13_A_-409,6-409,4_0,1
  range c14_rpm_0_8191_0k5: phys 0..8191.5, raw 0..16383  # 14_rpm_0-8191_0,5
  range c16_CRC_woSNA: raw 0..65535  # 16_CRC_w/oSNA
  range c16_m_pro_s_sq_m50_50_0d002: phys -50..81.07, raw 0..65535  # 16_m/s²_-50_+50_0.002
  range c16_ms_0_6553d5_0d1_noSNA: phys 0..6553.5, raw 0..65535  # 16_ms_0-6553,5_0,1_w/o_SNA
  range c16_deg_per_sec_m300_300_0d01: phys -300..355.35, raw 0..65535  # 16_°/s_-300-+300_0,01
  range c16_deg_per_s_sq_m1200_1200_0d04: phys -1200..1421.4, raw 0..65535  # 16_°/s²_-1200-+1200_0,04
  range c24_km_0_999999k9_0k1_Invld_SNA: phys 0..1677721.5, raw 0..16777215  # 24_km_0-999999,9_0,1_Invld_SNA
  range c32_ns_0_4294967295_1_noSNA: phys 0..4294967295, raw 0..4294967295  # 32_ns_0-4294967295_1_noSNA
  range c32_s_0_4294967295_1_noSNA: phys 0..4294967295, raw 0..4294967295  # 32_s_0-4294967295_1_noSNA
package /ApplicationDataTypes
  52 x app type:
    c02_GTS_ESP_Clk_Stat_ST3: category=VALUE, compu-method=c02_GTS_ESP_Clk_Stat_ST3, data-constr=c02_GTS_ESP_Clk_Stat_ST3  # 02_GTS_ESP_Clk_Stat_ST3
    c02_Inact_Act_ST3: category=VALUE, compu-method=c02_Inact_Act_ST3, data-constr=c02_Inact_Act_ST3, invalid-value=I_C02_INACT_ACT_ST3_SNA  # 02_Inact_Act_ST3
    c02_Ndef_False_True_ST3: category=VALUE, compu-method=c02_Ndef_False_True_ST3, data-constr=c02_Ndef_False_True_ST3, invalid-value=I_C02_NDEF_FALSE_TRUE_ST3_SNA  # 02_Ndef_False_True_ST3
    c02_PT_Rdy_V2: category=VALUE, compu-method=c02_PT_Rdy_V2, data-constr=c02_PT_Rdy_V2, invalid-value=I_C02_PT_RDY_V2_SNA  # 02_PT_Rdy_V2
    c02_Signal_Qual: category=VALUE, compu-method=c02_Signal_Qual, data-constr=c02_Signal_Qual  # 02_SignalQual
    c02_TmSync_Stat: category=VALUE, compu-method=c02_TmSync_Stat, data-constr=c02_TmSync_Stat, invalid-value=I_C02_TMSYNC_STAT_SNA  # 02_TmSync_Stat
    c02_TransMd_Stat: category=VALUE, compu-method=c02_TransMd_Stat, data-constr=c02_TransMd_Stat, invalid-value=I_C02_TRANSMD_STAT_SNA  # 02_TransMd_Stat
    c02_WhlDir: category=VALUE, compu-method=c02_WhlDir, data-constr=c02_WhlDir, invalid-value=I_C02_WHLDIR_SNA  # 02_WhlDir
    c03_EngStartPN14_Stat: category=VALUE, compu-method=c03_EngStartPN14_Stat, data-constr=c03_EngStartPN14_Stat, invalid-value=I_C03_ENGSTARTPN14_STAT_SNA  # 03_EngStartPN14_Stat_ST3
    c03_IMU_Force_Ang_Stat_ST3: category=VALUE, compu-method=c03_IMU_Force_Ang_Stat_ST3, data-constr=c03_IMU_Force_Ang_Stat_ST3  # 03_IMU_Force_Ang_Stat_ST3
    c03_IMU_Stat_ST3: category=VALUE, compu-method=c03_IMU_Stat_ST3, data-constr=c03_IMU_Stat_ST3  # 03_IMU_Stat_ST3
    c03_ISw_Stat: category=VALUE, compu-method=c03_ISw_Stat, data-constr=c03_ISw_Stat, invalid-value=I_C03_ISW_STAT_SNA  # 03_ISw_Stat
    c03_PN14_ProdMd_Stat_ST3: category=VALUE, compu-method=c03_PN14_ProdMd_Stat_ST3, data-constr=c03_PN14_ProdMd_Stat_ST3, invalid-value=I_C03_PN14_PRODMD_STAT_ST3_SNA  # 03_PN14_ProdMd_Stat_ST3
    c03_PN14_TDP_Sw_Stat: category=VALUE, compu-method=c03_PN14_TDP_Sw_Stat, data-constr=c03_PN14_TDP_Sw_Stat, invalid-value=I_C03_PN14_TDP_SW_STAT_SNA  # 03_PN14_TDP_Sw_Stat
    c04_VehOpMode: category=VALUE, compu-method=c04_VehOpMode, data-constr=c04_VehOpMode, invalid-value=I_C04_VEHOPMODE_SNA  # 04_VehOpMode
    c07_per_0to100_1_SNA: category=VALUE, compu-method=c07_per_0to100_1_SNA, data-constr=c07_per_0to100_1_SNA, invalid-value=I_C07_PER_0TO100_1_SNA_SNA %, unit=%  # 07_%_0-100_1_SNA
    c07_0_111_1_SNA: category=VALUE, compu-method=c07_0_111_1_SNA, data-constr=c07_0_111_1_SNA, invalid-value=I_C07_0_111_1_SNA_SNA, unit=NoUnit  # 07_0-111_SNA
    c08_0_254_1_SNA_255: category=VALUE, compu-method=c08_0_254_1_SNA_255, data-constr=c08_0_254_1_SNA_255, invalid-value=I_C08_0_254_1_SNA_255_SNA, unit=NoUnit  # 08_0-254_1_SNA=255
    c08_0_255_1_SNA_na: category=VALUE, compu {identical}, data-constr=c08_0_255_1_SNA_na, unit=NoUnit  # 08_0-255_1_SNA=-
    c08_Platform_Stat: category=VALUE, compu-method=c08_Platform_Stat, data-constr=c08_Platform_Stat, invalid-value=I_C08_PLATFORM_STAT_SNA  # 08_Platform_Stat
    c08_ROE_0: category=VALUE, compu-method=c08_ROE_0, data-constr=c08_ROE_0  # 08_ROE_0
    c08_TmSync_Stat: category=VALUE, compu-method=c08_TmSync_Stat  # 08_TmSync_Stat
    c08_UInt_SNA_na: category=VALUE, data-constr=c08_UInt_SNA_na  # 08_UInt_SNA=-
    c08_deg_m50_160_1: category=VALUE, compu-method=c08_deg_m50_160_1, data-constr=c08_deg_m50_160_1, invalid-value=I_C08_DEG_M50_160_1_SNA °, unit=°  # 08_°_-50-+160_1
    c08_degC_m40_85_0k5: category=VALUE, compu-method=c08_degC_m40_85_0k5, data-constr=c08_degC_m40_85_0k5, invalid-value=I_C08_DEGC_M40_85_0K5_SNA °C, unit=°C  # 08_°C_-40-+85_0,5
    c10_Impulses_0_1022_1: category=VALUE, compu-method=c10_Impulses_0_1022_1, data-constr=c10_Impulses_0_1022_1, invalid-value=I_C10_IMPULSES_0_1022_1_SNA Impulses, unit=Impulses  # 10_Impulses_0-1022_1
    c10_V_0_25k55_0k025: category=VALUE, compu-method=c10_V_0_25k55_0k025, data-constr=c10_V_0_25k55_0k025, invalid-value=I_C10_V_0_25K55_0K025_SNA V, unit=V  # 10_V_0-25,55_0,025
    c10_WakeupRsn_ST3: category=VALUE, compu-method=c10_WakeupRsn_ST3, data-constr=c10_WakeupRsn_ST3, invalid-value=I_C10_WAKEUPRSN_ST3_SNA  # 10_WakeupRsn_ST3
    c12_0_4094_1_SNA: category=VALUE, compu-method=c12_0_4094_1_SNA, data-constr=c12_0_4094_1_SNA, invalid-value=I_C12_0_4094_1_SNA_SNA, unit=NoUnit  # 12_0-4094_1_SNA
    c12_km_p_h_0_409k4_0k1: category=VALUE, compu-method=c12_km_p_h_0_409k4_0k1, data-constr=c12_km_p_h_0_409k4_0k1, invalid-value=I_C12_KM_P_H_0_409K4_0K1_SNA km/h, unit=km/h  # 12_km/h_0-409,4_0,1
    c13_A_m409k6_409k4_0k1: category=VALUE, compu-method=c13_A_m409k6_409k4_0k1, data-constr=c13_A_m409k6_409k4_0k1, invalid-value=I_C13_A_M409K6_409K4_0K1_SNA A, unit=A  # 13_A_-409,6-409,4_0,1
    c14_rpm_0_8191_0k5: category=VALUE, compu-method=c14_rpm_0_8191_0k5, data-constr=c14_rpm_0_8191_0k5, invalid-value=I_C14_RPM_0_8191_0K5_SNA rpm, unit=rpm  # 14_rpm_0-8191_0,5
    c16_CRC_woSNA: category=VALUE, data-constr=c16_CRC_woSNA  # 16_CRC_w/oSNA
    c16_m_pro_s_sq_m50_50_0d002: category=VALUE, compu-method=c16_m_pro_s_sq_m50_50_0d002, data-constr=c16_m_pro_s_sq_m50_50_0d002, invalid-value=I_C16_M_PRO_S_SQ_M50_50_0D002_SNA m/s², unit=m/s²  # 16_m/s²_-50_+50_0.002
    c16_ms_0_6553d5_0d1_noSNA: category=VALUE, compu {phys=raw*0.1; unit ms}, data-constr=c16_ms_0_6553d5_0d1_noSNA, unit=ms  # 16_ms_0-6553,5_0,1_w/o_SNA
    c16_deg_per_sec_m300_300_0d01: category=VALUE, compu-method=c16_deg_per_sec_m300_300_0d01, data-constr=c16_deg_per_sec_m300_300_0d01, invalid-value=I_C16_DEG_PER_SEC_M300_300_0D01_SNA °/s, unit=°/s  # 16_°/s_-300-+300_0,01
    c16_deg_per_s_sq_m1200_1200_0d04: category=VALUE, compu-method=c16_deg_per_s_sq_m1200_1200_0d04, data-constr=c16_deg_per_s_sq_m1200_1200_0d04, invalid-value=I_C16_DEG_PER_S_SQ_M1200_1200_0D04_SNA °/s², unit=°/s²  # 16_°/s²_-1200-+1200_0,04
    c24_km_0_999999k9_0k1_Invld_SNA: category=VALUE, compu-method=c24_km_0_999999k9_0k1_Invld_SNA, data-constr=c24_km_0_999999k9_0k1_Invld_SNA, invalid-value=I_C24_KM_0_999999K9_0K1_INVLD_SNA_SNA km, unit=km  # 24_km_0-999999,9_0,1_Invld_SNA
    c32_ns_0_4294967295_1_noSNA: category=VALUE, compu {identical; unit ns}, data-constr=c32_ns_0_4294967295_1_noSNA, unit=ns  # 32_ns_0-4294967295_1_noSNA
    c32_s_0_4294967295_1_noSNA: category=VALUE, compu {identical; unit s}, data-constr=c32_s_0_4294967295_1_noSNA, unit=s  # 32_s_0-4294967295_1_noSNA
    DC_BOOL: category=BOOLEAN, compu {0=FALSE, 1=TRUE}
    NM_ActvWakeup: category=BOOLEAN, compu {0=FALSE, 1=TRUE}
    NM_Coord_Id: category=VALUE, range raw 0..3
    NM_Coord_SleepRdy: category=BOOLEAN, compu {0=FALSE, 1=TRUE}
    NM_PartNw_Info: category=BOOLEAN, compu {0=FALSE, 1=TRUE}
    NM_RepeatMsg_Rq: category=BOOLEAN, compu {0=FALSE, 1=TRUE}
    Rsrv01: category=VALUE, range raw 0..1, invalid-value=1
    Rsrv03: category=VALUE, range raw 0..7, invalid-value=7
    Rsrv04: category=VALUE, range raw 0..15, invalid-value=15
    Rsrv08: category=VALUE, range raw 0..255, invalid-value=255
    Rsrv09: category=VALUE, range raw 0..511, invalid-value=511
    Rsrv16: category=VALUE, range raw 0..65535, invalid-value=65535
package /CompuMethods
  compu method c02_GTS_ESP_Clk_Stat_ST3: 0=I_C02_GTS_ESP_CLK_STAT_ST3_INIT (Init), 1=I_C02_GTS_ESP_CLK_STAT_ST3_INTERNAL_ESP_CLOCK_OK (Internal_ESP_Clock_Ok), 2=I_C02_GTS_ESP_CLK_STAT_ST3_INTERNAL_ESP_CLOCK_NOK (Internal_ESP_Clock_Nok)
  compu method c02_Inact_Act_ST3: 0=I_C02_INACT_ACT_ST3_INACTIVE (INACTIVE) (Inactive), 1=I_C02_INACT_ACT_ST3_ACTIVE (ACTIVE) (Active), 3=I_C02_INACT_ACT_ST3_SNA (SNA) (SNA value from data type)  # DO NOT USE for future implementation of STAR3 and following architectures. Use 02_Inactv_Actv_ST3 instead.
  compu method c02_Ndef_False_True_ST3: 1=I_C02_NDEF_FALSE_TRUE_ST3_FALSE (FALSE) (False), 2=I_C02_NDEF_FALSE_TRUE_ST3_TRUE (TRUE) (True), 3=I_C02_NDEF_FALSE_TRUE_ST3_SNA (SNA) (SNA value from data type)  # OLDNAME: st3_02_NDEF_FALSE_TRUE_SNA / DO NOT USE for future implementation of STAR3 and following architectures. Use 02_False_True instead.
  compu method c02_PT_Rdy_V2: 0=I_C02_PT_RDY_V2_PT_NOT_RDY (PT_NOT_RDY) (Powertrain is not ready), 1=I_C02_PT_RDY_V2_PT_RDY (PT_RDY) (Powertrain is ready), 2=I_C02_PT_RDY_V2_NDEF2 (NDEF2) (not defined), 3=I_C02_PT_RDY_V2_SNA (SNA) (SNA value from data type)  # Antrieb bereit / Powertrain ready
  compu method c02_Signal_Qual: 0=I_C02_SIGNAL_QUAL_NDEF0 (NDEF0) (not defined), 1=I_C02_SIGNAL_QUAL_ELEC (ELEC) (Electrical checks passed), 2=I_C02_SIGNAL_QUAL_FUNC (FUNC) (Functional and electrical checks passed), 3=I_C02_SIGNAL_QUAL_SIG_DEF (SIG_DEF) (Signal defect detected)  # DT for signal qualifier
  compu method c02_TmSync_Stat: 0=I_C02_TMSYNC_STAT_OK (OK) (synchronisation OK), 1=I_C02_TMSYNC_STAT_NO_INIT_SYNC (NO_INIT_SYNC) (no initial synchronisation with timemaster), 2=I_C02_TMSYNC_STAT_LOST_SYNC (LOST_SYNC) (synchronisation with timemaster lost), 3=I_C02_TMSYNC_STAT_SNA (SNA) (SNA value from data type)
  compu method c02_TransMd_Stat: 0=I_C02_TRANSMD_STAT_OFF (OFF) (Transport mode permanently off), 1=I_C02_TRANSMD_STAT_TEMP_OFF (TEMP_OFF) (Transport mode temporarily off), 2=I_C02_TRANSMD_STAT_ACTV (ACTV) (Transport mode active), 3=I_C02_TRANSMD_STAT_SNA (SNA) (SNA value from data type)
  compu method c02_WhlDir: 0=I_C02_WHLDIR_VOID (VOID) (Neither forward nor backward (stop)), 1=I_C02_WHLDIR_FORWARD (FORWARD) (Direction forward), 2=I_C02_WHLDIR_BACKWARD (BACKWARD) (Direction backward), 3=I_C02_WHLDIR_SNA (SNA) (SNA value from data type)
  compu method c03_EngStartPN14_Stat: 0=I_C03_ENGSTARTPN14_STAT_NO_COMBUSTIONSTART_RQ (NO_COMBUSTIONSTART_RQ) (No combustion start required), 1=I_C03_ENGSTARTPN14_STAT_CUSTOMER_START_RQ (CUSTOMER_START_RQ) (Customer start required), 2=I_C03_ENGSTARTPN14_STAT_AUTO_START_NO_PN_SUP_RQ (AUTO_START_NO_PN_SUP_RQ) (Automatic start without Powernet support required), 3=I_C03_ENGSTARTPN14_STAT_AUTO_START_PN_SUP_RQ (AUTO_START_PN_SUP_RQ) (Automatic start with Powernet support required), 7=I_C03_ENGSTARTPN14_STAT_SNA (SNA) (SNA value from data type)
  compu method c03_IMU_Force_Ang_Stat_ST3: 0=I_C03_IMU_FORCE_ANG_STAT_ST3_UNKNOWN (UNKNOWN) (Unknown), 1=I_C03_IMU_FORCE_ANG_STAT_ST3_INIT (INIT) (Initialization phase), 2=I_C03_IMU_FORCE_ANG_STAT_ST3_VALID (VALID) (Angular rates valid, within specification), 3=I_C03_IMU_FORCE_ANG_STAT_ST3_ERROR_SPORADIC (ERROR_SPORADIC) (Sporadic error of angular rates), 4=I_C03_IMU_FORCE_ANG_STAT_ST3_ERROR_PERMANENT (ERROR_PERMANENT) (Permanent error of angular rates), 5=I_C03_IMU_FORCE_ANG_STAT_ST3_ERROR_OVERLOAD (ERROR_OVERLOAD) (Overload of angular rates), 6=I_C03_IMU_FORCE_ANG_STAT_ST3_ERROR_TEMPERATURE (ERROR_TEMPERATURE) (Temperature outside of range or temperature gradient to high)
  compu method c03_IMU_Stat_ST3: 0=I_C03_IMU_STAT_ST3_UNKNOWN (UNKNOWN) (Unknown), 1=I_C03_IMU_STAT_ST3_INIT (INIT) (Initialization phase), 2=I_C03_IMU_STAT_ST3_OPERATIONAL (OPERATIONAL) (IMU operational, no overall error), 3=I_C03_IMU_STAT_ST3_ERROR_SPORADIC (ERROR_SPORADIC) (Overall sporadic error), 4=I_C03_IMU_STAT_ST3_ERROR_PERMANENT (ERROR_PERMANENT) (Overall permanent error)
  compu method c03_ISw_Stat: 0=I_C03_ISW_STAT_IGN_LOCK (IGN_LOCK) (Ignition lock (0)), 1=I_C03_ISW_STAT_IGN_OFF (IGN_OFF) (Ignition off (15c)), 2=I_C03_ISW_STAT_IGN_ACC (IGN_ACC) (Ignition accessory (15r)), 4=I_C03_ISW_STAT_IGN_ON (IGN_ON) (Ignition on (15)), 5=I_C03_ISW_STAT_IGN_START (IGN_START) (Ignition start (50)), 7=I_C03_ISW_STAT_SNA (SNA) (SNA value from data type)
  compu method c03_PN14_ProdMd_Stat_ST3: 0=I_C03_PN14_PRODMD_STAT_ST3_OFF (OFF) (Productionmode off), 1=I_C03_PN14_PRODMD_STAT_ST3_ON (ON) (Productionmode active), 2=I_C03_PN14_PRODMD_STAT_ST3_SF01 (SF01) (Productionmode Special Funcion 1), 3=I_C03_PN14_PRODMD_STAT_ST3_SF02 (SF02) (Productionmode Special Funcion 2), 4=I_C03_PN14_PRODMD_STAT_ST3_SF03 (SF03) (Productionmode Special Funcion 3), 7=I_C03_PN14_PRODMD_STAT_ST3_SNA (SNA) (SNA value from data type)
  compu method c03_PN14_TDP_Sw_Stat: 0=I_C03_PN14_TDP_SW_STAT_CLS (CLS) (TDP switch is closed), 1=I_C03_PN14_TDP_SW_STAT_PRE_RESET (PRE_RESET) (Pre-Reset warning), 2=I_C03_PN14_TDP_SW_STAT_RESET (RESET) (Reset active), 3=I_C03_PN14_TDP_SW_STAT_PRE_OPN (PRE_OPN) (Pre-Open warning), 4=I_C03_PN14_TDP_SW_STAT_OPN (OPN) (TDP switch is open), 7=I_C03_PN14_TDP_SW_STAT_SNA (SNA) (SNA value from data type)
  compu method c04_VehOpMode: 0=I_C04_VEHOPMODE_DRV (DRV) (Drive), 1=I_C04_VEHOPMODE_DIAG (DIAG) (Diagnostic), 2=I_C04_VEHOPMODE_REMSTART_PRECON (REMSTART_PRECON) (Remote_start preconditioning), 3=I_C04_VEHOPMODE_ENG_RUN_CONT (ENG_RUN_CONT) (Engine continuos running), 4=I_C04_VEHOPMODE_KEY_PARK (KEY_PARK) (Key_parking), 5=I_C04_VEHOPMODE_REMSTART_BAT_CHRG (REMSTART_BAT_CHRG) (Remote start battery charge), 6=I_C04_VEHOPMODE_AVP (AVP) (Automated Valet Parking), 7=I_C04_VEHOPMODE_SDC (SDC) (Self Driving Car), 8=I_C04_VEHOPMODE_ADSE (ADSE) (Automated Driving for Specific Environments), 15=I_C04_VEHOPMODE_SNA (SNA) (SNA value from data type)
  compu method c07_per_0to100_1_SNA: phys=raw for raw 0..100, 127=I_C07_PER_0TO100_1_SNA_SNA (SNA) (SNA value from data type); unit %
  compu method percent_1_0: identical; unit %
  compu method c07_0_111_1_SNA: phys=raw for raw 0..111, 127=I_C07_0_111_1_SNA_SNA (SNA) (SNA value from data type)
  compu method c08_0_254_1_SNA_255: phys=raw for raw 0..254, 255=I_C08_0_254_1_SNA_255_SNA (SNA) (SNA value from data type)
  compu method c08_Platform_Stat: 0=I_C08_PLATFORM_STAT_IDLE (IDLE) (Not defined), 1=I_C08_PLATFORM_STAT_STAR1 (STAR1) (Platform STAR1 (221ff)), 2=I_C08_PLATFORM_STAT_STAR2 (STAR2) (Platform STAR2 (222ff)), 4=I_C08_PLATFORM_STAT_STAR3 (STAR3) (Platform STAR3 (223ff)), 8=I_C08_PLATFORM_STAT_RES8 (RES8) (reserved), 16=I_C08_PLATFORM_STAT_RES16 (RES16) (reserved), 32=I_C08_PLATFORM_STAT_RES32 (RES32) (reserved), 64=I_C08_PLATFORM_STAT_RES64 (RES64) (reserved), 128=I_C08_PLATFORM_STAT_RES128 (RES128) (reserved), 255=I_C08_PLATFORM_STAT_SNA (SNA) (SNA value from data type)  # Plattform Status / Platform state
  compu method c08_ROE_0: 0=I_C08_ROE_0_IDLE (IDLE) (not defined), 1=I_C08_ROE_0_DTC_STATUS_CHANGE (DTC_STATUS_CHANGE) (DTC status change), 2=I_C08_ROE_0_OBSOLESCENCE_DATA (OBSOLESCENCE_DATA) (Obsolescence data), 3=I_C08_ROE_0_CONSUMABLE_DATA (CONSUMABLE_DATA) (Consumable data), 4=I_C08_ROE_0_AVAILABILITY_DATA (AVAILABILITY_DATA) (Availability data), 5=I_C08_ROE_0_DIAG_SESSION_CHANGE (DIAG_SESSION_CHANGE) (Diagnostic session change), 6=I_C08_ROE_0_SECURITY_EVENT_NOTIFICATION (SECURITY_EVENT_NOTIFICATION) (Security Event Notification)
  compu method c08_TmSync_Stat: mask 0b10000000: 0b00000000=c08_TmSync_Stat_TM_SYNC_STAT_INVALID_FALSE (c08_TmSync_Stat_TM_SYNC_STAT_INVALID), mask 0b10000000: 0b10000000=c08_TmSync_Stat_TM_SYNC_STAT_INVALID_TRUE (c08_TmSync_Stat_TM_SYNC_STAT_INVALID), mask 0b10000001: 0b00000000=c08_TmSync_Stat_TIMEOUT_FALSE (c08_TmSync_Stat_TIMEOUT), mask 0b10000001: 0b00000001=c08_TmSync_Stat_TIMEOUT_TRUE (c08_TmSync_Stat_TIMEOUT), mask 0b10000010: 0b00000000=c08_TmSync_Stat_BIT1_RESERVED_FALSE (c08_TmSync_Stat_BIT1_RESERVED), mask 0b10000010: 0b00000010=c08_TmSync_Stat_BIT1_RESERVED_TRUE (c08_TmSync_Stat_BIT1_RESERVED), mask 0b10000100: 0b00000000=c08_TmSync_Stat_SYNC_TO_GATEWAY_FALSE (c08_TmSync_Stat_SYNC_TO_GATEWAY), mask 0b10000100: 0b00000100=c08_TmSync_Stat_SYNC_TO_GATEWAY_TRUE (c08_TmSync_Stat_SYNC_TO_GATEWAY), mask 0b10001000: 0b00000000=c08_TmSync_Stat_GLOBAL_TIME_BASE_FALSE (c08_TmSync_Stat_GLOBAL_TIME_BASE), mask 0b10001000: 0b00001000=c08_TmSync_Stat_GLOBAL_TIME_BASE_TRUE (c08_TmSync_Stat_GLOBAL_TIME_BASE), mask 0b10010000: 0b00000000=c08_TmSync_Stat_TIMELEAP_FUTURE_FALSE (c08_TmSync_Stat_TIMELEAP_FUTURE), mask 0b10010000: 0b00010000=c08_TmSync_Stat_TIMELEAP_FUTURE_TRUE (c08_TmSync_Stat_TIMELEAP_FUTURE), mask 0b10100000: 0b00000000=c08_TmSync_Stat_TIMELEAP_PAST_FALSE (c08_TmSync_Stat_TIMELEAP_PAST), mask 0b10100000: 0b00100000=c08_TmSync_Stat_TIMELEAP_PAST_TRUE (c08_TmSync_Stat_TIMELEAP_PAST), mask 0b11000000: 0b00000000=c08_TmSync_Stat_SYNC_TO_PURE_LOCAL_TIME_BASE_FALSE (c08_TmSync_Stat_SYNC_TO_PURE_LOCAL_TIME_BASE), mask 0b11000000: 0b01000000=c08_TmSync_Stat_SYNC_TO_PURE_LOCAL_TIME_BASE_TRUE (c08_TmSync_Stat_SYNC_TO_PURE_LOCAL_TIME_BASE)
  compu method c08_deg_m50_160_1: phys=raw-50 for raw 0..210, 255=I_C08_DEG_M50_160_1_SNA (SNA) (SNA value from data type); unit °
  compu method deg_1_m50: phys=raw-50; unit °
  compu method c08_degC_m40_85_0k5: phys=raw*0.5-40 for raw 0..250, 255=I_C08_DEGC_M40_85_0K5_SNA (SNA) (SNA value from data type); unit °C
  compu method deg_C_0d5_m40: phys=raw*0.5-40; unit °C
  compu method c10_Impulses_0_1022_1: phys=raw for raw 0..1022, 1023=I_C10_IMPULSES_0_1022_1_SNA (SNA) (SNA value from data type); unit Impulses
  compu method Impulses_1_0: identical; unit Impulses
  compu method c10_V_0_25k55_0k025: phys=raw*0.025 for raw 0..1022, 1023=I_C10_V_0_25K55_0K025_SNA (SNA) (SNA value from data type); unit V
  compu method V_0d025_0: phys=raw*0.025; unit V
  compu method c10_WakeupRsn_ST3: 0=I_C10_WAKEUPRSN_ST3_NETWORK (NETWORK) (Wakeup by network), 1=I_C10_WAKEUPRSN_ST3_NW_MAIN (NW_MAIN) (Wakeup by MAIN Ethernet), 11=I_C10_WAKEUPRSN_ST3_NW_HEADUNIT1 (NW_HEADUNIT1) (Wakeup by HEADUNIT1 CAN), 12=I_C10_WAKEUPRSN_ST3_NW_HEADUNIT2 (NW_HEADUNIT2) (Wakeup by HEADUNIT2 CAN), 13=I_C10_WAKEUPRSN_ST3_NW_PERIPHERY (NW_PERIPHERY) (Wakeup by PERIPHERY CAN), 14=I_C10_WAKEUPRSN_ST3_NW_BODY1 (NW_BODY1) (Wakeup by BODY1 CAN), 15=I_C10_WAKEUPRSN_ST3_NW_CHASSIS (NW_CHASSIS) (Wakeup by CHASSIS FlexRay), 16=I_C10_WAKEUPRSN_ST3_NW_RADAR_R (NW_RADAR_R) (Wakeup by RADAR_R CAN), 17=I_C10_WAKEUPRSN_ST3_NW_RADAR_F (NW_RADAR_F) (Wakeup by RADAR_F CAN), 18=I_C10_WAKEUPRSN_ST3_NW_OBD_PTI (NW_OBD_PTI) (Wakeup by OBD_PTI CAN), 19=I_C10_WAKEUPRSN_ST3_NW_STEERING_WHEEL (NW_STEERING_WHEEL) (Wakeup by STEERING_WHEEL CAN), 20=I_C10_WAKEUPRSN_ST3_NW_CPC (NW_CPC) (Wakeup by CPC CAN), 21=I_C10_WAKEUPRSN_ST3_NW_ECM (NW_ECM) (Wakeup by ECM CAN), 22=I_C10_WAKEUPRSN_ST3_NW_ENERGY (NW_ENERGY) (Wakeup by ENERGY CAN), 23=I_C10_WAKEUPRSN_ST3_NW_INV (NW_INV) (Wakeup by INV CAN), 24=I_C10_WAKEUPRSN_ST3_NW_TCM (NW_TCM) (Wakeup by TCM CAN), 25=I_C10_WAKEUPRSN_ST3_NW_AEPU (NW_AEPU) (Wakeup by AEPU CAN), 26=I_C10_WAKEUPRSN_ST3_NW_BODY2 (NW_BODY2) (Wakeup by BODY2 CAN), 27=I_C10_WAKEUPRSN_ST3_NW_BODY3 (NW_BODY3) (Wakeup by BODY3 CAN), 28=I_C10_WAKEUPRSN_ST3_NW_CAL_COC (NW_CAL_COC) (Wakeup by CAL_COC CAN), 29=I_C10_WAKEUPRSN_ST3_NW_CAL_DL (NW_CAL_DL) (Wakeup by CAL_DL CAN), 30=I_C10_WAKEUPRSN_ST3_NW_CAL_DR (NW_CAL_DR) (Wakeup by CAL_DR CAN), 31=I_C10_WAKEUPRSN_ST3_NW_ECM_PERIPHERY1 (NW_ECM_PERIPHERY1) (Wakeup by ECM_PERIPHERY1 CAN), 32=I_C10_WAKEUPRSN_ST3_NW_ECM_PERIPHERY2 (NW_ECM_PERIPHERY2) (Wakeup by ECM_PERIPHERY2 CAN), 33=I_C10_WAKEUPRSN_ST3_NW_ENGINE_PT3 (NW_ENGINE_PT3) (Wakeup by ENGINE_PT3 CAN), 34=I_C10_WAKEUPRSN_ST3_NW_HAD_BACKUP (NW_HAD_BACKUP) (Wakeup by HAD_BACKUP CAN), 35=I_C10_WAKEUPRSN_ST3_NW_HYBRID_PT3 (NW_HYBRID_PT3) (Wakeup by HYBRID_PT3 CAN), 36=I_C10_WAKEUPRSN_ST3_NW_LSM_F (NW_LSM_F) (Wakeup by LSM_F CAN), 37=I_C10_WAKEUPRSN_ST3_NW_POWERTRAIN_PT3 (NW_POWERTRAIN_PT3) (Wakeup by POWERTRAIN_PT3 CAN), 38=I_C10_WAKEUPRSN_ST3_NW_PT_SENSOR_PT3 (NW_PT_SENSOR_PT3) (Wakeup by PT_SENSOR_PT3 CAN), 39=I_C10_WAKEUPRSN_ST3_NW_RVC_HSVL (NW_RVC_HSVL) (Wakeup by RVC_HSVL CAN), 40=I_C10_WAKEUPRSN_ST3_NW_SPV (NW_SPV) (Wakeup by SPV CAN), 41=I_C10_WAKEUPRSN_ST3_NW_SUSPENSION_F (NW_SUSPENSION_F) (Wakeup by SUSPENSION_F CAN), 42=I_C10_WAKEUPRSN_ST3_NW_SUSPENSION_R (NW_SUSPENSION_R) (Wakeup by SUSPENSION_R CAN), 43=I_C10_WAKEUPRSN_ST3_NW_EIS_BASE_GW (NW_EIS_BASE_GW) (Wakeup by EIS_BASE_GW CAN), 44=I_C10_WAKEUPRSN_ST3_NW_EIS_GW_BASE (NW_EIS_GW_BASE) (Wakeup by EIS_GW_BASE CAN), 45=I_C10_WAKEUPRSN_ST3_NW_AUXILIARY1 (NW_AUXILIARY1) (Wakeup by AUXILIARY1 CAN), 46=I_C10_WAKEUPRSN_ST3_NW_AUXILIARY2 (NW_AUXILIARY2) (Wakeup by AUXILIARY2 CAN), 47=I_C10_WAKEUPRSN_ST3_NW_DRIVE_UNIT (NW_DRIVE_UNIT) (Wakeup by DRIVE_UNIT CAN), 48=I_C10_WAKEUPRSN_ST3_NW_INLET (NW_INLET) (Wakeup by INLET CAN), 49=I_C10_WAKEUPRSN_ST3_NW_BODY4 (NW_BODY4) (Wakeup by BODY4 CAN), 50=I_C10_WAKEUPRSN_ST3_NW_DRIVING (NW_DRIVING) (Wakeup by DRIVING-CAN), 51=I_C10_WAKEUPRSN_ST3_NW_EDS1 (NW_EDS1) (Wakeup by EDS1-CAN), 52=I_C10_WAKEUPRSN_ST3_NW_EDS2 (NW_EDS2) (Wakeup by EDS2-CAN), 53=I_C10_WAKEUPRSN_ST3_NW_HAD_IMU (NW_HAD_IMU) (Wakeup by HAD_IMU-CAN), 54=I_C10_WAKEUPRSN_ST3_NW_MULTIPURPOSE (NW_MULTIPURPOSE) (Wakeup by MULTIPURPOSE-CAN), 55=I_C10_WAKEUPRSN_ST3_NW_PERIPHERY2 (NW_PERIPHERY2) (Wakeup by PERIPHERY2-CAN), 56=I_C10_WAKEUPRSN_ST3_NW_SUSPENSION_AMG (NW_SUSPENSION_AMG) (Wakeup by SUSPENSION_AMG-CAN), 57=I_C10_WAKEUPRSN_ST3_NW_BMS_SENSOR (NW_BMS_SENSOR) (Wakeup by BMS_SENSOR-CAN), 115=I_C10_WAKEUPRSN_ST3_LIN_HVAC_F (LIN_HVAC_F) (Wakeup by LIN-Slave HVAC_F), 116=I_C10_WAKEUPRSN_ST3_LIN_HVAC_R (LIN_HVAC_R) (Wakeup by LIN-Slave HVAC_R), 117=I_C10_WAKEUPRSN_ST3_LIN_VCS (LIN_VCS) (Wakeup by LIN-Slave VCS), 118=I_C10_WAKEUPRSN_ST3_LIN_WPRA (LIN_WPRA) (Wakeup by LIN-Slave WPRA), 119=I_C10_WAKEUPRSN_ST3_LIN_IHTM_RC (LIN_IHTM_RC) (Wakeup by LIN-Slave IHTM_RC), 120=I_C10_WAKEUPRSN_ST3_LIN_PTC48_R (LIN_PTC48_R) (Wakeup by LIN-Slave PTC48_R), 121=I_C10_WAKEUPRSN_ST3_LIN_AQS (LIN_AQS) (Wakeup by LIN-Slave AQS), 122=I_C10_WAKEUPRSN_ST3_LIN_ECP2_1 (LIN_ECP2_1) (Wakeup by LIN-Slave ECP2_1), 123=I_C10_WAKEUPRSN_ST3_LIN_EXV1 (LIN_EXV1) (Wakeup by LIN-Slave EXV1), 124=I_C10_WAKEUPRSN_ST3_LIN_IHTM (LIN_IHTM) (Wakeup by LIN-Slave IHTM), 125=I_C10_WAKEUPRSN_ST3_LIN_EAC (LIN_EAC) (Wakeup by LIN-Slave EAC), 126=I_C10_WAKEUPRSN_ST3_LIN_EAC48 (LIN_EAC48) (Wakeup by LIN-Slave EAC48), 127=I_C10_WAKEUPRSN_ST3_LIN_PTC_HV (LIN_PTC_HV) (Wakeup by LIN-Slave PTC_HV), 128=I_C10_WAKEUPRSN_ST3_TERM_15 (TERM_15) (Wakeup by discrete terminal 15 signal), 129=I_C10_WAKEUPRSN_ST3_SBW_LVR_PSD (SBW_LVR_PSD) (Shift By Wire Lever Pressed), 130=I_C10_WAKEUPRSN_ST3_TERM_54 (TERM_54) (Wakeup by terminal 54 active), 131=I_C10_WAKEUPRSN_ST3_LIN_HFA (LIN_HFA) (Wakeup by LIN-Slave Hands Free Access), 132=I_C10_WAKEUPRSN_ST3_LIN_IBS (LIN_IBS) (Wakeup by LIN-Slave Battery sensor), 133=I_C10_WAKEUPRSN_ST3_LIN_DOOR_HANDLE (LIN_DOOR_HANDLE) (Wakeup by LIN-Slave Door Handle), 134=I_C10_WAKEUPRSN_ST3_LIN_LISB48 (LIN_LISB48) (Wakeup by LIN-Slave LISB48), 135=I_C10_WAKEUPRSN_ST3_CMN_ECU_RST_POR (CMN_ECU_RST_POR) (Wakeup by ECU Power On Reset, Common Reason), 136=I_C10_WAKEUPRSN_ST3_CMN_ECU_RST_DIAG (CMN_ECU_RST_DIAG) (Wakeup by ECU Diagnostic Reset, Common Reason), 137=I_C10_WAKEUPRSN_ST3_CMN_ECU_RST_TEST (CMN_ECU_RST_TEST) (Wakeup by ECU Test Reset, Common Reason), 138=I_C10_WAKEUPRSN_ST3_CMN_ECU_RST_ERR (CMN_ECU_RST_ERR) (Wakeup by ECU Error Reset, Common Reason), 139=I_C10_WAKEUPRSN_ST3_CMN_ETH_WAKEUPLINE (CMN_ETH_WAKEUPLINE) (Wakeup by Ethernet Wakeup-Line, Common Reason), 140=I_C10_WAKEUPRSN_ST3_CMN_AFTERRUN (CMN_AFTERRUN) (Wakeup by afterrun, Common Reason), 141=I_C10_WAKEUPRSN_ST3_CRASH (CRASH) (Wakeup by crash signal), 142=I_C10_WAKEUPRSN_ST3_LIN_VCI (LIN_VCI) (Wakeup by LIN-Slave VCI), 143=I_C10_WAKEUPRSN_ST3_LIN_CIS (LIN_CIS) (Wakeup by LIN-Slave CIS), 150=I_C10_WAKEUPRSN_ST3_HANDLE_TAG2 (HANDLE_TAG2) (Wakeup by door handle TAG 2), 151=I_C10_WAKEUPRSN_ST3_DAC_MOBILE (DAC_MOBILE) (Wakeup by DAC Mobile (driving authorization check)), 181=I_C10_WAKEUPRSN_ST3_EASY_ENTRY_ACTV (EASY_ENTRY_ACTV) (Wakeup by Easy Entry active), 183=I_C10_WAKEUPRSN_ST3_ERR_SEAT_HTVN (ERR_SEAT_HTVN) (Wakeup by error seat heating/ventilation), 184=I_C10_WAKEUPRSN_ST3_ERR_SEAT_CHM (ERR_SEAT_CHM) (Wakeup by error console heating), 199=I_C10_WAKEUPRSN_ST3_VEHSL_EVENT (VEHSL_EVENT) (Wakeup by Vehicle State Living signal update), 200=I_C10_WAKEUPRSN_ST3_RLS (RLS) (Wakeup by rotary light switch), 201=I_C10_WAKEUPRSN_ST3_EF_KEY (EF_KEY) (Wakeup by emergency flasher key), 202=I_C10_WAKEUPRSN_ST3_RHU_FT (RHU_FT) (Wakeup by residual heat utilization front), 203=I_C10_WAKEUPRSN_ST3_RHU_R (RHU_R) (Wakeup by residual heat utilization rear), 204=I_C10_WAKEUPRSN_ST3_ICH_RQ (ICH_RQ) (Wakeup by idependent car heater request), 205=I_C10_WAKEUPRSN_ST3_VPRZR_VN (VPRZR_VN) (Wakeup by Vaporizer ventilation), 206=I_C10_WAKEUPRSN_ST3_PRECON (PRECON) (Wakeup by PreConditioning), 207=I_C10_WAKEUPRSN_ST3_SOL_VN (SOL_VN) (Wakeup by Solar Ventilation), 208=I_C10_WAKEUPRSN_ST3_EXTLGT_ACTV (EXTLGT_ACTV) (Wakeup by exterior lighting active), 209=I_C10_WAKEUPRSN_ST3_INTLGT_ACTV (INTLGT_ACTV) (Wakeup by interior lighting active), 210=I_C10_WAKEUPRSN_ST3_TSSR_ACTV (TSSR_ACTV) (Wakeup by TSSR active), 211=I_C10_WAKEUPRSN_ST3_SEAT_HT_F_ACTV (SEAT_HT_F_ACTV) (Wakeup by seat heating front active), 212=I_C10_WAKEUPRSN_ST3_SEAT_HT_R_ACTV (SEAT_HT_R_ACTV) (Wakeup by seat heating rear active), 213=I_C10_WAKEUPRSN_ST3_SEAT_VN_F_ACTV (SEAT_VN_F_ACTV) (Wakeup by seat ventilation front active), 214=I_C10_WAKEUPRSN_ST3_SEAT_VN_R_ACTV (SEAT_VN_R_ACTV) (Wakeup by seat ventilation rear active), 215=I_C10_WAKEUPRSN_ST3_EHS_3S (EHS_3S) (Wakeup by 3S engine hood switch (Pawl)), 216=I_C10_WAKEUPRSN_ST3_T58D_POTI (T58D_POTI) (Wakeup by terminal 58d potentiometer), 217=I_C10_WAKEUPRSN_ST3_DRB (DRB) (Wakeup by Double Roller Blind), 218=I_C10_WAKEUPRSN_ST3_BKRST_UNLK_RM (BKRST_UNLK_RM) (Wakeup by Backrest Unlock rear Middle), 219=I_C10_WAKEUPRSN_ST3_DL_SW2_PSD (DL_SW2_PSD) (Wakeup by Deck Lid Switch Pressed 2), 220=I_C10_WAKEUPRSN_ST3_DL_SW (DL_SW) (Wakeup by deck lid switch pressed), 221=I_C10_WAKEUPRSN_ST3_BGC_SW (BGC_SW) (Wakeup by switch inside baggage compartment pressed), 222=I_C10_WAKEUPRSN_ST3_BKRST_RL_LK_UNLK (BKRST_RL_LK_UNLK) (Wakeup by back rest rear left locked or unlocked), 223=I_C10_WAKEUPRSN_ST3_BKRST_RR_LK_UNLK (BKRST_RR_LK_UNLK) (Wakeup by back rest rear right locked or unlocked), 224=I_C10_WAKEUPRSN_ST3_DL_CLS_LK_SW (DL_CLS_LK_SW) (Wakeup by deck lid switch close/lock close pressed), 225=I_C10_WAKEUPRSN_ST3_DL_RLTCH (DL_RLTCH) (Wakeup by deck lid rotary latch pressed), 226=I_C10_WAKEUPRSN_ST3_BKRST_3L_LK_UNLK (BKRST_3L_LK_UNLK) (Wakeup by back rest 3rd row left locked or unlocked), 227=I_C10_WAKEUPRSN_ST3_BKRST_3R_LK_UNLK (BKRST_3R_LK_UNLK) (Wakeup by back rest 3rd row right locked or unlocked), 228=I_C10_WAKEUPRSN_ST3_GAS_DR_SW (GAS_DR_SW) (Wakeup by gas door switch), 229=I_C10_WAKEUPRSN_ST3_AILCF (AILCF) (Wakeup by AILCF), 230=I_C10_WAKEUPRSN_ST3_AILCC (AILCC) (Wakeup by AILCC), 250=I_C10_WAKEUPRSN_ST3_FRONT_TRUNK_SWITCH (FRONT_TRUNK_SWITCH) (Wakeup by front trunk switch), 251=I_C10_WAKEUPRSN_ST3_FRONT_TRUNK_LATCH_PRSD (FRONT_TRUNK_LATCH_PRSD) (Wakeup by front trunk latch pressed), 252=I_C10_WAKEUPRSN_ST3_BIG_FLIP_WNDW_SWITCH (BIG_FLIP_WNDW_SWITCH) (Wakeup by big flip window switch), 253=I_C10_WAKEUPRSN_ST3_BIG_FLIP_WNDW_STATE (BIG_FLIP_WNDW_STATE) (Wakeup by big flip window state), 256=I_C10_WAKEUPRSN_ST3_TRLR_ELEC_ACT (TRLR_ELEC_ACT) (Wakeup by electrical trailer hitch activation), 257=I_C10_WAKEUPRSN_ST3_TRLR_DET (TRLR_DET) (Wakeup by trailer detected), 258=I_C10_WAKEUPRSN_ST3_DL_LK (DL_LK) (Wakeup by delayed locking), 259=I_C10_WAKEUPRSN_ST3_START_SW_PSD (START_SW_PSD) (Wakeup by start switch pressed), 260=I_C10_WAKEUPRSN_ST3_RADIO_DATA (RADIO_DATA) (Wakeup by radio data), 261=I_C10_WAKEUPRSN_ST3_RLTCH_DR (RLTCH_DR) (Wakeup by rotational latch door), 263=I_C10_WAKEUPRSN_ST3_PKBRKSW (PKBRKSW) (Wakeup by Parking switch pressed), 264=I_C10_WAKEUPRSN_ST3_KEYLESS_GO (KEYLESS_GO) (Wakeup by Keyless Go/Start (Core 1/0)), 265=I_C10_WAKEUPRSN_ST3_PNM12 (PNM12) (Wakeup by Power network management 12V), 266=I_C10_WAKEUPRSN_ST3_PNM48 (PNM48) (Wakeup by Power network management 48V), 267=I_C10_WAKEUPRSN_ST3_BAT48_LOWCHARGE (BAT48_LOWCHARGE) (Wakeup by 48V battery due to low charge), 270=I_C10_WAKEUPRSN_ST3_PN14_IODM (PN14_IODM) (Wakeup by IOD Measurement), 271=I_C10_WAKEUPRSN_ST3_PN14_REMSRV_STAT (PN14_REMSRV_STAT) (Wakeup by Change of Remote Service Status), 272=I_C10_WAKEUPRSN_ST3_PN14_DDP (PN14_DDP) (Wakeup by Deep Discharge Protection), 273=I_C10_WAKEUPRSN_ST3_PN14_LOWCHARGE (PN14_LOWCHARGE) (Wakeup by low charge of the battery), 274=I_C10_WAKEUPRSN_ST3_PN14_REMODHV12V (PN14_REMODHV12V) (Wakeup by reload mode HV 12V), 275=I_C10_WAKEUPRSN_ST3_PN14_DLM (PN14_DLM) (Wakeup by Powernet CutOff (Dynamic Load Management)), 276=I_C10_WAKEUPRSN_ST3_SDC_PN2_LOWCHARGE (SDC_PN2_LOWCHARGE) (Wakeup by low charge of the battery in SDC_PNM2), 277=I_C10_WAKEUPRSN_ST3_SDC_PN2_REMODHV12V (SDC_PN2_REMODHV12V) (Wakeup by reload mode HV 12 in SDC_PNM2), 278=I_C10_WAKEUPRSN_ST3_PN14_REM_ENGINE_START (PN14_REM_ENGINE_START) (Wakeup by PN14 remote engine start), 280=I_C10_WAKEUPRSN_ST3_DATA_EXCHG (DATA_EXCHG) (Wakeup by data exchange with vehicle functions), 281=I_C10_WAKEUPRSN_ST3_INTERNET_CON (INTERNET_CON) (Wakeup by internet connection), 282=I_C10_WAKEUPRSN_ST3_CMN_USER_DATA (CMN_USER_DATA) (Wakeup by user data, Common Reason), 290=I_C10_WAKEUPRSN_ST3_CMN_SERV_LOCAL (CMN_SERV_LOCAL) (Wakeup by local activated service, Common Reason), 291=I_C10_WAKEUPRSN_ST3_CMN_SERV_REM (CMN_SERV_REM) (Wakeup by remote activated service, Common Reason), 292=I_C10_WAKEUPRSN_ST3_VEH_REAR_LOWERING (VEH_REAR_LOWERING) (Wakeup by vehicle rear lowering), 300=I_C10_WAKEUPRSN_ST3_CMN_BTN_PSD (CMN_BTN_PSD) (Wakeup by button pressed, Common Reason), 301=I_C10_WAKEUPRSN_ST3_FLAP_PSD (FLAP_PSD) (Wakeup by flap pressed), 302=I_C10_WAKEUPRSN_ST3_CHADEMO (CHADEMO) (Wakeup by CHADEMO charging system), 303=I_C10_WAKEUPRSN_ST3_GBT (GBT) (Wakeup by GBT charging system), 304=I_C10_WAKEUPRSN_ST3_CMN_PROXIMITY (CMN_PROXIMITY) (Wakeup by proximity, Common Reason), 305=I_C10_WAKEUPRSN_ST3_CTRL_PILOT (CTRL_PILOT) (Wakeup by control pilot), 306=I_C10_WAKEUPRSN_ST3_CMN_HV_DET (CMN_HV_DET) (Wakeup by HiVolt detection, Common Reason), 307=I_C10_WAKEUPRSN_ST3_CMN_CHRG_TMR (CMN_CHRG_TMR) (Wakeup by charging timer, Common Reason), 308=I_C10_WAKEUPRSN_ST3_TRCT_BAT_OP_STRATEGY (TRCT_BAT_OP_STRATEGY) (Wakeup by traction battery operating strategy), 309=I_C10_WAKEUPRSN_ST3_VTA (VTA) (Wakeup by VTA alarm), 310=I_C10_WAKEUPRSN_ST3_PDD (PDD) (Wakeup by PDD collision detected), 311=I_C10_WAKEUPRSN_ST3_UNEQUAL_STRING_VOLT (UNEQUAL_STRING_VOLT) (Wakeup by unequal string voltages), 312=I_C10_WAKEUPRSN_ST3_MUTE_ACTV (MUTE_ACTV) (Wakeup by mute activated), 313=I_C10_WAKEUPRSN_ST3_VIDEO_RQ (VIDEO_RQ) (Wakeup by video in request), 314=I_C10_WAKEUPRSN_ST3_ALARM_ACTV (ALARM_ACTV) (Wakeup by alarm activation), 315=I_C10_WAKEUPRSN_ST3_RECIRC_AIR_RQ (RECIRC_AIR_RQ) (Wakeup by FLA/NFS recirc air request), 316=I_C10_WAKEUPRSN_ST3_TPM_SYNC (TPM_SYNC) (Wakeup by TPM synchronize BackEndServer), 320=I_C10_WAKEUPRSN_ST3_DI_DISP_RQ (DI_DISP_RQ) (Wakeup by DI display request), 321=I_C10_WAKEUPRSN_ST3_DI_IND_RQ (DI_IND_RQ) (Wakeup by DI indicator request), 322=I_C10_WAKEUPRSN_ST3_HUD_RQ (HUD_RQ) (Wakeup by HUD request), 323=I_C10_WAKEUPRSN_ST3_ON_KEY (ON_KEY) (Wakeup by on key), 325=I_C10_WAKEUPRSN_ST3_MSG_DISP_RQ (MSG_DISP_RQ) (Wakeup by message display request), 326=I_C10_WAKEUPRSN_ST3_ROOF_LMP_ON_RQ (ROOF_LMP_ON_RQ) (Wakeup by rooflamps on request), 327=I_C10_WAKEUPRSN_ST3_IL_ON_RQ (IL_ON_RQ) (Wakeup by interior light activated from special vehicle), 328=I_C10_WAKEUPRSN_ST3_SPS_APPL (SPS_APPL) (Wakeup by special vehicle application), 330=I_C10_WAKEUPRSN_ST3_PWC_WRAPPER (PWC_WRAPPER) (Wakeup by PWC Wrapper), 331=I_C10_WAKEUPRSN_ST3_PW_SW (PW_SW) (Wakeup by power window switch), 332=I_C10_WAKEUPRSN_ST3_CLKS_SW (CLKS_SW) (Wakeup by centrol locking system switch), 333=I_C10_WAKEUPRSN_ST3_SEAT_SW (SEAT_SW) (Wakeup by seat switch), 334=I_C10_WAKEUPRSN_ST3_DL_REM_SW (DL_REM_SW) (Wakeup by deck lid remote switch), 335=I_C10_WAKEUPRSN_ST3_TANK_UNLK_SW (TANK_UNLK_SW) (Wakeup by tank unlock switch), 336=I_C10_WAKEUPRSN_ST3_SLTCH_DR (SLTCH_DR) (Wakeup by secondary latch), 337=I_C10_WAKEUPRSN_ST3_INSRLVR_SW (INSRLVR_SW) (Wakeup by inside release lever switch), 338=I_C10_WAKEUPRSN_ST3_OUTSRLVR_SW (OUTSRLVR_SW) (Wakeup by outside release lever switch), 339=I_C10_WAKEUPRSN_ST3_TRL_HTCH_SW (TRL_HTCH_SW) (Wakeup by trailer hitch switch), 340=I_C10_WAKEUPRSN_ST3_TSSR_R_RB_SW (TSSR_R_RB_SW) (Wakeup by TSSR switch), 341=I_C10_WAKEUPRSN_ST3_CSL_SW (CSL_SW) (Wakeup by child security switch), 342=I_C10_WAKEUPRSN_ST3_GEAR_SW (GEAR_SW) (Wakeup by gear switch), 343=I_C10_WAKEUPRSN_ST3_AD_SW (AD_SW) (Wakeup by automated door switch), 344=I_C10_WAKEUPRSN_ST3_T2R_SW (T2R_SW) (Wakeup by automated door Tip2Run), 345=I_C10_WAKEUPRSN_ST3_HV_INTERLOCK_ERR (HV_INTERLOCK_ERR) (Wakeup by interlock error), 346=I_C10_WAKEUPRSN_ST3_NFC (NFC) (Wakeup by NFC), 347=I_C10_WAKEUPRSN_ST3_POLLING (POLLING) (Wakeup by Polling (COD belonging to the car was detected)), 348=I_C10_WAKEUPRSN_ST3_TSL_P_PSD (TSL_P_PSD) (Wakeup by Transmission Selector Lever P button pressed), 349=I_C10_WAKEUPRSN_ST3_STWHL_LVR_PSD (STWHL_LVR_PSD) (Wakeup by Steering Wheel Lever pressed), 350=I_C10_WAKEUPRSN_ST3_BAT14_DDP (BAT14_DDP) (Wakeup by Deep discharge protection), 351=I_C10_WAKEUPRSN_ST3_BAT14_LOWCHARGE (BAT14_LOWCHARGE) (Wakeup by low charge of the 12V battery), 352=I_C10_WAKEUPRSN_ST3_BAT14_CHARGECURR (BAT14_CHARGECURR) (Wakeup by charge Current detection), 353=I_C10_WAKEUPRSN_ST3_BAT14_IODM (BAT14_IODM) (Wakeup by IOD Measurement), 354=I_C10_WAKEUPRSN_ST3_BAT14_IODAVG (BAT14_IODAVG) (Wakeup by Average IOD Measurement), 355=I_C10_WAKEUPRSN_ST3_BMS_TMR (BMS_TMR) (Wakeup by BMS timer), 356=I_C10_WAKEUPRSN_ST3_CPD (CPD) (Wakeup by child presence detection), 357=I_C10_WAKEUPRSN_ST3_BMS_TP_EVENT (BMS_TP_EVENT) (Wakeup by thermal propagation event), 358=I_C10_WAKEUPRSN_ST3_BMS_TEMP_CHANGE (BMS_TEMP_CHANGE) (Wakeup by temperature change in HV Battery), 359=I_C10_WAKEUPRSN_ST3_BMS_CHARGE_OVER_MAX_OCV (BMS_CHARGE_OVER_MAX_OCV) (Wakeup by charge over maximum allowed OCV), 360=I_C10_WAKEUPRSN_ST3_BRK_PDL (BRK_PDL) (Wakeup by brake pedal), 361=I_C10_WAKEUPRSN_ST3_VEPM_TMR (VEPM_TMR) (Wakeup by RTC event from VEPM), 362=I_C10_WAKEUPRSN_ST3_PNM_TMR (PNM_TMR) (Wakeup by RTC event from PNM), 363=I_C10_WAKEUPRSN_ST3_BAT14_PREOPEN (BAT14_PREOPEN) (Wakeup by Bat14 for pre open request), 364=I_C10_WAKEUPRSN_ST3_BAT14_HIGHCHARGE (BAT14_HIGHCHARGE) (Wakeup by high charge of the 12V battery), 365=I_C10_WAKEUPRSN_ST3_BAT14_FULLCHRGEMG (BAT14_FULLCHRGEMG) (Wakeup by Bat14 for Fullcharge emergency), 366=I_C10_WAKEUPRSN_ST3_BAT14_CTREMG (BAT14_CTREMG) (Wakeup by Bat14 for CTR emergency), 380=I_C10_WAKEUPRSN_ST3_PNSEC (PNSec) (Wakeup by Secondary Power Network 12V), 381=I_C10_WAKEUPRSN_ST3_PNSEC_BCM (PNSec_BCM) (Wakeup by BCM (recharge battery) of Secondary Power Network 12V), 382=I_C10_WAKEUPRSN_ST3_PNSEC_DCDCCTRL (PNSec_DCDCCtrl) (Wakeup by DCDCCtrl (DCDC-converter for battery recharge) of Secondary Power Network 12V), 383=I_C10_WAKEUPRSN_ST3_PNSEC_DDP (PNSec_DDP) (Wakeup by DDP (deep discharge protection) of Secondary Power Network 12V), 384=I_C10_WAKEUPRSN_ST3_PNSEC_ICC (PNSec_ICC) (Wakeup by ICC (battery warning) of Secondary Power Network 12V), 385=I_C10_WAKEUPRSN_ST3_DEPTM_TMR (DEPTM_TMR) (Wakeup by Departure Time Timer), 390=I_C10_WAKEUPRSN_ST3_CNM_ETH_WAKEUPLINE_CS (CNM_ETH_WAKEUPLINE_CS) (Wakeup by Ethernet CS Line), 391=I_C10_WAKEUPRSN_ST3_CNM_DIAGNOSTIC_ETH_ACT_LINE (CNM_DIAGNOSTIC_ETH_ACT_LINE) (Wakeup by Ethernet Tester connected via the TX Line and pulled the diagnostic activation line), 400=I_C10_WAKEUPRSN_ST3_FOTA_TMR (FOTA_TMR) (Wakeup by FOTA Timer), 410=I_C10_WAKEUPRSN_ST3_BMS_RTM_AFTERRUN_DATA_TRANSFER (BMS_RTM_AFTERRUN_DATA_TRANSFER) (Wakeup by real time monitoring data transfer trigger of BMS), 1020=I_C10_WAKEUPRSN_ST3_RESERVE_3 (RESERVE_3) (Wakeup by Reserve 3), 1021=I_C10_WAKEUPRSN_ST3_RESERVE_2 (RESERVE_2) (Wakeup by Reserve 2), 1022=I_C10_WAKEUPRSN_ST3_RESERVE_1 (RESERVE_1) (Wakeup by Reserve 1), 1023=I_C10_WAKEUPRSN_ST3_SNA (SNA) (SNA value from data type)  # 1 - 99: Auflistung der Netzwerke, z.B. MAIN Wakeup by MAIN -CHASSIS Wakeup by CHASSIS -ENGINE Wakeup by ENGINE … Was ist mit LIN? 100 - 1022: ECU-spezifische Weckgründe, allgemein gehalten, damit die Gründe von allen ECUs verwendet werden können. / 1 - 99: Networks,e.g. MAIN Wakeup by MAIN - CHASSIS Wakeup by CHASSIS -ENGINE Wakeup by ENGINE | What about LIN? 100 - 1022: ECU-specific wakeup reasons, generically so that the reasons can be used by all ECUs
  compu method c12_0_4094_1_SNA: phys=raw for raw 0..4094, 4095=I_C12_0_4094_1_SNA_SNA (SNA) (SNA value from data type)
  compu method c12_km_p_h_0_409k4_0k1: phys=raw*0.1 for raw 0..4094, 4095=I_C12_KM_P_H_0_409K4_0K1_SNA (SNA) (SNA value from data type); unit km/h
  compu method km_per_h_0d1_0: phys=raw*0.1; unit km/h
  compu method c13_A_m409k6_409k4_0k1: phys=raw*0.1-409.6 for raw 0..8190, 8191=I_C13_A_M409K6_409K4_0K1_SNA (SNA) (SNA value from data type); unit A
  compu method A_0d1_m409d6: phys=raw*0.1-409.6; unit A
  compu method c14_rpm_0_8191_0k5: phys=raw*0.5 for raw 0..16382, 16383=I_C14_RPM_0_8191_0K5_SNA (SNA) (SNA value from data type); unit rpm
  compu method rpm_0d5_0: phys=raw*0.5; unit rpm
  compu method c16_m_pro_s_sq_m50_50_0d002: phys=raw*0.002-50 for raw 0..50000, 65535=I_C16_M_PRO_S_SQ_M50_50_0D002_SNA (SNA) (SNA value from data type); unit m/s²
  compu method m_per_s_sq_0d002_m50d0: phys=raw*0.002-50; unit m/s²
  compu method c16_deg_per_sec_m300_300_0d01: phys=raw*0.01-300 for raw 0..60000, 65535=I_C16_DEG_PER_SEC_M300_300_0D01_SNA (SNA) (SNA value from data type); unit °/s
  compu method deg_per_sec_0d01_m300: phys=raw*0.01-300; unit °/s
  compu method c16_deg_per_s_sq_m1200_1200_0d04: phys=raw*0.04-1200 for raw 0..60000, 65535=I_C16_DEG_PER_S_SQ_M1200_1200_0D04_SNA (SNA) (SNA value from data type); unit °/s²
  compu method deg_per_s_sq_0d04_m1200: phys=raw*0.04-1200; unit °/s²
  compu method c24_km_0_999999k9_0k1_Invld_SNA: phys=raw*0.1 for raw 0..9999999, 16777214=I_C24_KM_0_999999K9_0K1_INVLD_SNA_INVLD (INVLD) (Invalid), 16777215=I_C24_KM_0_999999K9_0K1_INVLD_SNA_SNA (SNA) (SNA value from data type); unit km
  compu method km_0d1_0: phys=raw*0.1; unit km
package /DataTypeMappingSets
  data type mapping set DATA_TYPE_MAPPING_SET
    data-type-maps:
      application-data-type=c02_GTS_ESP_Clk_Stat_ST3, implementation-data-type=c02_GTS_ESP_Clk_Stat_ST3
      application-data-type=c02_Inact_Act_ST3, implementation-data-type=c02_Inact_Act_ST3
      application-data-type=c02_Ndef_False_True_ST3, implementation-data-type=c02_Ndef_False_True_ST3
      application-data-type=c02_PT_Rdy_V2, implementation-data-type=c02_PT_Rdy_V2
      application-data-type=c02_Signal_Qual, implementation-data-type=c02_Signal_Qual
      application-data-type=c02_TmSync_Stat, implementation-data-type=c02_TmSync_Stat
      application-data-type=c02_TransMd_Stat, implementation-data-type=c02_TransMd_Stat
      application-data-type=c02_WhlDir, implementation-data-type=c02_WhlDir
      application-data-type=c03_EngStartPN14_Stat, implementation-data-type=c03_EngStartPN14_Stat
      application-data-type=c03_IMU_Force_Ang_Stat_ST3, implementation-data-type=c03_IMU_Force_Ang_Stat_ST3
      application-data-type=c03_IMU_Stat_ST3, implementation-data-type=c03_IMU_Stat_ST3
      application-data-type=c03_ISw_Stat, implementation-data-type=c03_ISw_Stat
      application-data-type=c03_PN14_ProdMd_Stat_ST3, implementation-data-type=c03_PN14_ProdMd_Stat_ST3
      application-data-type=c03_PN14_TDP_Sw_Stat, implementation-data-type=c03_PN14_TDP_Sw_Stat
      application-data-type=c04_VehOpMode, implementation-data-type=c04_VehOpMode
      application-data-type=c07_per_0to100_1_SNA, implementation-data-type=c07_per_0to100_1_SNA
      application-data-type=c07_0_111_1_SNA, implementation-data-type=c07_0_111_1_SNA
      application-data-type=c08_0_254_1_SNA_255, implementation-data-type=c08_0_254_1_SNA_255
      application-data-type=c08_0_255_1_SNA_na, implementation-data-type=c08_0_255_1_SNA_na
      application-data-type=c08_Platform_Stat, implementation-data-type=c08_Platform_Stat
      application-data-type=c08_ROE_0, implementation-data-type=c08_ROE_0
      application-data-type=c08_TmSync_Stat, implementation-data-type=c08_TmSync_Stat
      application-data-type=c08_UInt_SNA_na, implementation-data-type=c08_UInt_SNA_na
      application-data-type=c08_deg_m50_160_1, implementation-data-type=c08_deg_m50_160_1
      application-data-type=c08_degC_m40_85_0k5, implementation-data-type=c08_degC_m40_85_0k5
      application-data-type=c10_Impulses_0_1022_1, implementation-data-type=c10_Impulses_0_1022_1
      application-data-type=c10_V_0_25k55_0k025, implementation-data-type=c10_V_0_25k55_0k025
      application-data-type=c10_WakeupRsn_ST3, implementation-data-type=c10_WakeupRsn_ST3
      application-data-type=c12_0_4094_1_SNA, implementation-data-type=c12_0_4094_1_SNA
      application-data-type=c12_km_p_h_0_409k4_0k1, implementation-data-type=c12_km_p_h_0_409k4_0k1
      application-data-type=c13_A_m409k6_409k4_0k1, implementation-data-type=c13_A_m409k6_409k4_0k1
      application-data-type=c14_rpm_0_8191_0k5, implementation-data-type=c14_rpm_0_8191_0k5
      application-data-type=c16_CRC_woSNA, implementation-data-type=c16_CRC_woSNA
      application-data-type=c16_m_pro_s_sq_m50_50_0d002, implementation-data-type=c16_m_pro_s_sq_m50_50_0d002
      application-data-type=c16_ms_0_6553d5_0d1_noSNA, implementation-data-type=c16_ms_0_6553d5_0d1_noSNA
      application-data-type=c16_deg_per_sec_m300_300_0d01, implementation-data-type=c16_deg_per_sec_m300_300_0d01
      application-data-type=c16_deg_per_s_sq_m1200_1200_0d04, implementation-data-type=c16_deg_per_s_sq_m1200_1200_0d04
      application-data-type=c24_km_0_999999k9_0k1_Invld_SNA, implementation-data-type=c24_km_0_999999k9_0k1_Invld_SNA
      application-data-type=c32_ns_0_4294967295_1_noSNA, implementation-data-type=c32_ns_0_4294967295_1_noSNA
      application-data-type=c32_s_0_4294967295_1_noSNA, implementation-data-type=c32_s_0_4294967295_1_noSNA
      application-data-type=DC_BOOL, implementation-data-type=DC_BOOL
      application-data-type=NM_ActvWakeup, implementation-data-type=NM_ActvWakeup
      application-data-type=NM_Coord_Id, implementation-data-type=NM_Coord_Id
      application-data-type=NM_Coord_SleepRdy, implementation-data-type=NM_Coord_SleepRdy
      application-data-type=NM_PartNw_Info, implementation-data-type=NM_PartNw_Info
      application-data-type=NM_RepeatMsg_Rq, implementation-data-type=NM_RepeatMsg_Rq
      application-data-type=Rsrv01, implementation-data-type=Rsrv01
      application-data-type=Rsrv03, implementation-data-type=Rsrv03
      application-data-type=Rsrv04, implementation-data-type=Rsrv04
      application-data-type=Rsrv08, implementation-data-type=Rsrv08
      application-data-type=Rsrv09, implementation-data-type=Rsrv09
      application-data-type=Rsrv16, implementation-data-type=Rsrv16
package /SystemSignalGroups
  30 x system signal group:
    BCS_Whl_Msg1_BTC_Pr5_ST3: system-signal=[BCS_Whl_Msg1_TmStmp_BTC_ST3, BCS_Whl_Msg1_TmSyncStat_BTC_ST3, CRC_BCS_Whl_Msg1_BTC_Pr5_ST3, GTS_ESP_Clk_Stat_Bckp_ST3, Rsrv1_BCS_Whl_Msg1_BTC_Pr5_ST3, SQC_BCS_Whl_Msg1_BTC_Pr5_ST3, WhlDir_FL_Stat_BTC_ST3, WhlDir_FR_Stat_BTC_ST3, WhlDir_RL_Stat_BTC_ST3, WhlDir_RR_Stat_BTC_ST3, WhlPlsCnt_FL_BTC_ST3, WhlPlsCnt_FR_BTC_ST3, WhlPlsCnt_RL_BTC_ST3, WhlPlsCnt_RR_BTC_ST3, WhlRPM_FL_BTC_ST3, WhlRPM_FL_Qual_BTC_ST3, WhlRPM_FR_BTC_ST3, WhlRPM_FR_Qual_BTC_ST3, WhlRPM_RL_BTC_ST3, WhlRPM_RL_Qual_BTC_ST3, WhlRPM_RR_BTC_ST3, WhlRPM_RR_Qual_BTC_ST3]  # BCS Whl Msg 1 BTC ST3
    BCS_Whl_Msg1_BTC_Pr5_ST3_3z5vvcdtzaheg7vz23u7gb0g6: system-signal=[BCS_Whl_Msg1_TmStmp_BTC_ST3, BCS_Whl_Msg1_TmSyncStat_BTC_ST3, CRC_BCS_Whl_Msg1_BTC_Pr5_ST3, GTS_ESP_Clk_Stat_Bckp_ST3, Rsrv1_BCS_Whl_Msg1_BTC_Pr5_ST3, SQC_BCS_Whl_Msg1_BTC_Pr5_ST3, WhlDir_FL_Stat_BTC_ST3, WhlDir_FR_Stat_BTC_ST3, WhlDir_RL_Stat_BTC_ST3, WhlDir_RR_Stat_BTC_ST3, WhlPlsCnt_FL_BTC_ST3, WhlPlsCnt_FR_BTC_ST3, WhlPlsCnt_RL_BTC_ST3, WhlPlsCnt_RR_BTC_ST3, WhlRPM_FL_BTC_ST3, WhlRPM_FL_Qual_BTC_ST3, WhlRPM_FR_BTC_ST3, WhlRPM_FR_Qual_BTC_ST3, WhlRPM_RL_BTC_ST3, WhlRPM_RL_Qual_BTC_ST3, WhlRPM_RR_BTC_ST3, WhlRPM_RR_Qual_BTC_ST3]  # BCS Whl Msg 1 BTC ST3 (degraded)
    Develop_Rq_IMU_B_ST3: system-signal=[Develop_Rq_IMU_B_01_ST3, Develop_Rq_IMU_B_02_ST3, Develop_Rq_IMU_B_03_ST3, Develop_Rq_IMU_B_04_ST3, Develop_Rq_IMU_B_05_ST3, Develop_Rq_IMU_B_06_ST3, Develop_Rq_IMU_B_07_ST3, Develop_Rq_IMU_B_08_ST3, Develop_Rq_IMU_B_09_ST3, Develop_Rq_IMU_B_10_ST3, Develop_Rq_IMU_B_11_ST3, Develop_Rq_IMU_B_12_ST3, Develop_Rq_IMU_B_13_ST3, Develop_Rq_IMU_B_14_ST3, Develop_Rq_IMU_B_15_ST3, Develop_Rq_IMU_B_16_ST3, Develop_Rq_IMU_B_17_ST3, Develop_Rq_IMU_B_18_ST3, Develop_Rq_IMU_B_19_ST3, Develop_Rq_IMU_B_20_ST3, Develop_Rq_IMU_B_21_ST3, Develop_Rq_IMU_B_22_ST3, Develop_Rq_IMU_B_23_ST3, Develop_Rq_IMU_B_24_ST3, Develop_Rq_IMU_B_25_ST3, Develop_Rq_IMU_B_26_ST3, Develop_Rq_IMU_B_27_ST3, Develop_Rq_IMU_B_28_ST3, Develop_Rq_IMU_B_29_ST3, Develop_Rq_IMU_B_30_ST3, Develop_Rq_IMU_B_31_ST3, Develop_Rq_IMU_B_32_ST3, Develop_Rq_IMU_B_33_ST3, Develop_Rq_IMU_B_34_ST3, Develop_Rq_IMU_B_35_ST3, Develop_Rq_IMU_B_36_ST3, Develop_Rq_IMU_B_37_ST3, Develop_Rq_IMU_B_38_ST3, Develop_Rq_IMU_B_39_ST3, Develop_Rq_IMU_B_40_ST3, Develop_Rq_IMU_B_41_ST3, Develop_Rq_IMU_B_42_ST3, Develop_Rq_IMU_B_43_ST3, Develop_Rq_IMU_B_44_ST3, Develop_Rq_IMU_B_45_ST3, Develop_Rq_IMU_B_46_ST3, Develop_Rq_IMU_B_47_ST3, Develop_Rq_IMU_B_48_ST3, Develop_Rq_IMU_B_49_ST3, Develop_Rq_IMU_B_50_ST3, Develop_Rq_IMU_B_51_ST3, Develop_Rq_IMU_B_52_ST3, Develop_Rq_IMU_B_53_ST3, Develop_Rq_IMU_B_54_ST3, Develop_Rq_IMU_B_55_ST3, Develop_Rq_IMU_B_56_ST3, Develop_Rq_IMU_B_57_ST3, Develop_Rq_IMU_B_58_ST3, Develop_Rq_IMU_B_59_ST3, Develop_Rq_IMU_B_60_ST3, Develop_Rq_IMU_B_61_ST3, Develop_Rq_IMU_B_62_ST3, Develop_Rq_IMU_B_63_ST3, Develop_Rq_IMU_B_64_ST3]  # Development Request
    Develop_Rq_IMU_B_ST3_8agq5stscd7rth0x4nwkynnrf: system-signal=[Develop_Rq_IMU_B_01_ST3, Develop_Rq_IMU_B_02_ST3, Develop_Rq_IMU_B_03_ST3, Develop_Rq_IMU_B_04_ST3, Develop_Rq_IMU_B_05_ST3, Develop_Rq_IMU_B_06_ST3, Develop_Rq_IMU_B_07_ST3, Develop_Rq_IMU_B_08_ST3, Develop_Rq_IMU_B_09_ST3, Develop_Rq_IMU_B_10_ST3, Develop_Rq_IMU_B_11_ST3, Develop_Rq_IMU_B_12_ST3, Develop_Rq_IMU_B_13_ST3, Develop_Rq_IMU_B_14_ST3, Develop_Rq_IMU_B_15_ST3, Develop_Rq_IMU_B_16_ST3, Develop_Rq_IMU_B_17_ST3, Develop_Rq_IMU_B_18_ST3, Develop_Rq_IMU_B_19_ST3, Develop_Rq_IMU_B_20_ST3, Develop_Rq_IMU_B_21_ST3, Develop_Rq_IMU_B_22_ST3, Develop_Rq_IMU_B_23_ST3, Develop_Rq_IMU_B_24_ST3, Develop_Rq_IMU_B_25_ST3, Develop_Rq_IMU_B_26_ST3, Develop_Rq_IMU_B_27_ST3, Develop_Rq_IMU_B_28_ST3, Develop_Rq_IMU_B_29_ST3, Develop_Rq_IMU_B_30_ST3, Develop_Rq_IMU_B_31_ST3, Develop_Rq_IMU_B_32_ST3, Develop_Rq_IMU_B_33_ST3, Develop_Rq_IMU_B_34_ST3, Develop_Rq_IMU_B_35_ST3, Develop_Rq_IMU_B_36_ST3, Develop_Rq_IMU_B_37_ST3, Develop_Rq_IMU_B_38_ST3, Develop_Rq_IMU_B_39_ST3, Develop_Rq_IMU_B_40_ST3, Develop_Rq_IMU_B_41_ST3, Develop_Rq_IMU_B_42_ST3, Develop_Rq_IMU_B_43_ST3, Develop_Rq_IMU_B_44_ST3, Develop_Rq_IMU_B_45_ST3, Develop_Rq_IMU_B_46_ST3, Develop_Rq_IMU_B_47_ST3, Develop_Rq_IMU_B_48_ST3, Develop_Rq_IMU_B_49_ST3, Develop_Rq_IMU_B_50_ST3, Develop_Rq_IMU_B_51_ST3, Develop_Rq_IMU_B_52_ST3, Develop_Rq_IMU_B_53_ST3, Develop_Rq_IMU_B_54_ST3, Develop_Rq_IMU_B_55_ST3, Develop_Rq_IMU_B_56_ST3, Develop_Rq_IMU_B_57_ST3, Develop_Rq_IMU_B_58_ST3, Develop_Rq_IMU_B_59_ST3, Develop_Rq_IMU_B_60_ST3, Develop_Rq_IMU_B_61_ST3, Develop_Rq_IMU_B_62_ST3, Develop_Rq_IMU_B_63_ST3, Develop_Rq_IMU_B_64_ST3]  # Development Request (degraded)
    Develop_Rs_IMU_B_ST3: system-signal=[Develop_Rs_IMU_B_01_ST3, Develop_Rs_IMU_B_02_ST3, Develop_Rs_IMU_B_03_ST3, Develop_Rs_IMU_B_04_ST3, Develop_Rs_IMU_B_05_ST3, Develop_Rs_IMU_B_06_ST3, Develop_Rs_IMU_B_07_ST3, Develop_Rs_IMU_B_08_ST3, Develop_Rs_IMU_B_09_ST3, Develop_Rs_IMU_B_10_ST3, Develop_Rs_IMU_B_11_ST3, Develop_Rs_IMU_B_12_ST3, Develop_Rs_IMU_B_13_ST3, Develop_Rs_IMU_B_14_ST3, Develop_Rs_IMU_B_15_ST3, Develop_Rs_IMU_B_16_ST3, Develop_Rs_IMU_B_17_ST3, Develop_Rs_IMU_B_18_ST3, Develop_Rs_IMU_B_19_ST3, Develop_Rs_IMU_B_20_ST3, Develop_Rs_IMU_B_21_ST3, Develop_Rs_IMU_B_22_ST3, Develop_Rs_IMU_B_23_ST3, Develop_Rs_IMU_B_24_ST3, Develop_Rs_IMU_B_25_ST3, Develop_Rs_IMU_B_26_ST3, Develop_Rs_IMU_B_27_ST3, Develop_Rs_IMU_B_28_ST3, Develop_Rs_IMU_B_29_ST3, Develop_Rs_IMU_B_30_ST3, Develop_Rs_IMU_B_31_ST3, Develop_Rs_IMU_B_32_ST3, Develop_Rs_IMU_B_33_ST3, Develop_Rs_IMU_B_34_ST3, Develop_Rs_IMU_B_35_ST3, Develop_Rs_IMU_B_36_ST3, Develop_Rs_IMU_B_37_ST3, Develop_Rs_IMU_B_38_ST3, Develop_Rs_IMU_B_39_ST3, Develop_Rs_IMU_B_40_ST3, Develop_Rs_IMU_B_41_ST3, Develop_Rs_IMU_B_42_ST3, Develop_Rs_IMU_B_43_ST3, Develop_Rs_IMU_B_44_ST3, Develop_Rs_IMU_B_45_ST3, Develop_Rs_IMU_B_46_ST3, Develop_Rs_IMU_B_47_ST3, Develop_Rs_IMU_B_48_ST3, Develop_Rs_IMU_B_49_ST3, Develop_Rs_IMU_B_50_ST3, Develop_Rs_IMU_B_51_ST3, Develop_Rs_IMU_B_52_ST3, Develop_Rs_IMU_B_53_ST3, Develop_Rs_IMU_B_54_ST3, Develop_Rs_IMU_B_55_ST3, Develop_Rs_IMU_B_56_ST3, Develop_Rs_IMU_B_57_ST3, Develop_Rs_IMU_B_58_ST3, Develop_Rs_IMU_B_59_ST3, Develop_Rs_IMU_B_60_ST3, Develop_Rs_IMU_B_61_ST3, Develop_Rs_IMU_B_62_ST3, Develop_Rs_IMU_B_63_ST3, Develop_Rs_IMU_B_64_ST3]  # Development Response
    Develop_Rs_IMU_B_ST3_6w339n32g20u8dfzm3fvalwqe: system-signal=[Develop_Rs_IMU_B_01_ST3, Develop_Rs_IMU_B_02_ST3, Develop_Rs_IMU_B_03_ST3, Develop_Rs_IMU_B_04_ST3, Develop_Rs_IMU_B_05_ST3, Develop_Rs_IMU_B_06_ST3, Develop_Rs_IMU_B_07_ST3, Develop_Rs_IMU_B_08_ST3, Develop_Rs_IMU_B_09_ST3, Develop_Rs_IMU_B_10_ST3, Develop_Rs_IMU_B_11_ST3, Develop_Rs_IMU_B_12_ST3, Develop_Rs_IMU_B_13_ST3, Develop_Rs_IMU_B_14_ST3, Develop_Rs_IMU_B_15_ST3, Develop_Rs_IMU_B_16_ST3, Develop_Rs_IMU_B_17_ST3, Develop_Rs_IMU_B_18_ST3, Develop_Rs_IMU_B_19_ST3, Develop_Rs_IMU_B_20_ST3, Develop_Rs_IMU_B_21_ST3, Develop_Rs_IMU_B_22_ST3, Develop_Rs_IMU_B_23_ST3, Develop_Rs_IMU_B_24_ST3, Develop_Rs_IMU_B_25_ST3, Develop_Rs_IMU_B_26_ST3, Develop_Rs_IMU_B_27_ST3, Develop_Rs_IMU_B_28_ST3, Develop_Rs_IMU_B_29_ST3, Develop_Rs_IMU_B_30_ST3, Develop_Rs_IMU_B_31_ST3, Develop_Rs_IMU_B_32_ST3, Develop_Rs_IMU_B_33_ST3, Develop_Rs_IMU_B_34_ST3, Develop_Rs_IMU_B_35_ST3, Develop_Rs_IMU_B_36_ST3, Develop_Rs_IMU_B_37_ST3, Develop_Rs_IMU_B_38_ST3, Develop_Rs_IMU_B_39_ST3, Develop_Rs_IMU_B_40_ST3, Develop_Rs_IMU_B_41_ST3, Develop_Rs_IMU_B_42_ST3, Develop_Rs_IMU_B_43_ST3, Develop_Rs_IMU_B_44_ST3, Develop_Rs_IMU_B_45_ST3, Develop_Rs_IMU_B_46_ST3, Develop_Rs_IMU_B_47_ST3, Develop_Rs_IMU_B_48_ST3, Develop_Rs_IMU_B_49_ST3, Develop_Rs_IMU_B_50_ST3, Develop_Rs_IMU_B_51_ST3, Develop_Rs_IMU_B_52_ST3, Develop_Rs_IMU_B_53_ST3, Develop_Rs_IMU_B_54_ST3, Develop_Rs_IMU_B_55_ST3, Develop_Rs_IMU_B_56_ST3, Develop_Rs_IMU_B_57_ST3, Develop_Rs_IMU_B_58_ST3, Develop_Rs_IMU_B_59_ST3, Develop_Rs_IMU_B_60_ST3, Develop_Rs_IMU_B_61_ST3, Develop_Rs_IMU_B_62_ST3, Develop_Rs_IMU_B_63_ST3, Develop_Rs_IMU_B_64_ST3]  # Development Response (degraded)
    DI_Odo_Pr5_ST3: system-signal=[CRC_DI_Odo_Pr5_ST3, Odo_ST3, SQC_DI_Odo_Pr5_ST3]  # DriverInformation Odometer
    DI_Odo_Pr5_ST3_e68xmtlkywxgxsdwekdjjhw3t: system-signal=[CRC_DI_Odo_Pr5_ST3, Odo_ST3, SQC_DI_Odo_Pr5_ST3]  # DriverInformation Odometer (degraded)
    Ign_Stat_Pr5_ST3: system-signal=[CRC_Ign_Stat_Pr5_ST3, ISw_Stat_ST3, KG_StartSw_Psd_ST3, SQC_Ign_Stat_Pr5_ST3, Veh_Op_Mode_ST3]  # Zuendungsstatus / Ignition state
    Ign_Stat_Pr5_ST3_csgs1dv6drms80o1i9p49677w: system-signal=[CRC_Ign_Stat_Pr5_ST3, ISw_Stat_ST3, KG_StartSw_Psd_ST3, SQC_Ign_Stat_Pr5_ST3, Veh_Op_Mode_ST3]  # Zuendungsstatus (degraded) / Ignition state (degraded)
    IMU_A_Output_Fast_Pr5_ST3: system-signal=[CRC_IMU_A_Output_Fast_Pr5_ST3, IMU_A_AngAcc_Stat_Fast_ST3, IMU_A_AngAcc_X_Fast_ST3, IMU_A_AngAcc_Y_Fast_ST3, IMU_A_AngAcc_Z_Fast_ST3, IMU_A_AngRate_X_Fast_ST3, IMU_A_AngRate_Y_Fast_ST3, IMU_A_AngRate_Z_Fast_ST3, IMU_A_AngRates_Stat_Fast_ST3, IMU_A_SpecForce_Stat_Fast_ST3, IMU_A_SpecForce_X_Fast_ST3, IMU_A_SpecForce_Y_Fast_ST3, IMU_A_SpecForce_Z_Fast_ST3, IMU_A_Stat_Fast_ST3, IMU_A_Temp_Fast_ST3, IMU_A_TmStmp_NanoSec_Fast_ST3, IMU_A_TmStmp_Sec_Fast_ST3, IMU_A_TmSync_Stat_Fast_ST3, Rsrv01_IMU_A_Output_Fast_Pr5_ST3, Rsrv02_IMU_A_Output_Fast_Pr5_ST3, Rsrv03_IMU_A_Output_Fast_Pr5_ST3, Rsrv04_IMU_A_Output_Fast_Pr5_ST3, Rsrv05_IMU_A_Output_Fast_Pr5_ST3, Rsrv06_IMU_A_Output_Fast_Pr5_ST3, Rsrv07_IMU_A_Output_Fast_Pr5_ST3, SQC_IMU_A_Output_Fast_Pr5_ST3]  # IMU A Output Pr 5 ST3
    IMU_A_Output_Fast_Pr5_ST3_5ym0lyqjosyobfhfksta75zc4: system-signal=[CRC_IMU_A_Output_Fast_Pr5_ST3, IMU_A_AngAcc_Stat_Fast_ST3, IMU_A_AngAcc_X_Fast_ST3, IMU_A_AngAcc_Y_Fast_ST3, IMU_A_AngAcc_Z_Fast_ST3, IMU_A_AngRate_X_Fast_ST3, IMU_A_AngRate_Y_Fast_ST3, IMU_A_AngRate_Z_Fast_ST3, IMU_A_AngRates_Stat_Fast_ST3, IMU_A_SpecForce_Stat_Fast_ST3, IMU_A_SpecForce_X_Fast_ST3, IMU_A_SpecForce_Y_Fast_ST3, IMU_A_SpecForce_Z_Fast_ST3, IMU_A_Stat_Fast_ST3, IMU_A_Temp_Fast_ST3, IMU_A_TmStmp_NanoSec_Fast_ST3, IMU_A_TmStmp_Sec_Fast_ST3, IMU_A_TmSync_Stat_Fast_ST3, Rsrv01_IMU_A_Output_Fast_Pr5_ST3, Rsrv02_IMU_A_Output_Fast_Pr5_ST3, Rsrv03_IMU_A_Output_Fast_Pr5_ST3, Rsrv04_IMU_A_Output_Fast_Pr5_ST3, Rsrv05_IMU_A_Output_Fast_Pr5_ST3, Rsrv06_IMU_A_Output_Fast_Pr5_ST3, Rsrv07_IMU_A_Output_Fast_Pr5_ST3, SQC_IMU_A_Output_Fast_Pr5_ST3]  # IMU A Output Pr 5 ST3 (degraded)
    IMU_B_Output_Pr5_ST3: system-signal=[CRC_IMU_B_Output_Pr5_ST3, IMU_B_AngAcc_Stat_ST3, IMU_B_AngAcc_X_ST3, IMU_B_AngAcc_Y_ST3, IMU_B_AngAcc_Z_ST3, IMU_B_AngRate_X_ST3, IMU_B_AngRate_Y_ST3, IMU_B_AngRate_Z_ST3, IMU_B_AngRates_Stat_ST3, IMU_B_SpecForce_Stat_ST3, IMU_B_SpecForce_X_ST3, IMU_B_SpecForce_Y_ST3, IMU_B_SpecForce_Z_ST3, IMU_B_Stat_ST3, IMU_B_Temp_ST3, IMU_B_TmStmp_NanoSec_ST3, IMU_B_TmStmp_Sec_ST3, IMU_B_TmSync_Stat_ST3, Rsrv01_IMU_B_Output_Pr5_ST3, Rsrv02_IMU_B_Output_Pr5_ST3, Rsrv03_IMU_B_Output_Pr5_ST3, Rsrv04_IMU_B_Output_Pr5_ST3, Rsrv05_IMU_B_Output_Pr5_ST3, Rsrv06_IMU_B_Output_Pr5_ST3, Rsrv07_IMU_B_Output_Pr5_ST3, SQC_IMU_B_Output_Pr5_ST3]  # IMU B Output Pr 5 ST3
    IMU_B_Output_Pr5_ST3_8enshzy4a8xe2badcgusoewm2: system-signal=[CRC_IMU_B_Output_Pr5_ST3, IMU_B_AngAcc_Stat_ST3, IMU_B_AngAcc_X_ST3, IMU_B_AngAcc_Y_ST3, IMU_B_AngAcc_Z_ST3, IMU_B_AngRate_X_ST3, IMU_B_AngRate_Y_ST3, IMU_B_AngRate_Z_ST3, IMU_B_AngRates_Stat_ST3, IMU_B_SpecForce_Stat_ST3, IMU_B_SpecForce_X_ST3, IMU_B_SpecForce_Y_ST3, IMU_B_SpecForce_Z_ST3, IMU_B_Stat_ST3, IMU_B_Temp_ST3, IMU_B_TmStmp_NanoSec_ST3, IMU_B_TmStmp_Sec_ST3, IMU_B_TmSync_Stat_ST3, Rsrv01_IMU_B_Output_Pr5_ST3, Rsrv02_IMU_B_Output_Pr5_ST3, Rsrv03_IMU_B_Output_Pr5_ST3, Rsrv04_IMU_B_Output_Pr5_ST3, Rsrv05_IMU_B_Output_Pr5_ST3, Rsrv06_IMU_B_Output_Pr5_ST3, Rsrv07_IMU_B_Output_Pr5_ST3, SQC_IMU_B_Output_Pr5_ST3]  # IMU B Output Pr 5 ST3 (degraded)
    Meas_IMU_B_ST3: system-signal=[Meas_IMU_B_01_ST3, Meas_IMU_B_02_ST3, Meas_IMU_B_03_ST3, Meas_IMU_B_04_ST3, Meas_IMU_B_05_ST3, Meas_IMU_B_06_ST3, Meas_IMU_B_07_ST3, Meas_IMU_B_08_ST3, Meas_IMU_B_09_ST3, Meas_IMU_B_10_ST3, Meas_IMU_B_11_ST3, Meas_IMU_B_12_ST3, Meas_IMU_B_13_ST3, Meas_IMU_B_14_ST3, Meas_IMU_B_15_ST3, Meas_IMU_B_16_ST3, Meas_IMU_B_17_ST3, Meas_IMU_B_18_ST3, Meas_IMU_B_19_ST3, Meas_IMU_B_20_ST3, Meas_IMU_B_21_ST3, Meas_IMU_B_22_ST3, Meas_IMU_B_23_ST3, Meas_IMU_B_24_ST3, Meas_IMU_B_25_ST3, Meas_IMU_B_26_ST3, Meas_IMU_B_27_ST3, Meas_IMU_B_28_ST3, Meas_IMU_B_29_ST3, Meas_IMU_B_30_ST3, Meas_IMU_B_31_ST3, Meas_IMU_B_32_ST3, Meas_IMU_B_33_ST3, Meas_IMU_B_34_ST3, Meas_IMU_B_35_ST3, Meas_IMU_B_36_ST3, Meas_IMU_B_37_ST3, Meas_IMU_B_38_ST3, Meas_IMU_B_39_ST3, Meas_IMU_B_40_ST3, Meas_IMU_B_41_ST3, Meas_IMU_B_42_ST3, Meas_IMU_B_43_ST3, Meas_IMU_B_44_ST3, Meas_IMU_B_45_ST3, Meas_IMU_B_46_ST3, Meas_IMU_B_47_ST3, Meas_IMU_B_48_ST3, Meas_IMU_B_49_ST3, Meas_IMU_B_50_ST3, Meas_IMU_B_51_ST3, Meas_IMU_B_52_ST3, Meas_IMU_B_53_ST3, Meas_IMU_B_54_ST3, Meas_IMU_B_55_ST3, Meas_IMU_B_56_ST3, Meas_IMU_B_57_ST3, Meas_IMU_B_58_ST3, Meas_IMU_B_59_ST3, Meas_IMU_B_60_ST3, Meas_IMU_B_61_ST3, Meas_IMU_B_62_ST3, Meas_IMU_B_63_ST3, Meas_IMU_B_64_ST3]  # Messbotschaft / Measurement
    Meas_IMU_B_ST3_9b4k5uqw790qkzbaaznvwy423: system-signal=[Meas_IMU_B_01_ST3, Meas_IMU_B_02_ST3, Meas_IMU_B_03_ST3, Meas_IMU_B_04_ST3, Meas_IMU_B_05_ST3, Meas_IMU_B_06_ST3, Meas_IMU_B_07_ST3, Meas_IMU_B_08_ST3, Meas_IMU_B_09_ST3, Meas_IMU_B_10_ST3, Meas_IMU_B_11_ST3, Meas_IMU_B_12_ST3, Meas_IMU_B_13_ST3, Meas_IMU_B_14_ST3, Meas_IMU_B_15_ST3, Meas_IMU_B_16_ST3, Meas_IMU_B_17_ST3, Meas_IMU_B_18_ST3, Meas_IMU_B_19_ST3, Meas_IMU_B_20_ST3, Meas_IMU_B_21_ST3, Meas_IMU_B_22_ST3, Meas_IMU_B_23_ST3, Meas_IMU_B_24_ST3, Meas_IMU_B_25_ST3, Meas_IMU_B_26_ST3, Meas_IMU_B_27_ST3, Meas_IMU_B_28_ST3, Meas_IMU_B_29_ST3, Meas_IMU_B_30_ST3, Meas_IMU_B_31_ST3, Meas_IMU_B_32_ST3, Meas_IMU_B_33_ST3, Meas_IMU_B_34_ST3, Meas_IMU_B_35_ST3, Meas_IMU_B_36_ST3, Meas_IMU_B_37_ST3, Meas_IMU_B_38_ST3, Meas_IMU_B_39_ST3, Meas_IMU_B_40_ST3, Meas_IMU_B_41_ST3, Meas_IMU_B_42_ST3, Meas_IMU_B_43_ST3, Meas_IMU_B_44_ST3, Meas_IMU_B_45_ST3, Meas_IMU_B_46_ST3, Meas_IMU_B_47_ST3, Meas_IMU_B_48_ST3, Meas_IMU_B_49_ST3, Meas_IMU_B_50_ST3, Meas_IMU_B_51_ST3, Meas_IMU_B_52_ST3, Meas_IMU_B_53_ST3, Meas_IMU_B_54_ST3, Meas_IMU_B_55_ST3, Meas_IMU_B_56_ST3, Meas_IMU_B_57_ST3, Meas_IMU_B_58_ST3, Meas_IMU_B_59_ST3, Meas_IMU_B_60_ST3, Meas_IMU_B_61_ST3, Meas_IMU_B_62_ST3, Meas_IMU_B_63_ST3, Meas_IMU_B_64_ST3]  # Messbotschaft (degraded) / Measurement (degraded)
    PT4_PTCoor4_Pr5_ST3: system-signal=[CRC_PT4_PTCoor4_Pr5_ST3, PT4_PTCoor_EngStartPN14_Stat_ST3, PT4_PTCoor_PT_Rdy_ST3, PT4_PTCoor_SSA_EngSp_ST3, Rsrv1_PT4_PTCoor_PT_Rdy_Pr5_ST3, SQC_PT4_PTCoor4_Pr5_ST3]
    PT4_PTCoor4_Pr5_ST3_af4fxb1ykieox3itqdfzs0kpb: system-signal=[CRC_PT4_PTCoor4_Pr5_ST3, PT4_PTCoor_EngStartPN14_Stat_ST3, PT4_PTCoor_PT_Rdy_ST3, PT4_PTCoor_SSA_EngSp_ST3, Rsrv1_PT4_PTCoor_PT_Rdy_Pr5_ST3, SQC_PT4_PTCoor4_Pr5_ST3]  # PT4_PTCoor4_Pr5_ST3 (degraded)
    ROE_IMU_B_ST3: system-signal=[ROE_0_IMU_B_ST3, ROE_1_IMU_B_ST3, ROE_2_IMU_B_ST3, ROE_3_IMU_B_ST3, ROE_4_IMU_B_ST3, ROE_5_IMU_B_ST3, ROE_6_IMU_B_ST3, ROE_7_IMU_B_ST3]  # Ereignis-Antwort / Response on Event
    ROE_IMU_B_ST3_7zavpp3siu6s2eitdaqxg7lwg: system-signal=[ROE_0_IMU_B_ST3, ROE_1_IMU_B_ST3, ROE_2_IMU_B_ST3, ROE_3_IMU_B_ST3, ROE_4_IMU_B_ST3, ROE_5_IMU_B_ST3, ROE_6_IMU_B_ST3, ROE_7_IMU_B_ST3]  # Ereignis-Antwort (degraded) / Response on Event (degraded)
    VSS_TP_Auth_ST3: system-signal=[VSS_TP_Auth_0_ST3, VSS_TP_Auth_1_ST3, VSS_TP_Auth_2_ST3, VSS_TP_Auth_3_ST3, VSS_TP_Auth_4_ST3, VSS_TP_Auth_5_ST3, VSS_TP_Auth_6_ST3, VSS_TP_Auth_7_ST3]  # VSS-Transportprotokoll für Authentifizierung / Vehicle Security System Transport Protocol for authentication broadcast
    VSS_TP_Auth_ST3_6j4id7sghlvlbroli4wjozjik: system-signal=[VSS_TP_Auth_0_ST3, VSS_TP_Auth_1_ST3, VSS_TP_Auth_2_ST3, VSS_TP_Auth_3_ST3, VSS_TP_Auth_4_ST3, VSS_TP_Auth_5_ST3, VSS_TP_Auth_6_ST3, VSS_TP_Auth_7_ST3]  # VSS-Transportprotokoll für Authentifizierung (degraded) / Vehicle Security System Transport Protocol for authentication broadcast (degraded)
    VSS_TP_RealTmOffset_ST3: system-signal=[VSS_TP_RealTmOffset_0_ST3, VSS_TP_RealTmOffset_1_ST3, VSS_TP_RealTmOffset_2_ST3, VSS_TP_RealTmOffset_3_ST3, VSS_TP_RealTmOffset_4_ST3, VSS_TP_RealTmOffset_5_ST3, VSS_TP_RealTmOffset_6_ST3, VSS_TP_RealTmOffset_7_ST3]  # VSS-Transportprotokoll für Echtzeit-Offset / Vehicle Security System Transport Protocol for real time offset broadcast
    VSS_TP_RealTmOffset_ST3_1t7vc44gftc0wv35k5kgc2in9: system-signal=[VSS_TP_RealTmOffset_0_ST3, VSS_TP_RealTmOffset_1_ST3, VSS_TP_RealTmOffset_2_ST3, VSS_TP_RealTmOffset_3_ST3, VSS_TP_RealTmOffset_4_ST3, VSS_TP_RealTmOffset_5_ST3, VSS_TP_RealTmOffset_6_ST3, VSS_TP_RealTmOffset_7_ST3]  # VSS-Transportprotokoll für Echtzeit-Offset (degraded) / Vehicle Security System Transport Protocol for real time offset broadcast (degraded)
    VSS_TP_SecTickCount_Lvl1_ST3: system-signal=[VSS_TP_SecTickCount_Lvl1_0_ST3, VSS_TP_SecTickCount_Lvl1_1_ST3, VSS_TP_SecTickCount_Lvl1_2_ST3, VSS_TP_SecTickCount_Lvl1_3_ST3, VSS_TP_SecTickCount_Lvl1_4_ST3, VSS_TP_SecTickCount_Lvl1_5_ST3, VSS_TP_SecTickCount_Lvl1_6_ST3, VSS_TP_SecTickCount_Lvl1_7_ST3]  # VSS-Transportprotokoll für sichere Zeit Stufe 1 / Vehicle Security System Transport Protocol for secure tick count level #1
    VSS_TP_SecTickCount_Lvl1_ST3_mzmfdqtqz5kvv1kfpvg0kql3: system-signal=[VSS_TP_SecTickCount_Lvl1_0_ST3, VSS_TP_SecTickCount_Lvl1_1_ST3, VSS_TP_SecTickCount_Lvl1_2_ST3, VSS_TP_SecTickCount_Lvl1_3_ST3, VSS_TP_SecTickCount_Lvl1_4_ST3, VSS_TP_SecTickCount_Lvl1_5_ST3, VSS_TP_SecTickCount_Lvl1_6_ST3, VSS_TP_SecTickCount_Lvl1_7_ST3]  # VSS-Transportprotokoll für sichere Zeit Stufe 1 (degraded) / Vehicle Security System Transport Protocol for secure tick count level #1 (degraded)
    VSS_TP_SharedSecret_ST3: system-signal=[VSS_TP_SharedSecret_0_ST3, VSS_TP_SharedSecret_1_ST3, VSS_TP_SharedSecret_2_ST3, VSS_TP_SharedSecret_3_ST3, VSS_TP_SharedSecret_4_ST3, VSS_TP_SharedSecret_5_ST3, VSS_TP_SharedSecret_6_ST3, VSS_TP_SharedSecret_7_ST3]  # VSS-Transportprotokoll für gemeinsames Geheimnis / Vehicle Security System Transport Protocol for shared secret broadcast
    VSS_TP_SharedSecret_ST3_8pj4t8t4rm3tw3pk5hj7vonti: system-signal=[VSS_TP_SharedSecret_0_ST3, VSS_TP_SharedSecret_1_ST3, VSS_TP_SharedSecret_2_ST3, VSS_TP_SharedSecret_3_ST3, VSS_TP_SharedSecret_4_ST3, VSS_TP_SharedSecret_5_ST3, VSS_TP_SharedSecret_6_ST3, VSS_TP_SharedSecret_7_ST3]  # VSS-Transportprotokoll für gemeinsames Geheimnis (degraded) / Vehicle Security System Transport Protocol for shared secret broadcast (degraded)
    VSS_TP_VIN_ST3: system-signal=[VSS_TP_VIN_0_ST3, VSS_TP_VIN_1_ST3, VSS_TP_VIN_2_ST3, VSS_TP_VIN_3_ST3, VSS_TP_VIN_4_ST3, VSS_TP_VIN_5_ST3, VSS_TP_VIN_6_ST3, VSS_TP_VIN_7_ST3]  # VSS-Transportprotokoll für Fahrzeugidentifikationsnummer / Vehicle Security System Transport Protocol for Vehicle Identification Number
    VSS_TP_VIN_ST3_bz1xsv84cxzl09j028gn39p69: system-signal=[VSS_TP_VIN_0_ST3, VSS_TP_VIN_1_ST3, VSS_TP_VIN_2_ST3, VSS_TP_VIN_3_ST3, VSS_TP_VIN_4_ST3, VSS_TP_VIN_5_ST3, VSS_TP_VIN_6_ST3, VSS_TP_VIN_7_ST3]  # VSS-Transportprotokoll für Fahrzeugidentifikationsnummer (degraded) / Vehicle Security System Transport Protocol for Vehicle Identification Number (degraded)
package /EcuInstances
  ecu instance IMU_A:
    associated-com-i-pdu-group=[IMU_A_IMU_INTERNAL_Tx_PNC_All_Active, IMU_A_IMU_INTERNAL_Tx_PNC_15_ComCtrl, IMU_A_IMU_INTERNAL_Tx_PNC_20, IMU_A_IMU_INTERNAL_Tx_PNC_23, IMU_A_IMU_INTERNAL_Rx_PNC_All_Active, IMU_A_IMU_INTERNAL_Rx_PNC_20, IMU_A_IMU_INTERNAL_Rx_PNC_23]
    com-configuration-gw-time-base=0.005
    com-configuration-rx-time-base=0.005
    com-configuration-tx-time-base=0.005
    pn-reset-time=1.1
    pnc-prepare-sleep-timer=1.3
    sleep-mode-supported=true
    wake-up-over-bus-supported=true
    can communication controller IMU_A_IMU_INTERNAL: wake-up-by-controller-supported=true, can-controller-attributes=can-controller-configuration-requirements={can-controller-fd-requirements={max-number-of-time-quanta-per-bit=20, max-sample-point=75.0, max-sync-jump-width=25.0, min-number-of-time-quanta-per-bit=20, min-sample-point=75.0, min-sync-jump-width=25.0, padding-value=0, tx-bit-rate-switch=true}, max-number-of-time-quanta-per-bit=40, max-sample-point=80.0, max-sync-jump-width=20.0, min-number-of-time-quanta-per-bit=40, min-sample-point=80.0, min-sync-jump-width=20.0}
    can communication connector IMU_A_IMU_INTERNAL_6hr0dxrs6bxnusth9n7j0x4yv: comm-controller=IMU_A_IMU_INTERNAL, pnc-gateway-type=ACTIVE, pnc-wakeup-data-mask=2424307968
  ecu instance IMU_B:
    associated-com-i-pdu-group=[TxMess_IMU_B_IMU_INTERNAL, IMU_B_IMU_INTERNAL_Tx_PNC_All_Active, IMU_B_IMU_INTERNAL_Tx_PNC_20, IMU_B_IMU_INTERNAL_Tx_PNC_23, IMU_B_IMU_INTERNAL_Rx_PNC_All_Active, IMU_B_IMU_INTERNAL_Rx_PNC_15_ComCtrl, IMU_B_IMU_INTERNAL_Rx_PNC_20, IMU_B_IMU_INTERNAL_Rx_PNC_23]
    com-configuration-gw-time-base=0.005
    com-configuration-rx-time-base=0.005
    com-configuration-tx-time-base=0.005
    pn-reset-time=1.1
    pnc-prepare-sleep-timer=1.3
    sleep-mode-supported=true
    wake-up-over-bus-supported=true
    can communication controller IMU_B_IMU_INTERNAL: wake-up-by-controller-supported=true, can-controller-attributes=can-controller-configuration-requirements={can-controller-fd-requirements={max-number-of-time-quanta-per-bit=20, max-sample-point=75.0, max-sync-jump-width=25.0, min-number-of-time-quanta-per-bit=20, min-sample-point=75.0, min-sync-jump-width=25.0, padding-value=0, tx-bit-rate-switch=true}, max-number-of-time-quanta-per-bit=40, max-sample-point=80.0, max-sync-jump-width=20.0, min-number-of-time-quanta-per-bit=40, min-sample-point=80.0, min-sync-jump-width=20.0}
    can communication connector IMU_B_IMU_INTERNAL_949amicgr3ot53d5rms7k8b3w: comm-controller=IMU_B_IMU_INTERNAL, pnc-gateway-type=PASSIVE, pnc-wakeup-data-mask=2424307968
package /Pdus/IMU_INTERNAL/PKG_IMU_INTERNAL
  pdu BCS_Whl_Msg1_BTC_ST3: length=20, transmission-mode-true-timing=cyclic-timing=time-period=0.02, unused-bit-pattern=255  # BCS Whl Msg 1 ST3
    signal BCS_Whl_Msg1_TmStmp_BTC_ST3: start 136, 16 bit, little-endian, data-type-policy=OVERRIDE, i-signal-type=PRIMITIVE, init-value=0, base-type=uint16, compu {phys=raw*0.1; unit ms}, data-constr=c16_ms_0_6553d5_0d1_noSNA, to IMU_B(timeout 0.21 s)  # Radbotschaft 1 Zeitstempel / Wheel message #1 time stamp
    signal BCS_Whl_Msg1_TmSyncStat_BTC_ST3: start 152, 2 bit, little-endian, data-type-policy=OVERRIDE, i-signal-type=PRIMITIVE, init-value=3, base-type=uint8, invalid-value=3, compu-method=c02_TmSync_Stat, data-constr=c02_TmSync_Stat, to IMU_B(timeout 0.21 s)  # Synchronisationsstatus des globalen Zeitstempels der Komponente ESP / Global Timestamp synchronisation status of component ESP
    signal CRC_BCS_Whl_Msg1_BTC_Pr5_ST3: start 0, 16 bit, little-endian, data-type-policy=OVERRIDE, i-signal-type=PRIMITIVE, init-value=3143, base-type=uint16, data-constr=c16_CRC_woSNA, to IMU_B(timeout 0.21 s)  # CRC-Checksumme der Signal Gruppe gemäß AUTOSAR Profil 5 / CRC-checksum of signal group according to AUTOSAR Profile 5
    signal GTS_ESP_Clk_Stat_Bckp_ST3: start 154, 2 bit, little-endian, data-type-policy=OVERRIDE, i-signal-type=PRIMITIVE, init-value=0, base-type=uint8, compu-method=c02_GTS_ESP_Clk_Stat_ST3, data-constr=c02_GTS_ESP_Clk_Stat_ST3, to IMU_B(timeout 0.21 s)  # Internal ESP GTS Clock Stat
    signal SQC_BCS_Whl_Msg1_BTC_Pr5_ST3: start 16, 8 bit, little-endian, data-type-policy=OVERRIDE, i-signal-type=PRIMITIVE, init-value=0, base-type=uint8, compu {identical}, data-constr=c08_0_255_1_SNA_na, to IMU_B(timeout 0.21 s)  # Sequenzzähler / Sequence counter
    signal WhlDir_FL_Stat_BTC_ST3: start 34, 2 bit, little-endian, data-type-policy=OVERRIDE, i-signal-type=PRIMITIVE, init-value=3, base-type=uint8, invalid-value=3, compu-method=c02_WhlDir, data-constr=c02_WhlDir, to IMU_B(timeout 0.21 s)  # Drehrichtung Rad vorne links (SNA falls Sensor nicht vorhanden) / Direction of rotation of front left wheel (SNA if sensor not present)
    signal WhlDir_FR_Stat_BTC_ST3: start 36, 2 bit, little-endian, data-type-policy=OVERRIDE, i-signal-type=PRIMITIVE, init-value=3, base-type=uint8, invalid-value=3, compu-method=c02_WhlDir, data-constr=c02_WhlDir, to IMU_B(timeout 0.21 s)  # Drehrichtung Rad vorne rechts (SNA falls Sensor nicht vorhanden) / Direction of rotation of front right wheel (SNA if sensor not present)
    signal WhlDir_RL_Stat_BTC_ST3: start 38, 2 bit, little-endian, data-type-policy=OVERRIDE, i-signal-type=PRIMITIVE, init-value=3, base-type=uint8, invalid-value=3, compu-method=c02_WhlDir, data-constr=c02_WhlDir, to IMU_B(timeout 0.21 s)  # Drehrichtung Rad hinten links (SNA falls Sensor nicht vorhanden) / Direction of rotation of rear left wheel (SNA if sensor not present)
    signal WhlDir_RR_Stat_BTC_ST3: start 134, 2 bit, little-endian, data-type-policy=OVERRIDE, i-signal-type=PRIMITIVE, init-value=3, base-type=uint8, invalid-value=3, compu-method=c02_WhlDir, data-constr=c02_WhlDir, to IMU_B(timeout 0.21 s)  # Drehrichtung Rad hinten rechts (SNA falls Sensor nicht vorhanden) / Direction of rotation of rear right wheel (SNA if sensor not present)
    signal WhlPlsCnt_FL_BTC_ST3: start 104, 10 bit, little-endian, data-type-policy=OVERRIDE, i-signal-type=PRIMITIVE, init-value=1023, base-type=uint16, invalid-value=1023, compu-method=c10_Impulses_0_1022_1, data-constr=c10_Impulses_0_1022_1, to IMU_B(timeout 0.21 s)  # Impuls-Ringzähler Rad vorne links (160 pro Umdrehung) / Wheel pulse counter front left (160 per rotation)
    signal WhlPlsCnt_FR_BTC_ST3: start 114, 10 bit, little-endian, data-type-policy=OVERRIDE, i-signal-type=PRIMITIVE, init-value=1023, base-type=uint16, invalid-value=1023, compu-method=c10_Impulses_0_1022_1, data-constr=c10_Impulses_0_1022_1, to IMU_B(timeout 0.21 s)  # Impuls-Ringzähler Rad vorne rechts (160 pro Umdrehung) / Wheel pulse counter front right (160 per rotation)
    signal WhlPlsCnt_RL_BTC_ST3: start 24, 10 bit, little-endian, data-type-policy=OVERRIDE, i-signal-type=PRIMITIVE, init-value=1023, base-type=uint16, invalid-value=1023, compu-method=c10_Impulses_0_1022_1, data-constr=c10_Impulses_0_1022_1, to IMU_B(timeout 0.21 s)  # Impuls-Ringzähler Rad hinten links (160 pro Umdrehung) / Wheel pulse counter rear left (160 per rotation)
    signal WhlPlsCnt_RR_BTC_ST3: start 124, 10 bit, little-endian, data-type-policy=OVERRIDE, i-signal-type=PRIMITIVE, init-value=1023, base-type=uint16, invalid-value=1023, compu-method=c10_Impulses_0_1022_1, data-constr=c10_Impulses_0_1022_1, to IMU_B(timeout 0.21 s)  # Impuls-Ringzähler Rad hinten rechts (160 pro Umdrehung) / Wheel pulse counter rear right (160 per rotation)
    signal WhlRPM_FL_BTC_ST3: start 40, 14 bit, little-endian, data-type-policy=OVERRIDE, i-signal-type=PRIMITIVE, init-value=16383, base-type=uint16, invalid-value=16383, compu-method=c14_rpm_0_8191_0k5, data-constr=c14_rpm_0_8191_0k5, to IMU_B(timeout 0.21 s)  # Raddrehzahl vorne links / Wheel rpm front left
    signal WhlRPM_FL_Qual_BTC_ST3: start 54, 2 bit, little-endian, data-type-policy=OVERRIDE, i-signal-type=PRIMITIVE, init-value=1, base-type=uint8, compu-method=c02_Signal_Qual, data-constr=c02_Signal_Qual, to IMU_B(timeout 0.21 s)  # Qualität der Raddrehzahl vorne links / Quality of wheel rpm front left
    signal WhlRPM_FR_BTC_ST3: start 56, 14 bit, little-endian, data-type-policy=OVERRIDE, i-signal-type=PRIMITIVE, init-value=16383, base-type=uint16, invalid-value=16383, compu-method=c14_rpm_0_8191_0k5, data-constr=c14_rpm_0_8191_0k5, to IMU_B(timeout 0.21 s)  # Raddrehzahl vorne rechts / Wheel rpm front right
    signal WhlRPM_FR_Qual_BTC_ST3: start 70, 2 bit, little-endian, data-type-policy=OVERRIDE, i-signal-type=PRIMITIVE, init-value=1, base-type=uint8, compu-method=c02_Signal_Qual, data-constr=c02_Signal_Qual, to IMU_B(timeout 0.21 s)  # Qualität der Raddrehzahl vorne rechts / Quality of wheel rpm front right
    signal WhlRPM_RL_BTC_ST3: start 72, 14 bit, little-endian, data-type-policy=OVERRIDE, i-signal-type=PRIMITIVE, init-value=16383, base-type=uint16, invalid-value=16383, compu-method=c14_rpm_0_8191_0k5, data-constr=c14_rpm_0_8191_0k5, to IMU_B(timeout 0.21 s)  # Raddrehzahl hinten links / Wheel rpm rear left
    signal WhlRPM_RL_Qual_BTC_ST3: start 86, 2 bit, little-endian, data-type-policy=OVERRIDE, i-signal-type=PRIMITIVE, init-value=1, base-type=uint8, compu-method=c02_Signal_Qual, data-constr=c02_Signal_Qual, to IMU_B(timeout 0.21 s)  # Qualität der Raddrehzahl hinten links / Quality of wheel rpm rear left
    signal WhlRPM_RR_BTC_ST3: start 88, 14 bit, little-endian, data-type-policy=OVERRIDE, i-signal-type=PRIMITIVE, init-value=16383, base-type=uint16, invalid-value=16383, compu-method=c14_rpm_0_8191_0k5, data-constr=c14_rpm_0_8191_0k5, to IMU_B(timeout 0.21 s)  # Raddrehzahl hinten rechts / Wheel rpm rear right
    signal WhlRPM_RR_Qual_BTC_ST3: start 102, 2 bit, little-endian, data-type-policy=OVERRIDE, i-signal-type=PRIMITIVE, init-value=1, base-type=uint8, compu-method=c02_Signal_Qual, data-constr=c02_Signal_Qual, to IMU_B(timeout 0.21 s)  # Qualität der Raddrehzahl hinten rechts / Quality of wheel rpm rear right
    signal Rsrv1_BCS_Whl_Msg1_BTC_Pr5_ST3: start 156, 4 bit, little-endian, data-type-policy=OVERRIDE, i-signal-type=PRIMITIVE, init-value=15, base-type=uint8, invalid-value=15, range raw 0..15, to IMU_B  # Reserviert für zukünftige Verwendung / Reserved for future use
    mapping BCS_Whl_Msg1_BTC_Pr5_ST3_3z5vvcdtzaheg7vz23u7gb0g6: i-signal-group=BCS_Whl_Msg1_BTC_Pr5_ST3_3z5vvcdtzaheg7vz23u7gb0g6, packing-byte-order=little-endian, transfer-property=PENDING
  pdu Ign_Stat_ST3: length=4, minimum-delay=0.02, transmission-mode-true-timing={cyclic-timing=time-period=0.1, event-controlled-timing=number-of-repetitions=0}, unused-bit-pattern=255  # Zuendungsstatus / Ignition state
    signal CRC_Ign_Stat_Pr5_ST3: start 0, 16 bit, little-endian, data-type-policy=OVERRIDE, i-signal-type=PRIMITIVE, init-value=20886, base-type=uint16, data-constr=c16_CRC_woSNA, transfer-property=PENDING, to IMU_B  # CRC-Checksumme der Signal Gruppe gemäß AUTOSAR Profil 5 / CRC-checksum of signal group according to AUTOSAR Profile 5
    signal ISw_Stat_ST3: start 24, 3 bit, little-endian, data-type-policy=OVERRIDE, i-signal-type=PRIMITIVE, init-value=7, base-type=uint8, invalid-value=7, compu-method=c03_ISw_Stat, data-constr=c03_ISw_Stat, transfer-property=TRIGGERED-ON-CHANGE, to IMU_B  # Klemmenstatus / Ignition switch state
    signal KG_StartSw_Psd_ST3: start 31, 1 bit, little-endian, data-type-policy=OVERRIDE, i-signal-type=PRIMITIVE, init-value=0, base-type=boolean, transfer-property=TRIGGERED-ON-CHANGE, to IMU_B  # Keyless Go Starttaster betätigt / Keyless Go start switch pressed
    signal SQC_Ign_Stat_Pr5_ST3: start 16, 8 bit, little-endian, data-type-policy=OVERRIDE, i-signal-type=PRIMITIVE, init-value=0, base-type=uint8, compu {identical}, data-constr=c08_0_255_1_SNA_na, transfer-property=PENDING, to IMU_B  # Sequenzzähler / Sequence counter
    signal Veh_Op_Mode_ST3: start 27, 4 bit, little-endian, data-type-policy=OVERRIDE, i-signal-type=PRIMITIVE, init-value=0, base-type=uint8, invalid-value=15, compu-method=c04_VehOpMode, data-constr=c04_VehOpMode, transfer-property=TRIGGERED-ON-CHANGE, to IMU_B  # Fahrzeug Betriebsmodus / Operating Mode Vehicle
    mapping Ign_Stat_Pr5_ST3_csgs1dv6drms80o1i9p49677w: i-signal-group=Ign_Stat_Pr5_ST3_csgs1dv6drms80o1i9p49677w, packing-byte-order=little-endian, transfer-property=TRIGGERED-ON-CHANGE
  pdu IMU_A_Output_Fast_ST3: length=40, minimum-delay=0.005, transmission-mode-true-timing=event-controlled-timing=number-of-repetitions=0, unused-bit-pattern=255  # IMU A Output ST3
    signal CRC_IMU_A_Output_Fast_Pr5_ST3: start 0, 16 bit, little-endian, data-type-policy=OVERRIDE, i-signal-type=PRIMITIVE, init-value=19231, base-type=uint16, data-constr=c16_CRC_woSNA, to IMU_B  # CRC-Checksumme der Signal Gruppe gemäß AUTOSAR Profil 5 / CRC-checksum of signal group according to AUTOSAR Profile 5
    signal IMU_A_AngAcc_Stat_Fast_ST3: start 27, 3 bit, little-endian, data-type-policy=OVERRIDE, i-signal-type=PRIMITIVE, init-value=0, base-type=uint8, compu-method=c03_IMU_Force_Ang_Stat_ST3, data-constr=c03_IMU_Force_Ang_Stat_ST3, to IMU_B  # Status der Winkelbeschleunigungssignale fast / Status of angular acceleration signals fast
    signal IMU_A_AngAcc_X_Fast_ST3: start 55, 16 bit, little-endian, data-type-policy=OVERRIDE, i-signal-type=PRIMITIVE, init-value=65535, base-type=uint16, invalid-value=65535, compu-method=c16_deg_per_s_sq_m1200_1200_0d04, data-constr=c16_deg_per_s_sq_m1200_1200_0d04, to IMU_B  # Winkelbeschleunigung um die X-Achse fast / Angular acceleration about X axis fast
    signal IMU_A_AngAcc_Y_Fast_ST3: start 71, 16 bit, little-endian, data-type-policy=OVERRIDE, i-signal-type=PRIMITIVE, init-value=65535, base-type=uint16, invalid-value=65535, compu-method=c16_deg_per_s_sq_m1200_1200_0d04, data-constr=c16_deg_per_s_sq_m1200_1200_0d04, to IMU_B  # Winkelbeschleunigung um die Y-Achse fast / Angular acceleration about Y axis fast
    signal IMU_A_AngAcc_Z_Fast_ST3: start 87, 16 bit, little-endian, data-type-policy=OVERRIDE, i-signal-type=PRIMITIVE, init-value=65535, base-type=uint16, invalid-value=65535, compu-method=c16_deg_per_s_sq_m1200_1200_0d04, data-constr=c16_deg_per_s_sq_m1200_1200_0d04, to IMU_B  # Winkelbeschleunigung um die Z-Achse fast / Angular acceleration about Z axis fast
    signal IMU_A_AngRate_X_Fast_ST3: start 103, 16 bit, little-endian, data-type-policy=OVERRIDE, i-signal-type=PRIMITIVE, init-value=65535, base-type=uint16, invalid-value=65535, compu-method=c16_deg_per_sec_m300_300_0d01, data-constr=c16_deg_per_sec_m300_300_0d01, to IMU_B  # Drehrate über die X-Achse fast / Angular rate about X axis fast
    signal IMU_A_AngRate_Y_Fast_ST3: start 119, 16 bit, little-endian, data-type-policy=OVERRIDE, i-signal-type=PRIMITIVE, init-value=65535, base-type=uint16, invalid-value=65535, compu-method=c16_deg_per_sec_m300_300_0d01, data-constr=c16_deg_per_sec_m300_300_0d01, to IMU_B  # Drehrate über die Y-Achse fast / Angular rate about Y axis fast
    signal IMU_A_AngRate_Z_Fast_ST3: start 135, 16 bit, little-endian, data-type-policy=OVERRIDE, i-signal-type=PRIMITIVE, init-value=65535, base-type=uint16, invalid-value=65535, compu-method=c16_deg_per_sec_m300_300_0d01, data-constr=c16_deg_per_sec_m300_300_0d01, to IMU_B  # Drehrate über die Z-Achse fast / Angular rate about Z axis fast
    signal IMU_A_AngRates_Stat_Fast_ST3: start 30, 3 bit, little-endian, data-type-policy=OVERRIDE, i-signal-type=PRIMITIVE, init-value=0, base-type=uint8, compu-method=c03_IMU_Force_Ang_Stat_ST3, data-constr=c03_IMU_Force_Ang_Stat_ST3, to IMU_B  # Status der Drehratensignale fast / Status of angular rate signals fast
    signal IMU_A_SpecForce_Stat_Fast_ST3: start 36, 3 bit, little-endian, data-type-policy=OVERRIDE, i-signal-type=PRIMITIVE, init-value=0, base-type=uint8, compu-method=c03_IMU_Force_Ang_Stat_ST3, data-constr=c03_IMU_Force_Ang_Stat_ST3, to IMU_B  # Status spezifischer Kraftsignale fast / Status of specific force signals fast
    signal IMU_A_SpecForce_X_Fast_ST3: start 151, 16 bit, little-endian, data-type-policy=OVERRIDE, i-signal-type=PRIMITIVE, init-value=65535, base-type=uint16, invalid-value=65535, compu-method=c16_m_pro_s_sq_m50_50_0d002, data-constr=c16_m_pro_s_sq_m50_50_0d002, to IMU_B  # Spezifische Kraft entlang der X-Achse fast / Specific force along X axis fast
    signal IMU_A_SpecForce_Y_Fast_ST3: start 167, 16 bit, little-endian, data-type-policy=OVERRIDE, i-signal-type=PRIMITIVE, init-value=65535, base-type=uint16, invalid-value=65535, compu-method=c16_m_pro_s_sq_m50_50_0d002, data-constr=c16_m_pro_s_sq_m50_50_0d002, to IMU_B  # Spezifische Kraft entlang der Y-Achse fast / Specific force along Y axis fast
    signal IMU_A_SpecForce_Z_Fast_ST3: start 183, 16 bit, little-endian, data-type-policy=OVERRIDE, i-signal-type=PRIMITIVE, init-value=65535, base-type=uint16, invalid-value=65535, compu-method=c16_m_pro_s_sq_m50_50_0d002, data-constr=c16_m_pro_s_sq_m50_50_0d002, to IMU_B  # Spezifische Kraft entlang der Z-Achse fast / Specific force along Z axis fast
    signal IMU_A_Stat_Fast_ST3: start 24, 3 bit, little-endian, data-type-policy=OVERRIDE, i-signal-type=PRIMITIVE, init-value=0, base-type=uint8, compu-method=c03_IMU_Stat_ST3, data-constr=c03_IMU_Stat_ST3, to IMU_B  # Gesamtstatus der IMU fast / Overall IMU status fast
    signal IMU_A_Temp_Fast_ST3: start 39, 8 bit, little-endian, data-type-policy=OVERRIDE, i-signal-type=PRIMITIVE, init-value=255, base-type=uint8, invalid-value=255, compu-method=c08_deg_m50_160_1, data-constr=c08_deg_m50_160_1, to IMU_B  # IMU-Temperatur fast / IMU Temperature fast
    signal IMU_A_TmStmp_NanoSec_Fast_ST3: start 199, 32 bit, little-endian, data-type-policy=OVERRIDE, i-signal-type=PRIMITIVE, init-value=0, base-type=uint32, compu {identical; unit ns}, data-constr=c32_ns_0_4294967295_1_noSNA, to IMU_B  # IMU Zeitstempel, Ziffernbruchteil in Nanosekunden fast / IMU Time Stamp, fractional digits part in nanoseconds fast
    signal IMU_A_TmStmp_Sec_Fast_ST3: start 231, 32 bit, little-endian, data-type-policy=OVERRIDE, i-signal-type=PRIMITIVE, init-value=0, base-type=uint32, compu {identical; unit s}, data-constr=c32_s_0_4294967295_1_noSNA, to IMU_B  # IMU Zeitstempel, ganze Sekunde Teil fast / IMU Time Stamp, whole seconds part fast
    signal IMU_A_TmSync_Stat_Fast_ST3: start 47, 8 bit, little-endian, data-type-policy=OVERRIDE, i-signal-type=PRIMITIVE, init-value=128, base-type=uint8, compu-method=c08_TmSync_Stat, to IMU_B  # Status der globalen Zeitsynchronisierung fast / Global Time Sync Status fast
    signal SQC_IMU_A_Output_Fast_Pr5_ST3: start 16, 8 bit, little-endian, data-type-policy=OVERRIDE, i-signal-type=PRIMITIVE, init-value=0, base-type=uint8, compu {identical}, data-constr=c08_0_255_1_SNA_na, to IMU_B  # Sequenzzähler / Sequence counter
    signal Rsrv01_IMU_A_Output_Fast_Pr5_ST3: start 263, 9 bit, little-endian, data-type-policy=OVERRIDE, i-signal-type=PRIMITIVE, init-value=511, base-type=uint16, invalid-value=511, range raw 0..511, to IMU_B  # Rsrv 01 IMU A Output Pr 5 ST3 fast
    signal Rsrv02_IMU_A_Output_Fast_Pr5_ST3: start 272, 8 bit, little-endian, data-type-policy=OVERRIDE, i-signal-type=PRIMITIVE, init-value=255, base-type=uint8, invalid-value=255, range raw 0..255, to IMU_B  # Rsrv 02 IMU A Output Pr 5 ST3 fast
    signal Rsrv03_IMU_A_Output_Fast_Pr5_ST3: start 280, 8 bit, little-endian, data-type-policy=OVERRIDE, i-signal-type=PRIMITIVE, init-value=255, base-type=uint8, invalid-value=255, range raw 0..255, to IMU_B  # Rsrv 03 IMU A Output Pr 5 ST3 fast
    signal Rsrv04_IMU_A_Output_Fast_Pr5_ST3: start 288, 8 bit, little-endian, data-type-policy=OVERRIDE, i-signal-type=PRIMITIVE, init-value=255, base-type=uint8, invalid-value=255, range raw 0..255, to IMU_B  # Rsrv 04 IMU A Output Pr 5 ST3 fast
    signal Rsrv05_IMU_A_Output_Fast_Pr5_ST3: start 296, 8 bit, little-endian, data-type-policy=OVERRIDE, i-signal-type=PRIMITIVE, init-value=255, base-type=uint8, invalid-value=255, range raw 0..255, to IMU_B  # Rsrv 05 IMU A Output Pr 5 ST3 fast
    signal Rsrv06_IMU_A_Output_Fast_Pr5_ST3: start 304, 16 bit, little-endian, data-type-policy=OVERRIDE, i-signal-type=PRIMITIVE, init-value=65535, base-type=uint16, invalid-value=65535, range raw 0..65535, to IMU_B  # Rsrv 06 IMU A Output Pr 5 ST3 fast
    signal Rsrv07_IMU_A_Output_Fast_Pr5_ST3: start 33, 3 bit, little-endian, data-type-policy=OVERRIDE, i-signal-type=PRIMITIVE, init-value=7, base-type=uint8, invalid-value=7, range raw 0..7, to IMU_B  # Rsrv 07 IMU A Output Pr 5 ST3 fast
    mapping IMU_A_Output_Fast_Pr5_ST3_5ym0lyqjosyobfhfksta75zc4: i-signal-group=IMU_A_Output_Fast_Pr5_ST3_5ym0lyqjosyobfhfksta75zc4, packing-byte-order=little-endian, transfer-property=TRIGGERED
  pdu IMU_B_Output_ST3: length=40, minimum-delay=0.01, transmission-mode-true-timing=event-controlled-timing=number-of-repetitions=0, unused-bit-pattern=255  # IMU B Output ST3
    signal CRC_IMU_B_Output_Pr5_ST3: start 0, 16 bit, little-endian, data-type-policy=OVERRIDE, i-signal-type=PRIMITIVE, init-value=30882, base-type=uint16, data-constr=c16_CRC_woSNA, to IMU_A  # CRC-Checksumme der Signal Gruppe gemäß AUTOSAR Profil 5 / CRC-checksum of signal group according to AUTOSAR Profile 5
    signal IMU_B_AngAcc_Stat_ST3: start 27, 3 bit, little-endian, data-type-policy=OVERRIDE, i-signal-type=PRIMITIVE, init-value=0, base-type=uint8, compu-method=c03_IMU_Force_Ang_Stat_ST3, data-constr=c03_IMU_Force_Ang_Stat_ST3, to IMU_A  # Status der Winkelbeschleunigungssignale / Status of angular acceleration signals
    signal IMU_B_AngAcc_X_ST3: start 55, 16 bit, little-endian, data-type-policy=OVERRIDE, i-signal-type=PRIMITIVE, init-value=65535, base-type=uint16, invalid-value=65535, compu-method=c16_deg_per_s_sq_m1200_1200_0d04, data-constr=c16_deg_per_s_sq_m1200_1200_0d04, to IMU_A  # Winkelbeschleunigung um die X-Achse / Angular acceleration about X axis
    signal IMU_B_AngAcc_Y_ST3: start 71, 16 bit, little-endian, data-type-policy=OVERRIDE, i-signal-type=PRIMITIVE, init-value=65535, base-type=uint16, invalid-value=65535, compu-method=c16_deg_per_s_sq_m1200_1200_0d04, data-constr=c16_deg_per_s_sq_m1200_1200_0d04, to IMU_A  # Winkelbeschleunigung um die Y-Achse / Angular acceleration about Y axis
    signal IMU_B_AngAcc_Z_ST3: start 87, 16 bit, little-endian, data-type-policy=OVERRIDE, i-signal-type=PRIMITIVE, init-value=65535, base-type=uint16, invalid-value=65535, compu-method=c16_deg_per_s_sq_m1200_1200_0d04, data-constr=c16_deg_per_s_sq_m1200_1200_0d04, to IMU_A  # Winkelbeschleunigung um die Z-Achse / Angular acceleration about Z axis
    signal IMU_B_AngRate_X_ST3: start 103, 16 bit, little-endian, data-type-policy=OVERRIDE, i-signal-type=PRIMITIVE, init-value=65535, base-type=uint16, invalid-value=65535, compu-method=c16_deg_per_sec_m300_300_0d01, data-constr=c16_deg_per_sec_m300_300_0d01, to IMU_A  # Drehrate über die X-Achse / Angular rate about X axis
    signal IMU_B_AngRate_Y_ST3: start 119, 16 bit, little-endian, data-type-policy=OVERRIDE, i-signal-type=PRIMITIVE, init-value=65535, base-type=uint16, invalid-value=65535, compu-method=c16_deg_per_sec_m300_300_0d01, data-constr=c16_deg_per_sec_m300_300_0d01, to IMU_A  # Drehrate über die Y-Achse / Angular rate about Y axis
    signal IMU_B_AngRate_Z_ST3: start 135, 16 bit, little-endian, data-type-policy=OVERRIDE, i-signal-type=PRIMITIVE, init-value=65535, base-type=uint16, invalid-value=65535, compu-method=c16_deg_per_sec_m300_300_0d01, data-constr=c16_deg_per_sec_m300_300_0d01, to IMU_A  # Drehrate über die Z-Achse / Angular rate about Z axis
    signal IMU_B_AngRates_Stat_ST3: start 30, 3 bit, little-endian, data-type-policy=OVERRIDE, i-signal-type=PRIMITIVE, init-value=0, base-type=uint8, compu-method=c03_IMU_Force_Ang_Stat_ST3, data-constr=c03_IMU_Force_Ang_Stat_ST3, to IMU_A  # Status der Drehratensignale / Status of angular rate signals
    signal IMU_B_SpecForce_Stat_ST3: start 36, 3 bit, little-endian, data-type-policy=OVERRIDE, i-signal-type=PRIMITIVE, init-value=0, base-type=uint8, compu-method=c03_IMU_Force_Ang_Stat_ST3, data-constr=c03_IMU_Force_Ang_Stat_ST3, to IMU_A  # Status spezifischer Kraftsignale / Status of specific force signals
    signal IMU_B_SpecForce_X_ST3: start 151, 16 bit, little-endian, data-type-policy=OVERRIDE, i-signal-type=PRIMITIVE, init-value=65535, base-type=uint16, invalid-value=65535, compu-method=c16_m_pro_s_sq_m50_50_0d002, data-constr=c16_m_pro_s_sq_m50_50_0d002, to IMU_A  # Spezifische Kraft entlang der X-Achse / Specific force along X axis
    signal IMU_B_SpecForce_Y_ST3: start 167, 16 bit, little-endian, data-type-policy=OVERRIDE, i-signal-type=PRIMITIVE, init-value=65535, base-type=uint16, invalid-value=65535, compu-method=c16_m_pro_s_sq_m50_50_0d002, data-constr=c16_m_pro_s_sq_m50_50_0d002, to IMU_A  # Spezifische Kraft entlang der Y-Achse / Specific force along Y axis
    signal IMU_B_SpecForce_Z_ST3: start 183, 16 bit, little-endian, data-type-policy=OVERRIDE, i-signal-type=PRIMITIVE, init-value=65535, base-type=uint16, invalid-value=65535, compu-method=c16_m_pro_s_sq_m50_50_0d002, data-constr=c16_m_pro_s_sq_m50_50_0d002, to IMU_A  # Spezifische Kraft entlang der Z-Achse / Specific force along Z axis
    signal IMU_B_Stat_ST3: start 24, 3 bit, little-endian, data-type-policy=OVERRIDE, i-signal-type=PRIMITIVE, init-value=0, base-type=uint8, compu-method=c03_IMU_Stat_ST3, data-constr=c03_IMU_Stat_ST3, to IMU_A  # Gesamtstatus der IMU / Overall IMU status
    signal IMU_B_Temp_ST3: start 39, 8 bit, little-endian, data-type-policy=OVERRIDE, i-signal-type=PRIMITIVE, init-value=255, base-type=uint8, invalid-value=255, compu-method=c08_deg_m50_160_1, data-constr=c08_deg_m50_160_1, to IMU_A  # IMU-Temperatur / IMU Temperature
    signal IMU_B_TmStmp_NanoSec_ST3: start 199, 32 bit, little-endian, data-type-policy=OVERRIDE, i-signal-type=PRIMITIVE, init-value=0, base-type=uint32, compu {identical; unit ns}, data-constr=c32_ns_0_4294967295_1_noSNA, to IMU_A  # IMU Zeitstempel, Ziffernbruchteil in Nanosekunden / IMU Time Stamp, fractional digits part in nanoseconds
    signal IMU_B_TmStmp_Sec_ST3: start 231, 32 bit, little-endian, data-type-policy=OVERRIDE, i-signal-type=PRIMITIVE, init-value=0, base-type=uint32, compu {identical; unit s}, data-constr=c32_s_0_4294967295_1_noSNA, to IMU_A  # IMU Zeitstempel, ganze Sekunde Teil / IMU Time Stamp, whole seconds part
    signal IMU_B_TmSync_Stat_ST3: start 47, 8 bit, little-endian, data-type-policy=OVERRIDE, i-signal-type=PRIMITIVE, init-value=128, base-type=uint8, compu-method=c08_TmSync_Stat, to IMU_A  # Status der globalen Zeitsynchronisierung / Global Time Sync Status
    signal SQC_IMU_B_Output_Pr5_ST3: start 16, 8 bit, little-endian, data-type-policy=OVERRIDE, i-signal-type=PRIMITIVE, init-value=0, base-type=uint8, compu {identical}, data-constr=c08_0_255_1_SNA_na, to IMU_A  # Sequenzzähler / Sequence counter
    signal Rsrv01_IMU_B_Output_Pr5_ST3: start 263, 9 bit, little-endian, data-type-policy=OVERRIDE, i-signal-type=PRIMITIVE, init-value=511, base-type=uint16, invalid-value=511, range raw 0..511, to IMU_A  # Rsrv 01 IMU B Output Pr 5 ST3
    signal Rsrv02_IMU_B_Output_Pr5_ST3: start 272, 8 bit, little-endian, data-type-policy=OVERRIDE, i-signal-type=PRIMITIVE, init-value=255, base-type=uint8, invalid-value=255, range raw 0..255, to IMU_A  # Rsrv 02 IMU B Output Pr 5 ST3
    signal Rsrv03_IMU_B_Output_Pr5_ST3: start 280, 8 bit, little-endian, data-type-policy=OVERRIDE, i-signal-type=PRIMITIVE, init-value=255, base-type=uint8, invalid-value=255, range raw 0..255, to IMU_A  # Rsrv 03 IMU B Output Pr 5 ST3
    signal Rsrv04_IMU_B_Output_Pr5_ST3: start 288, 8 bit, little-endian, data-type-policy=OVERRIDE, i-signal-type=PRIMITIVE, init-value=255, base-type=uint8, invalid-value=255, range raw 0..255, to IMU_A  # Rsrv 04 IMU B Output Pr 5 ST3
    signal Rsrv05_IMU_B_Output_Pr5_ST3: start 296, 8 bit, little-endian, data-type-policy=OVERRIDE, i-signal-type=PRIMITIVE, init-value=255, base-type=uint8, invalid-value=255, range raw 0..255, to IMU_A  # Rsrv 05 IMU B Output Pr 5 ST3
    signal Rsrv06_IMU_B_Output_Pr5_ST3: start 304, 16 bit, little-endian, data-type-policy=OVERRIDE, i-signal-type=PRIMITIVE, init-value=65535, base-type=uint16, invalid-value=65535, range raw 0..65535, to IMU_A  # Rsrv 06 IMU B Output Pr 5 ST3
    signal Rsrv07_IMU_B_Output_Pr5_ST3: start 33, 3 bit, little-endian, data-type-policy=OVERRIDE, i-signal-type=PRIMITIVE, init-value=7, base-type=uint8, invalid-value=7, range raw 0..7, to IMU_A  # Rsrv 07 IMU B Output Pr 5 ST3
    mapping IMU_B_Output_Pr5_ST3_8enshzy4a8xe2badcgusoewm2: i-signal-group=IMU_B_Output_Pr5_ST3_8enshzy4a8xe2badcgusoewm2, packing-byte-order=little-endian, transfer-property=TRIGGERED
  pdu PN14_Master_Stat1_ST3: length=8, transmission-mode-true-timing=cyclic-timing=time-period=0.2, unused-bit-pattern=255  # Status 12V Bordnetz Master / Powernetwork 12V master state
    signal PN14_DDP_Sw2_Stat_ST3: start 57, 3 bit, little-endian, data-type-policy=OVERRIDE, i-signal-type=PRIMITIVE, init-value=7, base-type=uint8, invalid-value=7, compu-method=c03_PN14_TDP_Sw_Stat, data-constr=c03_PN14_TDP_Sw_Stat, transfer-property=PENDING, to IMU_B  # Schalterstatus DDP Switch 2 (Always On Switch) / State of DDP Switch2 (Always On Switch)
    signal PN14_DDP_Sw_Stat_ST3: start 2, 3 bit, little-endian, data-type-policy=OVERRIDE, i-signal-type=PRIMITIVE, init-value=0, base-type=uint8, invalid-value=7, compu-method=c03_PN14_TDP_Sw_Stat, data-constr=c03_PN14_TDP_Sw_Stat, transfer-property=PENDING, to IMU_B  # Schalterstatus Tiefentladeschutz / Deep discharge protection switch state
    signal PN14_ExtBat_Charge_Actv_ST3: start 55, 2 bit, little-endian, data-type-policy=OVERRIDE, i-signal-type=PRIMITIVE, init-value=3, base-type=uint8, invalid-value=3, compu-method=c02_Ndef_False_True_ST3, data-constr=c02_Ndef_False_True_ST3, transfer-property=PENDING, to IMU_B  # Externe Batterieladung erkannt / external barttery charging detected
    signal PN14_PNSec_RechargeEnable_ST3: start 53, 2 bit, little-endian, data-type-policy=OVERRIDE, i-signal-type=PRIMITIVE, init-value=3, base-type=uint8, invalid-value=3, compu-method=c02_Ndef_False_True_ST3, data-constr=c02_Ndef_False_True_ST3, transfer-property=PENDING, to IMU_B  # Freigabe zum Nachladen der Sekundärbatterie / Enable for Recharge Secondary-Batterie
    signal PN14_ProdMd_BatStat_ST3: start 8, 7 bit, little-endian, data-type-policy=OVERRIDE, i-signal-type=PRIMITIVE, init-value=127, base-type=uint8, invalid-value=127, compu-method=c07_per_0to100_1_SNA, data-constr=c07_per_0to100_1_SNA, transfer-property=PENDING, to IMU_B  # Der aktuelle Status der 12V Versorgungsbatterie während Produktions-Mode. / Actual 12V battery state during production mode
    signal PN14_ProdMd_Stat_ST3: start 5, 3 bit, little-endian, data-type-policy=OVERRIDE, i-signal-type=PRIMITIVE, init-value=7, base-type=uint8, invalid-value=7, compu-method=c03_PN14_ProdMd_Stat_ST3, data-constr=c03_PN14_ProdMd_Stat_ST3, transfer-property=PENDING, to IMU_B  # Status des Bordnetz Produktionsmodus / Powernet production mode state
    signal PN14_SupBat_Curr_ST3: start 32, 13 bit, little-endian, data-type-policy=OVERRIDE, i-signal-type=PRIMITIVE, init-value=8191, base-type=uint16, invalid-value=8191, compu-method=c13_A_m409k6_409k4_0k1, data-constr=c13_A_m409k6_409k4_0k1, transfer-property=PENDING, to IMU_B  # Versorgungsbatterie Iststrom / Supply battery current
    signal PN14_SupBat_Stat_ST3: start 15, 7 bit, little-endian, data-type-policy=OVERRIDE, i-signal-type=PRIMITIVE, init-value=127, base-type=uint8, invalid-value=127, compu-method=c07_0_111_1_SNA, data-constr=c07_0_111_1_SNA, transfer-property=PENDING, to IMU_B  # Status Versorgungsbatterie / Supply battery state
    signal PN14_SupBat_Temp_ST3: start 45, 8 bit, little-endian, data-type-policy=OVERRIDE, i-signal-type=PRIMITIVE, init-value=255, base-type=uint8, invalid-value=255, compu-method=c08_degC_m40_85_0k5, data-constr=c08_degC_m40_85_0k5, transfer-property=PENDING, to IMU_B  # Temperatur Versorgungsbatterie / Supply battery temperature
    signal PN14_SupBat_Volt_ST3: start 22, 10 bit, little-endian, data-type-policy=OVERRIDE, i-signal-type=PRIMITIVE, init-value=1023, base-type=uint16, invalid-value=1023, compu-method=c10_V_0_25k55_0k025, data-constr=c10_V_0_25k55_0k025, transfer-property=PENDING, to IMU_B  # Versorgungsbatterie Istspannung / Supply battery voltage
    signal PN14_TransMd_Stat_ST3: start 0, 2 bit, little-endian, data-type-policy=OVERRIDE, i-signal-type=PRIMITIVE, init-value=3, base-type=uint8, invalid-value=3, compu-method=c02_TransMd_Stat, data-constr=c02_TransMd_Stat, transfer-property=PENDING, to IMU_B  # Bordnetz Status Transportmodus / Powernet transport mode status
  pdu PT4_PTCoor4_ST3: length=4, minimum-delay=0.01, transmission-mode-true-timing={cyclic-timing=time-period=0.1, event-controlled-timing=number-of-repetitions=0}, unused-bit-pattern=255
    signal CRC_PT4_PTCoor4_Pr5_ST3: start 0, 16 bit, little-endian, data-type-policy=OVERRIDE, i-signal-type=PRIMITIVE, init-value=4203, base-type=uint16, data-constr=c16_CRC_woSNA, transfer-property=PENDING, to IMU_B  # CRC-Checksumme der Signal Gruppe gemäß AUTOSAR Profil 5 / CRC-checksum of signal group according to AUTOSAR Profile 5
    signal PT4_PTCoor_EngStartPN14_Stat_ST3: start 28, 3 bit, little-endian, data-type-policy=OVERRIDE, i-signal-type=PRIMITIVE, init-value=0, base-type=uint8, invalid-value=7, compu-method=c03_EngStartPN14_Stat, data-constr=c03_EngStartPN14_Stat, transfer-property=TRIGGERED-ON-CHANGE, to IMU_B  # Status PN14 bei Motorstart / PT4 Engine Start PN14 State
    signal PT4_PTCoor_PT_Rdy_ST3: start 24, 2 bit, little-endian, data-type-policy=OVERRIDE, i-signal-type=PRIMITIVE, init-value=0, base-type=uint8, invalid-value=3, compu-method=c02_PT_Rdy_V2, data-constr=c02_PT_Rdy_V2, transfer-property=TRIGGERED-ON-CHANGE, to IMU_B  # Antrieb bereit / Powertrain ready
    signal PT4_PTCoor_SSA_EngSp_ST3: start 26, 2 bit, little-endian, data-type-policy=OVERRIDE, i-signal-type=PRIMITIVE, init-value=3, base-type=uint8, invalid-value=3, compu-method=c02_Ndef_False_True_ST3, data-constr=c02_Ndef_False_True_ST3, transfer-property=TRIGGERED-ON-CHANGE, to IMU_B  # ASS Motorstopp / Stop/start automatic has engine stopped
    signal SQC_PT4_PTCoor4_Pr5_ST3: start 16, 8 bit, little-endian, data-type-policy=OVERRIDE, i-signal-type=PRIMITIVE, init-value=0, base-type=uint8, compu {identical}, data-constr=c08_0_255_1_SNA_na, transfer-property=PENDING, to IMU_B  # Sequenzzähler / Sequence counter
    signal Rsrv1_PT4_PTCoor_PT_Rdy_Pr5_ST3: start 31, 1 bit, little-endian, data-type-policy=OVERRIDE, i-signal-type=PRIMITIVE, init-value=1, base-type=uint8, invalid-value=1, range raw 0..1, transfer-property=PENDING, to IMU_B  # Reserviert für zukünftige Verwendung / Reserved for future use
    mapping PT4_PTCoor4_Pr5_ST3_af4fxb1ykieox3itqdfzs0kpb: i-signal-group=PT4_PTCoor4_Pr5_ST3_af4fxb1ykieox3itqdfzs0kpb, packing-byte-order=little-endian, transfer-property=TRIGGERED-ON-CHANGE
  dcm i pdu SDU_DIAG_GLOBAL_ExtEth_RQ_IMU_INTERNAL_ST3: length=7, diag-pdu-type=DIAG-REQUEST
  dcm i pdu SDU_DIAG_GLOBAL_IntEth_RQ_IMU_INTERNAL_ST3: length=7, diag-pdu-type=DIAG-REQUEST
  dcm i pdu SDU_DIAG_IMU_B_2F_ExtEth_RQ_IMU_INTERNAL_ST3: length=4095, diag-pdu-type=DIAG-REQUEST
  dcm i pdu SDU_DIAG_IMU_B_2F_ExtEth_RS_IMU_INTERNAL_ST3: length=4095, diag-pdu-type=DIAG-RESPONSE
  dcm i pdu SDU_DIAG_IMU_B_2F_IntEth_RQ_IMU_INTERNAL_ST3: length=4095, diag-pdu-type=DIAG-REQUEST
  dcm i pdu SDU_DIAG_IMU_B_2F_IntEth_RS_IMU_INTERNAL_ST3: length=4095, diag-pdu-type=DIAG-RESPONSE
package /DataTransformations
  data transformation set DATATRANSFORMATION_SET
    4 x data transformation, all with execute-despite-data-unavailability=true:
      BaseTrans_Profile_5_20: transformer-chain=[ComBasedTransformer20, E2E_Profile_5]  # Base Transformer Base Profile 5
      BaseTrans_Profile_5_6: transformer-chain=[ComBasedTransformer6, E2E_Profile_5]  # Base Transformer Base Profile 5
      BaseTrans_Profile_5_4: transformer-chain=[ComBasedTransformer4, E2E_Profile_5]  # Base Transformer Base Profile 5
      BaseTrans_Profile_5_40: transformer-chain=[ComBasedTransformer40, E2E_Profile_5]  # Base Transformer Base Profile 5
    5 x transformation technology:
      ComBasedTransformer20: buffer-properties={buffer-computation=compu-rational-coeffs={compu-numerator=20, compu-denominator=1}, header-length=0, in-place=false}, protocol=COMBased, transformer-class=SERIALIZER, version=1
      E2E_Profile_5:  # E2E Profile 5
        buffer-properties={header-length=0, in-place=true}
        has-internal-state=true
        needs-original-data=false
        protocol=E2E
        end-to-end-transformation-description{max-delta-counter=3, max-error-state-init=0, max-error-state-invalid=0, max-error-state-valid=0, min-ok-state-init=1, min-ok-state-invalid=1, min-ok-state-valid=1, offset=0, profile-name=PROFILE_05, upper-header-bits-to-shift=0, window-size-init=10, window-size-invalid=10, window-size-valid=10}
        transformer-class=SAFETY
        version=1.0.0
      ComBasedTransformer6: buffer-properties={buffer-computation=compu-rational-coeffs={compu-numerator=6, compu-denominator=1}, header-length=0, in-place=false}, protocol=COMBased, transformer-class=SERIALIZER, version=1
      ComBasedTransformer4: buffer-properties={buffer-computation=compu-rational-coeffs={compu-numerator=4, compu-denominator=1}, header-length=0, in-place=false}, protocol=COMBased, transformer-class=SERIALIZER, version=1
      ComBasedTransformer40: buffer-properties={buffer-computation=compu-rational-coeffs={compu-numerator=40, compu-denominator=1}, header-length=0, in-place=false}, protocol=COMBased, transformer-class=SERIALIZER, version=1
package /ISignalGroups/IMU_INTERNAL/PKG_IMU_INTERNAL/BCS_Whl_Msg1_BTC_ST3
  i signal group BCS_Whl_Msg1_BTC_Pr5_ST3_3z5vvcdtzaheg7vz23u7gb0g6:  # BCS Whl Msg 1 BTC ST3 (degraded)
    com-based-signal-group-transformations=BaseTrans_Profile_5_20
    i-signal=[BCS_Whl_Msg1_TmStmp_BTC_ST3, BCS_Whl_Msg1_TmSyncStat_BTC_ST3, CRC_BCS_Whl_Msg1_BTC_Pr5_ST3, GTS_ESP_Clk_Stat_Bckp_ST3, Rsrv1_BCS_Whl_Msg1_BTC_Pr5_ST3, SQC_BCS_Whl_Msg1_BTC_Pr5_ST3, WhlDir_FL_Stat_BTC_ST3, WhlDir_FR_Stat_BTC_ST3, WhlDir_RL_Stat_BTC_ST3, WhlDir_RR_Stat_BTC_ST3, WhlPlsCnt_FL_BTC_ST3, WhlPlsCnt_FR_BTC_ST3, WhlPlsCnt_RL_BTC_ST3, WhlPlsCnt_RR_BTC_ST3, WhlRPM_FL_BTC_ST3, WhlRPM_FL_Qual_BTC_ST3, WhlRPM_FR_BTC_ST3, WhlRPM_FR_Qual_BTC_ST3, WhlRPM_RL_BTC_ST3, WhlRPM_RL_Qual_BTC_ST3, WhlRPM_RR_BTC_ST3, WhlRPM_RR_Qual_BTC_ST3]
    system-signal-group=BCS_Whl_Msg1_BTC_Pr5_ST3_3z5vvcdtzaheg7vz23u7gb0g6
    end-to-end-transformation-i-signal-props{transformer=E2E_Profile_5, data-ids=413, data-length=160}
package /ISignalGroups/IMU_INTERNAL/PKG_IMU_INTERNAL/Develop_Rq_IMU_B_ST3
  i signal group Develop_Rq_IMU_B_ST3_8agq5stscd7rth0x4nwkynnrf: i-signal=[Develop_Rq_IMU_B_01_ST3, Develop_Rq_IMU_B_02_ST3, Develop_Rq_IMU_B_03_ST3, Develop_Rq_IMU_B_04_ST3, Develop_Rq_IMU_B_05_ST3, Develop_Rq_IMU_B_06_ST3, Develop_Rq_IMU_B_07_ST3, Develop_Rq_IMU_B_08_ST3, Develop_Rq_IMU_B_09_ST3, Develop_Rq_IMU_B_10_ST3, Develop_Rq_IMU_B_11_ST3, Develop_Rq_IMU_B_12_ST3, Develop_Rq_IMU_B_13_ST3, Develop_Rq_IMU_B_14_ST3, Develop_Rq_IMU_B_15_ST3, Develop_Rq_IMU_B_16_ST3, Develop_Rq_IMU_B_17_ST3, Develop_Rq_IMU_B_18_ST3, Develop_Rq_IMU_B_19_ST3, Develop_Rq_IMU_B_20_ST3, Develop_Rq_IMU_B_21_ST3, Develop_Rq_IMU_B_22_ST3, Develop_Rq_IMU_B_23_ST3, Develop_Rq_IMU_B_24_ST3, Develop_Rq_IMU_B_25_ST3, Develop_Rq_IMU_B_26_ST3, Develop_Rq_IMU_B_27_ST3, Develop_Rq_IMU_B_28_ST3, Develop_Rq_IMU_B_29_ST3, Develop_Rq_IMU_B_30_ST3, Develop_Rq_IMU_B_31_ST3, Develop_Rq_IMU_B_32_ST3, Develop_Rq_IMU_B_33_ST3, Develop_Rq_IMU_B_34_ST3, Develop_Rq_IMU_B_35_ST3, Develop_Rq_IMU_B_36_ST3, Develop_Rq_IMU_B_37_ST3, Develop_Rq_IMU_B_38_ST3, Develop_Rq_IMU_B_39_ST3, Develop_Rq_IMU_B_40_ST3, Develop_Rq_IMU_B_41_ST3, Develop_Rq_IMU_B_42_ST3, Develop_Rq_IMU_B_43_ST3, Develop_Rq_IMU_B_44_ST3, Develop_Rq_IMU_B_45_ST3, Develop_Rq_IMU_B_46_ST3, Develop_Rq_IMU_B_47_ST3, Develop_Rq_IMU_B_48_ST3, Develop_Rq_IMU_B_49_ST3, Develop_Rq_IMU_B_50_ST3, Develop_Rq_IMU_B_51_ST3, Develop_Rq_IMU_B_52_ST3, Develop_Rq_IMU_B_53_ST3, Develop_Rq_IMU_B_54_ST3, Develop_Rq_IMU_B_55_ST3, Develop_Rq_IMU_B_56_ST3, Develop_Rq_IMU_B_57_ST3, Develop_Rq_IMU_B_58_ST3, Develop_Rq_IMU_B_59_ST3, Develop_Rq_IMU_B_60_ST3, Develop_Rq_IMU_B_61_ST3, Develop_Rq_IMU_B_62_ST3, Develop_Rq_IMU_B_63_ST3, Develop_Rq_IMU_B_64_ST3], system-signal-group=Develop_Rq_IMU_B_ST3_8agq5stscd7rth0x4nwkynnrf  # Development Request (degraded)
package /ISignalGroups/IMU_INTERNAL/PKG_IMU_INTERNAL/Develop_Rs_IMU_B_ST3
  i signal group Develop_Rs_IMU_B_ST3_6w339n32g20u8dfzm3fvalwqe: i-signal=[Develop_Rs_IMU_B_01_ST3, Develop_Rs_IMU_B_02_ST3, Develop_Rs_IMU_B_03_ST3, Develop_Rs_IMU_B_04_ST3, Develop_Rs_IMU_B_05_ST3, Develop_Rs_IMU_B_06_ST3, Develop_Rs_IMU_B_07_ST3, Develop_Rs_IMU_B_08_ST3, Develop_Rs_IMU_B_09_ST3, Develop_Rs_IMU_B_10_ST3, Develop_Rs_IMU_B_11_ST3, Develop_Rs_IMU_B_12_ST3, Develop_Rs_IMU_B_13_ST3, Develop_Rs_IMU_B_14_ST3, Develop_Rs_IMU_B_15_ST3, Develop_Rs_IMU_B_16_ST3, Develop_Rs_IMU_B_17_ST3, Develop_Rs_IMU_B_18_ST3, Develop_Rs_IMU_B_19_ST3, Develop_Rs_IMU_B_20_ST3, Develop_Rs_IMU_B_21_ST3, Develop_Rs_IMU_B_22_ST3, Develop_Rs_IMU_B_23_ST3, Develop_Rs_IMU_B_24_ST3, Develop_Rs_IMU_B_25_ST3, Develop_Rs_IMU_B_26_ST3, Develop_Rs_IMU_B_27_ST3, Develop_Rs_IMU_B_28_ST3, Develop_Rs_IMU_B_29_ST3, Develop_Rs_IMU_B_30_ST3, Develop_Rs_IMU_B_31_ST3, Develop_Rs_IMU_B_32_ST3, Develop_Rs_IMU_B_33_ST3, Develop_Rs_IMU_B_34_ST3, Develop_Rs_IMU_B_35_ST3, Develop_Rs_IMU_B_36_ST3, Develop_Rs_IMU_B_37_ST3, Develop_Rs_IMU_B_38_ST3, Develop_Rs_IMU_B_39_ST3, Develop_Rs_IMU_B_40_ST3, Develop_Rs_IMU_B_41_ST3, Develop_Rs_IMU_B_42_ST3, Develop_Rs_IMU_B_43_ST3, Develop_Rs_IMU_B_44_ST3, Develop_Rs_IMU_B_45_ST3, Develop_Rs_IMU_B_46_ST3, Develop_Rs_IMU_B_47_ST3, Develop_Rs_IMU_B_48_ST3, Develop_Rs_IMU_B_49_ST3, Develop_Rs_IMU_B_50_ST3, Develop_Rs_IMU_B_51_ST3, Develop_Rs_IMU_B_52_ST3, Develop_Rs_IMU_B_53_ST3, Develop_Rs_IMU_B_54_ST3, Develop_Rs_IMU_B_55_ST3, Develop_Rs_IMU_B_56_ST3, Develop_Rs_IMU_B_57_ST3, Develop_Rs_IMU_B_58_ST3, Develop_Rs_IMU_B_59_ST3, Develop_Rs_IMU_B_60_ST3, Develop_Rs_IMU_B_61_ST3, Develop_Rs_IMU_B_62_ST3, Develop_Rs_IMU_B_63_ST3, Develop_Rs_IMU_B_64_ST3], system-signal-group=Develop_Rs_IMU_B_ST3_6w339n32g20u8dfzm3fvalwqe  # Development Response (degraded)
package /ISignalGroups/IMU_INTERNAL/PKG_IMU_INTERNAL/DI_OdoSpeedometer_ST3
  i signal group DI_Odo_Pr5_ST3_e68xmtlkywxgxsdwekdjjhw3t: com-based-signal-group-transformations=BaseTrans_Profile_5_6, i-signal=[CRC_DI_Odo_Pr5_ST3, Odo_ST3, SQC_DI_Odo_Pr5_ST3], system-signal-group=DI_Odo_Pr5_ST3_e68xmtlkywxgxsdwekdjjhw3t, end-to-end-transformation-i-signal-props{transformer=E2E_Profile_5, data-ids=186, data-length=48}  # DriverInformation Odometer (degraded)
package /ISignalGroups/IMU_INTERNAL/PKG_IMU_INTERNAL/Ign_Stat_ST3
  i signal group Ign_Stat_Pr5_ST3_csgs1dv6drms80o1i9p49677w: com-based-signal-group-transformations=BaseTrans_Profile_5_4, i-signal=[CRC_Ign_Stat_Pr5_ST3, ISw_Stat_ST3, KG_StartSw_Psd_ST3, SQC_Ign_Stat_Pr5_ST3, Veh_Op_Mode_ST3], system-signal-group=Ign_Stat_Pr5_ST3_csgs1dv6drms80o1i9p49677w, end-to-end-transformation-i-signal-props{transformer=E2E_Profile_5, data-ids=51, data-length=32}  # Zuendungsstatus (degraded) / Ignition state (degraded)
package /ISignalGroups/IMU_INTERNAL/PKG_IMU_INTERNAL/IMU_A_Output_Fast_ST3
  i signal group IMU_A_Output_Fast_Pr5_ST3_5ym0lyqjosyobfhfksta75zc4:  # IMU A Output Pr 5 ST3 (degraded)
    com-based-signal-group-transformations=BaseTrans_Profile_5_40
    i-signal=[CRC_IMU_A_Output_Fast_Pr5_ST3, IMU_A_AngAcc_Stat_Fast_ST3, IMU_A_AngAcc_X_Fast_ST3, IMU_A_AngAcc_Y_Fast_ST3, IMU_A_AngAcc_Z_Fast_ST3, IMU_A_AngRate_X_Fast_ST3, IMU_A_AngRate_Y_Fast_ST3, IMU_A_AngRate_Z_Fast_ST3, IMU_A_AngRates_Stat_Fast_ST3, IMU_A_SpecForce_Stat_Fast_ST3, IMU_A_SpecForce_X_Fast_ST3, IMU_A_SpecForce_Y_Fast_ST3, IMU_A_SpecForce_Z_Fast_ST3, IMU_A_Stat_Fast_ST3, IMU_A_Temp_Fast_ST3, IMU_A_TmStmp_NanoSec_Fast_ST3, IMU_A_TmStmp_Sec_Fast_ST3, IMU_A_TmSync_Stat_Fast_ST3, Rsrv01_IMU_A_Output_Fast_Pr5_ST3, Rsrv02_IMU_A_Output_Fast_Pr5_ST3, Rsrv03_IMU_A_Output_Fast_Pr5_ST3, Rsrv04_IMU_A_Output_Fast_Pr5_ST3, Rsrv05_IMU_A_Output_Fast_Pr5_ST3, Rsrv06_IMU_A_Output_Fast_Pr5_ST3, Rsrv07_IMU_A_Output_Fast_Pr5_ST3, SQC_IMU_A_Output_Fast_Pr5_ST3]
    system-signal-group=IMU_A_Output_Fast_Pr5_ST3_5ym0lyqjosyobfhfksta75zc4
    end-to-end-transformation-i-signal-props{transformer=E2E_Profile_5, data-ids=931, data-length=320}
package /ISignalGroups/IMU_INTERNAL/PKG_IMU_INTERNAL/IMU_B_Output_ST3
  i signal group IMU_B_Output_Pr5_ST3_8enshzy4a8xe2badcgusoewm2:  # IMU B Output Pr 5 ST3 (degraded)
    com-based-signal-group-transformations=BaseTrans_Profile_5_40
    i-signal=[CRC_IMU_B_Output_Pr5_ST3, IMU_B_AngAcc_Stat_ST3, IMU_B_AngAcc_X_ST3, IMU_B_AngAcc_Y_ST3, IMU_B_AngAcc_Z_ST3, IMU_B_AngRate_X_ST3, IMU_B_AngRate_Y_ST3, IMU_B_AngRate_Z_ST3, IMU_B_AngRates_Stat_ST3, IMU_B_SpecForce_Stat_ST3, IMU_B_SpecForce_X_ST3, IMU_B_SpecForce_Y_ST3, IMU_B_SpecForce_Z_ST3, IMU_B_Stat_ST3, IMU_B_Temp_ST3, IMU_B_TmStmp_NanoSec_ST3, IMU_B_TmStmp_Sec_ST3, IMU_B_TmSync_Stat_ST3, Rsrv01_IMU_B_Output_Pr5_ST3, Rsrv02_IMU_B_Output_Pr5_ST3, Rsrv03_IMU_B_Output_Pr5_ST3, Rsrv04_IMU_B_Output_Pr5_ST3, Rsrv05_IMU_B_Output_Pr5_ST3, Rsrv06_IMU_B_Output_Pr5_ST3, Rsrv07_IMU_B_Output_Pr5_ST3, SQC_IMU_B_Output_Pr5_ST3]
    system-signal-group=IMU_B_Output_Pr5_ST3_8enshzy4a8xe2badcgusoewm2
    end-to-end-transformation-i-signal-props{transformer=E2E_Profile_5, data-ids=845, data-length=320}
