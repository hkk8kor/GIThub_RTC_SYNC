AUTOSAR XML (schema 4-2-2)
package /RB/UBK/Project/EcucModuleConfigurationValuess
  module config Can
    CanConfigSet
      10 x CanHardwareObject, all with CanFdPaddingValue=0, CanHandleType=FULL:
        GTS_Main_CAN_ST3_GTS_Main_CAN_ST3_f3ngr2mgh7ij5tktyk1o5ahui_HAD_BACKUP_HAD_BACKUP_IN: CanIdType=STANDARD, CanObjectType=RECEIVE, CanControllerRef=CanIfControllerConfig_1, CanMainFunctionRWPeriodRef=CanMainFunctionRWPeriods_5ms
          CanHwFilter_121 (CanHwFilter): CanHwFilterCode=121, CanHwFilterMask=2047
        IMU_B_Output_ST3_IMU_B_Output_ST3_cvwgbah9by246et0yw6ftuq1e_HAD_BACKUP_HAD_BACKUP_OUT: CanIdType=STANDARD, CanObjectType=TRANSMIT, CanControllerRef=CanIfControllerConfig_1
        ECU_Stat_IMU_A_ST3_ECU_Stat_IMU_A_ST3_aex3322f36mc6lh9solc55ki7_HAD_BACKUP_HAD_BACKUP_OUT: CanIdType=EXTENDED, CanObjectType=TRANSMIT, CanControllerRef=CanIfControllerConfig_1, CanMainFunctionRWPeriodRef=CanMainFunctionRWPeriods_5ms
        GTS_Main_CAN_ST3_GTS_Main_CAN_ST3_3roc9cgit8y88llo701fz09aw_IMU_INTERNAL_IMU_INTERNAL_OUT: CanIdType=STANDARD, CanObjectType=TRANSMIT, CanControllerRef=CanIfControllerConfig_0, CanMainFunctionRWPeriodRef=CanMainFunctionRWPeriods_5ms
        IMU_B_Output_ST3_IMU_B_Output_ST3_867n3yp1q4vwzcxr3cdsioonf_IMU_INTERNAL_IMU_INTERNAL_IN: CanIdType=STANDARD, CanObjectType=RECEIVE, CanControllerRef=CanIfControllerConfig_0
          CanHwFilter_934 (CanHwFilter): CanHwFilterCode=934, CanHwFilterMask=2047
        IMU_A_HAD_BACKUP_COM_Container1_ST3_IMU_A_HAD_BACKUP_COM_Container1_ST3_c0akuwucqk1bxnpja1dfcudm3_HAD_BACKUP_HAD_BACKUP_OUT: CanIdType=STANDARD, CanObjectType=TRANSMIT, CanControllerRef=CanIfControllerConfig_1, CanMainFunctionRWPeriodRef=CanMainFunctionRWPeriods_5ms
        IMU_A_HAD_BACKUP_GW_Container1_ST3_IMU_A_HAD_BACKUP_GW_Container1_ST3_roywpbiicz3ehpmr7k0lzj66_HAD_BACKUP_HAD_BACKUP_OUT: CanIdType=STANDARD, CanObjectType=TRANSMIT, CanControllerRef=CanIfControllerConfig_1, CanMainFunctionRWPeriodRef=CanMainFunctionRWPeriods_5ms
        ECU_Stat_IMU_B_ST3_ECU_Stat_IMU_B_ST3_7e1x143vymagm1ezvyz5npfy4_IMU_INTERNAL_IMU_INTERNAL_IN: CanIdType=EXTENDED, CanObjectType=RECEIVE, CanControllerRef=CanIfControllerConfig_0, CanMainFunctionRWPeriodRef=CanMainFunctionRWPeriods_5ms
          CanHwFilter_373424491 (CanHwFilter): CanHwFilterCode=373424491, CanHwFilterMask=536870911
        ROE_IMU_B_ST3_ROE_IMU_B_ST3_d4w0rsqy5i9ayk13lul7n8ule_IMU_INTERNAL_IMU_INTERNAL_IN: CanIdType=EXTENDED, CanObjectType=RECEIVE, CanControllerRef=CanIfControllerConfig_0, CanMainFunctionRWPeriodRef=CanMainFunctionRWPeriods_5ms
          CanHwFilter_417426176 (CanHwFilter): CanHwFilterCode=417426176, CanHwFilterMask=536870911
        Meas_IMU_A_ST3_Meas_IMU_A_ST3_bxis0tfg6gwef0ybcs7e7x8gd_HAD_BACKUP_HAD_BACKUP_OUT: CanIdType=EXTENDED, CanObjectType=TRANSMIT, CanControllerRef=CanIfControllerConfig_1, CanMainFunctionRWPeriodRef=CanMainFunctionRWPeriods_5ms
    CanGeneral:
      CanDevErrorDetection = false
      CanDynamicMCANIpDetection = true
      CanErrorPassiveProcessing = OFF
      CanIndex = 0
      CanLiteConfiguration = false
      CanMainFunctionBusoffPeriod = 0.005
      CanMainFunctionModePeriod = 0.005
      CanVersionInfoApi = false
      CanDemEventParameterRefs: CAN_E_TIMEOUT=CAN_E_TIME_OUT
  module config CanIf
    CanIfInitCfg
      6 x CanIfBufferCfg, all with CanIfBufferSize=0:
        Bu_IMU_B_Output_ST3_IMU_B_Output_ST3_cvwgbah9by246et0yw6ftuq1e_HAD_BACKUP_HAD_BACKUP_OUT: CanIfBufferHthRef=CanIfInitHohCfg/IMU_B_Output_ST3_IMU_B_Output_ST3_cvwgbah9by246et0yw6ftuq1e_HAD_BACKUP_HAD_BACKUP_OUT
        Bu_ECU_Stat_IMU_A_ST3_ECU_Stat_IMU_A_ST3_aex3322f36mc6lh9solc55ki7_HAD_BACKUP_HAD_BACKUP_OUT: CanIfBufferHthRef=CanIfInitHohCfg/ECU_Stat_IMU_A_ST3_ECU_Stat_IMU_A_ST3_aex3322f36mc6lh9solc55ki7_HAD_BACKUP_HAD_BACKUP_OUT
        Bu_GTS_Main_CAN_ST3_GTS_Main_CAN_ST3_3roc9cgit8y88llo701fz09aw_IMU_INTERNAL_IMU_INTERNAL_OUT: CanIfBufferHthRef=CanIfInitHohCfg/GTS_Main_CAN_ST3_GTS_Main_CAN_ST3_3roc9cgit8y88llo701fz09aw_IMU_INTERNAL_IMU_INTERNAL_OUT
        Bu_IMU_A_HAD_BACKUP_COM_Container1_ST3_IMU_A_HAD_BACKUP_COM_Container1_ST3_c0akuwucqk1bxnpja1dfcudm3_HAD_BACKUP_HAD_BACKUP_OUT: CanIfBufferHthRef=CanIfInitHohCfg/IMU_A_HAD_BACKUP_COM_Container1_ST3_IMU_A_HAD_BACKUP_COM_Container1_ST3_c0akuwucqk1bxnpja1dfcudm3_HAD_BACKUP_HAD_BACKUP_OUT
        Bu_IMU_A_HAD_BACKUP_GW_Container1_ST3_IMU_A_HAD_BACKUP_GW_Container1_ST3_roywpbiicz3ehpmr7k0lzj66_HAD_BACKUP_HAD_BACKUP_OUT: CanIfBufferHthRef=CanIfInitHohCfg/IMU_A_HAD_BACKUP_GW_Container1_ST3_IMU_A_HAD_BACKUP_GW_Container1_ST3_roywpbiicz3ehpmr7k0lzj66_HAD_BACKUP_HAD_BACKUP_OUT
        Bu_Meas_IMU_A_ST3_Meas_IMU_A_ST3_bxis0tfg6gwef0ybcs7e7x8gd_HAD_BACKUP_HAD_BACKUP_OUT: CanIfBufferHthRef=CanIfInitHohCfg/Meas_IMU_A_ST3_Meas_IMU_A_ST3_bxis0tfg6gwef0ybcs7e7x8gd_HAD_BACKUP_HAD_BACKUP_OUT
      CanIfInitHohCfg
        4 x CanIfHrhCfg:
          GTS_Main_CAN_ST3_GTS_Main_CAN_ST3_f3ngr2mgh7ij5tktyk1o5ahui_HAD_BACKUP_HAD_BACKUP_IN: CanIfHrhCanCtrlIdRef=CanIfControllerConfig_1, CanIfHrhIdSymRef=CanConfigSet/GTS_Main_CAN_ST3_GTS_Main_CAN_ST3_f3ngr2mgh7ij5tktyk1o5ahui_HAD_BACKUP_HAD_BACKUP_IN
          IMU_B_Output_ST3_IMU_B_Output_ST3_867n3yp1q4vwzcxr3cdsioonf_IMU_INTERNAL_IMU_INTERNAL_IN: CanIfHrhCanCtrlIdRef=CanIfControllerConfig_0, CanIfHrhIdSymRef=CanConfigSet/IMU_B_Output_ST3_IMU_B_Output_ST3_867n3yp1q4vwzcxr3cdsioonf_IMU_INTERNAL_IMU_INTERNAL_IN
          ECU_Stat_IMU_B_ST3_ECU_Stat_IMU_B_ST3_7e1x143vymagm1ezvyz5npfy4_IMU_INTERNAL_IMU_INTERNAL_IN: CanIfHrhCanCtrlIdRef=CanIfControllerConfig_0, CanIfHrhIdSymRef=CanConfigSet/ECU_Stat_IMU_B_ST3_ECU_Stat_IMU_B_ST3_7e1x143vymagm1ezvyz5npfy4_IMU_INTERNAL_IMU_INTERNAL_IN
          ROE_IMU_B_ST3_ROE_IMU_B_ST3_d4w0rsqy5i9ayk13lul7n8ule_IMU_INTERNAL_IMU_INTERNAL_IN: CanIfHrhCanCtrlIdRef=CanIfControllerConfig_0, CanIfHrhIdSymRef=CanConfigSet/ROE_IMU_B_ST3_ROE_IMU_B_ST3_d4w0rsqy5i9ayk13lul7n8ule_IMU_INTERNAL_IMU_INTERNAL_IN
        6 x CanIfHthCfg:
          IMU_B_Output_ST3_IMU_B_Output_ST3_cvwgbah9by246et0yw6ftuq1e_HAD_BACKUP_HAD_BACKUP_OUT: CanIfHthCanCtrlIdRef=CanIfControllerConfig_1, CanIfHthIdSymRef=CanConfigSet/IMU_B_Output_ST3_IMU_B_Output_ST3_cvwgbah9by246et0yw6ftuq1e_HAD_BACKUP_HAD_BACKUP_OUT
          ECU_Stat_IMU_A_ST3_ECU_Stat_IMU_A_ST3_aex3322f36mc6lh9solc55ki7_HAD_BACKUP_HAD_BACKUP_OUT: CanIfHthCanCtrlIdRef=CanIfControllerConfig_1, CanIfHthIdSymRef=CanConfigSet/ECU_Stat_IMU_A_ST3_ECU_Stat_IMU_A_ST3_aex3322f36mc6lh9solc55ki7_HAD_BACKUP_HAD_BACKUP_OUT
          GTS_Main_CAN_ST3_GTS_Main_CAN_ST3_3roc9cgit8y88llo701fz09aw_IMU_INTERNAL_IMU_INTERNAL_OUT: CanIfHthCanCtrlIdRef=CanIfControllerConfig_0, CanIfHthIdSymRef=CanConfigSet/GTS_Main_CAN_ST3_GTS_Main_CAN_ST3_3roc9cgit8y88llo701fz09aw_IMU_INTERNAL_IMU_INTERNAL_OUT
          IMU_A_HAD_BACKUP_COM_Container1_ST3_IMU_A_HAD_BACKUP_COM_Container1_ST3_c0akuwucqk1bxnpja1dfcudm3_HAD_BACKUP_HAD_BACKUP_OUT: CanIfHthCanCtrlIdRef=CanIfControllerConfig_1, CanIfHthIdSymRef=CanConfigSet/IMU_A_HAD_BACKUP_COM_Container1_ST3_IMU_A_HAD_BACKUP_COM_Container1_ST3_c0akuwucqk1bxnpja1dfcudm3_HAD_BACKUP_HAD_BACKUP_OUT
          IMU_A_HAD_BACKUP_GW_Container1_ST3_IMU_A_HAD_BACKUP_GW_Container1_ST3_roywpbiicz3ehpmr7k0lzj66_HAD_BACKUP_HAD_BACKUP_OUT: CanIfHthCanCtrlIdRef=CanIfControllerConfig_1, CanIfHthIdSymRef=CanConfigSet/IMU_A_HAD_BACKUP_GW_Container1_ST3_IMU_A_HAD_BACKUP_GW_Container1_ST3_roywpbiicz3ehpmr7k0lzj66_HAD_BACKUP_HAD_BACKUP_OUT
          Meas_IMU_A_ST3_Meas_IMU_A_ST3_bxis0tfg6gwef0ybcs7e7x8gd_HAD_BACKUP_HAD_BACKUP_OUT: CanIfHthCanCtrlIdRef=CanIfControllerConfig_1, CanIfHthIdSymRef=CanConfigSet/Meas_IMU_A_ST3_Meas_IMU_A_ST3_bxis0tfg6gwef0ybcs7e7x8gd_HAD_BACKUP_HAD_BACKUP_OUT
      4 x CanIfRxPduCfg:
        GTS_Main_CAN_ST3_GTS_Main_CAN_ST3_f3ngr2mgh7ij5tktyk1o5ahui_HAD_BACKUP_HAD_BACKUP_IN: CanIfRxPduCanId=121, CanIfRxPduCanIdType=STANDARD_FD_CAN, CanIfRxPduDlc=8, CanIfRxPduReadData=false, CanIfRxPduReadNotifyStatus=false, CanIfRxPduUserRxIndicationName=CanTSyn_RxIndication, CanIfRxPduUserRxIndicationUL=CAN_TSYN, CanIfRxPduHrhIdRef=CanIfInitHohCfg/GTS_Main_CAN_ST3_GTS_Main_CAN_ST3_f3ngr2mgh7ij5tktyk1o5ahui_HAD_BACKUP_HAD_BACKUP_IN, CanIfRxPduRef=GTS_Main_CAN_ST3_CanIf2CanTSyn_HAD_BACKUP_CAN
        IMU_B_Output_ST3_IMU_B_Output_ST3_867n3yp1q4vwzcxr3cdsioonf_IMU_INTERNAL_IMU_INTERNAL_IN: CanIfRxPduCanId=934, CanIfRxPduCanIdType=STANDARD_FD_CAN, CanIfRxPduDlc=44, CanIfRxPduUserRxIndicationName=PduR_CanIfRxIndication, CanIfRxPduUserRxIndicationUL=PDUR, CanIfRxPduHrhIdRef=CanIfInitHohCfg/IMU_B_Output_ST3_IMU_B_Output_ST3_867n3yp1q4vwzcxr3cdsioonf_IMU_INTERNAL_IMU_INTERNAL_IN, CanIfRxPduRef=EcucPduCollection/IMU_B_Output_ST3_secured_CanIf2PduR_IMU_INTERNAL_CAN
        ECU_Stat_IMU_B_ST3_ECU_Stat_IMU_B_ST3_7e1x143vymagm1ezvyz5npfy4_IMU_INTERNAL_IMU_INTERNAL_IN: CanIfRxPduCanId=373424491, CanIfRxPduCanIdType=EXTENDED_FD_CAN, CanIfRxPduDlc=8, CanIfRxPduReadData=false, CanIfRxPduReadNotifyStatus=false, CanIfRxPduUserRxIndicationName=PduR_CanIfRxIndication, CanIfRxPduUserRxIndicationUL=PDUR, CanIfRxPduHrhIdRef=CanIfInitHohCfg/ECU_Stat_IMU_B_ST3_ECU_Stat_IMU_B_ST3_7e1x143vymagm1ezvyz5npfy4_IMU_INTERNAL_IMU_INTERNAL_IN, CanIfRxPduRef=EcucPduCollection/ECU_Stat_IMU_B_ST3_CanIf2PduR_IMU_INTERNAL_CAN
        ROE_IMU_B_ST3_ROE_IMU_B_ST3_d4w0rsqy5i9ayk13lul7n8ule_IMU_INTERNAL_IMU_INTERNAL_IN: CanIfRxPduCanId=417426176, CanIfRxPduCanIdType=EXTENDED_FD_CAN, CanIfRxPduDlc=8, CanIfRxPduReadData=false, CanIfRxPduReadNotifyStatus=false, CanIfRxPduUserRxIndicationName=PduR_CanIfRxIndication, CanIfRxPduUserRxIndicationUL=PDUR, CanIfRxPduHrhIdRef=CanIfInitHohCfg/ROE_IMU_B_ST3_ROE_IMU_B_ST3_d4w0rsqy5i9ayk13lul7n8ule_IMU_INTERNAL_IMU_INTERNAL_IN, CanIfRxPduRef=EcucPduCollection/ROE_IMU_B_ST3_CanIf2PduR_IMU_INTERNAL_CAN
      6 x CanIfTxPduCfg, all with CanIfTxPduReadNotifyStatus=false, CanIfTxPduType=STATIC:
        IMU_B_Output_ST3_IMU_B_Output_ST3_cvwgbah9by246et0yw6ftuq1e_HAD_BACKUP_HAD_BACKUP_OUT: CanIfTxPduCanId=934, CanIfTxPduCanIdType=STANDARD_FD_CAN, CanIfTxPduTruncation=true, CanIfTxPduUserTxConfirmationName=PduR_CanIfTxConfirmation, CanIfTxPduUserTxConfirmationUL=PDUR, CanIfTxPduBufferRef=Bu_IMU_B_Output_ST3_IMU_B_Output_ST3_cvwgbah9by246et0yw6ftuq1e_HAD_BACKUP_HAD_BACKUP_OUT, CanIfTxPduRef=EcucPduCollection/IMU_B_Output_ST3_secured_PduR2CanIf_HAD_BACKUP_CAN
        ECU_Stat_IMU_A_ST3_ECU_Stat_IMU_A_ST3_aex3322f36mc6lh9solc55ki7_HAD_BACKUP_HAD_BACKUP_OUT: CanIfTxPduCanId=373424490, CanIfTxPduCanIdType=EXTENDED_FD_CAN, CanIfTxPduTruncation=false, CanIfTxPduUserTxConfirmationName=PduR_CanIfTxConfirmation, CanIfTxPduUserTxConfirmationUL=PDUR, CanIfTxPduBufferRef=Bu_ECU_Stat_IMU_A_ST3_ECU_Stat_IMU_A_ST3_aex3322f36mc6lh9solc55ki7_HAD_BACKUP_HAD_BACKUP_OUT, CanIfTxPduRef=EcucPduCollection/ECU_Stat_IMU_A_ST3_PduR2CanIf_HAD_BACKUP_CAN
        GTS_Main_CAN_ST3_GTS_Main_CAN_ST3_3roc9cgit8y88llo701fz09aw_IMU_INTERNAL_IMU_INTERNAL_OUT: CanIfTxPduCanId=121, CanIfTxPduCanIdType=STANDARD_FD_CAN, CanIfTxPduTruncation=false, CanIfTxPduUserTxConfirmationName=CanTSyn_TxConfirmation, CanIfTxPduUserTxConfirmationUL=CAN_TSYN, CanIfTxPduBufferRef=Bu_GTS_Main_CAN_ST3_GTS_Main_CAN_ST3_3roc9cgit8y88llo701fz09aw_IMU_INTERNAL_IMU_INTERNAL_OUT, CanIfTxPduRef=GTS_Main_CAN_ST3_CanTSyn2CanIf_IMU_INTERNAL_CAN
        IMU_A_HAD_BACKUP_COM_Container1_ST3_IMU_A_HAD_BACKUP_COM_Container1_ST3_c0akuwucqk1bxnpja1dfcudm3_HAD_BACKUP_HAD_BACKUP_OUT: CanIfTxPduCanId=150, CanIfTxPduCanIdType=STANDARD_FD_CAN, CanIfTxPduTruncation=false, CanIfTxPduUserTxConfirmationName=PduR_CanIfTxConfirmation, CanIfTxPduUserTxConfirmationUL=PDUR, CanIfTxPduBufferRef=Bu_IMU_A_HAD_BACKUP_COM_Container1_ST3_IMU_A_HAD_BACKUP_COM_Container1_ST3_c0akuwucqk1bxnpja1dfcudm3_HAD_BACKUP_HAD_BACKUP_OUT, CanIfTxPduRef=EcucPduCollection/IMU_A_HAD_BACKUP_COM_Container1_ST3_ContainerIPdu_PduR2CanIf_HAD_BACKUP_CAN
        IMU_A_HAD_BACKUP_GW_Container1_ST3_IMU_A_HAD_BACKUP_GW_Container1_ST3_roywpbiicz3ehpmr7k0lzj66_HAD_BACKUP_HAD_BACKUP_OUT: CanIfTxPduCanId=156, CanIfTxPduCanIdType=STANDARD_FD_CAN, CanIfTxPduTruncation=false, CanIfTxPduUserTxConfirmationName=PduR_CanIfTxConfirmation, CanIfTxPduUserTxConfirmationUL=PDUR, CanIfTxPduBufferRef=Bu_IMU_A_HAD_BACKUP_GW_Container1_ST3_IMU_A_HAD_BACKUP_GW_Container1_ST3_roywpbiicz3ehpmr7k0lzj66_HAD_BACKUP_HAD_BACKUP_OUT, CanIfTxPduRef=EcucPduCollection/IMU_A_HAD_BACKUP_GW_Container1_ST3_ContainerIPdu_PduR2CanIf_HAD_BACKUP_CAN
        Meas_IMU_A_ST3_Meas_IMU_A_ST3_bxis0tfg6gwef0ybcs7e7x8gd_HAD_BACKUP_HAD_BACKUP_OUT: CanIfTxPduCanId=417426064, CanIfTxPduCanIdType=EXTENDED_FD_CAN, CanIfTxPduTruncation=false, CanIfTxPduUserTxConfirmationName=PduR_CanIfTxConfirmation, CanIfTxPduUserTxConfirmationUL=PDUR, CanIfTxPduBufferRef=Bu_Meas_IMU_A_ST3_Meas_IMU_A_ST3_bxis0tfg6gwef0ybcs7e7x8gd_HAD_BACKUP_HAD_BACKUP_OUT, CanIfTxPduRef=EcucPduCollection/Meas_IMU_A_ST3_PduR2CanIf_HAD_BACKUP_CAN
  module config Com
    ComConfig
      3 x ComIPdu, all with ComIPduDirection=SEND, ComIPduSignalProcessing=DEFERRED, ComIPduType=NORMAL, ComIPduGroupRef=IPG_IMU_A_HAD_BACKUP_Tx_PNC_All_Active_CAN, ComIPduGroupRef=IPG_IMU_A_HAD_BACKUP_Tx_PNC_20_CAN:
        IP_IMU_A_HAD_BACKUP_COM_Container1_ST3_ROE_IMU_A_ST3_CAN_Tx: ComIPduSignalGroupRef=SG_ROE_IMU_A_ST3_edm6y60q0qq6e5iaka50e3c31_HAD_BACKUP_CAN_Tx, ComPduIdRef=EcucPduCollection/IMU_A_HAD_BACKUP_COM_Container1_ST3_ROE_IMU_A_ST3_Com2PduR_HAD_BACKUP_CAN
          ComTxIPdu: ComMinimumDelayTime=0.2, ComTxIPduUnusedAreasDefault=0
            ComTxModeTrue
              ComTxMode: ComTxModeMode=DIRECT, ComTxModeNumberOfRepetitions=0
        IP_ECU_Stat_IMU_A_ST3_HAD_BACKUP_CAN_Tx: ComIPduSignalRef=S_Awake_Diag_Actv_IMU_A_ST3_HAD_BACKUP_CAN_Tx, ComIPduSignalRef=S_Awake_NwStart_IMU_A_ST3_HAD_BACKUP_CAN_Tx, ComIPduSignalRef=S_ECU_Id_IMU_A_ST3_HAD_BACKUP_CAN_Tx, ComIPduSignalRef=S_WakeupRsn_IMU_A_ST3_HAD_BACKUP_CAN_Tx, ComIPduSignalRef=S_NwId_Rsrv_ST3_HAD_BACKUP_CAN_Tx, ComPduIdRef=EcucPduCollection/ECU_Stat_IMU_A_ST3_Com2PduR_HAD_BACKUP_CAN
          ComTxIPdu: ComTxIPduUnusedAreasDefault=0
            ComTxModeTrue
              ComTxMode: ComTxModeMode=PERIODIC, ComTxModeTimeOffset=0.005, ComTxModeTimePeriod=1.0
        IP_Meas_IMU_A_ST3_HAD_BACKUP_CAN_Tx: ComIPduSignalGroupRef=SG_Meas_IMU_A_ST3_3n5lsz3gjs8xv6brvjbxgbhhx_HAD_BACKUP_CAN_Tx, ComPduIdRef=EcucPduCollection/Meas_IMU_A_ST3_Com2PduR_HAD_BACKUP_CAN
          ComTxIPdu: ComMinimumDelayTime=0.5, ComTxIPduUnusedAreasDefault=0
            ComTxModeTrue
              ComTxMode: ComTxModeMode=DIRECT, ComTxModeNumberOfRepetitions=0
      9 x ComIPduGroup:
        IPG_IMU_A_HAD_BACKUP_Rx_PNC_All_Active_CAN
        IPG_IMU_A_HAD_BACKUP_Tx_PNC_All_Active_CAN
        IPG_IMU_A_HAD_BACKUP_Tx_PNC_20_CAN
        IPG_IMU_A_HAD_BACKUP_Rx_PNC_20_CAN
        IPG_IMU_A_IMU_INTERNAL_Tx_PNC_All_Active_CAN
        IPG_IMU_A_IMU_INTERNAL_Tx_PNC_15_ComCtrl_CAN
        IPG_IMU_A_IMU_INTERNAL_Tx_PNC_20_CAN
        IPG_IMU_A_IMU_INTERNAL_Rx_PNC_All_Active_CAN
        IPG_IMU_A_IMU_INTERNAL_Rx_PNC_20_CAN
      5 x ComSignal, all with ComInitialValueOnly=false, ComSignalEndianness=LITTLE_ENDIAN, ComTransferProperty=PENDING:
        S_Awake_Diag_Actv_IMU_A_ST3_HAD_BACKUP_CAN_Tx: ComBitPosition=30, ComBitSize=1, ComSignalInitValue=0, ComSignalType=BOOLEAN, ComSystemTemplateSystemSignalRef=Awake_Diag_Actv_IMU_A_ST3
        S_Awake_NwStart_IMU_A_ST3_HAD_BACKUP_CAN_Tx: ComBitPosition=31, ComBitSize=1, ComSignalInitValue=0, ComSignalType=BOOLEAN, ComSystemTemplateSystemSignalRef=Awake_NwStart_IMU_A_ST3
        S_ECU_Id_IMU_A_ST3_HAD_BACKUP_CAN_Tx: ComBitPosition=0, ComBitSize=12, ComSignalInitValue=362, ComSignalType=UINT16, ComSystemTemplateSystemSignalRef=ECU_Id_IMU_A_ST3
        S_WakeupRsn_IMU_A_ST3_HAD_BACKUP_CAN_Tx: ComBitPosition=20, ComBitSize=10, ComSignalInitValue=1023, ComSignalType=UINT16, ComSystemTemplateSystemSignalRef=WakeupRsn_IMU_A_ST3
        S_NwId_Rsrv_ST3_HAD_BACKUP_CAN_Tx: ComBitPosition=12, ComBitSize=8, ComSignalInitValue=0, ComSignalType=UINT8, ComSystemTemplateSystemSignalRef=NwId_Rsrv_ST3
      SG_ROE_IMU_A_ST3_edm6y60q0qq6e5iaka50e3c31_HAD_BACKUP_CAN_Tx (ComSignalGroup): ComSignalGroupArrayAccess=false, ComTransferProperty=TRIGGERED, ComSystemTemplateSignalGroupRef=ROE_IMU_A_ST3_edm6y60q0qq6e5iaka50e3c31
        8 x ComGroupSignal, all with ComBitSize=8, ComSignalEndianness=LITTLE_ENDIAN, ComSignalInitValue=0, ComSignalType=UINT8:
          GS_ROE_0_IMU_A_ST3_HAD_BACKUP_CAN_Tx: ComBitPosition=0, ComSystemTemplateSystemSignalRef=ROE_0_IMU_A_ST3
          GS_ROE_1_IMU_A_ST3_HAD_BACKUP_CAN_Tx: ComBitPosition=8, ComSystemTemplateSystemSignalRef=ROE_1_IMU_A_ST3
          GS_ROE_2_IMU_A_ST3_HAD_BACKUP_CAN_Tx: ComBitPosition=16, ComSystemTemplateSystemSignalRef=ROE_2_IMU_A_ST3
          GS_ROE_3_IMU_A_ST3_HAD_BACKUP_CAN_Tx: ComBitPosition=24, ComSystemTemplateSystemSignalRef=ROE_3_IMU_A_ST3
          GS_ROE_4_IMU_A_ST3_HAD_BACKUP_CAN_Tx: ComBitPosition=32, ComSystemTemplateSystemSignalRef=ROE_4_IMU_A_ST3
          GS_ROE_5_IMU_A_ST3_HAD_BACKUP_CAN_Tx: ComBitPosition=40, ComSystemTemplateSystemSignalRef=ROE_5_IMU_A_ST3
          GS_ROE_6_IMU_A_ST3_HAD_BACKUP_CAN_Tx: ComBitPosition=48, ComSystemTemplateSystemSignalRef=ROE_6_IMU_A_ST3
          GS_ROE_7_IMU_A_ST3_HAD_BACKUP_CAN_Tx: ComBitPosition=56, ComSystemTemplateSystemSignalRef=ROE_7_IMU_A_ST3
      SG_Meas_IMU_A_ST3_3n5lsz3gjs8xv6brvjbxgbhhx_HAD_BACKUP_CAN_Tx (ComSignalGroup):
        ComInitialValueOnly = false
        ComSignalGroupArrayAccess = false
        ComTransferProperty = TRIGGERED
        ComSystemTemplateSignalGroupRef = Meas_IMU_A_ST3_3n5lsz3gjs8xv6brvjbxgbhhx
        64 x ComGroupSignal, all with ComBitSize=8, ComSignalEndianness=LITTLE_ENDIAN, ComSignalInitValue=0, ComSignalType=UINT8:
          GS_Meas_IMU_A_01_ST3_HAD_BACKUP_CAN_Tx: ComBitPosition=0, ComSystemTemplateSystemSignalRef=Meas_IMU_A_01_ST3
          GS_Meas_IMU_A_02_ST3_HAD_BACKUP_CAN_Tx: ComBitPosition=8, ComSystemTemplateSystemSignalRef=Meas_IMU_A_02_ST3
          GS_Meas_IMU_A_03_ST3_HAD_BACKUP_CAN_Tx: ComBitPosition=16, ComSystemTemplateSystemSignalRef=Meas_IMU_A_03_ST3
          GS_Meas_IMU_A_04_ST3_HAD_BACKUP_CAN_Tx: ComBitPosition=24, ComSystemTemplateSystemSignalRef=Meas_IMU_A_04_ST3
          GS_Meas_IMU_A_05_ST3_HAD_BACKUP_CAN_Tx: ComBitPosition=32, ComSystemTemplateSystemSignalRef=Meas_IMU_A_05_ST3
          GS_Meas_IMU_A_06_ST3_HAD_BACKUP_CAN_Tx: ComBitPosition=40, ComSystemTemplateSystemSignalRef=Meas_IMU_A_06_ST3
          GS_Meas_IMU_A_07_ST3_HAD_BACKUP_CAN_Tx: ComBitPosition=48, ComSystemTemplateSystemSignalRef=Meas_IMU_A_07_ST3
          GS_Meas_IMU_A_08_ST3_HAD_BACKUP_CAN_Tx: ComBitPosition=56, ComSystemTemplateSystemSignalRef=Meas_IMU_A_08_ST3
          GS_Meas_IMU_A_09_ST3_HAD_BACKUP_CAN_Tx: ComBitPosition=64, ComSystemTemplateSystemSignalRef=Meas_IMU_A_09_ST3
          GS_Meas_IMU_A_10_ST3_HAD_BACKUP_CAN_Tx: ComBitPosition=72, ComSystemTemplateSystemSignalRef=Meas_IMU_A_10_ST3
          GS_Meas_IMU_A_11_ST3_HAD_BACKUP_CAN_Tx: ComBitPosition=80, ComSystemTemplateSystemSignalRef=Meas_IMU_A_11_ST3
          GS_Meas_IMU_A_12_ST3_HAD_BACKUP_CAN_Tx: ComBitPosition=88, ComSystemTemplateSystemSignalRef=Meas_IMU_A_12_ST3
          GS_Meas_IMU_A_13_ST3_HAD_BACKUP_CAN_Tx: ComBitPosition=96, ComSystemTemplateSystemSignalRef=Meas_IMU_A_13_ST3
          GS_Meas_IMU_A_14_ST3_HAD_BACKUP_CAN_Tx: ComBitPosition=104, ComSystemTemplateSystemSignalRef=Meas_IMU_A_14_ST3
          GS_Meas_IMU_A_15_ST3_HAD_BACKUP_CAN_Tx: ComBitPosition=112, ComSystemTemplateSystemSignalRef=Meas_IMU_A_15_ST3
          GS_Meas_IMU_A_16_ST3_HAD_BACKUP_CAN_Tx: ComBitPosition=120, ComSystemTemplateSystemSignalRef=Meas_IMU_A_16_ST3
          GS_Meas_IMU_A_17_ST3_HAD_BACKUP_CAN_Tx: ComBitPosition=128, ComSystemTemplateSystemSignalRef=Meas_IMU_A_17_ST3
          GS_Meas_IMU_A_18_ST3_HAD_BACKUP_CAN_Tx: ComBitPosition=136, ComSystemTemplateSystemSignalRef=Meas_IMU_A_18_ST3
          GS_Meas_IMU_A_19_ST3_HAD_BACKUP_CAN_Tx: ComBitPosition=144, ComSystemTemplateSystemSignalRef=Meas_IMU_A_19_ST3
          GS_Meas_IMU_A_20_ST3_HAD_BACKUP_CAN_Tx: ComBitPosition=152, ComSystemTemplateSystemSignalRef=Meas_IMU_A_20_ST3
          GS_Meas_IMU_A_21_ST3_HAD_BACKUP_CAN_Tx: ComBitPosition=160, ComSystemTemplateSystemSignalRef=Meas_IMU_A_21_ST3
          GS_Meas_IMU_A_22_ST3_HAD_BACKUP_CAN_Tx: ComBitPosition=168, ComSystemTemplateSystemSignalRef=Meas_IMU_A_22_ST3
          GS_Meas_IMU_A_23_ST3_HAD_BACKUP_CAN_Tx: ComBitPosition=176, ComSystemTemplateSystemSignalRef=Meas_IMU_A_23_ST3
          GS_Meas_IMU_A_24_ST3_HAD_BACKUP_CAN_Tx: ComBitPosition=184, ComSystemTemplateSystemSignalRef=Meas_IMU_A_24_ST3
          GS_Meas_IMU_A_25_ST3_HAD_BACKUP_CAN_Tx: ComBitPosition=192, ComSystemTemplateSystemSignalRef=Meas_IMU_A_25_ST3
          GS_Meas_IMU_A_26_ST3_HAD_BACKUP_CAN_Tx: ComBitPosition=200, ComSystemTemplateSystemSignalRef=Meas_IMU_A_26_ST3
          GS_Meas_IMU_A_27_ST3_HAD_BACKUP_CAN_Tx: ComBitPosition=208, ComSystemTemplateSystemSignalRef=Meas_IMU_A_27_ST3
          GS_Meas_IMU_A_28_ST3_HAD_BACKUP_CAN_Tx: ComBitPosition=216, ComSystemTemplateSystemSignalRef=Meas_IMU_A_28_ST3
          GS_Meas_IMU_A_29_ST3_HAD_BACKUP_CAN_Tx: ComBitPosition=224, ComSystemTemplateSystemSignalRef=Meas_IMU_A_29_ST3
          GS_Meas_IMU_A_30_ST3_HAD_BACKUP_CAN_Tx: ComBitPosition=232, ComSystemTemplateSystemSignalRef=Meas_IMU_A_30_ST3
          GS_Meas_IMU_A_31_ST3_HAD_BACKUP_CAN_Tx: ComBitPosition=240, ComSystemTemplateSystemSignalRef=Meas_IMU_A_31_ST3
          GS_Meas_IMU_A_32_ST3_HAD_BACKUP_CAN_Tx: ComBitPosition=248, ComSystemTemplateSystemSignalRef=Meas_IMU_A_32_ST3
          GS_Meas_IMU_A_33_ST3_HAD_BACKUP_CAN_Tx: ComBitPosition=256, ComSystemTemplateSystemSignalRef=Meas_IMU_A_33_ST3
          GS_Meas_IMU_A_34_ST3_HAD_BACKUP_CAN_Tx: ComBitPosition=264, ComSystemTemplateSystemSignalRef=Meas_IMU_A_34_ST3
          GS_Meas_IMU_A_35_ST3_HAD_BACKUP_CAN_Tx: ComBitPosition=272, ComSystemTemplateSystemSignalRef=Meas_IMU_A_35_ST3
          GS_Meas_IMU_A_36_ST3_HAD_BACKUP_CAN_Tx: ComBitPosition=280, ComSystemTemplateSystemSignalRef=Meas_IMU_A_36_ST3
          GS_Meas_IMU_A_37_ST3_HAD_BACKUP_CAN_Tx: ComBitPosition=288, ComSystemTemplateSystemSignalRef=Meas_IMU_A_37_ST3
          GS_Meas_IMU_A_38_ST3_HAD_BACKUP_CAN_Tx: ComBitPosition=296, ComSystemTemplateSystemSignalRef=Meas_IMU_A_38_ST3
          GS_Meas_IMU_A_39_ST3_HAD_BACKUP_CAN_Tx: ComBitPosition=304, ComSystemTemplateSystemSignalRef=Meas_IMU_A_39_ST3
          GS_Meas_IMU_A_40_ST3_HAD_BACKUP_CAN_Tx: ComBitPosition=312, ComSystemTemplateSystemSignalRef=Meas_IMU_A_40_ST3
          GS_Meas_IMU_A_41_ST3_HAD_BACKUP_CAN_Tx: ComBitPosition=320, ComSystemTemplateSystemSignalRef=Meas_IMU_A_41_ST3
          GS_Meas_IMU_A_42_ST3_HAD_BACKUP_CAN_Tx: ComBitPosition=328, ComSystemTemplateSystemSignalRef=Meas_IMU_A_42_ST3
          GS_Meas_IMU_A_43_ST3_HAD_BACKUP_CAN_Tx: ComBitPosition=336, ComSystemTemplateSystemSignalRef=Meas_IMU_A_43_ST3
          GS_Meas_IMU_A_44_ST3_HAD_BACKUP_CAN_Tx: ComBitPosition=344, ComSystemTemplateSystemSignalRef=Meas_IMU_A_44_ST3
          GS_Meas_IMU_A_45_ST3_HAD_BACKUP_CAN_Tx: ComBitPosition=352, ComSystemTemplateSystemSignalRef=Meas_IMU_A_45_ST3
          GS_Meas_IMU_A_46_ST3_HAD_BACKUP_CAN_Tx: ComBitPosition=360, ComSystemTemplateSystemSignalRef=Meas_IMU_A_46_ST3
          GS_Meas_IMU_A_47_ST3_HAD_BACKUP_CAN_Tx: ComBitPosition=368, ComSystemTemplateSystemSignalRef=Meas_IMU_A_47_ST3
          GS_Meas_IMU_A_48_ST3_HAD_BACKUP_CAN_Tx: ComBitPosition=376, ComSystemTemplateSystemSignalRef=Meas_IMU_A_48_ST3
          GS_Meas_IMU_A_49_ST3_HAD_BACKUP_CAN_Tx: ComBitPosition=384, ComSystemTemplateSystemSignalRef=Meas_IMU_A_49_ST3
          GS_Meas_IMU_A_50_ST3_HAD_BACKUP_CAN_Tx: ComBitPosition=392, ComSystemTemplateSystemSignalRef=Meas_IMU_A_50_ST3
          GS_Meas_IMU_A_51_ST3_HAD_BACKUP_CAN_Tx: ComBitPosition=400, ComSystemTemplateSystemSignalRef=Meas_IMU_A_51_ST3
          GS_Meas_IMU_A_52_ST3_HAD_BACKUP_CAN_Tx: ComBitPosition=408, ComSystemTemplateSystemSignalRef=Meas_IMU_A_52_ST3
          GS_Meas_IMU_A_53_ST3_HAD_BACKUP_CAN_Tx: ComBitPosition=416, ComSystemTemplateSystemSignalRef=Meas_IMU_A_53_ST3
          GS_Meas_IMU_A_54_ST3_HAD_BACKUP_CAN_Tx: ComBitPosition=424, ComSystemTemplateSystemSignalRef=Meas_IMU_A_54_ST3
          GS_Meas_IMU_A_55_ST3_HAD_BACKUP_CAN_Tx: ComBitPosition=432, ComSystemTemplateSystemSignalRef=Meas_IMU_A_55_ST3
          GS_Meas_IMU_A_56_ST3_HAD_BACKUP_CAN_Tx: ComBitPosition=440, ComSystemTemplateSystemSignalRef=Meas_IMU_A_56_ST3
          GS_Meas_IMU_A_57_ST3_HAD_BACKUP_CAN_Tx: ComBitPosition=448, ComSystemTemplateSystemSignalRef=Meas_IMU_A_57_ST3
          GS_Meas_IMU_A_58_ST3_HAD_BACKUP_CAN_Tx: ComBitPosition=456, ComSystemTemplateSystemSignalRef=Meas_IMU_A_58_ST3
          GS_Meas_IMU_A_59_ST3_HAD_BACKUP_CAN_Tx: ComBitPosition=464, ComSystemTemplateSystemSignalRef=Meas_IMU_A_59_ST3
          GS_Meas_IMU_A_60_ST3_HAD_BACKUP_CAN_Tx: ComBitPosition=472, ComSystemTemplateSystemSignalRef=Meas_IMU_A_60_ST3
          GS_Meas_IMU_A_61_ST3_HAD_BACKUP_CAN_Tx: ComBitPosition=480, ComSystemTemplateSystemSignalRef=Meas_IMU_A_61_ST3
          GS_Meas_IMU_A_62_ST3_HAD_BACKUP_CAN_Tx: ComBitPosition=488, ComSystemTemplateSystemSignalRef=Meas_IMU_A_62_ST3
          GS_Meas_IMU_A_63_ST3_HAD_BACKUP_CAN_Tx: ComBitPosition=496, ComSystemTemplateSystemSignalRef=Meas_IMU_A_63_ST3
          GS_Meas_IMU_A_64_ST3_HAD_BACKUP_CAN_Tx: ComBitPosition=504, ComSystemTemplateSystemSignalRef=Meas_IMU_A_64_ST3
  module config EcuC
    EcucConfigSet
      EcucPduCollection
        60 x Pdu:
          IMU_A_HAD_BACKUP_COM_Container1_ST3_ContainerIPdu_IpduM2PduR_HAD_BACKUP_CAN: PduLength=64, SysTPduToPduTriggeringRef=IMU_A_HAD_BACKUP_COM_Container1_ST3_5fc40qe7eix9l29216sw0x3pc
          IMU_A_HAD_BACKUP_COM_Container1_ST3_ContainerIPdu_PduR2CanIf_HAD_BACKUP_CAN: PduLength=64, SysTPduToPduTriggeringRef=IMU_A_HAD_BACKUP_COM_Container1_ST3_5fc40qe7eix9l29216sw0x3pc
          IMU_A_HAD_BACKUP_COM_Container1_ST3_ROE_IMU_A_ST3_Com2PduR_HAD_BACKUP_CAN: PduLength=8, SysTPduToPduTriggeringRef=IMU_A_HAD_BACKUP_COM_Container1_ST3_IMU_A_HAD_BACKUP_COM_Container1_ST3_ROE_IMU_A_ST3_f430b8ou54rp0u3dqgmzehof0
          IMU_A_HAD_BACKUP_COM_Container1_ST3_ROE_IMU_A_ST3_PduR2IpduM_HAD_BACKUP_CAN: PduLength=8, SysTPduToPduTriggeringRef=IMU_A_HAD_BACKUP_COM_Container1_ST3_IMU_A_HAD_BACKUP_COM_Container1_ST3_ROE_IMU_A_ST3_f430b8ou54rp0u3dqgmzehof0
          IMU_A_HAD_BACKUP_GW_Container1_ST3_ContainerIPdu_IpduM2PduR_HAD_BACKUP_CAN: PduLength=64, SysTPduToPduTriggeringRef=IMU_A_HAD_BACKUP_GW_Container1_ST3_5f8t0vj1dqcedcau7bepxw1r5
          IMU_A_HAD_BACKUP_GW_Container1_ST3_ContainerIPdu_PduR2CanIf_HAD_BACKUP_CAN: PduLength=64, SysTPduToPduTriggeringRef=IMU_A_HAD_BACKUP_GW_Container1_ST3_5f8t0vj1dqcedcau7bepxw1r5
          ESP_HAD_BACKUP_GW_Container3_ST3_ContainerIPdu_CanIf2PduR_HAD_BACKUP_CAN: PduLength=64, SysTPduToPduTriggeringRef=ESP_HAD_BACKUP_GW_Container3_ST3_es20z922k0hdxd542vyccnt5z
          ESP_HAD_BACKUP_GW_Container3_ST3_ContainerIPdu_PduR2IpduM_HAD_BACKUP_CAN: PduLength=64, SysTPduToPduTriggeringRef=ESP_HAD_BACKUP_GW_Container3_ST3_es20z922k0hdxd542vyccnt5z
          ESP_HAD_BACKUP_GW_Container3_ST3_VSS_TP_Auth_ST3_IpduM2PduR_HAD_BACKUP_CAN: PduLength=8, SysTPduToPduTriggeringRef=ESP_HAD_BACKUP_GW_Container3_ST3_ESP_HAD_BACKUP_GW_Container3_ST3_VSS_TP_Auth_ST3_a5m1oehgi1yzcicgsdebhigxy
          ESP_HAD_BACKUP_GW_Container3_ST3_VSS_TP_Auth_ST3_PduR2Com_HAD_BACKUP_CAN: PduLength=8, SysTPduToPduTriggeringRef=ESP_HAD_BACKUP_GW_Container3_ST3_ESP_HAD_BACKUP_GW_Container3_ST3_VSS_TP_Auth_ST3_a5m1oehgi1yzcicgsdebhigxy
          ESP_HAD_BACKUP_GW_Container3_ST3_VSS_TP_RealTmOffset_ST3_IpduM2PduR_HAD_BACKUP_CAN: PduLength=8, SysTPduToPduTriggeringRef=ESP_HAD_BACKUP_GW_Container3_ST3_ESP_HAD_BACKUP_GW_Container3_ST3_VSS_TP_RealTmOffset_ST3_2686huv0x9rg4cu1k20p07zrz
          ESP_HAD_BACKUP_GW_Container3_ST3_VSS_TP_RealTmOffset_ST3_PduR2Com_HAD_BACKUP_CAN: PduLength=8, SysTPduToPduTriggeringRef=ESP_HAD_BACKUP_GW_Container3_ST3_ESP_HAD_BACKUP_GW_Container3_ST3_VSS_TP_RealTmOffset_ST3_2686huv0x9rg4cu1k20p07zrz
          ESP_HAD_BACKUP_GW_Container3_ST3_VSS_TP_SecTickCount_Lvl1_ST3_IpduM2PduR_HAD_BACKUP_CAN: PduLength=8, SysTPduToPduTriggeringRef=ESP_HAD_BACKUP_GW_Container3_ST3_ESP_HAD_BACKUP_GW_Container3_ST3_VSS_TP_SecTickCount_Lvl1_ST3_azhv8t4onxhjhi2zn8in2my2n
          ESP_HAD_BACKUP_GW_Container3_ST3_VSS_TP_SecTickCount_Lvl1_ST3_PduR2Com_HAD_BACKUP_CAN: PduLength=8, SysTPduToPduTriggeringRef=ESP_HAD_BACKUP_GW_Container3_ST3_ESP_HAD_BACKUP_GW_Container3_ST3_VSS_TP_SecTickCount_Lvl1_ST3_azhv8t4onxhjhi2zn8in2my2n
          ESP_HAD_BACKUP_GW_Container3_ST3_VSS_TP_SharedSecret_ST3_IpduM2PduR_HAD_BACKUP_CAN: PduLength=8, SysTPduToPduTriggeringRef=ESP_HAD_BACKUP_GW_Container3_ST3_ESP_HAD_BACKUP_GW_Container3_ST3_VSS_TP_SharedSecret_ST3_82pb6fg4cswmgotegs6aplrj2
          ESP_HAD_BACKUP_GW_Container3_ST3_VSS_TP_SharedSecret_ST3_PduR2Com_HAD_BACKUP_CAN: PduLength=8, SysTPduToPduTriggeringRef=ESP_HAD_BACKUP_GW_Container3_ST3_ESP_HAD_BACKUP_GW_Container3_ST3_VSS_TP_SharedSecret_ST3_82pb6fg4cswmgotegs6aplrj2
          ESP_HAD_BACKUP_GW_Container3_ST3_VSS_TP_VIN_ST3_IpduM2PduR_HAD_BACKUP_CAN: PduLength=8, SysTPduToPduTriggeringRef=ESP_HAD_BACKUP_GW_Container3_ST3_ESP_HAD_BACKUP_GW_Container3_ST3_VSS_TP_VIN_ST3_3331jz4zbik8yl0ehm51yf8w4
          ESP_HAD_BACKUP_GW_Container3_ST3_VSS_TP_VIN_ST3_PduR2Com_HAD_BACKUP_CAN: PduLength=8, SysTPduToPduTriggeringRef=ESP_HAD_BACKUP_GW_Container3_ST3_ESP_HAD_BACKUP_GW_Container3_ST3_VSS_TP_VIN_ST3_3331jz4zbik8yl0ehm51yf8w4
          IMU_A_Output_ST3_secured_SecOC2PduR_HAD_BACKUP_CAN: PduLength=44, SysTPduToPduTriggeringRef=IMU_A_Output_ST3_32ru3309rvckjvcx6fmcjcw7u
          IMU_A_Output_ST3_secured_PduR2CanIf_HAD_BACKUP_CAN: PduLength=44, SysTPduToPduTriggeringRef=IMU_A_Output_ST3_32ru3309rvckjvcx6fmcjcw7u
          IMU_A_Output_ST3_Com2PduR_HAD_BACKUP_CAN: PduLength=40, SysTPduToPduTriggeringRef=IMU_A_Output_ST3_brfz9q0nahr147hbo9yhq1vvv
          IMU_A_Output_ST3_PduR2SecOC_HAD_BACKUP_CAN: PduLength=40, SysTPduToPduTriggeringRef=IMU_A_Output_ST3_brfz9q0nahr147hbo9yhq1vvv
          IMU_B_Output_ST3_secured_PduR2CanIf_HAD_BACKUP_CAN: PduLength=44, SysTPduToPduTriggeringRef=IMU_B_Output_ST3_bffs41or7tdzn6fa29pvrjq4c
          IMU_B_Output_ST3_secured_SecOC2PduR_HAD_BACKUP_CAN: PduLength=44, SysTPduToPduTriggeringRef=IMU_B_Output_ST3_bffs41or7tdzn6fa29pvrjq4c
          IMU_B_Output_ST3_Com2PduR_HAD_BACKUP_CAN: PduLength=40, SysTPduToPduTriggeringRef=IMU_B_Output_ST3_e7us6pv8twmgl1lendhudwh3s
          IMU_B_Output_ST3_PduR2SecOC_HAD_BACKUP_CAN: PduLength=40, SysTPduToPduTriggeringRef=IMU_B_Output_ST3_e7us6pv8twmgl1lendhudwh3s
          NM_IMU_A_ST3_CanNm2CanIf_HAD_BACKUP_CAN: PduLength=8, SysTPduToFrameTriggeringRef=NM_IMU_A_ST3_mqes5157d517lzmkzlhjas48
          NM_Dummy_ST3_CanIf2CanNm_HAD_BACKUP_CAN: PduLength=8, SysTPduToFrameTriggeringRef=NM_Dummy_ST3_5v44zxwqibhgfzivqlgrinq52
          ECU_Stat_IMU_A_ST3_Com2PduR_HAD_BACKUP_CAN: PduLength=8, SysTPduToPduTriggeringRef=ECU_Stat_IMU_A_ST3_136g7awpfvh0itxq740bqmwve
          ECU_Stat_IMU_A_ST3_PduR2CanIf_HAD_BACKUP_CAN: PduLength=8, SysTPduToPduTriggeringRef=ECU_Stat_IMU_A_ST3_136g7awpfvh0itxq740bqmwve
          NM_IMU_A_ST3_Com2PduR_HAD_BACKUP_CAN: PduLength=7, SysTPduToFrameTriggeringRef=NM_IMU_A_ST3_mqes5157d517lzmkzlhjas48
          NM_IMU_A_ST3_PduR2CanNm_HAD_BACKUP_CAN: PduLength=7, SysTPduToFrameTriggeringRef=NM_IMU_A_ST3_mqes5157d517lzmkzlhjas48
          IMU_A_Output_ST3_secured_SecOC2PduR_IMU_INTERNAL_CAN: PduLength=44, SysTPduToPduTriggeringRef=IMU_A_Output_ST3_6l4id86kym3ykh1x8fnhhai2g
          IMU_A_Output_ST3_secured_PduR2CanIf_IMU_INTERNAL_CAN: PduLength=44, SysTPduToPduTriggeringRef=IMU_A_Output_ST3_6l4id86kym3ykh1x8fnhhai2g
          IMU_A_Output_ST3_Com2PduR_IMU_INTERNAL_CAN: PduLength=40, SysTPduToPduTriggeringRef=IMU_A_Output_ST3_1s7p55wldfbcir6iy5a616rwn
          IMU_A_Output_ST3_PduR2SecOC_IMU_INTERNAL_CAN: PduLength=40, SysTPduToPduTriggeringRef=IMU_A_Output_ST3_1s7p55wldfbcir6iy5a616rwn
          IMU_B_Output_ST3_secured_CanIf2PduR_IMU_INTERNAL_CAN: PduLength=44, SysTPduToPduTriggeringRef=IMU_B_Output_ST3_bwk2sg041c3g1zxomqmr61qdl
          IMU_B_Output_ST3_secured_PduR2SecOC_IMU_INTERNAL_CAN: PduLength=44, SysTPduToPduTriggeringRef=IMU_B_Output_ST3_bwk2sg041c3g1zxomqmr61qdl
          IMU_B_Output_ST3_SecOC2PduR_IMU_INTERNAL_CAN: PduLength=40, SysTPduToPduTriggeringRef=IMU_B_Output_ST3_71wg165b3j1a1mormsg5xnlfr
          IMU_B_Output_ST3_PduR2Com_IMU_INTERNAL_CAN: PduLength=40, SysTPduToPduTriggeringRef=IMU_B_Output_ST3_71wg165b3j1a1mormsg5xnlfr
          NM_IMU_A_ST3_CanNm2CanIf_IMU_INTERNAL_CAN: PduLength=8, SysTPduToFrameTriggeringRef=NM_IMU_A_ST3_6vo2o7b9cyd47cbahjaygi9t7
          NM_Dummy_ST3_CanIf2CanNm_IMU_INTERNAL_CAN: PduLength=8, SysTPduToFrameTriggeringRef=NM_Dummy_ST3_47cxd2tpch3havy6ru1a9do2q
          ECU_Stat_IMU_A_IMU_INTERNAL_ST3_Com2PduR_IMU_INTERNAL_CAN: PduLength=8, SysTPduToPduTriggeringRef=ECU_Stat_IMU_A_IMU_INTERNAL_ST3_a8phq4pa8364mz7zku4m1zggs
          ECU_Stat_IMU_A_IMU_INTERNAL_ST3_PduR2CanIf_IMU_INTERNAL_CAN: PduLength=8, SysTPduToPduTriggeringRef=ECU_Stat_IMU_A_IMU_INTERNAL_ST3_a8phq4pa8364mz7zku4m1zggs
          ECU_Stat_IMU_B_ST3_CanIf2PduR_IMU_INTERNAL_CAN: PduLength=8, SysTPduToPduTriggeringRef=ECU_Stat_IMU_B_ST3_1l9xnste3w36iapn7j8fv2gjj
          ECU_Stat_IMU_B_ST3_PduR2Com_IMU_INTERNAL_CAN: PduLength=8, SysTPduToPduTriggeringRef=ECU_Stat_IMU_B_ST3_1l9xnste3w36iapn7j8fv2gjj
          ROE_IMU_B_ST3_CanIf2PduR_IMU_INTERNAL_CAN: PduLength=8, SysTPduToPduTriggeringRef=ROE_IMU_B_ST3_ybki1p1g4q0gpufyixy3mote
          ROE_IMU_B_ST3_PduR2Com_IMU_INTERNAL_CAN: PduLength=8, SysTPduToPduTriggeringRef=ROE_IMU_B_ST3_ybki1p1g4q0gpufyixy3mote
          NmPnEiraRxNSduRef_CAN_CanNm2PduR_IMU_INTERNAL_CAN: PduLength=7, SysTPduToFrameTriggeringRef=NM_Dummy_ST3_47cxd2tpch3havy6ru1a9do2q
          NmPnEiraRxNSduRef_CAN_PduR2Com_IMU_INTERNAL_CAN: PduLength=7, SysTPduToFrameTriggeringRef=NM_Dummy_ST3_47cxd2tpch3havy6ru1a9do2q
          NM_IMU_A_ST3_Com2PduR_IMU_INTERNAL_CAN: PduLength=7, SysTPduToFrameTriggeringRef=NM_IMU_A_ST3_6vo2o7b9cyd47cbahjaygi9t7
          NM_IMU_A_ST3_PduR2CanNm_IMU_INTERNAL_CAN: PduLength=7, SysTPduToFrameTriggeringRef=NM_IMU_A_ST3_6vo2o7b9cyd47cbahjaygi9t7
          GTS_Main_CAN_ST3_CanTSyn2CanIf_IMU_INTERNAL_CAN: PduLength=8
          GTS_Main_CAN_ST3_CanIf2CanTSyn_HAD_BACKUP_CAN: PduLength=8
          IMU_A_HAD_BACKUP_GW_Container1_ST3_ECU_Stat_IMU_B_ST3_PduR2IpduM_HAD_BACKUP_CAN: PduLength=8, SysTPduToPduTriggeringRef=IMU_A_HAD_BACKUP_GW_Container1_ST3_IMU_A_HAD_BACKUP_GW_Container1_ST3_ECU_Stat_IMU_B_ST3_b0no16iuzsaidp6epdjs3jmj3
          IMU_A_HAD_BACKUP_GW_Container1_ST3_ECU_Stat_IMU_B_ST3_Com2PduR_HAD_BACKUP_CAN: PduLength=8, SysTPduToPduTriggeringRef=IMU_A_HAD_BACKUP_GW_Container1_ST3_IMU_A_HAD_BACKUP_GW_Container1_ST3_ECU_Stat_IMU_B_ST3_b0no16iuzsaidp6epdjs3jmj3
          IMU_A_HAD_BACKUP_GW_Container1_ST3_ROE_IMU_B_ST3_PduR2IpduM_HAD_BACKUP_CAN: PduLength=8, SysTPduToPduTriggeringRef=IMU_A_HAD_BACKUP_GW_Container1_ST3_IMU_A_HAD_BACKUP_GW_Container1_ST3_ROE_IMU_B_ST3_7evmftg8vujspy0p3yge2cozt
          IMU_A_HAD_BACKUP_GW_Container1_ST3_ROE_IMU_B_ST3_Com2PduR_HAD_BACKUP_CAN: PduLength=8, SysTPduToPduTriggeringRef=IMU_A_HAD_BACKUP_GW_Container1_ST3_IMU_A_HAD_BACKUP_GW_Container1_ST3_ROE_IMU_B_ST3_7evmftg8vujspy0p3yge2cozt
          Meas_IMU_A_ST3_Com2PduR_HAD_BACKUP_CAN: PduLength=64, SysTPduToPduTriggeringRef=Meas_IMU_A_ST3_bcya807sfy2xqyg51auylav0f
          Meas_IMU_A_ST3_PduR2CanIf_HAD_BACKUP_CAN: PduLength=64, SysTPduToPduTriggeringRef=Meas_IMU_A_ST3_bcya807sfy2xqyg51auylav0f
  module config IpduM: implementation-config-variant=VARIANT-PRE-COMPILE
    IpduMConfig
      3 x IpduMContainedTxPdu, all with IpduMContainedTxPduCollectionSemantics=IPDUM_COLLECT_QUEUED, IpduMContainedTxPduTrigger=IPDUM_TRIGGER_ALWAYS:
        CdTx_IMU_A_HAD_BACKUP_COM_Container1_ST3_IMU_A_HAD_BACKUP_COM_Container1_ST3_ROE_IMU_A__1A754A8EF6CC3BAD7D0FF2B38403C0D53FEBDFDC: IpduMContainedPduHeaderId=3801299, IpduMContainedTxPduSendTimeout=0.01, IpduMContainedTxInContainerPduRef=CrTx_IMU_A_HAD_BACKUP_COM_Container1_ST3_ContainerIPdu_HAD_BACKUP_CAN, IpduMContainedTxPduRef=EcucPduCollection/IMU_A_HAD_BACKUP_COM_Container1_ST3_ROE_IMU_A_ST3_PduR2IpduM_HAD_BACKUP_CAN
        CdTx_IMU_A_HAD_BACKUP_GW_Container1_ST3_IMU_A_HAD_BACKUP_GW_Container1_ST3_ECU_Stat_IMU_C2B4246C4D56BF1B4B8DC7A4FD33AB3A92461030: IpduMContainedPduHeaderId=3800814, IpduMContainedTxInContainerPduRef=CrTx_IMU_A_HAD_BACKUP_GW_Container1_ST3_ContainerIPdu_HAD_BACKUP_CAN, IpduMContainedTxPduRef=EcucPduCollection/IMU_A_HAD_BACKUP_GW_Container1_ST3_ECU_Stat_IMU_B_ST3_PduR2IpduM_HAD_BACKUP_CAN
        CdTx_IMU_A_HAD_BACKUP_GW_Container1_ST3_IMU_A_HAD_BACKUP_GW_Container1_ST3_ROE_IMU_B_ST_E47F1800E664BE01F9A97529B3F331507BA4DD1A: IpduMContainedPduHeaderId=3801313, IpduMContainedTxInContainerPduRef=CrTx_IMU_A_HAD_BACKUP_GW_Container1_ST3_ContainerIPdu_HAD_BACKUP_CAN, IpduMContainedTxPduRef=EcucPduCollection/IMU_A_HAD_BACKUP_GW_Container1_ST3_ROE_IMU_B_ST3_PduR2IpduM_HAD_BACKUP_CAN
      CrTx_IMU_A_HAD_BACKUP_COM_Container1_ST3_ContainerIPdu_HAD_BACKUP_CAN (IpduMContainerTxPdu):
        IpduMContainerHeaderSize = IPDUM_HEADERTYPE_SHORT
        IpduMContainerQueueSize = 1
        IpduMContainerTxFirstContainedPduTrigger = false
        IpduMContainerTxSendTimeout = 0.01
        IpduMContainerTxSizeThreshold = 59
        IpduMContainerTxTriggerMode = IPDUM_DIRECT
        IpduMContainerTxPduRef = EcucPduCollection/IMU_A_HAD_BACKUP_COM_Container1_ST3_ContainerIPdu_IpduM2PduR_HAD_BACKUP_CAN
      CrTx_IMU_A_HAD_BACKUP_GW_Container1_ST3_ContainerIPdu_HAD_BACKUP_CAN (IpduMContainerTxPdu):
        IpduMContainerHeaderSize = IPDUM_HEADERTYPE_SHORT
        IpduMContainerQueueSize = 1
        IpduMContainerTxFirstContainedPduTrigger = false
        IpduMContainerTxSendTimeout = 0.015
        IpduMContainerTxSizeThreshold = 59
        IpduMContainerTxTriggerMode = IPDUM_DIRECT
        IpduMContainerTxPduRef = EcucPduCollection/IMU_A_HAD_BACKUP_GW_Container1_ST3_ContainerIPdu_IpduM2PduR_HAD_BACKUP_CAN
    IpduMGeneral:
      IpduMDevErrorDetect = false
      IpduMHeaderByteOrder = IPDUM_BIG_ENDIAN
      IpduMRxTimeBase = 0.005
      IpduMStaticPartExists = true
      IpduMTxTimeBase = 0.005
      IpduMVersionInfoApi = false
    IpduMPublishedInformation: IpduMRxDirectComInvocation=false
  module config PduR
    PduRRoutingTables
      PduRRoutingTable
        8 x PduRRoutingPath:
          IMU_B_Output_ST3_secured_GATEWAY_IMU_INTERNAL_CAN
            IMU_B_Output_ST3_secured_PduR2CanIf_HAD_BACKUP_CAN (PduRDestPdu): PduRDestPduDataProvision=PDUR_DIRECT, PduRDestPduRef=EcucPduCollection/IMU_B_Output_ST3_secured_PduR2CanIf_HAD_BACKUP_CAN
            IMU_B_Output_ST3_secured_CanIf2PduR_IMU_INTERNAL_CAN (PduRSrcPdu): PduRSrcPduRef=EcucPduCollection/IMU_B_Output_ST3_secured_CanIf2PduR_IMU_INTERNAL_CAN
          ECU_Stat_IMU_A_ST3_Com2CanIf_HAD_BACKUP_CAN
            ECU_Stat_IMU_A_ST3_PduR2CanIf_HAD_BACKUP_CAN (PduRDestPdu): PduRDestPduRef=EcucPduCollection/ECU_Stat_IMU_A_ST3_PduR2CanIf_HAD_BACKUP_CAN
            ECU_Stat_IMU_A_ST3_Com2PduR_HAD_BACKUP_CAN (PduRSrcPdu): PduRSrcPduRef=EcucPduCollection/ECU_Stat_IMU_A_ST3_Com2PduR_HAD_BACKUP_CAN
          IMU_A_HAD_BACKUP_COM_Container1_ST3_ContainerIPdu_IpduM2CanIf_HAD_BACKUP_CAN
            IMU_A_HAD_BACKUP_COM_Container1_ST3_ContainerIPdu_PduR2CanIf_HAD_BACKUP_CAN (PduRDestPdu): PduRDestPduRef=EcucPduCollection/IMU_A_HAD_BACKUP_COM_Container1_ST3_ContainerIPdu_PduR2CanIf_HAD_BACKUP_CAN
            IMU_A_HAD_BACKUP_COM_Container1_ST3_ContainerIPdu_IpduM2PduR_HAD_BACKUP_CAN (PduRSrcPdu): PduRSrcPduRef=EcucPduCollection/IMU_A_HAD_BACKUP_COM_Container1_ST3_ContainerIPdu_IpduM2PduR_HAD_BACKUP_CAN
          IMU_A_HAD_BACKUP_COM_Container1_ST3_ROE_IMU_A_ST3_Com2IpduM_HAD_BACKUP_CAN
            IMU_A_HAD_BACKUP_COM_Container1_ST3_ROE_IMU_A_ST3_PduR2IpduM_HAD_BACKUP_CAN (PduRDestPdu): PduRDestPduRef=EcucPduCollection/IMU_A_HAD_BACKUP_COM_Container1_ST3_ROE_IMU_A_ST3_PduR2IpduM_HAD_BACKUP_CAN
            IMU_A_HAD_BACKUP_COM_Container1_ST3_ROE_IMU_A_ST3_Com2PduR_HAD_BACKUP_CAN (PduRSrcPdu): PduRSrcPduRef=EcucPduCollection/IMU_A_HAD_BACKUP_COM_Container1_ST3_ROE_IMU_A_ST3_Com2PduR_HAD_BACKUP_CAN
          IMU_A_HAD_BACKUP_GW_Container1_ST3_ContainerIPdu_IpduM2CanIf_HAD_BACKUP_CAN
            IMU_A_HAD_BACKUP_GW_Container1_ST3_ContainerIPdu_PduR2CanIf_HAD_BACKUP_CAN (PduRDestPdu): PduRDestPduRef=EcucPduCollection/IMU_A_HAD_BACKUP_GW_Container1_ST3_ContainerIPdu_PduR2CanIf_HAD_BACKUP_CAN
            IMU_A_HAD_BACKUP_GW_Container1_ST3_ContainerIPdu_IpduM2PduR_HAD_BACKUP_CAN (PduRSrcPdu): PduRSrcPduRef=EcucPduCollection/IMU_A_HAD_BACKUP_GW_Container1_ST3_ContainerIPdu_IpduM2PduR_HAD_BACKUP_CAN
          ECU_Stat_IMU_B_ST3_GATEWAY_IMU_INTERNAL_CAN
            IMU_A_HAD_BACKUP_GW_Container1_ST3_ECU_Stat_IMU_B_ST3_PduR2IpduM_HAD_BACKUP_CAN (PduRDestPdu):
              PduRDestPduDataProvision = PDUR_DIRECT
              PduRDestPduRef = EcucPduCollection/IMU_A_HAD_BACKUP_GW_Container1_ST3_ECU_Stat_IMU_B_ST3_PduR2IpduM_HAD_BACKUP_CAN
            ECU_Stat_IMU_B_ST3_CanIf2PduR_IMU_INTERNAL_CAN (PduRSrcPdu): PduRSrcPduRef=EcucPduCollection/ECU_Stat_IMU_B_ST3_CanIf2PduR_IMU_INTERNAL_CAN
          ROE_IMU_B_ST3_GATEWAY_IMU_INTERNAL_CAN
            IMU_A_HAD_BACKUP_GW_Container1_ST3_ROE_IMU_B_ST3_PduR2IpduM_HAD_BACKUP_CAN (PduRDestPdu):
              PduRDestPduDataProvision = PDUR_DIRECT
              PduRDestPduRef = EcucPduCollection/IMU_A_HAD_BACKUP_GW_Container1_ST3_ROE_IMU_B_ST3_PduR2IpduM_HAD_BACKUP_CAN
            ROE_IMU_B_ST3_CanIf2PduR_IMU_INTERNAL_CAN (PduRSrcPdu): PduRSrcPduRef=EcucPduCollection/ROE_IMU_B_ST3_CanIf2PduR_IMU_INTERNAL_CAN
          Meas_IMU_A_ST3_Com2CanIf_HAD_BACKUP_CAN
            Meas_IMU_A_ST3_PduR2CanIf_HAD_BACKUP_CAN (PduRDestPdu): PduRDestPduRef=EcucPduCollection/Meas_IMU_A_ST3_PduR2CanIf_HAD_BACKUP_CAN
            Meas_IMU_A_ST3_Com2PduR_HAD_BACKUP_CAN (PduRSrcPdu): PduRSrcPduRef=EcucPduCollection/Meas_IMU_A_ST3_Com2PduR_HAD_BACKUP_CAN
    PduRGeneral:
      PduRDevErrorDetect = false
      PduRDSMReInitEnabled = false
      PduRGwTpWithLimitedBuffer = false
      PduRIFGatewayOperation = true
      PduRMulticastToIfSupport = true
      PduRQueueingSupport = false
      PduRVersionInfoApi = true
      PduRZeroCostOperation = false
    IpduM (PduRBswModules):
      PduRCancelReceive = false
      PduRCancelTransmit = false
      PduRCommunicationInterface = true
      PduRLowerModule = true
      PduRTransportProtocol = false
      PduRTriggertransmit = true
      PduRTxConfirmation = true
      PduRUpperModule = true
      PduRBswModuleRef = IpduM
  module config rba_ComDrv
    rba_ComDrvGeneral: ComDrvCpuCanType=MCU_RB_REN_RH850_P1MC_D3V2, ComDrvCpuType=MCU_RB_REN_RH850_P1MC_D3V2
  module config rba_SysElem
    rba_SysElem_SystemModel
      rba_SysElem_ISignalGroups
        10 x rba_SysElem_ISignalGroup:
          Ign_Stat_Pr5_ST3_csgs1dv6drms80o1i9p49677w: rba_SysElem_ISignalGroupForeignRef=Ign_Stat_Pr5_ST3_csgs1dv6drms80o1i9p49677w, rba_SysElem_ComBasedSignalGroupTransformationRef=BaseTrans_Profile_5_4, rba_SysElem_ISignalRef=rba_SysElem_ISignals/CRC_Ign_Stat_Pr5_ST3, rba_SysElem_ISignalRef=rba_SysElem_ISignals/ISw_Stat_ST3, rba_SysElem_ISignalRef=rba_SysElem_ISignals/KG_StartSw_Psd_ST3, rba_SysElem_ISignalRef=rba_SysElem_ISignals/SQC_Ign_Stat_Pr5_ST3, rba_SysElem_ISignalRef=rba_SysElem_ISignals/Veh_Op_Mode_ST3, rba_SysElem_SystemSignalGroupRef=rba_SysElem_SystemSignalGroups/Ign_Stat_Pr5_ST3_csgs1dv6drms80o1i9p49677w
            E2E_Profile_5 (rba_SysElem_TransformationISignalProps)
              rba_SysElem_EndToEndTransformationISignalProps: rba_SysElem_DataID=51, rba_SysElem_DataLength=32, rba_SysElem_TransformationTechnologyRef=rba_SysElem_TransformationTechnologies/E2E_Profile_5
          PT4_PTCoor4_Pr5_ST3_af4fxb1ykieox3itqdfzs0kpb: rba_SysElem_ISignalGroupForeignRef=PT4_PTCoor4_Pr5_ST3_af4fxb1ykieox3itqdfzs0kpb, rba_SysElem_ComBasedSignalGroupTransformationRef=BaseTrans_Profile_5_4, rba_SysElem_ISignalRef=rba_SysElem_ISignals/CRC_PT4_PTCoor4_Pr5_ST3, rba_SysElem_ISignalRef=rba_SysElem_ISignals/PT4_PTCoor_EngStartPN14_Stat_ST3, rba_SysElem_ISignalRef=rba_SysElem_ISignals/PT4_PTCoor_PT_Rdy_ST3, rba_SysElem_ISignalRef=rba_SysElem_ISignals/PT4_PTCoor_SSA_EngSp_ST3, rba_SysElem_ISignalRef=rba_SysElem_ISignals/Rsrv1_PT4_PTCoor_PT_Rdy_Pr5_ST3, rba_SysElem_ISignalRef=rba_SysElem_ISignals/SQC_PT4_PTCoor4_Pr5_ST3, rba_SysElem_SystemSignalGroupRef=rba_SysElem_SystemSignalGroups/PT4_PTCoor4_Pr5_ST3_af4fxb1ykieox3itqdfzs0kpb
            E2E_Profile_5 (rba_SysElem_TransformationISignalProps)
              rba_SysElem_EndToEndTransformationISignalProps: rba_SysElem_DataID=196, rba_SysElem_DataLength=32, rba_SysElem_TransformationTechnologyRef=rba_SysElem_TransformationTechnologies/E2E_Profile_5
          DI_Odo_Pr5_ST3_e68xmtlkywxgxsdwekdjjhw3t: rba_SysElem_ISignalGroupForeignRef=DI_Odo_Pr5_ST3_e68xmtlkywxgxsdwekdjjhw3t, rba_SysElem_ComBasedSignalGroupTransformationRef=BaseTrans_Profile_5_6, rba_SysElem_ISignalRef=rba_SysElem_ISignals/CRC_DI_Odo_Pr5_ST3, rba_SysElem_ISignalRef=rba_SysElem_ISignals/Odo_ST3, rba_SysElem_ISignalRef=rba_SysElem_ISignals/SQC_DI_Odo_Pr5_ST3, rba_SysElem_SystemSignalGroupRef=rba_SysElem_SystemSignalGroups/DI_Odo_Pr5_ST3_e68xmtlkywxgxsdwekdjjhw3t
            E2E_Profile_5 (rba_SysElem_TransformationISignalProps)
              rba_SysElem_EndToEndTransformationISignalProps: rba_SysElem_DataID=186, rba_SysElem_DataLength=48, rba_SysElem_TransformationTechnologyRef=rba_SysElem_TransformationTechnologies/E2E_Profile_5
          IMU_A_Output_Pr5_ST3_bezr5ct33mhwxias0s8rjhbne: rba_SysElem_ISignalGroupForeignRef=IMU_A_Output_Pr5_ST3_bezr5ct33mhwxias0s8rjhbne, rba_SysElem_ComBasedSignalGroupTransformationRef=BaseTrans_Profile_5_40, rba_SysElem_ISignalRef=rba_SysElem_ISignals/CRC_IMU_A_Output_Pr5_ST3, rba_SysElem_ISignalRef=rba_SysElem_ISignals/IMU_A_AngAcc_Stat_ST3, rba_SysElem_ISignalRef=rba_SysElem_ISignals/IMU_A_AngAcc_X_ST3, rba_SysElem_ISignalRef=rba_SysElem_ISignals/IMU_A_AngAcc_Y_ST3, rba_SysElem_ISignalRef=rba_SysElem_ISignals/IMU_A_AngAcc_Z_ST3, rba_SysElem_ISignalRef=rba_SysElem_ISignals/IMU_A_AngRate_X_ST3, rba_SysElem_ISignalRef=rba_SysElem_ISignals/IMU_A_AngRate_Y_ST3, rba_SysElem_ISignalRef=rba_SysElem_ISignals/IMU_A_AngRate_Z_ST3, rba_SysElem_ISignalRef=rba_SysElem_ISignals/IMU_A_AngRates_Stat_ST3, rba_SysElem_ISignalRef=rba_SysElem_ISignals/IMU_A_SpecForce_Stat_ST3, rba_SysElem_ISignalRef=rba_SysElem_ISignals/IMU_A_SpecForce_X_ST3, rba_SysElem_ISignalRef=rba_SysElem_ISignals/IMU_A_SpecForce_Y_ST3, rba_SysElem_ISignalRef=rba_SysElem_ISignals/IMU_A_SpecForce_Z_ST3, rba_SysElem_ISignalRef=rba_SysElem_ISignals/IMU_A_Stat_ST3, rba_SysElem_ISignalRef=rba_SysElem_ISignals/IMU_A_Temp_ST3, rba_SysElem_ISignalRef=rba_SysElem_ISignals/IMU_A_TmStmp_NanoSec_ST3, rba_SysElem_ISignalRef=rba_SysElem_ISignals/IMU_A_TmStmp_Sec_ST3, rba_SysElem_ISignalRef=rba_SysElem_ISignals/IMU_A_TmSync_Stat_ST3, rba_SysElem_ISignalRef=rba_SysElem_ISignals/Rsrv01_IMU_A_Output_Pr5_ST3, rba_SysElem_ISignalRef=rba_SysElem_ISignals/Rsrv02_IMU_A_Output_Pr5_ST3, rba_SysElem_ISignalRef=rba_SysElem_ISignals/Rsrv03_IMU_A_Output_Pr5_ST3, rba_SysElem_ISignalRef=rba_SysElem_ISignals/Rsrv04_IMU_A_Output_Pr5_ST3, rba_SysElem_ISignalRef=rba_SysElem_ISignals/Rsrv05_IMU_A_Output_Pr5_ST3, rba_SysElem_ISignalRef=rba_SysElem_ISignals/Rsrv06_IMU_A_Output_Pr5_ST3, rba_SysElem_ISignalRef=rba_SysElem_ISignals/Rsrv07_IMU_A_Output_Pr5_ST3, rba_SysElem_ISignalRef=rba_SysElem_ISignals/SQC_IMU_A_Output_Pr5_ST3, rba_SysElem_SystemSignalGroupRef=rba_SysElem_SystemSignalGroups/IMU_A_Output_Pr5_ST3_bezr5ct33mhwxias0s8rjhbne
            E2E_Profile_5 (rba_SysElem_TransformationISignalProps)
              rba_SysElem_EndToEndTransformationISignalProps: rba_SysElem_DataID=844, rba_SysElem_DataLength=320, rba_SysElem_TransformationTechnologyRef=rba_SysElem_TransformationTechnologies/E2E_Profile_5
          IMU_B_Output_Pr5_ST3_8enshzy4a8xe2badcgusoewm2: rba_SysElem_ISignalGroupForeignRef=IMU_B_Output_Pr5_ST3_8enshzy4a8xe2badcgusoewm2, rba_SysElem_ComBasedSignalGroupTransformationRef=BaseTrans_Profile_5_40, rba_SysElem_ISignalRef=rba_SysElem_ISignals/CRC_IMU_B_Output_Pr5_ST3, rba_SysElem_ISignalRef=rba_SysElem_ISignals/IMU_B_AngAcc_Stat_ST3, rba_SysElem_ISignalRef=rba_SysElem_ISignals/IMU_B_AngAcc_X_ST3, rba_SysElem_ISignalRef=rba_SysElem_ISignals/IMU_B_AngAcc_Y_ST3, rba_SysElem_ISignalRef=rba_SysElem_ISignals/IMU_B_AngAcc_Z_ST3, rba_SysElem_ISignalRef=rba_SysElem_ISignals/IMU_B_AngRate_X_ST3, rba_SysElem_ISignalRef=rba_SysElem_ISignals/IMU_B_AngRate_Y_ST3, rba_SysElem_ISignalRef=rba_SysElem_ISignals/IMU_B_AngRate_Z_ST3, rba_SysElem_ISignalRef=rba_SysElem_ISignals/IMU_B_AngRates_Stat_ST3, rba_SysElem_ISignalRef=rba_SysElem_ISignals/IMU_B_SpecForce_Stat_ST3, rba_SysElem_ISignalRef=rba_SysElem_ISignals/IMU_B_SpecForce_X_ST3, rba_SysElem_ISignalRef=rba_SysElem_ISignals/IMU_B_SpecForce_Y_ST3, rba_SysElem_ISignalRef=rba_SysElem_ISignals/IMU_B_SpecForce_Z_ST3, rba_SysElem_ISignalRef=rba_SysElem_ISignals/IMU_B_Stat_ST3, rba_SysElem_ISignalRef=rba_SysElem_ISignals/IMU_B_Temp_ST3, rba_SysElem_ISignalRef=rba_SysElem_ISignals/IMU_B_TmStmp_NanoSec_ST3, rba_SysElem_ISignalRef=rba_SysElem_ISignals/IMU_B_TmStmp_Sec_ST3, rba_SysElem_ISignalRef=rba_SysElem_ISignals/IMU_B_TmSync_Stat_ST3, rba_SysElem_ISignalRef=rba_SysElem_ISignals/Rsrv01_IMU_B_Output_Pr5_ST3, rba_SysElem_ISignalRef=rba_SysElem_ISignals/Rsrv02_IMU_B_Output_Pr5_ST3, rba_SysElem_ISignalRef=rba_SysElem_ISignals/Rsrv03_IMU_B_Output_Pr5_ST3, rba_SysElem_ISignalRef=rba_SysElem_ISignals/Rsrv04_IMU_B_Output_Pr5_ST3, rba_SysElem_ISignalRef=rba_SysElem_ISignals/Rsrv05_IMU_B_Output_Pr5_ST3, rba_SysElem_ISignalRef=rba_SysElem_ISignals/Rsrv06_IMU_B_Output_Pr5_ST3, rba_SysElem_ISignalRef=rba_SysElem_ISignals/Rsrv07_IMU_B_Output_Pr5_ST3, rba_SysElem_ISignalRef=rba_SysElem_ISignals/SQC_IMU_B_Output_Pr5_ST3, rba_SysElem_SystemSignalGroupRef=rba_SysElem_SystemSignalGroups/IMU_B_Output_Pr5_ST3_8enshzy4a8xe2badcgusoewm2
            E2E_Profile_5 (rba_SysElem_TransformationISignalProps)
              rba_SysElem_EndToEndTransformationISignalProps: rba_SysElem_DataID=845, rba_SysElem_DataLength=320, rba_SysElem_TransformationTechnologyRef=rba_SysElem_TransformationTechnologies/E2E_Profile_5
          Ign_Stat_Pr5_ST3_csgs1dv6drms80o1i9p49677w_RENAME1: rba_SysElem_ISignalGroupForeignRef=Ign_Stat_Pr5_ST3_csgs1dv6drms80o1i9p49677w, rba_SysElem_ComBasedSignalGroupTransformationRef=BaseTrans_Profile_5_4, rba_SysElem_ISignalRef=CRC_Ign_Stat_Pr5_ST3_RENAME1, rba_SysElem_ISignalRef=ISw_Stat_ST3_RENAME1, rba_SysElem_ISignalRef=KG_StartSw_Psd_ST3_RENAME1, rba_SysElem_ISignalRef=SQC_Ign_Stat_Pr5_ST3_RENAME1, rba_SysElem_ISignalRef=Veh_Op_Mode_ST3_RENAME1, rba_SysElem_SystemSignalGroupRef=rba_SysElem_SystemSignalGroups/Ign_Stat_Pr5_ST3_csgs1dv6drms80o1i9p49677w
            E2E_Profile_5 (rba_SysElem_TransformationISignalProps)
              rba_SysElem_EndToEndTransformationISignalProps: rba_SysElem_DataID=51, rba_SysElem_DataLength=32, rba_SysElem_TransformationTechnologyRef=rba_SysElem_TransformationTechnologies/E2E_Profile_5
          IMU_A_Output_Pr5_ST3_bezr5ct33mhwxias0s8rjhbne_RENAME1: rba_SysElem_ISignalGroupForeignRef=IMU_A_Output_Pr5_ST3_bezr5ct33mhwxias0s8rjhbne, rba_SysElem_ComBasedSignalGroupTransformationRef=BaseTrans_Profile_5_40, rba_SysElem_ISignalRef=CRC_IMU_A_Output_Pr5_ST3_RENAME1, rba_SysElem_ISignalRef=IMU_A_AngAcc_Stat_ST3_RENAME1, rba_SysElem_ISignalRef=IMU_A_AngAcc_X_ST3_RENAME1, rba_SysElem_ISignalRef=IMU_A_AngAcc_Y_ST3_RENAME1, rba_SysElem_ISignalRef=IMU_A_AngAcc_Z_ST3_RENAME1, rba_SysElem_ISignalRef=IMU_A_AngRate_X_ST3_RENAME1, rba_SysElem_ISignalRef=IMU_A_AngRate_Y_ST3_RENAME1, rba_SysElem_ISignalRef=IMU_A_AngRate_Z_ST3_RENAME1, rba_SysElem_ISignalRef=IMU_A_AngRates_Stat_ST3_RENAME1, rba_SysElem_ISignalRef=IMU_A_SpecForce_Stat_ST3_RENAME1, rba_SysElem_ISignalRef=IMU_A_SpecForce_X_ST3_RENAME1, rba_SysElem_ISignalRef=IMU_A_SpecForce_Y_ST3_RENAME1, rba_SysElem_ISignalRef=IMU_A_SpecForce_Z_ST3_RENAME1, rba_SysElem_ISignalRef=IMU_A_Stat_ST3_RENAME1, rba_SysElem_ISignalRef=IMU_A_Temp_ST3_RENAME1, rba_SysElem_ISignalRef=IMU_A_TmStmp_NanoSec_ST3_RENAME1, rba_SysElem_ISignalRef=IMU_A_TmStmp_Sec_ST3_RENAME1, rba_SysElem_ISignalRef=IMU_A_TmSync_Stat_ST3_RENAME1, rba_SysElem_ISignalRef=Rsrv01_IMU_A_Output_Pr5_ST3_RENAME1, rba_SysElem_ISignalRef=Rsrv02_IMU_A_Output_Pr5_ST3_RENAME1, rba_SysElem_ISignalRef=Rsrv03_IMU_A_Output_Pr5_ST3_RENAME1, rba_SysElem_ISignalRef=Rsrv04_IMU_A_Output_Pr5_ST3_RENAME1, rba_SysElem_ISignalRef=Rsrv05_IMU_A_Output_Pr5_ST3_RENAME1, rba_SysElem_ISignalRef=Rsrv06_IMU_A_Output_Pr5_ST3_RENAME1, rba_SysElem_ISignalRef=Rsrv07_IMU_A_Output_Pr5_ST3_RENAME1, rba_SysElem_ISignalRef=SQC_IMU_A_Output_Pr5_ST3_RENAME1, rba_SysElem_SystemSignalGroupRef=rba_SysElem_SystemSignalGroups/IMU_A_Output_Pr5_ST3_bezr5ct33mhwxias0s8rjhbne
            E2E_Profile_5 (rba_SysElem_TransformationISignalProps)
              rba_SysElem_EndToEndTransformationISignalProps: rba_SysElem_DataID=844, rba_SysElem_DataLength=320, rba_SysElem_TransformationTechnologyRef=rba_SysElem_TransformationTechnologies/E2E_Profile_5
          IMU_B_Output_Pr5_ST3_8enshzy4a8xe2badcgusoewm2_RENAME1: rba_SysElem_ISignalGroupForeignRef=IMU_B_Output_Pr5_ST3_8enshzy4a8xe2badcgusoewm2, rba_SysElem_ComBasedSignalGroupTransformationRef=BaseTrans_Profile_5_40, rba_SysElem_ISignalRef=CRC_IMU_B_Output_Pr5_ST3_RENAME1, rba_SysElem_ISignalRef=IMU_B_AngAcc_Stat_ST3_RENAME1, rba_SysElem_ISignalRef=IMU_B_AngAcc_X_ST3_RENAME1, rba_SysElem_ISignalRef=IMU_B_AngAcc_Y_ST3_RENAME1, rba_SysElem_ISignalRef=IMU_B_AngAcc_Z_ST3_RENAME1, rba_SysElem_ISignalRef=IMU_B_AngRate_X_ST3_RENAME1, rba_SysElem_ISignalRef=IMU_B_AngRate_Y_ST3_RENAME1, rba_SysElem_ISignalRef=IMU_B_AngRate_Z_ST3_RENAME1, rba_SysElem_ISignalRef=IMU_B_AngRates_Stat_ST3_RENAME1, rba_SysElem_ISignalRef=IMU_B_SpecForce_Stat_ST3_RENAME1, rba_SysElem_ISignalRef=IMU_B_SpecForce_X_ST3_RENAME1, rba_SysElem_ISignalRef=IMU_B_SpecForce_Y_ST3_RENAME1, rba_SysElem_ISignalRef=IMU_B_SpecForce_Z_ST3_RENAME1, rba_SysElem_ISignalRef=IMU_B_Stat_ST3_RENAME1, rba_SysElem_ISignalRef=IMU_B_Temp_ST3_RENAME1, rba_SysElem_ISignalRef=IMU_B_TmStmp_NanoSec_ST3_RENAME1, rba_SysElem_ISignalRef=IMU_B_TmStmp_Sec_ST3_RENAME1, rba_SysElem_ISignalRef=IMU_B_TmSync_Stat_ST3_RENAME1, rba_SysElem_ISignalRef=Rsrv01_IMU_B_Output_Pr5_ST3_RENAME1, rba_SysElem_ISignalRef=Rsrv02_IMU_B_Output_Pr5_ST3_RENAME1, rba_SysElem_ISignalRef=Rsrv03_IMU_B_Output_Pr5_ST3_RENAME1, rba_SysElem_ISignalRef=Rsrv04_IMU_B_Output_Pr5_ST3_RENAME1, rba_SysElem_ISignalRef=Rsrv05_IMU_B_Output_Pr5_ST3_RENAME1, rba_SysElem_ISignalRef=Rsrv06_IMU_B_Output_Pr5_ST3_RENAME1, rba_SysElem_ISignalRef=Rsrv07_IMU_B_Output_Pr5_ST3_RENAME1, rba_SysElem_ISignalRef=SQC_IMU_B_Output_Pr5_ST3_RENAME1, rba_SysElem_SystemSignalGroupRef=rba_SysElem_SystemSignalGroups/IMU_B_Output_Pr5_ST3_8enshzy4a8xe2badcgusoewm2
            E2E_Profile_5 (rba_SysElem_TransformationISignalProps)
              rba_SysElem_EndToEndTransformationISignalProps: rba_SysElem_DataID=845, rba_SysElem_DataLength=320, rba_SysElem_TransformationTechnologyRef=rba_SysElem_TransformationTechnologies/E2E_Profile_5
          PT4_PTCoor4_Pr5_ST3_af4fxb1ykieox3itqdfzs0kpb_RENAME1: rba_SysElem_ISignalGroupForeignRef=PT4_PTCoor4_Pr5_ST3_af4fxb1ykieox3itqdfzs0kpb, rba_SysElem_ComBasedSignalGroupTransformationRef=BaseTrans_Profile_5_4, rba_SysElem_ISignalRef=CRC_PT4_PTCoor4_Pr5_ST3_RENAME1, rba_SysElem_ISignalRef=PT4_PTCoor_EngStartPN14_Stat_ST3_RENAME1, rba_SysElem_ISignalRef=PT4_PTCoor_PT_Rdy_ST3_RENAME1, rba_SysElem_ISignalRef=PT4_PTCoor_SSA_EngSp_ST3_RENAME1, rba_SysElem_ISignalRef=Rsrv1_PT4_PTCoor_PT_Rdy_Pr5_ST3_RENAME1, rba_SysElem_ISignalRef=SQC_PT4_PTCoor4_Pr5_ST3_RENAME1, rba_SysElem_SystemSignalGroupRef=rba_SysElem_SystemSignalGroups/PT4_PTCoor4_Pr5_ST3_af4fxb1ykieox3itqdfzs0kpb
            E2E_Profile_5 (rba_SysElem_TransformationISignalProps)
              rba_SysElem_EndToEndTransformationISignalProps: rba_SysElem_DataID=196, rba_SysElem_DataLength=32, rba_SysElem_TransformationTechnologyRef=rba_SysElem_TransformationTechnologies/E2E_Profile_5
          DI_Odo_Pr5_ST3_e68xmtlkywxgxsdwekdjjhw3t_RENAME1: rba_SysElem_ISignalGroupForeignRef=DI_Odo_Pr5_ST3_e68xmtlkywxgxsdwekdjjhw3t, rba_SysElem_ComBasedSignalGroupTransformationRef=BaseTrans_Profile_5_6, rba_SysElem_ISignalRef=CRC_DI_Odo_Pr5_ST3_RENAME1, rba_SysElem_ISignalRef=Odo_ST3_RENAME1, rba_SysElem_ISignalRef=SQC_DI_Odo_Pr5_ST3_RENAME1, rba_SysElem_SystemSignalGroupRef=rba_SysElem_SystemSignalGroups/DI_Odo_Pr5_ST3_e68xmtlkywxgxsdwekdjjhw3t
            E2E_Profile_5 (rba_SysElem_TransformationISignalProps)
              rba_SysElem_EndToEndTransformationISignalProps: rba_SysElem_DataID=186, rba_SysElem_DataLength=48, rba_SysElem_TransformationTechnologyRef=rba_SysElem_TransformationTechnologies/E2E_Profile_5
      rba_SysElem_ISignals
        132 x rba_SysElem_ISignal, all with rba_SysElem_DataTypePolicy=override:
          CRC_Ign_Stat_Pr5_ST3: rba_SysElem_Length=16, rba_SysElem_ISignalForeignRef=CRC_Ign_Stat_Pr5_ST3, rba_SysElem_SystemSignalRef=rba_SysElem_SystemSignals/CRC_Ign_Stat_Pr5_ST3
            rba_SysElem_InitValue
              rba_SysElem_NumericalValueSpecification: rba_SysElem_NumericalValue=20886
          ISw_Stat_ST3: rba_SysElem_Length=3, rba_SysElem_ISignalForeignRef=ISw_Stat_ST3, rba_SysElem_SystemSignalRef=rba_SysElem_SystemSignals/ISw_Stat_ST3
            rba_SysElem_InitValue
              rba_SysElem_NumericalValueSpecification: rba_SysElem_NumericalValue=7
          KG_StartSw_Psd_ST3: rba_SysElem_Length=1, rba_SysElem_ISignalForeignRef=KG_StartSw_Psd_ST3, rba_SysElem_SystemSignalRef=rba_SysElem_SystemSignals/KG_StartSw_Psd_ST3
            rba_SysElem_InitValue
              rba_SysElem_NumericalValueSpecification: rba_SysElem_NumericalValue=0
          SQC_Ign_Stat_Pr5_ST3: rba_SysElem_Length=8, rba_SysElem_ISignalForeignRef=SQC_Ign_Stat_Pr5_ST3, rba_SysElem_SystemSignalRef=rba_SysElem_SystemSignals/SQC_Ign_Stat_Pr5_ST3
            rba_SysElem_InitValue
              rba_SysElem_NumericalValueSpecification: rba_SysElem_NumericalValue=0
          Veh_Op_Mode_ST3: rba_SysElem_Length=4, rba_SysElem_ISignalForeignRef=Veh_Op_Mode_ST3, rba_SysElem_SystemSignalRef=rba_SysElem_SystemSignals/Veh_Op_Mode_ST3
            rba_SysElem_InitValue
              rba_SysElem_NumericalValueSpecification: rba_SysElem_NumericalValue=0
          CRC_Ign_Stat_Pr5_ST3_RENAME1: rba_SysElem_Length=16, rba_SysElem_ISignalForeignRef=CRC_Ign_Stat_Pr5_ST3, rba_SysElem_SystemSignalRef=rba_SysElem_SystemSignals/CRC_Ign_Stat_Pr5_ST3
            rba_SysElem_InitValue
              rba_SysElem_NumericalValueSpecification: rba_SysElem_NumericalValue=20886
          ISw_Stat_ST3_RENAME1: rba_SysElem_Length=3, rba_SysElem_ISignalForeignRef=ISw_Stat_ST3, rba_SysElem_SystemSignalRef=rba_SysElem_SystemSignals/ISw_Stat_ST3
            rba_SysElem_InitValue
              rba_SysElem_NumericalValueSpecification: rba_SysElem_NumericalValue=7
          KG_StartSw_Psd_ST3_RENAME1: rba_SysElem_Length=1, rba_SysElem_ISignalForeignRef=KG_StartSw_Psd_ST3, rba_SysElem_SystemSignalRef=rba_SysElem_SystemSignals/KG_StartSw_Psd_ST3
            rba_SysElem_InitValue
              rba_SysElem_NumericalValueSpecification: rba_SysElem_NumericalValue=0
          SQC_Ign_Stat_Pr5_ST3_RENAME1: rba_SysElem_Length=8, rba_SysElem_ISignalForeignRef=SQC_Ign_Stat_Pr5_ST3, rba_SysElem_SystemSignalRef=rba_SysElem_SystemSignals/SQC_Ign_Stat_Pr5_ST3
            rba_SysElem_InitValue
              rba_SysElem_NumericalValueSpecification: rba_SysElem_NumericalValue=0
          Veh_Op_Mode_ST3_RENAME1: rba_SysElem_Length=4, rba_SysElem_ISignalForeignRef=Veh_Op_Mode_ST3, rba_SysElem_SystemSignalRef=rba_SysElem_SystemSignals/Veh_Op_Mode_ST3
            rba_SysElem_InitValue
              rba_SysElem_NumericalValueSpecification: rba_SysElem_NumericalValue=0
          CRC_PT4_PTCoor4_Pr5_ST3: rba_SysElem_Length=16, rba_SysElem_ISignalForeignRef=CRC_PT4_PTCoor4_Pr5_ST3, rba_SysElem_SystemSignalRef=rba_SysElem_SystemSignals/CRC_PT4_PTCoor4_Pr5_ST3
            rba_SysElem_InitValue
              rba_SysElem_NumericalValueSpecification: rba_SysElem_NumericalValue=4203
          PT4_PTCoor_EngStartPN14_Stat_ST3: rba_SysElem_Length=3, rba_SysElem_ISignalForeignRef=PT4_PTCoor_EngStartPN14_Stat_ST3, rba_SysElem_SystemSignalRef=rba_SysElem_SystemSignals/PT4_PTCoor_EngStartPN14_Stat_ST3
            rba_SysElem_InitValue
              rba_SysElem_NumericalValueSpecification: rba_SysElem_NumericalValue=0
          PT4_PTCoor_PT_Rdy_ST3: rba_SysElem_Length=2, rba_SysElem_ISignalForeignRef=PT4_PTCoor_PT_Rdy_ST3, rba_SysElem_SystemSignalRef=rba_SysElem_SystemSignals/PT4_PTCoor_PT_Rdy_ST3
            rba_SysElem_InitValue
              rba_SysElem_NumericalValueSpecification: rba_SysElem_NumericalValue=0
          PT4_PTCoor_SSA_EngSp_ST3: rba_SysElem_Length=2, rba_SysElem_ISignalForeignRef=PT4_PTCoor_SSA_EngSp_ST3, rba_SysElem_SystemSignalRef=rba_SysElem_SystemSignals/PT4_PTCoor_SSA_EngSp_ST3
            rba_SysElem_InitValue
              rba_SysElem_NumericalValueSpecification: rba_SysElem_NumericalValue=3
          Rsrv1_PT4_PTCoor_PT_Rdy_Pr5_ST3: rba_SysElem_Length=1, rba_SysElem_ISignalForeignRef=Rsrv1_PT4_PTCoor_PT_Rdy_Pr5_ST3, rba_SysElem_SystemSignalRef=rba_SysElem_SystemSignals/Rsrv1_PT4_PTCoor_PT_Rdy_Pr5_ST3
            rba_SysElem_InitValue
              rba_SysElem_NumericalValueSpecification: rba_SysElem_NumericalValue=1
          SQC_PT4_PTCoor4_Pr5_ST3: rba_SysElem_Length=8, rba_SysElem_ISignalForeignRef=SQC_PT4_PTCoor4_Pr5_ST3, rba_SysElem_SystemSignalRef=rba_SysElem_SystemSignals/SQC_PT4_PTCoor4_Pr5_ST3
            rba_SysElem_InitValue
              rba_SysElem_NumericalValueSpecification: rba_SysElem_NumericalValue=0
          CRC_PT4_PTCoor4_Pr5_ST3_RENAME1: rba_SysElem_Length=16, rba_SysElem_ISignalForeignRef=CRC_PT4_PTCoor4_Pr5_ST3, rba_SysElem_SystemSignalRef=rba_SysElem_SystemSignals/CRC_PT4_PTCoor4_Pr5_ST3
            rba_SysElem_InitValue
              rba_SysElem_NumericalValueSpecification: rba_SysElem_NumericalValue=4203
          PT4_PTCoor_EngStartPN14_Stat_ST3_RENAME1: rba_SysElem_Length=3, rba_SysElem_ISignalForeignRef=PT4_PTCoor_EngStartPN14_Stat_ST3, rba_SysElem_SystemSignalRef=rba_SysElem_SystemSignals/PT4_PTCoor_EngStartPN14_Stat_ST3
            rba_SysElem_InitValue
              rba_SysElem_NumericalValueSpecification: rba_SysElem_NumericalValue=0
          PT4_PTCoor_PT_Rdy_ST3_RENAME1: rba_SysElem_Length=2, rba_SysElem_ISignalForeignRef=PT4_PTCoor_PT_Rdy_ST3, rba_SysElem_SystemSignalRef=rba_SysElem_SystemSignals/PT4_PTCoor_PT_Rdy_ST3
            rba_SysElem_InitValue
              rba_SysElem_NumericalValueSpecification: rba_SysElem_NumericalValue=0
          PT4_PTCoor_SSA_EngSp_ST3_RENAME1: rba_SysElem_Length=2, rba_SysElem_ISignalForeignRef=PT4_PTCoor_SSA_EngSp_ST3, rba_SysElem_SystemSignalRef=rba_SysElem_SystemSignals/PT4_PTCoor_SSA_EngSp_ST3
            rba_SysElem_InitValue
              rba_SysElem_NumericalValueSpecification: rba_SysElem_NumericalValue=3
          Rsrv1_PT4_PTCoor_PT_Rdy_Pr5_ST3_RENAME1: rba_SysElem_Length=1, rba_SysElem_ISignalForeignRef=Rsrv1_PT4_PTCoor_PT_Rdy_Pr5_ST3, rba_SysElem_SystemSignalRef=rba_SysElem_SystemSignals/Rsrv1_PT4_PTCoor_PT_Rdy_Pr5_ST3
            rba_SysElem_InitValue
              rba_SysElem_NumericalValueSpecification: rba_SysElem_NumericalValue=1
          SQC_PT4_PTCoor4_Pr5_ST3_RENAME1: rba_SysElem_Length=8, rba_SysElem_ISignalForeignRef=SQC_PT4_PTCoor4_Pr5_ST3, rba_SysElem_SystemSignalRef=rba_SysElem_SystemSignals/SQC_PT4_PTCoor4_Pr5_ST3
            rba_SysElem_InitValue
              rba_SysElem_NumericalValueSpecification: rba_SysElem_NumericalValue=0
          CRC_DI_Odo_Pr5_ST3: rba_SysElem_Length=16, rba_SysElem_ISignalForeignRef=CRC_DI_Odo_Pr5_ST3, rba_SysElem_SystemSignalRef=rba_SysElem_SystemSignals/CRC_DI_Odo_Pr5_ST3
            rba_SysElem_InitValue
              rba_SysElem_NumericalValueSpecification: rba_SysElem_NumericalValue=8633
          Odo_ST3: rba_SysElem_Length=24, rba_SysElem_ISignalForeignRef=Odo_ST3, rba_SysElem_SystemSignalRef=rba_SysElem_SystemSignals/Odo_ST3
            rba_SysElem_InitValue
              rba_SysElem_NumericalValueSpecification: rba_SysElem_NumericalValue=16777215
          SQC_DI_Odo_Pr5_ST3: rba_SysElem_Length=8, rba_SysElem_ISignalForeignRef=SQC_DI_Odo_Pr5_ST3, rba_SysElem_SystemSignalRef=rba_SysElem_SystemSignals/SQC_DI_Odo_Pr5_ST3
            rba_SysElem_InitValue
              rba_SysElem_NumericalValueSpecification: rba_SysElem_NumericalValue=0
          CRC_DI_Odo_Pr5_ST3_RENAME1: rba_SysElem_Length=16, rba_SysElem_ISignalForeignRef=CRC_DI_Odo_Pr5_ST3, rba_SysElem_SystemSignalRef=rba_SysElem_SystemSignals/CRC_DI_Odo_Pr5_ST3
            rba_SysElem_InitValue
              rba_SysElem_NumericalValueSpecification: rba_SysElem_NumericalValue=8633
          Odo_ST3_RENAME1: rba_SysElem_Length=24, rba_SysElem_ISignalForeignRef=Odo_ST3, rba_SysElem_SystemSignalRef=rba_SysElem_SystemSignals/Odo_ST3
            rba_SysElem_InitValue
              rba_SysElem_NumericalValueSpecification: rba_SysElem_NumericalValue=16777215
          SQC_DI_Odo_Pr5_ST3_RENAME1: rba_SysElem_Length=8, rba_SysElem_ISignalForeignRef=SQC_DI_Odo_Pr5_ST3, rba_SysElem_SystemSignalRef=rba_SysElem_SystemSignals/SQC_DI_Odo_Pr5_ST3
            rba_SysElem_InitValue
              rba_SysElem_NumericalValueSpecification: rba_SysElem_NumericalValue=0
          CRC_IMU_A_Output_Pr5_ST3: rba_SysElem_Length=16, rba_SysElem_ISignalForeignRef=CRC_IMU_A_Output_Pr5_ST3, rba_SysElem_SystemSignalRef=rba_SysElem_SystemSignals/CRC_IMU_A_Output_Pr5_ST3
            rba_SysElem_InitValue
              rba_SysElem_NumericalValueSpecification: rba_SysElem_NumericalValue=19347
          IMU_A_AngAcc_Stat_ST3: rba_SysElem_Length=3, rba_SysElem_ISignalForeignRef=IMU_A_AngAcc_Stat_ST3, rba_SysElem_SystemSignalRef=rba_SysElem_SystemSignals/IMU_A_AngAcc_Stat_ST3
            rba_SysElem_InitValue
              rba_SysElem_NumericalValueSpecification: rba_SysElem_NumericalValue=0
          IMU_A_AngAcc_X_ST3: rba_SysElem_Length=16, rba_SysElem_ISignalForeignRef=IMU_A_AngAcc_X_ST3, rba_SysElem_SystemSignalRef=rba_SysElem_SystemSignals/IMU_A_AngAcc_X_ST3
            rba_SysElem_InitValue
              rba_SysElem_NumericalValueSpecification: rba_SysElem_NumericalValue=65535
          IMU_A_AngAcc_Y_ST3: rba_SysElem_Length=16, rba_SysElem_ISignalForeignRef=IMU_A_AngAcc_Y_ST3, rba_SysElem_SystemSignalRef=rba_SysElem_SystemSignals/IMU_A_AngAcc_Y_ST3
            rba_SysElem_InitValue
              rba_SysElem_NumericalValueSpecification: rba_SysElem_NumericalValue=65535
          IMU_A_AngAcc_Z_ST3: rba_SysElem_Length=16, rba_SysElem_ISignalForeignRef=IMU_A_AngAcc_Z_ST3, rba_SysElem_SystemSignalRef=rba_SysElem_SystemSignals/IMU_A_AngAcc_Z_ST3
            rba_SysElem_InitValue
              rba_SysElem_NumericalValueSpecification: rba_SysElem_NumericalValue=65535
          IMU_A_AngRate_X_ST3: rba_SysElem_Length=16, rba_SysElem_ISignalForeignRef=IMU_A_AngRate_X_ST3, rba_SysElem_SystemSignalRef=rba_SysElem_SystemSignals/IMU_A_AngRate_X_ST3
            rba_SysElem_InitValue
              rba_SysElem_NumericalValueSpecification: rba_SysElem_NumericalValue=65535
          IMU_A_AngRate_Y_ST3: rba_SysElem_Length=16, rba_SysElem_ISignalForeignRef=IMU_A_AngRate_Y_ST3, rba_SysElem_SystemSignalRef=rba_SysElem_SystemSignals/IMU_A_AngRate_Y_ST3
            rba_SysElem_InitValue
              rba_SysElem_NumericalValueSpecification: rba_SysElem_NumericalValue=65535
          IMU_A_AngRate_Z_ST3: rba_SysElem_Length=16, rba_SysElem_ISignalForeignRef=IMU_A_AngRate_Z_ST3, rba_SysElem_SystemSignalRef=rba_SysElem_SystemSignals/IMU_A_AngRate_Z_ST3
            rba_SysElem_InitValue
              rba_SysElem_NumericalValueSpecification: rba_SysElem_NumericalValue=65535
          IMU_A_AngRates_Stat_ST3: rba_SysElem_Length=3, rba_SysElem_ISignalForeignRef=IMU_A_AngRates_Stat_ST3, rba_SysElem_SystemSignalRef=rba_SysElem_SystemSignals/IMU_A_AngRates_Stat_ST3
            rba_SysElem_InitValue
              rba_SysElem_NumericalValueSpecification: rba_SysElem_NumericalValue=0
          IMU_A_SpecForce_Stat_ST3: rba_SysElem_Length=3, rba_SysElem_ISignalForeignRef=IMU_A_SpecForce_Stat_ST3, rba_SysElem_SystemSignalRef=rba_SysElem_SystemSignals/IMU_A_SpecForce_Stat_ST3
            rba_SysElem_InitValue
              rba_SysElem_NumericalValueSpecification: rba_SysElem_NumericalValue=0
          IMU_A_SpecForce_X_ST3: rba_SysElem_Length=16, rba_SysElem_ISignalForeignRef=IMU_A_SpecForce_X_ST3, rba_SysElem_SystemSignalRef=rba_SysElem_SystemSignals/IMU_A_SpecForce_X_ST3
            rba_SysElem_InitValue
              rba_SysElem_NumericalValueSpecification: rba_SysElem_NumericalValue=65535
          IMU_A_SpecForce_Y_ST3: rba_SysElem_Length=16, rba_SysElem_ISignalForeignRef=IMU_A_SpecForce_Y_ST3, rba_SysElem_SystemSignalRef=rba_SysElem_SystemSignals/IMU_A_SpecForce_Y_ST3
            rba_SysElem_InitValue
              rba_SysElem_NumericalValueSpecification: rba_SysElem_NumericalValue=65535
          IMU_A_SpecForce_Z_ST3: rba_SysElem_Length=16, rba_SysElem_ISignalForeignRef=IMU_A_SpecForce_Z_ST3, rba_SysElem_SystemSignalRef=rba_SysElem_SystemSignals/IMU_A_SpecForce_Z_ST3
            rba_SysElem_InitValue
              rba_SysElem_NumericalValueSpecification: rba_SysElem_NumericalValue=65535
          IMU_A_Stat_ST3: rba_SysElem_Length=3, rba_SysElem_ISignalForeignRef=IMU_A_Stat_ST3, rba_SysElem_SystemSignalRef=rba_SysElem_SystemSignals/IMU_A_Stat_ST3
            rba_SysElem_InitValue
              rba_SysElem_NumericalValueSpecification: rba_SysElem_NumericalValue=0
          IMU_A_Temp_ST3: rba_SysElem_Length=8, rba_SysElem_ISignalForeignRef=IMU_A_Temp_ST3, rba_SysElem_SystemSignalRef=rba_SysElem_SystemSignals/IMU_A_Temp_ST3
            rba_SysElem_InitValue
              rba_SysElem_NumericalValueSpecification: rba_SysElem_NumericalValue=255
          IMU_A_TmStmp_NanoSec_ST3: rba_SysElem_Length=32, rba_SysElem_ISignalForeignRef=IMU_A_TmStmp_NanoSec_ST3, rba_SysElem_SystemSignalRef=rba_SysElem_SystemSignals/IMU_A_TmStmp_NanoSec_ST3
            rba_SysElem_InitValue
              rba_SysElem_NumericalValueSpecification: rba_SysElem_NumericalValue=0
          IMU_A_TmStmp_Sec_ST3: rba_SysElem_Length=32, rba_SysElem_ISignalForeignRef=IMU_A_TmStmp_Sec_ST3, rba_SysElem_SystemSignalRef=rba_SysElem_SystemSignals/IMU_A_TmStmp_Sec_ST3
            rba_SysElem_InitValue
              rba_SysElem_NumericalValueSpecification: rba_SysElem_NumericalValue=0
          IMU_A_TmSync_Stat_ST3: rba_SysElem_Length=8, rba_SysElem_ISignalForeignRef=IMU_A_TmSync_Stat_ST3, rba_SysElem_SystemSignalRef=rba_SysElem_SystemSignals/IMU_A_TmSync_Stat_ST3
            rba_SysElem_InitValue
              rba_SysElem_NumericalValueSpecification: rba_SysElem_NumericalValue=128
          Rsrv01_IMU_A_Output_Pr5_ST3: rba_SysElem_Length=9, rba_SysElem_ISignalForeignRef=Rsrv01_IMU_A_Output_Pr5_ST3, rba_SysElem_SystemSignalRef=rba_SysElem_SystemSignals/Rsrv01_IMU_A_Output_Pr5_ST3
            rba_SysElem_InitValue
              rba_SysElem_NumericalValueSpecification: rba_SysElem_NumericalValue=511
          Rsrv02_IMU_A_Output_Pr5_ST3: rba_SysElem_Length=8, rba_SysElem_ISignalForeignRef=Rsrv02_IMU_A_Output_Pr5_ST3, rba_SysElem_SystemSignalRef=rba_SysElem_SystemSignals/Rsrv02_IMU_A_Output_Pr5_ST3
            rba_SysElem_InitValue
              rba_SysElem_NumericalValueSpecification: rba_SysElem_NumericalValue=255
          Rsrv03_IMU_A_Output_Pr5_ST3: rba_SysElem_Length=8, rba_SysElem_ISignalForeignRef=Rsrv03_IMU_A_Output_Pr5_ST3, rba_SysElem_SystemSignalRef=rba_SysElem_SystemSignals/Rsrv03_IMU_A_Output_Pr5_ST3
            rba_SysElem_InitValue
              rba_SysElem_NumericalValueSpecification: rba_SysElem_NumericalValue=255
          Rsrv04_IMU_A_Output_Pr5_ST3: rba_SysElem_Length=8, rba_SysElem_ISignalForeignRef=Rsrv04_IMU_A_Output_Pr5_ST3, rba_SysElem_SystemSignalRef=rba_SysElem_SystemSignals/Rsrv04_IMU_A_Output_Pr5_ST3
            rba_SysElem_InitValue
              rba_SysElem_NumericalValueSpecification: rba_SysElem_NumericalValue=255
          Rsrv05_IMU_A_Output_Pr5_ST3: rba_SysElem_Length=8, rba_SysElem_ISignalForeignRef=Rsrv05_IMU_A_Output_Pr5_ST3, rba_SysElem_SystemSignalRef=rba_SysElem_SystemSignals/Rsrv05_IMU_A_Output_Pr5_ST3
            rba_SysElem_InitValue
              rba_SysElem_NumericalValueSpecification: rba_SysElem_NumericalValue=255
          Rsrv06_IMU_A_Output_Pr5_ST3: rba_SysElem_Length=16, rba_SysElem_ISignalForeignRef=Rsrv06_IMU_A_Output_Pr5_ST3, rba_SysElem_SystemSignalRef=rba_SysElem_SystemSignals/Rsrv06_IMU_A_Output_Pr5_ST3
            rba_SysElem_InitValue
              rba_SysElem_NumericalValueSpecification: rba_SysElem_NumericalValue=65535
          Rsrv07_IMU_A_Output_Pr5_ST3: rba_SysElem_Length=3, rba_SysElem_ISignalForeignRef=Rsrv07_IMU_A_Output_Pr5_ST3, rba_SysElem_SystemSignalRef=rba_SysElem_SystemSignals/Rsrv07_IMU_A_Output_Pr5_ST3
            rba_SysElem_InitValue
              rba_SysElem_NumericalValueSpecification: rba_SysElem_NumericalValue=7
          SQC_IMU_A_Output_Pr5_ST3: rba_SysElem_Length=8, rba_SysElem_ISignalForeignRef=SQC_IMU_A_Output_Pr5_ST3, rba_SysElem_SystemSignalRef=rba_SysElem_SystemSignals/SQC_IMU_A_Output_Pr5_ST3
            rba_SysElem_InitValue
              rba_SysElem_NumericalValueSpecification: rba_SysElem_NumericalValue=0
          CRC_IMU_A_Output_Pr5_ST3_RENAME1: rba_SysElem_Length=16, rba_SysElem_ISignalForeignRef=CRC_IMU_A_Output_Pr5_ST3, rba_SysElem_SystemSignalRef=rba_SysElem_SystemSignals/CRC_IMU_A_Output_Pr5_ST3
            rba_SysElem_InitValue
              rba_SysElem_NumericalValueSpecification: rba_SysElem_NumericalValue=19347
          IMU_A_AngAcc_Stat_ST3_RENAME1: rba_SysElem_Length=3, rba_SysElem_ISignalForeignRef=IMU_A_AngAcc_Stat_ST3, rba_SysElem_SystemSignalRef=rba_SysElem_SystemSignals/IMU_A_AngAcc_Stat_ST3
            rba_SysElem_InitValue
              rba_SysElem_NumericalValueSpecification: rba_SysElem_NumericalValue=0
          IMU_A_AngAcc_X_ST3_RENAME1: rba_SysElem_Length=16, rba_SysElem_ISignalForeignRef=IMU_A_AngAcc_X_ST3, rba_SysElem_SystemSignalRef=rba_SysElem_SystemSignals/IMU_A_AngAcc_X_ST3
            rba_SysElem_InitValue
              rba_SysElem_NumericalValueSpecification: rba_SysElem_NumericalValue=65535
          IMU_A_AngAcc_Y_ST3_RENAME1: rba_SysElem_Length=16, rba_SysElem_ISignalForeignRef=IMU_A_AngAcc_Y_ST3, rba_SysElem_SystemSignalRef=rba_SysElem_SystemSignals/IMU_A_AngAcc_Y_ST3
            rba_SysElem_InitValue
              rba_SysElem_NumericalValueSpecification: rba_SysElem_NumericalValue=65535
          IMU_A_AngAcc_Z_ST3_RENAME1: rba_SysElem_Length=16, rba_SysElem_ISignalForeignRef=IMU_A_AngAcc_Z_ST3, rba_SysElem_SystemSignalRef=rba_SysElem_SystemSignals/IMU_A_AngAcc_Z_ST3
            rba_SysElem_InitValue
              rba_SysElem_NumericalValueSpecification: rba_SysElem_NumericalValue=65535
          IMU_A_AngRate_X_ST3_RENAME1: rba_SysElem_Length=16, rba_SysElem_ISignalForeignRef=IMU_A_AngRate_X_ST3, rba_SysElem_SystemSignalRef=rba_SysElem_SystemSignals/IMU_A_AngRate_X_ST3
            rba_SysElem_InitValue
              rba_SysElem_NumericalValueSpecification: rba_SysElem_NumericalValue=65535
          IMU_A_AngRate_Y_ST3_RENAME1: rba_SysElem_Length=16, rba_SysElem_ISignalForeignRef=IMU_A_AngRate_Y_ST3, rba_SysElem_SystemSignalRef=rba_SysElem_SystemSignals/IMU_A_AngRate_Y_ST3
            rba_SysElem_InitValue
              rba_SysElem_NumericalValueSpecification: rba_SysElem_NumericalValue=65535
          IMU_A_AngRate_Z_ST3_RENAME1: rba_SysElem_Length=16, rba_SysElem_ISignalForeignRef=IMU_A_AngRate_Z_ST3, rba_SysElem_SystemSignalRef=rba_SysElem_SystemSignals/IMU_A_AngRate_Z_ST3
            rba_SysElem_InitValue
              rba_SysElem_NumericalValueSpecification: rba_SysElem_NumericalValue=65535
          IMU_A_AngRates_Stat_ST3_RENAME1: rba_SysElem_Length=3, rba_SysElem_ISignalForeignRef=IMU_A_AngRates_Stat_ST3, rba_SysElem_SystemSignalRef=rba_SysElem_SystemSignals/IMU_A_AngRates_Stat_ST3
            rba_SysElem_InitValue
              rba_SysElem_NumericalValueSpecification: rba_SysElem_NumericalValue=0
          IMU_A_SpecForce_Stat_ST3_RENAME1: rba_SysElem_Length=3, rba_SysElem_ISignalForeignRef=IMU_A_SpecForce_Stat_ST3, rba_SysElem_SystemSignalRef=rba_SysElem_SystemSignals/IMU_A_SpecForce_Stat_ST3
            rba_SysElem_InitValue
              rba_SysElem_NumericalValueSpecification: rba_SysElem_NumericalValue=0
          IMU_A_SpecForce_X_ST3_RENAME1: rba_SysElem_Length=16, rba_SysElem_ISignalForeignRef=IMU_A_SpecForce_X_ST3, rba_SysElem_SystemSignalRef=rba_SysElem_SystemSignals/IMU_A_SpecForce_X_ST3
            rba_SysElem_InitValue
              rba_SysElem_NumericalValueSpecification: rba_SysElem_NumericalValue=65535
          IMU_A_SpecForce_Y_ST3_RENAME1: rba_SysElem_Length=16, rba_SysElem_ISignalForeignRef=IMU_A_SpecForce_Y_ST3, rba_SysElem_SystemSignalRef=rba_SysElem_SystemSignals/IMU_A_SpecForce_Y_ST3
            rba_SysElem_InitValue
              rba_SysElem_NumericalValueSpecification: rba_SysElem_NumericalValue=65535
          IMU_A_SpecForce_Z_ST3_RENAME1: rba_SysElem_Length=16, rba_SysElem_ISignalForeignRef=IMU_A_SpecForce_Z_ST3, rba_SysElem_SystemSignalRef=rba_SysElem_SystemSignals/IMU_A_SpecForce_Z_ST3
            rba_SysElem_InitValue
              rba_SysElem_NumericalValueSpecification: rba_SysElem_NumericalValue=65535
          IMU_A_Stat_ST3_RENAME1: rba_SysElem_Length=3, rba_SysElem_ISignalForeignRef=IMU_A_Stat_ST3, rba_SysElem_SystemSignalRef=rba_SysElem_SystemSignals/IMU_A_Stat_ST3
            rba_SysElem_InitValue
              rba_SysElem_NumericalValueSpecification: rba_SysElem_NumericalValue=0
          IMU_A_Temp_ST3_RENAME1: rba_SysElem_Length=8, rba_SysElem_ISignalForeignRef=IMU_A_Temp_ST3, rba_SysElem_SystemSignalRef=rba_SysElem_SystemSignals/IMU_A_Temp_ST3
            rba_SysElem_InitValue
              rba_SysElem_NumericalValueSpecification: rba_SysElem_NumericalValue=255
          IMU_A_TmStmp_NanoSec_ST3_RENAME1: rba_SysElem_Length=32, rba_SysElem_ISignalForeignRef=IMU_A_TmStmp_NanoSec_ST3, rba_SysElem_SystemSignalRef=rba_SysElem_SystemSignals/IMU_A_TmStmp_NanoSec_ST3
            rba_SysElem_InitValue
              rba_SysElem_NumericalValueSpecification: rba_SysElem_NumericalValue=0
          IMU_A_TmStmp_Sec_ST3_RENAME1: rba_SysElem_Length=32, rba_SysElem_ISignalForeignRef=IMU_A_TmStmp_Sec_ST3, rba_SysElem_SystemSignalRef=rba_SysElem_SystemSignals/IMU_A_TmStmp_Sec_ST3
            rba_SysElem_InitValue
              rba_SysElem_NumericalValueSpecification: rba_SysElem_NumericalValue=0
          IMU_A_TmSync_Stat_ST3_RENAME1: rba_SysElem_Length=8, rba_SysElem_ISignalForeignRef=IMU_A_TmSync_Stat_ST3, rba_SysElem_SystemSignalRef=rba_SysElem_SystemSignals/IMU_A_TmSync_Stat_ST3
            rba_SysElem_InitValue
              rba_SysElem_NumericalValueSpecification: rba_SysElem_NumericalValue=128
          Rsrv01_IMU_A_Output_Pr5_ST3_RENAME1: rba_SysElem_Length=9, rba_SysElem_ISignalForeignRef=Rsrv01_IMU_A_Output_Pr5_ST3, rba_SysElem_SystemSignalRef=rba_SysElem_SystemSignals/Rsrv01_IMU_A_Output_Pr5_ST3
            rba_SysElem_InitValue
              rba_SysElem_NumericalValueSpecification: rba_SysElem_NumericalValue=511
          Rsrv02_IMU_A_Output_Pr5_ST3_RENAME1: rba_SysElem_Length=8, rba_SysElem_ISignalForeignRef=Rsrv02_IMU_A_Output_Pr5_ST3, rba_SysElem_SystemSignalRef=rba_SysElem_SystemSignals/Rsrv02_IMU_A_Output_Pr5_ST3
            rba_SysElem_InitValue
              rba_SysElem_NumericalValueSpecification: rba_SysElem_NumericalValue=255
          Rsrv03_IMU_A_Output_Pr5_ST3_RENAME1: rba_SysElem_Length=8, rba_SysElem_ISignalForeignRef=Rsrv03_IMU_A_Output_Pr5_ST3, rba_SysElem_SystemSignalRef=rba_SysElem_SystemSignals/Rsrv03_IMU_A_Output_Pr5_ST3
            rba_SysElem_InitValue
              rba_SysElem_NumericalValueSpecification: rba_SysElem_NumericalValue=255
          Rsrv04_IMU_A_Output_Pr5_ST3_RENAME1: rba_SysElem_Length=8, rba_SysElem_ISignalForeignRef=Rsrv04_IMU_A_Output_Pr5_ST3, rba_SysElem_SystemSignalRef=rba_SysElem_SystemSignals/Rsrv04_IMU_A_Output_Pr5_ST3
            rba_SysElem_InitValue
              rba_SysElem_NumericalValueSpecification: rba_SysElem_NumericalValue=255
          Rsrv05_IMU_A_Output_Pr5_ST3_RENAME1: rba_SysElem_Length=8, rba_SysElem_ISignalForeignRef=Rsrv05_IMU_A_Output_Pr5_ST3, rba_SysElem_SystemSignalRef=rba_SysElem_SystemSignals/Rsrv05_IMU_A_Output_Pr5_ST3
            rba_SysElem_InitValue
              rba_SysElem_NumericalValueSpecification: rba_SysElem_NumericalValue=255
          Rsrv06_IMU_A_Output_Pr5_ST3_RENAME1: rba_SysElem_Length=16, rba_SysElem_ISignalForeignRef=Rsrv06_IMU_A_Output_Pr5_ST3, rba_SysElem_SystemSignalRef=rba_SysElem_SystemSignals/Rsrv06_IMU_A_Output_Pr5_ST3
            rba_SysElem_InitValue
              rba_SysElem_NumericalValueSpecification: rba_SysElem_NumericalValue=65535
          Rsrv07_IMU_A_Output_Pr5_ST3_RENAME1: rba_SysElem_Length=3, rba_SysElem_ISignalForeignRef=Rsrv07_IMU_A_Output_Pr5_ST3, rba_SysElem_SystemSignalRef=rba_SysElem_SystemSignals/Rsrv07_IMU_A_Output_Pr5_ST3
            rba_SysElem_InitValue
              rba_SysElem_NumericalValueSpecification: rba_SysElem_NumericalValue=7
          SQC_IMU_A_Output_Pr5_ST3_RENAME1: rba_SysElem_Length=8, rba_SysElem_ISignalForeignRef=SQC_IMU_A_Output_Pr5_ST3, rba_SysElem_SystemSignalRef=rba_SysElem_SystemSignals/SQC_IMU_A_Output_Pr5_ST3
            rba_SysElem_InitValue
              rba_SysElem_NumericalValueSpecification: rba_SysElem_NumericalValue=0
          CRC_IMU_B_Output_Pr5_ST3: rba_SysElem_Length=16, rba_SysElem_ISignalForeignRef=CRC_IMU_B_Output_Pr5_ST3, rba_SysElem_SystemSignalRef=rba_SysElem_SystemSignals/CRC_IMU_B_Output_Pr5_ST3
            rba_SysElem_InitValue
              rba_SysElem_NumericalValueSpecification: rba_SysElem_NumericalValue=30882
          IMU_B_AngAcc_Stat_ST3: rba_SysElem_Length=3, rba_SysElem_ISignalForeignRef=IMU_B_AngAcc_Stat_ST3, rba_SysElem_SystemSignalRef=rba_SysElem_SystemSignals/IMU_B_AngAcc_Stat_ST3
            rba_SysElem_InitValue
              rba_SysElem_NumericalValueSpecification: rba_SysElem_NumericalValue=0
          IMU_B_AngAcc_X_ST3: rba_SysElem_Length=16, rba_SysElem_ISignalForeignRef=IMU_B_AngAcc_X_ST3, rba_SysElem_SystemSignalRef=rba_SysElem_SystemSignals/IMU_B_AngAcc_X_ST3
            rba_SysElem_InitValue
              rba_SysElem_NumericalValueSpecification: rba_SysElem_NumericalValue=65535
          IMU_B_AngAcc_Y_ST3: rba_SysElem_Length=16, rba_SysElem_ISignalForeignRef=IMU_B_AngAcc_Y_ST3, rba_SysElem_SystemSignalRef=rba_SysElem_SystemSignals/IMU_B_AngAcc_Y_ST3
            rba_SysElem_InitValue
              rba_SysElem_NumericalValueSpecification: rba_SysElem_NumericalValue=65535
          IMU_B_AngAcc_Z_ST3: rba_SysElem_Length=16, rba_SysElem_ISignalForeignRef=IMU_B_AngAcc_Z_ST3, rba_SysElem_SystemSignalRef=rba_SysElem_SystemSignals/IMU_B_AngAcc_Z_ST3
            rba_SysElem_InitValue
              rba_SysElem_NumericalValueSpecification: rba_SysElem_NumericalValue=65535
          IMU_B_AngRate_X_ST3: rba_SysElem_Length=16, rba_SysElem_ISignalForeignRef=IMU_B_AngRate_X_ST3, rba_SysElem_SystemSignalRef=rba_SysElem_SystemSignals/IMU_B_AngRate_X_ST3
            rba_SysElem_InitValue
              rba_SysElem_NumericalValueSpecification: rba_SysElem_NumericalValue=65535
          IMU_B_AngRate_Y_ST3: rba_SysElem_Length=16, rba_SysElem_ISignalForeignRef=IMU_B_AngRate_Y_ST3, rba_SysElem_SystemSignalRef=rba_SysElem_SystemSignals/IMU_B_AngRate_Y_ST3
            rba_SysElem_InitValue
              rba_SysElem_NumericalValueSpecification: rba_SysElem_NumericalValue=65535
          IMU_B_AngRate_Z_ST3: rba_SysElem_Length=16, rba_SysElem_ISignalForeignRef=IMU_B_AngRate_Z_ST3, rba_SysElem_SystemSignalRef=rba_SysElem_SystemSignals/IMU_B_AngRate_Z_ST3
            rba_SysElem_InitValue
              rba_SysElem_NumericalValueSpecification: rba_SysElem_NumericalValue=65535
          IMU_B_AngRates_Stat_ST3: rba_SysElem_Length=3, rba_SysElem_ISignalForeignRef=IMU_B_AngRates_Stat_ST3, rba_SysElem_SystemSignalRef=rba_SysElem_SystemSignals/IMU_B_AngRates_Stat_ST3
            rba_SysElem_InitValue
              rba_SysElem_NumericalValueSpecification: rba_SysElem_NumericalValue=0
          IMU_B_SpecForce_Stat_ST3: rba_SysElem_Length=3, rba_SysElem_ISignalForeignRef=IMU_B_SpecForce_Stat_ST3, rba_SysElem_SystemSignalRef=rba_SysElem_SystemSignals/IMU_B_SpecForce_Stat_ST3
            rba_SysElem_InitValue
              rba_SysElem_NumericalValueSpecification: rba_SysElem_NumericalValue=0
          IMU_B_SpecForce_X_ST3: rba_SysElem_Length=16, rba_SysElem_ISignalForeignRef=IMU_B_SpecForce_X_ST3, rba_SysElem_SystemSignalRef=rba_SysElem_SystemSignals/IMU_B_SpecForce_X_ST3
            rba_SysElem_InitValue
              rba_SysElem_NumericalValueSpecification: rba_SysElem_NumericalValue=65535
          IMU_B_SpecForce_Y_ST3: rba_SysElem_Length=16, rba_SysElem_ISignalForeignRef=IMU_B_SpecForce_Y_ST3, rba_SysElem_SystemSignalRef=rba_SysElem_SystemSignals/IMU_B_SpecForce_Y_ST3
            rba_SysElem_InitValue
              rba_SysElem_NumericalValueSpecification: rba_SysElem_NumericalValue=65535
          IMU_B_SpecForce_Z_ST3: rba_SysElem_Length=16, rba_SysElem_ISignalForeignRef=IMU_B_SpecForce_Z_ST3, rba_SysElem_SystemSignalRef=rba_SysElem_SystemSignals/IMU_B_SpecForce_Z_ST3
            rba_SysElem_InitValue
              rba_SysElem_NumericalValueSpecification: rba_SysElem_NumericalValue=65535
          IMU_B_Stat_ST3: rba_SysElem_Length=3, rba_SysElem_ISignalForeignRef=IMU_B_Stat_ST3, rba_SysElem_SystemSignalRef=rba_SysElem_SystemSignals/IMU_B_Stat_ST3
            rba_SysElem_InitValue
              rba_SysElem_NumericalValueSpecification: rba_SysElem_NumericalValue=0
          IMU_B_Temp_ST3: rba_SysElem_Length=8, rba_SysElem_ISignalForeignRef=IMU_B_Temp_ST3, rba_SysElem_SystemSignalRef=rba_SysElem_SystemSignals/IMU_B_Temp_ST3
            rba_SysElem_InitValue
              rba_SysElem_NumericalValueSpecification: rba_SysElem_NumericalValue=255
          IMU_B_TmStmp_NanoSec_ST3: rba_SysElem_Length=32, rba_SysElem_ISignalForeignRef=IMU_B_TmStmp_NanoSec_ST3, rba_SysElem_SystemSignalRef=rba_SysElem_SystemSignals/IMU_B_TmStmp_NanoSec_ST3
            rba_SysElem_InitValue
              rba_SysElem_NumericalValueSpecification: rba_SysElem_NumericalValue=0
          IMU_B_TmStmp_Sec_ST3: rba_SysElem_Length=32, rba_SysElem_ISignalForeignRef=IMU_B_TmStmp_Sec_ST3, rba_SysElem_SystemSignalRef=rba_SysElem_SystemSignals/IMU_B_TmStmp_Sec_ST3
            rba_SysElem_InitValue
              rba_SysElem_NumericalValueSpecification: rba_SysElem_NumericalValue=0
          IMU_B_TmSync_Stat_ST3: rba_SysElem_Length=8, rba_SysElem_ISignalForeignRef=IMU_B_TmSync_Stat_ST3, rba_SysElem_SystemSignalRef=rba_SysElem_SystemSignals/IMU_B_TmSync_Stat_ST3
            rba_SysElem_InitValue
              rba_SysElem_NumericalValueSpecification: rba_SysElem_NumericalValue=128
          Rsrv01_IMU_B_Output_Pr5_ST3: rba_SysElem_Length=9, rba_SysElem_ISignalForeignRef=Rsrv01_IMU_B_Output_Pr5_ST3, rba_SysElem_SystemSignalRef=rba_SysElem_SystemSignals/Rsrv01_IMU_B_Output_Pr5_ST3
            rba_SysElem_InitValue
              rba_SysElem_NumericalValueSpecification: rba_SysElem_NumericalValue=511
          Rsrv02_IMU_B_Output_Pr5_ST3: rba_SysElem_Length=8, rba_SysElem_ISignalForeignRef=Rsrv02_IMU_B_Output_Pr5_ST3, rba_SysElem_SystemSignalRef=rba_SysElem_SystemSignals/Rsrv02_IMU_B_Output_Pr5_ST3
            rba_SysElem_InitValue
              rba_SysElem_NumericalValueSpecification: rba_SysElem_NumericalValue=255
          Rsrv03_IMU_B_Output_Pr5_ST3: rba_SysElem_Length=8, rba_SysElem_ISignalForeignRef=Rsrv03_IMU_B_Output_Pr5_ST3, rba_SysElem_SystemSignalRef=rba_SysElem_SystemSignals/Rsrv03_IMU_B_Output_Pr5_ST3
            rba_SysElem_InitValue
              rba_SysElem_NumericalValueSpecification: rba_SysElem_NumericalValue=255
          Rsrv04_IMU_B_Output_Pr5_ST3: rba_SysElem_Length=8, rba_SysElem_ISignalForeignRef=Rsrv04_IMU_B_Output_Pr5_ST3, rba_SysElem_SystemSignalRef=rba_SysElem_SystemSignals/Rsrv04_IMU_B_Output_Pr5_ST3
            rba_SysElem_InitValue
              rba_SysElem_NumericalValueSpecification: rba_SysElem_NumericalValue=255
          Rsrv05_IMU_B_Output_Pr5_ST3: rba_SysElem_Length=8, rba_SysElem_ISignalForeignRef=Rsrv05_IMU_B_Output_Pr5_ST3, rba_SysElem_SystemSignalRef=rba_SysElem_SystemSignals/Rsrv05_IMU_B_Output_Pr5_ST3
            rba_SysElem_InitValue
              rba_SysElem_NumericalValueSpecification: rba_SysElem_NumericalValue=255
          Rsrv06_IMU_B_Output_Pr5_ST3: rba_SysElem_Length=16, rba_SysElem_ISignalForeignRef=Rsrv06_IMU_B_Output_Pr5_ST3, rba_SysElem_SystemSignalRef=rba_SysElem_SystemSignals/Rsrv06_IMU_B_Output_Pr5_ST3
            rba_SysElem_InitValue
              rba_SysElem_NumericalValueSpecification: rba_SysElem_NumericalValue=65535
          Rsrv07_IMU_B_Output_Pr5_ST3: rba_SysElem_Length=3, rba_SysElem_ISignalForeignRef=Rsrv07_IMU_B_Output_Pr5_ST3, rba_SysElem_SystemSignalRef=rba_SysElem_SystemSignals/Rsrv07_IMU_B_Output_Pr5_ST3
            rba_SysElem_InitValue
              rba_SysElem_NumericalValueSpecification: rba_SysElem_NumericalValue=7
          SQC_IMU_B_Output_Pr5_ST3: rba_SysElem_Length=8, rba_SysElem_ISignalForeignRef=SQC_IMU_B_Output_Pr5_ST3, rba_SysElem_SystemSignalRef=rba_SysElem_SystemSignals/SQC_IMU_B_Output_Pr5_ST3
            rba_SysElem_InitValue
              rba_SysElem_NumericalValueSpecification: rba_SysElem_NumericalValue=0
          CRC_IMU_B_Output_Pr5_ST3_RENAME1: rba_SysElem_Length=16, rba_SysElem_ISignalForeignRef=CRC_IMU_B_Output_Pr5_ST3, rba_SysElem_SystemSignalRef=rba_SysElem_SystemSignals/CRC_IMU_B_Output_Pr5_ST3
            rba_SysElem_InitValue
              rba_SysElem_NumericalValueSpecification: rba_SysElem_NumericalValue=30882
          IMU_B_AngAcc_Stat_ST3_RENAME1: rba_SysElem_Length=3, rba_SysElem_ISignalForeignRef=IMU_B_AngAcc_Stat_ST3, rba_SysElem_SystemSignalRef=rba_SysElem_SystemSignals/IMU_B_AngAcc_Stat_ST3
            rba_SysElem_InitValue
              rba_SysElem_NumericalValueSpecification: rba_SysElem_NumericalValue=0
          IMU_B_AngAcc_X_ST3_RENAME1: rba_SysElem_Length=16, rba_SysElem_ISignalForeignRef=IMU_B_AngAcc_X_ST3, rba_SysElem_SystemSignalRef=rba_SysElem_SystemSignals/IMU_B_AngAcc_X_ST3
            rba_SysElem_InitValue
              rba_SysElem_NumericalValueSpecification: rba_SysElem_NumericalValue=65535
          IMU_B_AngAcc_Y_ST3_RENAME1: rba_SysElem_Length=16, rba_SysElem_ISignalForeignRef=IMU_B_AngAcc_Y_ST3, rba_SysElem_SystemSignalRef=rba_SysElem_SystemSignals/IMU_B_AngAcc_Y_ST3
            rba_SysElem_InitValue
              rba_SysElem_NumericalValueSpecification: rba_SysElem_NumericalValue=65535
          IMU_B_AngAcc_Z_ST3_RENAME1: rba_SysElem_Length=16, rba_SysElem_ISignalForeignRef=IMU_B_AngAcc_Z_ST3, rba_SysElem_SystemSignalRef=rba_SysElem_SystemSignals/IMU_B_AngAcc_Z_ST3
            rba_SysElem_InitValue
              rba_SysElem_NumericalValueSpecification: rba_SysElem_NumericalValue=65535
          IMU_B_AngRate_X_ST3_RENAME1: rba_SysElem_Length=16, rba_SysElem_ISignalForeignRef=IMU_B_AngRate_X_ST3, rba_SysElem_SystemSignalRef=rba_SysElem_SystemSignals/IMU_B_AngRate_X_ST3
            rba_SysElem_InitValue
              rba_SysElem_NumericalValueSpecification: rba_SysElem_NumericalValue=65535
          IMU_B_AngRate_Y_ST3_RENAME1: rba_SysElem_Length=16, rba_SysElem_ISignalForeignRef=IMU_B_AngRate_Y_ST3, rba_SysElem_SystemSignalRef=rba_SysElem_SystemSignals/IMU_B_AngRate_Y_ST3
            rba_SysElem_InitValue
              rba_SysElem_NumericalValueSpecification: rba_SysElem_NumericalValue=65535
          IMU_B_AngRate_Z_ST3_RENAME1: rba_SysElem_Length=16, rba_SysElem_ISignalForeignRef=IMU_B_AngRate_Z_ST3, rba_SysElem_SystemSignalRef=rba_SysElem_SystemSignals/IMU_B_AngRate_Z_ST3
            rba_SysElem_InitValue
              rba_SysElem_NumericalValueSpecification: rba_SysElem_NumericalValue=65535
          IMU_B_AngRates_Stat_ST3_RENAME1: rba_SysElem_Length=3, rba_SysElem_ISignalForeignRef=IMU_B_AngRates_Stat_ST3, rba_SysElem_SystemSignalRef=rba_SysElem_SystemSignals/IMU_B_AngRates_Stat_ST3
            rba_SysElem_InitValue
              rba_SysElem_NumericalValueSpecification: rba_SysElem_NumericalValue=0
          IMU_B_SpecForce_Stat_ST3_RENAME1: rba_SysElem_Length=3, rba_SysElem_ISignalForeignRef=IMU_B_SpecForce_Stat_ST3, rba_SysElem_SystemSignalRef=rba_SysElem_SystemSignals/IMU_B_SpecForce_Stat_ST3
            rba_SysElem_InitValue
              rba_SysElem_NumericalValueSpecification: rba_SysElem_NumericalValue=0
          IMU_B_SpecForce_X_ST3_RENAME1: rba_SysElem_Length=16, rba_SysElem_ISignalForeignRef=IMU_B_SpecForce_X_ST3, rba_SysElem_SystemSignalRef=rba_SysElem_SystemSignals/IMU_B_SpecForce_X_ST3
            rba_SysElem_InitValue
              rba_SysElem_NumericalValueSpecification: rba_SysElem_NumericalValue=65535
          IMU_B_SpecForce_Y_ST3_RENAME1: rba_SysElem_Length=16, rba_SysElem_ISignalForeignRef=IMU_B_SpecForce_Y_ST3, rba_SysElem_SystemSignalRef=rba_SysElem_SystemSignals/IMU_B_SpecForce_Y_ST3
            rba_SysElem_InitValue
              rba_SysElem_NumericalValueSpecification: rba_SysElem_NumericalValue=65535
          IMU_B_SpecForce_Z_ST3_RENAME1: rba_SysElem_Length=16, rba_SysElem_ISignalForeignRef=IMU_B_SpecForce_Z_ST3, rba_SysElem_SystemSignalRef=rba_SysElem_SystemSignals/IMU_B_SpecForce_Z_ST3
            rba_SysElem_InitValue
              rba_SysElem_NumericalValueSpecification: rba_SysElem_NumericalValue=65535
          IMU_B_Stat_ST3_RENAME1: rba_SysElem_Length=3, rba_SysElem_ISignalForeignRef=IMU_B_Stat_ST3, rba_SysElem_SystemSignalRef=rba_SysElem_SystemSignals/IMU_B_Stat_ST3
            rba_SysElem_InitValue
              rba_SysElem_NumericalValueSpecification: rba_SysElem_NumericalValue=0
          IMU_B_Temp_ST3_RENAME1: rba_SysElem_Length=8, rba_SysElem_ISignalForeignRef=IMU_B_Temp_ST3, rba_SysElem_SystemSignalRef=rba_SysElem_SystemSignals/IMU_B_Temp_ST3
            rba_SysElem_InitValue
              rba_SysElem_NumericalValueSpecification: rba_SysElem_NumericalValue=255
          IMU_B_TmStmp_NanoSec_ST3_RENAME1: rba_SysElem_Length=32, rba_SysElem_ISignalForeignRef=IMU_B_TmStmp_NanoSec_ST3, rba_SysElem_SystemSignalRef=rba_SysElem_SystemSignals/IMU_B_TmStmp_NanoSec_ST3
            rba_SysElem_InitValue
              rba_SysElem_NumericalValueSpecification: rba_SysElem_NumericalValue=0
          IMU_B_TmStmp_Sec_ST3_RENAME1: rba_SysElem_Length=32, rba_SysElem_ISignalForeignRef=IMU_B_TmStmp_Sec_ST3, rba_SysElem_SystemSignalRef=rba_SysElem_SystemSignals/IMU_B_TmStmp_Sec_ST3
            rba_SysElem_InitValue
              rba_SysElem_NumericalValueSpecification: rba_SysElem_NumericalValue=0
          IMU_B_TmSync_Stat_ST3_RENAME1: rba_SysElem_Length=8, rba_SysElem_ISignalForeignRef=IMU_B_TmSync_Stat_ST3, rba_SysElem_SystemSignalRef=rba_SysElem_SystemSignals/IMU_B_TmSync_Stat_ST3
            rba_SysElem_InitValue
              rba_SysElem_NumericalValueSpecification: rba_SysElem_NumericalValue=128
          Rsrv01_IMU_B_Output_Pr5_ST3_RENAME1: rba_SysElem_Length=9, rba_SysElem_ISignalForeignRef=Rsrv01_IMU_B_Output_Pr5_ST3, rba_SysElem_SystemSignalRef=rba_SysElem_SystemSignals/Rsrv01_IMU_B_Output_Pr5_ST3
            rba_SysElem_InitValue
              rba_SysElem_NumericalValueSpecification: rba_SysElem_NumericalValue=511
          Rsrv02_IMU_B_Output_Pr5_ST3_RENAME1: rba_SysElem_Length=8, rba_SysElem_ISignalForeignRef=Rsrv02_IMU_B_Output_Pr5_ST3, rba_SysElem_SystemSignalRef=rba_SysElem_SystemSignals/Rsrv02_IMU_B_Output_Pr5_ST3
            rba_SysElem_InitValue
              rba_SysElem_NumericalValueSpecification: rba_SysElem_NumericalValue=255
          Rsrv03_IMU_B_Output_Pr5_ST3_RENAME1: rba_SysElem_Length=8, rba_SysElem_ISignalForeignRef=Rsrv03_IMU_B_Output_Pr5_ST3, rba_SysElem_SystemSignalRef=rba_SysElem_SystemSignals/Rsrv03_IMU_B_Output_Pr5_ST3
            rba_SysElem_InitValue
              rba_SysElem_NumericalValueSpecification: rba_SysElem_NumericalValue=255
          Rsrv04_IMU_B_Output_Pr5_ST3_RENAME1: rba_SysElem_Length=8, rba_SysElem_ISignalForeignRef=Rsrv04_IMU_B_Output_Pr5_ST3, rba_SysElem_SystemSignalRef=rba_SysElem_SystemSignals/Rsrv04_IMU_B_Output_Pr5_ST3
            rba_SysElem_InitValue
              rba_SysElem_NumericalValueSpecification: rba_SysElem_NumericalValue=255
          Rsrv05_IMU_B_Output_Pr5_ST3_RENAME1: rba_SysElem_Length=8, rba_SysElem_ISignalForeignRef=Rsrv05_IMU_B_Output_Pr5_ST3, rba_SysElem_SystemSignalRef=rba_SysElem_SystemSignals/Rsrv05_IMU_B_Output_Pr5_ST3
            rba_SysElem_InitValue
              rba_SysElem_NumericalValueSpecification: rba_SysElem_NumericalValue=255
          Rsrv06_IMU_B_Output_Pr5_ST3_RENAME1: rba_SysElem_Length=16, rba_SysElem_ISignalForeignRef=Rsrv06_IMU_B_Output_Pr5_ST3, rba_SysElem_SystemSignalRef=rba_SysElem_SystemSignals/Rsrv06_IMU_B_Output_Pr5_ST3
            rba_SysElem_InitValue
              rba_SysElem_NumericalValueSpecification: rba_SysElem_NumericalValue=65535
          Rsrv07_IMU_B_Output_Pr5_ST3_RENAME1: rba_SysElem_Length=3, rba_SysElem_ISignalForeignRef=Rsrv07_IMU_B_Output_Pr5_ST3, rba_SysElem_SystemSignalRef=rba_SysElem_SystemSignals/Rsrv07_IMU_B_Output_Pr5_ST3
            rba_SysElem_InitValue
              rba_SysElem_NumericalValueSpecification: rba_SysElem_NumericalValue=7
          SQC_IMU_B_Output_Pr5_ST3_RENAME1: rba_SysElem_Length=8, rba_SysElem_ISignalForeignRef=SQC_IMU_B_Output_Pr5_ST3, rba_SysElem_SystemSignalRef=rba_SysElem_SystemSignals/SQC_IMU_B_Output_Pr5_ST3
            rba_SysElem_InitValue
              rba_SysElem_NumericalValueSpecification: rba_SysElem_NumericalValue=0
      rba_SysElem_SystemSignals
        66 x rba_SysElem_SystemSignal, all with rba_SysElem_DynamicLength=false:
          CRC_Ign_Stat_Pr5_ST3: rba_SysElem_SystemSignalForeignRef=CRC_Ign_Stat_Pr5_ST3
          ISw_Stat_ST3: rba_SysElem_SystemSignalForeignRef=ISw_Stat_ST3
          KG_StartSw_Psd_ST3: rba_SysElem_SystemSignalForeignRef=KG_StartSw_Psd_ST3
          SQC_Ign_Stat_Pr5_ST3: rba_SysElem_SystemSignalForeignRef=SQC_Ign_Stat_Pr5_ST3
          Veh_Op_Mode_ST3: rba_SysElem_SystemSignalForeignRef=Veh_Op_Mode_ST3
          CRC_PT4_PTCoor4_Pr5_ST3: rba_SysElem_SystemSignalForeignRef=CRC_PT4_PTCoor4_Pr5_ST3
          PT4_PTCoor_EngStartPN14_Stat_ST3: rba_SysElem_SystemSignalForeignRef=PT4_PTCoor_EngStartPN14_Stat_ST3
          PT4_PTCoor_PT_Rdy_ST3: rba_SysElem_SystemSignalForeignRef=PT4_PTCoor_PT_Rdy_ST3
          PT4_PTCoor_SSA_EngSp_ST3: rba_SysElem_SystemSignalForeignRef=PT4_PTCoor_SSA_EngSp_ST3
          Rsrv1_PT4_PTCoor_PT_Rdy_Pr5_ST3: rba_SysElem_SystemSignalForeignRef=Rsrv1_PT4_PTCoor_PT_Rdy_Pr5_ST3
          SQC_PT4_PTCoor4_Pr5_ST3: rba_SysElem_SystemSignalForeignRef=SQC_PT4_PTCoor4_Pr5_ST3
          CRC_DI_Odo_Pr5_ST3: rba_SysElem_SystemSignalForeignRef=CRC_DI_Odo_Pr5_ST3
          Odo_ST3: rba_SysElem_SystemSignalForeignRef=Odo_ST3
          SQC_DI_Odo_Pr5_ST3: rba_SysElem_SystemSignalForeignRef=SQC_DI_Odo_Pr5_ST3
          CRC_IMU_A_Output_Pr5_ST3: rba_SysElem_SystemSignalForeignRef=CRC_IMU_A_Output_Pr5_ST3
          IMU_A_AngAcc_Stat_ST3: rba_SysElem_SystemSignalForeignRef=IMU_A_AngAcc_Stat_ST3
          IMU_A_AngAcc_X_ST3: rba_SysElem_SystemSignalForeignRef=IMU_A_AngAcc_X_ST3
          IMU_A_AngAcc_Y_ST3: rba_SysElem_SystemSignalForeignRef=IMU_A_AngAcc_Y_ST3
          IMU_A_AngAcc_Z_ST3: rba_SysElem_SystemSignalForeignRef=IMU_A_AngAcc_Z_ST3
          IMU_A_AngRate_X_ST3: rba_SysElem_SystemSignalForeignRef=IMU_A_AngRate_X_ST3
          IMU_A_AngRate_Y_ST3: rba_SysElem_SystemSignalForeignRef=IMU_A_AngRate_Y_ST3
          IMU_A_AngRate_Z_ST3: rba_SysElem_SystemSignalForeignRef=IMU_A_AngRate_Z_ST3
          IMU_A_AngRates_Stat_ST3: rba_SysElem_SystemSignalForeignRef=IMU_A_AngRates_Stat_ST3
          IMU_A_SpecForce_Stat_ST3: rba_SysElem_SystemSignalForeignRef=IMU_A_SpecForce_Stat_ST3
          IMU_A_SpecForce_X_ST3: rba_SysElem_SystemSignalForeignRef=IMU_A_SpecForce_X_ST3
          IMU_A_SpecForce_Y_ST3: rba_SysElem_SystemSignalForeignRef=IMU_A_SpecForce_Y_ST3
          IMU_A_SpecForce_Z_ST3: rba_SysElem_SystemSignalForeignRef=IMU_A_SpecForce_Z_ST3
          IMU_A_Stat_ST3: rba_SysElem_SystemSignalForeignRef=IMU_A_Stat_ST3
          IMU_A_Temp_ST3: rba_SysElem_SystemSignalForeignRef=IMU_A_Temp_ST3
          IMU_A_TmStmp_NanoSec_ST3: rba_SysElem_SystemSignalForeignRef=IMU_A_TmStmp_NanoSec_ST3
          IMU_A_TmStmp_Sec_ST3: rba_SysElem_SystemSignalForeignRef=IMU_A_TmStmp_Sec_ST3
          IMU_A_TmSync_Stat_ST3: rba_SysElem_SystemSignalForeignRef=IMU_A_TmSync_Stat_ST3
          Rsrv{01..07}_IMU_A_Output_Pr5_ST3: rba_SysElem_SystemSignalForeignRef=Rsrv{01..07}_IMU_A_Output_Pr5_ST3
          SQC_IMU_A_Output_Pr5_ST3: rba_SysElem_SystemSignalForeignRef=SQC_IMU_A_Output_Pr5_ST3
          CRC_IMU_B_Output_Pr5_ST3: rba_SysElem_SystemSignalForeignRef=CRC_IMU_B_Output_Pr5_ST3
          IMU_B_AngAcc_Stat_ST3: rba_SysElem_SystemSignalForeignRef=IMU_B_AngAcc_Stat_ST3
          IMU_B_AngAcc_X_ST3: rba_SysElem_SystemSignalForeignRef=IMU_B_AngAcc_X_ST3
          IMU_B_AngAcc_Y_ST3: rba_SysElem_SystemSignalForeignRef=IMU_B_AngAcc_Y_ST3
          IMU_B_AngAcc_Z_ST3: rba_SysElem_SystemSignalForeignRef=IMU_B_AngAcc_Z_ST3
          IMU_B_AngRate_X_ST3: rba_SysElem_SystemSignalForeignRef=IMU_B_AngRate_X_ST3
          IMU_B_AngRate_Y_ST3: rba_SysElem_SystemSignalForeignRef=IMU_B_AngRate_Y_ST3
          IMU_B_AngRate_Z_ST3: rba_SysElem_SystemSignalForeignRef=IMU_B_AngRate_Z_ST3
          IMU_B_AngRates_Stat_ST3: rba_SysElem_SystemSignalForeignRef=IMU_B_AngRates_Stat_ST3
          IMU_B_SpecForce_Stat_ST3: rba_SysElem_SystemSignalForeignRef=IMU_B_SpecForce_Stat_ST3
          IMU_B_SpecForce_X_ST3: rba_SysElem_SystemSignalForeignRef=IMU_B_SpecForce_X_ST3
          IMU_B_SpecForce_Y_ST3: rba_SysElem_SystemSignalForeignRef=IMU_B_SpecForce_Y_ST3
          IMU_B_SpecForce_Z_ST3: rba_SysElem_SystemSignalForeignRef=IMU_B_SpecForce_Z_ST3
          IMU_B_Stat_ST3: rba_SysElem_SystemSignalForeignRef=IMU_B_Stat_ST3
          IMU_B_Temp_ST3: rba_SysElem_SystemSignalForeignRef=IMU_B_Temp_ST3
          IMU_B_TmStmp_NanoSec_ST3: rba_SysElem_SystemSignalForeignRef=IMU_B_TmStmp_NanoSec_ST3
          IMU_B_TmStmp_Sec_ST3: rba_SysElem_SystemSignalForeignRef=IMU_B_TmStmp_Sec_ST3
          IMU_B_TmSync_Stat_ST3: rba_SysElem_SystemSignalForeignRef=IMU_B_TmSync_Stat_ST3
          Rsrv{01..07}_IMU_B_Output_Pr5_ST3: rba_SysElem_SystemSignalForeignRef=Rsrv{01..07}_IMU_B_Output_Pr5_ST3
          SQC_IMU_B_Output_Pr5_ST3: rba_SysElem_SystemSignalForeignRef=SQC_IMU_B_Output_Pr5_ST3
      rba_SysElem_SystemSignalGroups
        5 x rba_SysElem_SystemSignalGroup:
          Ign_Stat_Pr5_ST3_csgs1dv6drms80o1i9p49677w: rba_SysElem_SystemSignalGroupForeignRef=Ign_Stat_Pr5_ST3_csgs1dv6drms80o1i9p49677w, rba_SysElem_SystemSignal=rba_SysElem_SystemSignals/CRC_Ign_Stat_Pr5_ST3, rba_SysElem_SystemSignal=rba_SysElem_SystemSignals/ISw_Stat_ST3, rba_SysElem_SystemSignal=rba_SysElem_SystemSignals/KG_StartSw_Psd_ST3, rba_SysElem_SystemSignal=rba_SysElem_SystemSignals/SQC_Ign_Stat_Pr5_ST3, rba_SysElem_SystemSignal=rba_SysElem_SystemSignals/Veh_Op_Mode_ST3
          PT4_PTCoor4_Pr5_ST3_af4fxb1ykieox3itqdfzs0kpb: rba_SysElem_SystemSignalGroupForeignRef=PT4_PTCoor4_Pr5_ST3_af4fxb1ykieox3itqdfzs0kpb, rba_SysElem_SystemSignal=rba_SysElem_SystemSignals/CRC_PT4_PTCoor4_Pr5_ST3, rba_SysElem_SystemSignal=rba_SysElem_SystemSignals/PT4_PTCoor_EngStartPN14_Stat_ST3, rba_SysElem_SystemSignal=rba_SysElem_SystemSignals/PT4_PTCoor_PT_Rdy_ST3, rba_SysElem_SystemSignal=rba_SysElem_SystemSignals/PT4_PTCoor_SSA_EngSp_ST3, rba_SysElem_SystemSignal=rba_SysElem_SystemSignals/Rsrv1_PT4_PTCoor_PT_Rdy_Pr5_ST3, rba_SysElem_SystemSignal=rba_SysElem_SystemSignals/SQC_PT4_PTCoor4_Pr5_ST3
          DI_Odo_Pr5_ST3_e68xmtlkywxgxsdwekdjjhw3t: rba_SysElem_SystemSignalGroupForeignRef=DI_Odo_Pr5_ST3_e68xmtlkywxgxsdwekdjjhw3t, rba_SysElem_SystemSignal=rba_SysElem_SystemSignals/CRC_DI_Odo_Pr5_ST3, rba_SysElem_SystemSignal=rba_SysElem_SystemSignals/Odo_ST3, rba_SysElem_SystemSignal=rba_SysElem_SystemSignals/SQC_DI_Odo_Pr5_ST3
          IMU_A_Output_Pr5_ST3_bezr5ct33mhwxias0s8rjhbne: rba_SysElem_SystemSignalGroupForeignRef=IMU_A_Output_Pr5_ST3_bezr5ct33mhwxias0s8rjhbne, rba_SysElem_SystemSignal=rba_SysElem_SystemSignals/CRC_IMU_A_Output_Pr5_ST3, rba_SysElem_SystemSignal=rba_SysElem_SystemSignals/IMU_A_AngAcc_Stat_ST3, rba_SysElem_SystemSignal=rba_SysElem_SystemSignals/IMU_A_AngAcc_X_ST3, rba_SysElem_SystemSignal=rba_SysElem_SystemSignals/IMU_A_AngAcc_Y_ST3, rba_SysElem_SystemSignal=rba_SysElem_SystemSignals/IMU_A_AngAcc_Z_ST3, rba_SysElem_SystemSignal=rba_SysElem_SystemSignals/IMU_A_AngRate_X_ST3, rba_SysElem_SystemSignal=rba_SysElem_SystemSignals/IMU_A_AngRate_Y_ST3, rba_SysElem_SystemSignal=rba_SysElem_SystemSignals/IMU_A_AngRate_Z_ST3, rba_SysElem_SystemSignal=rba_SysElem_SystemSignals/IMU_A_AngRates_Stat_ST3, rba_SysElem_SystemSignal=rba_SysElem_SystemSignals/IMU_A_SpecForce_Stat_ST3, rba_SysElem_SystemSignal=rba_SysElem_SystemSignals/IMU_A_SpecForce_X_ST3, rba_SysElem_SystemSignal=rba_SysElem_SystemSignals/IMU_A_SpecForce_Y_ST3, rba_SysElem_SystemSignal=rba_SysElem_SystemSignals/IMU_A_SpecForce_Z_ST3, rba_SysElem_SystemSignal=rba_SysElem_SystemSignals/IMU_A_Stat_ST3, rba_SysElem_SystemSignal=rba_SysElem_SystemSignals/IMU_A_Temp_ST3, rba_SysElem_SystemSignal=rba_SysElem_SystemSignals/IMU_A_TmStmp_NanoSec_ST3, rba_SysElem_SystemSignal=rba_SysElem_SystemSignals/IMU_A_TmStmp_Sec_ST3, rba_SysElem_SystemSignal=rba_SysElem_SystemSignals/IMU_A_TmSync_Stat_ST3, rba_SysElem_SystemSignal=rba_SysElem_SystemSignals/Rsrv01_IMU_A_Output_Pr5_ST3, rba_SysElem_SystemSignal=rba_SysElem_SystemSignals/Rsrv02_IMU_A_Output_Pr5_ST3, rba_SysElem_SystemSignal=rba_SysElem_SystemSignals/Rsrv03_IMU_A_Output_Pr5_ST3, rba_SysElem_SystemSignal=rba_SysElem_SystemSignals/Rsrv04_IMU_A_Output_Pr5_ST3, rba_SysElem_SystemSignal=rba_SysElem_SystemSignals/Rsrv05_IMU_A_Output_Pr5_ST3, rba_SysElem_SystemSignal=rba_SysElem_SystemSignals/Rsrv06_IMU_A_Output_Pr5_ST3, rba_SysElem_SystemSignal=rba_SysElem_SystemSignals/Rsrv07_IMU_A_Output_Pr5_ST3, rba_SysElem_SystemSignal=rba_SysElem_SystemSignals/SQC_IMU_A_Output_Pr5_ST3
          IMU_B_Output_Pr5_ST3_8enshzy4a8xe2badcgusoewm2: rba_SysElem_SystemSignalGroupForeignRef=IMU_B_Output_Pr5_ST3_8enshzy4a8xe2badcgusoewm2, rba_SysElem_SystemSignal=rba_SysElem_SystemSignals/CRC_IMU_B_Output_Pr5_ST3, rba_SysElem_SystemSignal=rba_SysElem_SystemSignals/IMU_B_AngAcc_Stat_ST3, rba_SysElem_SystemSignal=rba_SysElem_SystemSignals/IMU_B_AngAcc_X_ST3, rba_SysElem_SystemSignal=rba_SysElem_SystemSignals/IMU_B_AngAcc_Y_ST3, rba_SysElem_SystemSignal=rba_SysElem_SystemSignals/IMU_B_AngAcc_Z_ST3, rba_SysElem_SystemSignal=rba_SysElem_SystemSignals/IMU_B_AngRate_X_ST3, rba_SysElem_SystemSignal=rba_SysElem_SystemSignals/IMU_B_AngRate_Y_ST3, rba_SysElem_SystemSignal=rba_SysElem_SystemSignals/IMU_B_AngRate_Z_ST3, rba_SysElem_SystemSignal=rba_SysElem_SystemSignals/IMU_B_AngRates_Stat_ST3, rba_SysElem_SystemSignal=rba_SysElem_SystemSignals/IMU_B_SpecForce_Stat_ST3, rba_SysElem_SystemSignal=rba_SysElem_SystemSignals/IMU_B_SpecForce_X_ST3, rba_SysElem_SystemSignal=rba_SysElem_SystemSignals/IMU_B_SpecForce_Y_ST3, rba_SysElem_SystemSignal=rba_SysElem_SystemSignals/IMU_B_SpecForce_Z_ST3, rba_SysElem_SystemSignal=rba_SysElem_SystemSignals/IMU_B_Stat_ST3, rba_SysElem_SystemSignal=rba_SysElem_SystemSignals/IMU_B_Temp_ST3, rba_SysElem_SystemSignal=rba_SysElem_SystemSignals/IMU_B_TmStmp_NanoSec_ST3, rba_SysElem_SystemSignal=rba_SysElem_SystemSignals/IMU_B_TmStmp_Sec_ST3, rba_SysElem_SystemSignal=rba_SysElem_SystemSignals/IMU_B_TmSync_Stat_ST3, rba_SysElem_SystemSignal=rba_SysElem_SystemSignals/Rsrv01_IMU_B_Output_Pr5_ST3, rba_SysElem_SystemSignal=rba_SysElem_SystemSignals/Rsrv02_IMU_B_Output_Pr5_ST3, rba_SysElem_SystemSignal=rba_SysElem_SystemSignals/Rsrv03_IMU_B_Output_Pr5_ST3, rba_SysElem_SystemSignal=rba_SysElem_SystemSignals/Rsrv04_IMU_B_Output_Pr5_ST3, rba_SysElem_SystemSignal=rba_SysElem_SystemSignals/Rsrv05_IMU_B_Output_Pr5_ST3, rba_SysElem_SystemSignal=rba_SysElem_SystemSignals/Rsrv06_IMU_B_Output_Pr5_ST3, rba_SysElem_SystemSignal=rba_SysElem_SystemSignals/Rsrv07_IMU_B_Output_Pr5_ST3, rba_SysElem_SystemSignal=rba_SysElem_SystemSignals/SQC_IMU_B_Output_Pr5_ST3
      rba_SysElem_DataTransformations
        3 x rba_SysElem_DataTransformation, all with rba_SysElem_Direction=out, rba_SysElem_ExecuteDespiteDataUnavailability=true:
          BaseTrans_Profile_5_4
            ComBasedTransformer4 (rba_SysElem_TransformationTechnology): rba_SysElem_Index=0, rba_SysElem_TransformationTechnologyRef=rba_SysElem_TransformationTechnologies/ComBasedTransformer4
            E2E_Profile_5 (rba_SysElem_TransformationTechnology): rba_SysElem_Index=1, rba_SysElem_TransformationTechnologyRef=rba_SysElem_TransformationTechnologies/E2E_Profile_5
          BaseTrans_Profile_5_6
            ComBasedTransformer6 (rba_SysElem_TransformationTechnology): rba_SysElem_Index=0, rba_SysElem_TransformationTechnologyRef=rba_SysElem_TransformationTechnologies/ComBasedTransformer6
            E2E_Profile_5 (rba_SysElem_TransformationTechnology): rba_SysElem_Index=1, rba_SysElem_TransformationTechnologyRef=rba_SysElem_TransformationTechnologies/E2E_Profile_5
          BaseTrans_Profile_5_40
            ComBasedTransformer40 (rba_SysElem_TransformationTechnology): rba_SysElem_Index=0, rba_SysElem_TransformationTechnologyRef=rba_SysElem_TransformationTechnologies/ComBasedTransformer40
            E2E_Profile_5 (rba_SysElem_TransformationTechnology): rba_SysElem_Index=1, rba_SysElem_TransformationTechnologyRef=rba_SysElem_TransformationTechnologies/E2E_Profile_5
      rba_SysElem_TransformationTechnologies
        4 x rba_SysElem_TransformationTechnology, all with rba_SysElem_Version=1:
          ComBasedTransformer4: rba_SysElem_Protocol=COMBased, rba_SysElem_TransformerClass=serializer, rba_SysElem_TransformationTechnologyForeignRef=ComBasedTransformer4
            rba_SysElem_BufferProperties: rba_SysElem_InPlace=false, rba_SysElem_HeaderLength=0
              rba_SysElem_CompuScale: rba_SysElem_Denominator=1, rba_SysElem_Numerator2=0, rba_SysElem_Numerator1=4
          E2E_Profile_5: rba_SysElem_Protocol=E2E, rba_SysElem_NeedsOriginalData=false, rba_SysElem_TransformerClass=safety, rba_SysElem_TransformationTechnologyForeignRef=E2E_Profile_5
            rba_SysElem_BufferProperties: rba_SysElem_InPlace=true, rba_SysElem_HeaderLength=0
            rba_SysElem_TransformationDescription
              rba_SysElem_EndToEndTransformationDescription:
                rba_SysElem_MaxDeltaCounter = 3
                rba_SysElem_MaxErrorStateValid = 0
                rba_SysElem_MinOkStateInvalid = 1
                rba_SysElem_MaxErrorStateInit = 0
                rba_SysElem_UpperHeaderBitsToShift = 0
                rba_SysElem_MinOkStateInit = 1
                rba_SysElem_Offset = 0
                rba_SysElem_ProfileName = PROFILE_05
                rba_SysElem_MaxErrorStateInvalid = 0
                rba_SysElem_MinOkStateValid = 1
          ComBasedTransformer6: rba_SysElem_Protocol=COMBased, rba_SysElem_TransformerClass=serializer, rba_SysElem_TransformationTechnologyForeignRef=ComBasedTransformer6
            rba_SysElem_BufferProperties: rba_SysElem_InPlace=false, rba_SysElem_HeaderLength=0
              rba_SysElem_CompuScale: rba_SysElem_Denominator=1, rba_SysElem_Numerator2=0, rba_SysElem_Numerator1=6
          ComBasedTransformer40: rba_SysElem_Protocol=COMBased, rba_SysElem_TransformerClass=serializer, rba_SysElem_TransformationTechnologyForeignRef=ComBasedTransformer40
            rba_SysElem_BufferProperties: rba_SysElem_InPlace=false, rba_SysElem_HeaderLength=0
              rba_SysElem_CompuScale: rba_SysElem_Denominator=1, rba_SysElem_Numerator2=0, rba_SysElem_Numerator1=40
      rba_SysElem_IPdus
        10 x rba_SysElem_IPdu:
          ESP_HAD_BACKUP_GW_Container2_ST3_Ign_Stat_ST3
            rba_SysElem_ISignalIPdu: rba_SysElem_UseLdCom=false, rba_SysElem_Length=4, rba_SysElem_UnusedBitPattern=255
              6 x rba_SysElem_ISignalToPduMapping:
                Ign_Stat_Pr5_ST3_csgs1dv6drms80o1i9p49677w: rba_SysElem_ISignalGroupRef=rba_SysElem_ISignalGroups/Ign_Stat_Pr5_ST3_csgs1dv6drms80o1i9p49677w, rba_SysElem_ISignalToPduMappingForeignRef=Ign_Stat_Pr5_ST3_csgs1dv6drms80o1i9p49677w
                CRC_Ign_Stat_Pr5_ST3: rba_SysElem_StartPosition=0, rba_SysElem_PackingByteOrder=mostSignificantByteLast, rba_SysElem_ISignalRef=rba_SysElem_ISignals/CRC_Ign_Stat_Pr5_ST3, rba_SysElem_ISignalToPduMappingForeignRef=CRC_Ign_Stat_Pr5_ST3
                ISw_Stat_ST3: rba_SysElem_StartPosition=24, rba_SysElem_PackingByteOrder=mostSignificantByteLast, rba_SysElem_ISignalRef=rba_SysElem_ISignals/ISw_Stat_ST3, rba_SysElem_ISignalToPduMappingForeignRef=ISw_Stat_ST3
                KG_StartSw_Psd_ST3: rba_SysElem_StartPosition=31, rba_SysElem_PackingByteOrder=mostSignificantByteLast, rba_SysElem_ISignalRef=rba_SysElem_ISignals/KG_StartSw_Psd_ST3, rba_SysElem_ISignalToPduMappingForeignRef=KG_StartSw_Psd_ST3
                SQC_Ign_Stat_Pr5_ST3: rba_SysElem_StartPosition=16, rba_SysElem_PackingByteOrder=mostSignificantByteLast, rba_SysElem_ISignalRef=rba_SysElem_ISignals/SQC_Ign_Stat_Pr5_ST3, rba_SysElem_ISignalToPduMappingForeignRef=SQC_Ign_Stat_Pr5_ST3
                Veh_Op_Mode_ST3: rba_SysElem_StartPosition=27, rba_SysElem_PackingByteOrder=mostSignificantByteLast, rba_SysElem_ISignalRef=rba_SysElem_ISignals/Veh_Op_Mode_ST3, rba_SysElem_ISignalToPduMappingForeignRef=Veh_Op_Mode_ST3
          ESP_HAD_BACKUP_GW_Container2_ST3_PT4_PTCoor4_ST3
            rba_SysElem_ISignalIPdu: rba_SysElem_UseLdCom=false, rba_SysElem_Length=4, rba_SysElem_UnusedBitPattern=255
              7 x rba_SysElem_ISignalToPduMapping:
                PT4_PTCoor4_Pr5_ST3_af4fxb1ykieox3itqdfzs0kpb: rba_SysElem_ISignalGroupRef=rba_SysElem_ISignalGroups/PT4_PTCoor4_Pr5_ST3_af4fxb1ykieox3itqdfzs0kpb, rba_SysElem_ISignalToPduMappingForeignRef=PT4_PTCoor4_Pr5_ST3_af4fxb1ykieox3itqdfzs0kpb
                CRC_PT4_PTCoor4_Pr5_ST3: rba_SysElem_StartPosition=0, rba_SysElem_PackingByteOrder=mostSignificantByteLast, rba_SysElem_ISignalRef=rba_SysElem_ISignals/CRC_PT4_PTCoor4_Pr5_ST3, rba_SysElem_ISignalToPduMappingForeignRef=CRC_PT4_PTCoor4_Pr5_ST3
                PT4_PTCoor_EngStartPN14_Stat_ST3: rba_SysElem_StartPosition=28, rba_SysElem_PackingByteOrder=mostSignificantByteLast, rba_SysElem_ISignalRef=rba_SysElem_ISignals/PT4_PTCoor_EngStartPN14_Stat_ST3, rba_SysElem_ISignalToPduMappingForeignRef=PT4_PTCoor_EngStartPN14_Stat_ST3
                PT4_PTCoor_PT_Rdy_ST3: rba_SysElem_StartPosition=24, rba_SysElem_PackingByteOrder=mostSignificantByteLast, rba_SysElem_ISignalRef=rba_SysElem_ISignals/PT4_PTCoor_PT_Rdy_ST3, rba_SysElem_ISignalToPduMappingForeignRef=PT4_PTCoor_PT_Rdy_ST3
                PT4_PTCoor_SSA_EngSp_ST3: rba_SysElem_StartPosition=26, rba_SysElem_PackingByteOrder=mostSignificantByteLast, rba_SysElem_ISignalRef=rba_SysElem_ISignals/PT4_PTCoor_SSA_EngSp_ST3, rba_SysElem_ISignalToPduMappingForeignRef=PT4_PTCoor_SSA_EngSp_ST3
                SQC_PT4_PTCoor4_Pr5_ST3: rba_SysElem_StartPosition=16, rba_SysElem_PackingByteOrder=mostSignificantByteLast, rba_SysElem_ISignalRef=rba_SysElem_ISignals/SQC_PT4_PTCoor4_Pr5_ST3, rba_SysElem_ISignalToPduMappingForeignRef=SQC_PT4_PTCoor4_Pr5_ST3
                Rsrv1_PT4_PTCoor_PT_Rdy_Pr5_ST3: rba_SysElem_StartPosition=31, rba_SysElem_PackingByteOrder=mostSignificantByteLast, rba_SysElem_ISignalRef=rba_SysElem_ISignals/Rsrv1_PT4_PTCoor_PT_Rdy_Pr5_ST3, rba_SysElem_ISignalToPduMappingForeignRef=Rsrv1_PT4_PTCoor_PT_Rdy_Pr5_ST3
          ESP_HAD_BACKUP_GW_Container4_ST3_DI_OdoSpeedometer_ST3
            rba_SysElem_ISignalIPdu: rba_SysElem_UseLdCom=false, rba_SysElem_Length=8, rba_SysElem_UnusedBitPattern=255
              4 x rba_SysElem_ISignalToPduMapping:
                DI_Odo_Pr5_ST3_e68xmtlkywxgxsdwekdjjhw3t: rba_SysElem_ISignalGroupRef=rba_SysElem_ISignalGroups/DI_Odo_Pr5_ST3_e68xmtlkywxgxsdwekdjjhw3t, rba_SysElem_ISignalToPduMappingForeignRef=DI_Odo_Pr5_ST3_e68xmtlkywxgxsdwekdjjhw3t
                CRC_DI_Odo_Pr5_ST3: rba_SysElem_StartPosition=0, rba_SysElem_PackingByteOrder=mostSignificantByteLast, rba_SysElem_ISignalRef=rba_SysElem_ISignals/CRC_DI_Odo_Pr5_ST3, rba_SysElem_ISignalToPduMappingForeignRef=CRC_DI_Odo_Pr5_ST3
                Odo_ST3: rba_SysElem_StartPosition=24, rba_SysElem_PackingByteOrder=mostSignificantByteLast, rba_SysElem_ISignalRef=rba_SysElem_ISignals/Odo_ST3, rba_SysElem_ISignalToPduMappingForeignRef=Odo_ST3
                SQC_DI_Odo_Pr5_ST3: rba_SysElem_StartPosition=16, rba_SysElem_PackingByteOrder=mostSignificantByteLast, rba_SysElem_ISignalRef=rba_SysElem_ISignals/SQC_DI_Odo_Pr5_ST3, rba_SysElem_ISignalToPduMappingForeignRef=SQC_DI_Odo_Pr5_ST3
          IMU_A_Output_ST3
            rba_SysElem_ISignalIPdu: rba_SysElem_UseLdCom=false, rba_SysElem_Length=40, rba_SysElem_UnusedBitPattern=255
              27 x rba_SysElem_ISignalToPduMapping:
                IMU_A_Output_Pr5_ST3_bezr5ct33mhwxias0s8rjhbne: rba_SysElem_ISignalGroupRef=rba_SysElem_ISignalGroups/IMU_A_Output_Pr5_ST3_bezr5ct33mhwxias0s8rjhbne, rba_SysElem_ISignalToPduMappingForeignRef=IMU_A_Output_Pr5_ST3_bezr5ct33mhwxias0s8rjhbne
                CRC_IMU_A_Output_Pr5_ST3: rba_SysElem_StartPosition=0, rba_SysElem_PackingByteOrder=mostSignificantByteLast, rba_SysElem_ISignalRef=rba_SysElem_ISignals/CRC_IMU_A_Output_Pr5_ST3, rba_SysElem_ISignalToPduMappingForeignRef=CRC_IMU_A_Output_Pr5_ST3
                IMU_A_AngAcc_Stat_ST3: rba_SysElem_StartPosition=27, rba_SysElem_PackingByteOrder=mostSignificantByteLast, rba_SysElem_ISignalRef=rba_SysElem_ISignals/IMU_A_AngAcc_Stat_ST3, rba_SysElem_ISignalToPduMappingForeignRef=IMU_A_AngAcc_Stat_ST3
                IMU_A_AngAcc_X_ST3: rba_SysElem_StartPosition=55, rba_SysElem_PackingByteOrder=mostSignificantByteLast, rba_SysElem_ISignalRef=rba_SysElem_ISignals/IMU_A_AngAcc_X_ST3, rba_SysElem_ISignalToPduMappingForeignRef=IMU_A_AngAcc_X_ST3
                IMU_A_AngAcc_Y_ST3: rba_SysElem_StartPosition=71, rba_SysElem_PackingByteOrder=mostSignificantByteLast, rba_SysElem_ISignalRef=rba_SysElem_ISignals/IMU_A_AngAcc_Y_ST3, rba_SysElem_ISignalToPduMappingForeignRef=IMU_A_AngAcc_Y_ST3
                IMU_A_AngAcc_Z_ST3: rba_SysElem_StartPosition=87, rba_SysElem_PackingByteOrder=mostSignificantByteLast, rba_SysElem_ISignalRef=rba_SysElem_ISignals/IMU_A_AngAcc_Z_ST3, rba_SysElem_ISignalToPduMappingForeignRef=IMU_A_AngAcc_Z_ST3
                IMU_A_AngRate_X_ST3: rba_SysElem_StartPosition=103, rba_SysElem_PackingByteOrder=mostSignificantByteLast, rba_SysElem_ISignalRef=rba_SysElem_ISignals/IMU_A_AngRate_X_ST3, rba_SysElem_ISignalToPduMappingForeignRef=IMU_A_AngRate_X_ST3
                IMU_A_AngRate_Y_ST3: rba_SysElem_StartPosition=119, rba_SysElem_PackingByteOrder=mostSignificantByteLast, rba_SysElem_ISignalRef=rba_SysElem_ISignals/IMU_A_AngRate_Y_ST3, rba_SysElem_ISignalToPduMappingForeignRef=IMU_A_AngRate_Y_ST3
                IMU_A_AngRate_Z_ST3: rba_SysElem_StartPosition=135, rba_SysElem_PackingByteOrder=mostSignificantByteLast, rba_SysElem_ISignalRef=rba_SysElem_ISignals/IMU_A_AngRate_Z_ST3, rba_SysElem_ISignalToPduMappingForeignRef=IMU_A_AngRate_Z_ST3
                IMU_A_AngRates_Stat_ST3: rba_SysElem_StartPosition=30, rba_SysElem_PackingByteOrder=mostSignificantByteLast, rba_SysElem_ISignalRef=rba_SysElem_ISignals/IMU_A_AngRates_Stat_ST3, rba_SysElem_ISignalToPduMappingForeignRef=IMU_A_AngRates_Stat_ST3
                IMU_A_SpecForce_Stat_ST3: rba_SysElem_StartPosition=36, rba_SysElem_PackingByteOrder=mostSignificantByteLast, rba_SysElem_ISignalRef=rba_SysElem_ISignals/IMU_A_SpecForce_Stat_ST3, rba_SysElem_ISignalToPduMappingForeignRef=IMU_A_SpecForce_Stat_ST3
                IMU_A_SpecForce_X_ST3: rba_SysElem_StartPosition=151, rba_SysElem_PackingByteOrder=mostSignificantByteLast, rba_SysElem_ISignalRef=rba_SysElem_ISignals/IMU_A_SpecForce_X_ST3, rba_SysElem_ISignalToPduMappingForeignRef=IMU_A_SpecForce_X_ST3
                IMU_A_SpecForce_Y_ST3: rba_SysElem_StartPosition=167, rba_SysElem_PackingByteOrder=mostSignificantByteLast, rba_SysElem_ISignalRef=rba_SysElem_ISignals/IMU_A_SpecForce_Y_ST3, rba_SysElem_ISignalToPduMappingForeignRef=IMU_A_SpecForce_Y_ST3
                IMU_A_SpecForce_Z_ST3: rba_SysElem_StartPosition=183, rba_SysElem_PackingByteOrder=mostSignificantByteLast, rba_SysElem_ISignalRef=rba_SysElem_ISignals/IMU_A_SpecForce_Z_ST3, rba_SysElem_ISignalToPduMappingForeignRef=IMU_A_SpecForce_Z_ST3
                IMU_A_Stat_ST3: rba_SysElem_StartPosition=24, rba_SysElem_PackingByteOrder=mostSignificantByteLast, rba_SysElem_ISignalRef=rba_SysElem_ISignals/IMU_A_Stat_ST3, rba_SysElem_ISignalToPduMappingForeignRef=IMU_A_Stat_ST3
                IMU_A_Temp_ST3: rba_SysElem_StartPosition=39, rba_SysElem_PackingByteOrder=mostSignificantByteLast, rba_SysElem_ISignalRef=rba_SysElem_ISignals/IMU_A_Temp_ST3, rba_SysElem_ISignalToPduMappingForeignRef=IMU_A_Temp_ST3
                IMU_A_TmStmp_NanoSec_ST3: rba_SysElem_StartPosition=199, rba_SysElem_PackingByteOrder=mostSignificantByteLast, rba_SysElem_ISignalRef=rba_SysElem_ISignals/IMU_A_TmStmp_NanoSec_ST3, rba_SysElem_ISignalToPduMappingForeignRef=IMU_A_TmStmp_NanoSec_ST3
                IMU_A_TmStmp_Sec_ST3: rba_SysElem_StartPosition=231, rba_SysElem_PackingByteOrder=mostSignificantByteLast, rba_SysElem_ISignalRef=rba_SysElem_ISignals/IMU_A_TmStmp_Sec_ST3, rba_SysElem_ISignalToPduMappingForeignRef=IMU_A_TmStmp_Sec_ST3
                IMU_A_TmSync_Stat_ST3: rba_SysElem_StartPosition=47, rba_SysElem_PackingByteOrder=mostSignificantByteLast, rba_SysElem_ISignalRef=rba_SysElem_ISignals/IMU_A_TmSync_Stat_ST3, rba_SysElem_ISignalToPduMappingForeignRef=IMU_A_TmSync_Stat_ST3
                SQC_IMU_A_Output_Pr5_ST3: rba_SysElem_StartPosition=16, rba_SysElem_PackingByteOrder=mostSignificantByteLast, rba_SysElem_ISignalRef=rba_SysElem_ISignals/SQC_IMU_A_Output_Pr5_ST3, rba_SysElem_ISignalToPduMappingForeignRef=SQC_IMU_A_Output_Pr5_ST3
                Rsrv01_IMU_A_Output_Pr5_ST3: rba_SysElem_StartPosition=263, rba_SysElem_PackingByteOrder=mostSignificantByteLast, rba_SysElem_ISignalRef=rba_SysElem_ISignals/Rsrv01_IMU_A_Output_Pr5_ST3, rba_SysElem_ISignalToPduMappingForeignRef=Rsrv01_IMU_A_Output_Pr5_ST3
                Rsrv02_IMU_A_Output_Pr5_ST3: rba_SysElem_StartPosition=272, rba_SysElem_PackingByteOrder=mostSignificantByteLast, rba_SysElem_ISignalRef=rba_SysElem_ISignals/Rsrv02_IMU_A_Output_Pr5_ST3, rba_SysElem_ISignalToPduMappingForeignRef=Rsrv02_IMU_A_Output_Pr5_ST3
                Rsrv03_IMU_A_Output_Pr5_ST3: rba_SysElem_StartPosition=280, rba_SysElem_PackingByteOrder=mostSignificantByteLast, rba_SysElem_ISignalRef=rba_SysElem_ISignals/Rsrv03_IMU_A_Output_Pr5_ST3, rba_SysElem_ISignalToPduMappingForeignRef=Rsrv03_IMU_A_Output_Pr5_ST3
                Rsrv04_IMU_A_Output_Pr5_ST3: rba_SysElem_StartPosition=288, rba_SysElem_PackingByteOrder=mostSignificantByteLast, rba_SysElem_ISignalRef=rba_SysElem_ISignals/Rsrv04_IMU_A_Output_Pr5_ST3, rba_SysElem_ISignalToPduMappingForeignRef=Rsrv04_IMU_A_Output_Pr5_ST3
                Rsrv05_IMU_A_Output_Pr5_ST3: rba_SysElem_StartPosition=296, rba_SysElem_PackingByteOrder=mostSignificantByteLast, rba_SysElem_ISignalRef=rba_SysElem_ISignals/Rsrv05_IMU_A_Output_Pr5_ST3, rba_SysElem_ISignalToPduMappingForeignRef=Rsrv05_IMU_A_Output_Pr5_ST3
                Rsrv06_IMU_A_Output_Pr5_ST3: rba_SysElem_StartPosition=304, rba_SysElem_PackingByteOrder=mostSignificantByteLast, rba_SysElem_ISignalRef=rba_SysElem_ISignals/Rsrv06_IMU_A_Output_Pr5_ST3, rba_SysElem_ISignalToPduMappingForeignRef=Rsrv06_IMU_A_Output_Pr5_ST3
                Rsrv07_IMU_A_Output_Pr5_ST3: rba_SysElem_StartPosition=33, rba_SysElem_PackingByteOrder=mostSignificantByteLast, rba_SysElem_ISignalRef=rba_SysElem_ISignals/Rsrv07_IMU_A_Output_Pr5_ST3, rba_SysElem_ISignalToPduMappingForeignRef=Rsrv07_IMU_A_Output_Pr5_ST3
          IMU_B_Output_ST3
            rba_SysElem_ISignalIPdu: rba_SysElem_UseLdCom=false, rba_SysElem_Length=40, rba_SysElem_UnusedBitPattern=255
              27 x rba_SysElem_ISignalToPduMapping:
                IMU_B_Output_Pr5_ST3_8enshzy4a8xe2badcgusoewm2: rba_SysElem_ISignalGroupRef=rba_SysElem_ISignalGroups/IMU_B_Output_Pr5_ST3_8enshzy4a8xe2badcgusoewm2, rba_SysElem_ISignalToPduMappingForeignRef=IMU_B_Output_Pr5_ST3_8enshzy4a8xe2badcgusoewm2
                CRC_IMU_B_Output_Pr5_ST3: rba_SysElem_StartPosition=0, rba_SysElem_PackingByteOrder=mostSignificantByteLast, rba_SysElem_ISignalRef=rba_SysElem_ISignals/CRC_IMU_B_Output_Pr5_ST3, rba_SysElem_ISignalToPduMappingForeignRef=CRC_IMU_B_Output_Pr5_ST3
                IMU_B_AngAcc_Stat_ST3: rba_SysElem_StartPosition=27, rba_SysElem_PackingByteOrder=mostSignificantByteLast, rba_SysElem_ISignalRef=rba_SysElem_ISignals/IMU_B_AngAcc_Stat_ST3, rba_SysElem_ISignalToPduMappingForeignRef=IMU_B_AngAcc_Stat_ST3
                IMU_B_AngAcc_X_ST3: rba_SysElem_StartPosition=55, rba_SysElem_PackingByteOrder=mostSignificantByteLast, rba_SysElem_ISignalRef=rba_SysElem_ISignals/IMU_B_AngAcc_X_ST3, rba_SysElem_ISignalToPduMappingForeignRef=IMU_B_AngAcc_X_ST3
                IMU_B_AngAcc_Y_ST3: rba_SysElem_StartPosition=71, rba_SysElem_PackingByteOrder=mostSignificantByteLast, rba_SysElem_ISignalRef=rba_SysElem_ISignals/IMU_B_AngAcc_Y_ST3, rba_SysElem_ISignalToPduMappingForeignRef=IMU_B_AngAcc_Y_ST3
                IMU_B_AngAcc_Z_ST3: rba_SysElem_StartPosition=87, rba_SysElem_PackingByteOrder=mostSignificantByteLast, rba_SysElem_ISignalRef=rba_SysElem_ISignals/IMU_B_AngAcc_Z_ST3, rba_SysElem_ISignalToPduMappingForeignRef=IMU_B_AngAcc_Z_ST3
                IMU_B_AngRate_X_ST3: rba_SysElem_StartPosition=103, rba_SysElem_PackingByteOrder=mostSignificantByteLast, rba_SysElem_ISignalRef=rba_SysElem_ISignals/IMU_B_AngRate_X_ST3, rba_SysElem_ISignalToPduMappingForeignRef=IMU_B_AngRate_X_ST3
                IMU_B_AngRate_Y_ST3: rba_SysElem_StartPosition=119, rba_SysElem_PackingByteOrder=mostSignificantByteLast, rba_SysElem_ISignalRef=rba_SysElem_ISignals/IMU_B_AngRate_Y_ST3, rba_SysElem_ISignalToPduMappingForeignRef=IMU_B_AngRate_Y_ST3
                IMU_B_AngRate_Z_ST3: rba_SysElem_StartPosition=135, rba_SysElem_PackingByteOrder=mostSignificantByteLast, rba_SysElem_ISignalRef=rba_SysElem_ISignals/IMU_B_AngRate_Z_ST3, rba_SysElem_ISignalToPduMappingForeignRef=IMU_B_AngRate_Z_ST3
                IMU_B_AngRates_Stat_ST3: rba_SysElem_StartPosition=30, rba_SysElem_PackingByteOrder=mostSignificantByteLast, rba_SysElem_ISignalRef=rba_SysElem_ISignals/IMU_B_AngRates_Stat_ST3, rba_SysElem_ISignalToPduMappingForeignRef=IMU_B_AngRates_Stat_ST3
                IMU_B_SpecForce_Stat_ST3: rba_SysElem_StartPosition=36, rba_SysElem_PackingByteOrder=mostSignificantByteLast, rba_SysElem_ISignalRef=rba_SysElem_ISignals/IMU_B_SpecForce_Stat_ST3, rba_SysElem_ISignalToPduMappingForeignRef=IMU_B_SpecForce_Stat_ST3
                IMU_B_SpecForce_X_ST3: rba_SysElem_StartPosition=151, rba_SysElem_PackingByteOrder=mostSignificantByteLast, rba_SysElem_ISignalRef=rba_SysElem_ISignals/IMU_B_SpecForce_X_ST3, rba_SysElem_ISignalToPduMappingForeignRef=IMU_B_SpecForce_X_ST3
                IMU_B_SpecForce_Y_ST3: rba_SysElem_StartPosition=167, rba_SysElem_PackingByteOrder=mostSignificantByteLast, rba_SysElem_ISignalRef=rba_SysElem_ISignals/IMU_B_SpecForce_Y_ST3, rba_SysElem_ISignalToPduMappingForeignRef=IMU_B_SpecForce_Y_ST3
                IMU_B_SpecForce_Z_ST3: rba_SysElem_StartPosition=183, rba_SysElem_PackingByteOrder=mostSignificantByteLast, rba_SysElem_ISignalRef=rba_SysElem_ISignals/IMU_B_SpecForce_Z_ST3, rba_SysElem_ISignalToPduMappingForeignRef=IMU_B_SpecForce_Z_ST3
                IMU_B_Stat_ST3: rba_SysElem_StartPosition=24, rba_SysElem_PackingByteOrder=mostSignificantByteLast, rba_SysElem_ISignalRef=rba_SysElem_ISignals/IMU_B_Stat_ST3, rba_SysElem_ISignalToPduMappingForeignRef=IMU_B_Stat_ST3
                IMU_B_Temp_ST3: rba_SysElem_StartPosition=39, rba_SysElem_PackingByteOrder=mostSignificantByteLast, rba_SysElem_ISignalRef=rba_SysElem_ISignals/IMU_B_Temp_ST3, rba_SysElem_ISignalToPduMappingForeignRef=IMU_B_Temp_ST3
                IMU_B_TmStmp_NanoSec_ST3: rba_SysElem_StartPosition=199, rba_SysElem_PackingByteOrder=mostSignificantByteLast, rba_SysElem_ISignalRef=rba_SysElem_ISignals/IMU_B_TmStmp_NanoSec_ST3, rba_SysElem_ISignalToPduMappingForeignRef=IMU_B_TmStmp_NanoSec_ST3
                IMU_B_TmStmp_Sec_ST3: rba_SysElem_StartPosition=231, rba_SysElem_PackingByteOrder=mostSignificantByteLast, rba_SysElem_ISignalRef=rba_SysElem_ISignals/IMU_B_TmStmp_Sec_ST3, rba_SysElem_ISignalToPduMappingForeignRef=IMU_B_TmStmp_Sec_ST3
                IMU_B_TmSync_Stat_ST3: rba_SysElem_StartPosition=47, rba_SysElem_PackingByteOrder=mostSignificantByteLast, rba_SysElem_ISignalRef=rba_SysElem_ISignals/IMU_B_TmSync_Stat_ST3, rba_SysElem_ISignalToPduMappingForeignRef=IMU_B_TmSync_Stat_ST3
                SQC_IMU_B_Output_Pr5_ST3: rba_SysElem_StartPosition=16, rba_SysElem_PackingByteOrder=mostSignificantByteLast, rba_SysElem_ISignalRef=rba_SysElem_ISignals/SQC_IMU_B_Output_Pr5_ST3, rba_SysElem_ISignalToPduMappingForeignRef=SQC_IMU_B_Output_Pr5_ST3
                Rsrv01_IMU_B_Output_Pr5_ST3: rba_SysElem_StartPosition=263, rba_SysElem_PackingByteOrder=mostSignificantByteLast, rba_SysElem_ISignalRef=rba_SysElem_ISignals/Rsrv01_IMU_B_Output_Pr5_ST3, rba_SysElem_ISignalToPduMappingForeignRef=Rsrv01_IMU_B_Output_Pr5_ST3
                Rsrv02_IMU_B_Output_Pr5_ST3: rba_SysElem_StartPosition=272, rba_SysElem_PackingByteOrder=mostSignificantByteLast, rba_SysElem_ISignalRef=rba_SysElem_ISignals/Rsrv02_IMU_B_Output_Pr5_ST3, rba_SysElem_ISignalToPduMappingForeignRef=Rsrv02_IMU_B_Output_Pr5_ST3
                Rsrv03_IMU_B_Output_Pr5_ST3: rba_SysElem_StartPosition=280, rba_SysElem_PackingByteOrder=mostSignificantByteLast, rba_SysElem_ISignalRef=rba_SysElem_ISignals/Rsrv03_IMU_B_Output_Pr5_ST3, rba_SysElem_ISignalToPduMappingForeignRef=Rsrv03_IMU_B_Output_Pr5_ST3
                Rsrv04_IMU_B_Output_Pr5_ST3: rba_SysElem_StartPosition=288, rba_SysElem_PackingByteOrder=mostSignificantByteLast, rba_SysElem_ISignalRef=rba_SysElem_ISignals/Rsrv04_IMU_B_Output_Pr5_ST3, rba_SysElem_ISignalToPduMappingForeignRef=Rsrv04_IMU_B_Output_Pr5_ST3
                Rsrv05_IMU_B_Output_Pr5_ST3: rba_SysElem_StartPosition=296, rba_SysElem_PackingByteOrder=mostSignificantByteLast, rba_SysElem_ISignalRef=rba_SysElem_ISignals/Rsrv05_IMU_B_Output_Pr5_ST3, rba_SysElem_ISignalToPduMappingForeignRef=Rsrv05_IMU_B_Output_Pr5_ST3
                Rsrv06_IMU_B_Output_Pr5_ST3: rba_SysElem_StartPosition=304, rba_SysElem_PackingByteOrder=mostSignificantByteLast, rba_SysElem_ISignalRef=rba_SysElem_ISignals/Rsrv06_IMU_B_Output_Pr5_ST3, rba_SysElem_ISignalToPduMappingForeignRef=Rsrv06_IMU_B_Output_Pr5_ST3
                Rsrv07_IMU_B_Output_Pr5_ST3: rba_SysElem_StartPosition=33, rba_SysElem_PackingByteOrder=mostSignificantByteLast, rba_SysElem_ISignalRef=rba_SysElem_ISignals/Rsrv07_IMU_B_Output_Pr5_ST3, rba_SysElem_ISignalToPduMappingForeignRef=Rsrv07_IMU_B_Output_Pr5_ST3
          Ign_Stat_ST3
            rba_SysElem_ISignalIPdu: rba_SysElem_UseLdCom=false, rba_SysElem_Length=4, rba_SysElem_UnusedBitPattern=255
              6 x rba_SysElem_ISignalToPduMapping:
                Ign_Stat_Pr5_ST3_csgs1dv6drms80o1i9p49677w: rba_SysElem_ISignalGroupRef=Ign_Stat_Pr5_ST3_csgs1dv6drms80o1i9p49677w_RENAME1, rba_SysElem_ISignalToPduMappingForeignRef=Ign_Stat_Pr5_ST3_csgs1dv6drms80o1i9p49677w
                CRC_Ign_Stat_Pr5_ST3: rba_SysElem_StartPosition=0, rba_SysElem_PackingByteOrder=mostSignificantByteLast, rba_SysElem_ISignalRef=CRC_Ign_Stat_Pr5_ST3_RENAME1, rba_SysElem_ISignalToPduMappingForeignRef=CRC_Ign_Stat_Pr5_ST3
                ISw_Stat_ST3: rba_SysElem_StartPosition=24, rba_SysElem_PackingByteOrder=mostSignificantByteLast, rba_SysElem_ISignalRef=ISw_Stat_ST3_RENAME1, rba_SysElem_ISignalToPduMappingForeignRef=ISw_Stat_ST3
                KG_StartSw_Psd_ST3: rba_SysElem_StartPosition=31, rba_SysElem_PackingByteOrder=mostSignificantByteLast, rba_SysElem_ISignalRef=KG_StartSw_Psd_ST3_RENAME1, rba_SysElem_ISignalToPduMappingForeignRef=KG_StartSw_Psd_ST3
                SQC_Ign_Stat_Pr5_ST3: rba_SysElem_StartPosition=16, rba_SysElem_PackingByteOrder=mostSignificantByteLast, rba_SysElem_ISignalRef=SQC_Ign_Stat_Pr5_ST3_RENAME1, rba_SysElem_ISignalToPduMappingForeignRef=SQC_Ign_Stat_Pr5_ST3
                Veh_Op_Mode_ST3: rba_SysElem_StartPosition=27, rba_SysElem_PackingByteOrder=mostSignificantByteLast, rba_SysElem_ISignalRef=Veh_Op_Mode_ST3_RENAME1, rba_SysElem_ISignalToPduMappingForeignRef=Veh_Op_Mode_ST3
          IMU_A_Output_ST3_RENAME1
            rba_SysElem_ISignalIPdu: rba_SysElem_UseLdCom=false, rba_SysElem_Length=40, rba_SysElem_UnusedBitPattern=255
              27 x rba_SysElem_ISignalToPduMapping:
                IMU_A_Output_Pr5_ST3_bezr5ct33mhwxias0s8rjhbne: rba_SysElem_ISignalGroupRef=IMU_A_Output_Pr5_ST3_bezr5ct33mhwxias0s8rjhbne_RENAME1, rba_SysElem_ISignalToPduMappingForeignRef=IMU_A_Output_Pr5_ST3_bezr5ct33mhwxias0s8rjhbne
                CRC_IMU_A_Output_Pr5_ST3: rba_SysElem_StartPosition=0, rba_SysElem_PackingByteOrder=mostSignificantByteLast, rba_SysElem_ISignalRef=CRC_IMU_A_Output_Pr5_ST3_RENAME1, rba_SysElem_ISignalToPduMappingForeignRef=CRC_IMU_A_Output_Pr5_ST3
                IMU_A_AngAcc_Stat_ST3: rba_SysElem_StartPosition=27, rba_SysElem_PackingByteOrder=mostSignificantByteLast, rba_SysElem_ISignalRef=IMU_A_AngAcc_Stat_ST3_RENAME1, rba_SysElem_ISignalToPduMappingForeignRef=IMU_A_AngAcc_Stat_ST3
                IMU_A_AngAcc_X_ST3: rba_SysElem_StartPosition=55, rba_SysElem_PackingByteOrder=mostSignificantByteLast, rba_SysElem_ISignalRef=IMU_A_AngAcc_X_ST3_RENAME1, rba_SysElem_ISignalToPduMappingForeignRef=IMU_A_AngAcc_X_ST3
                IMU_A_AngAcc_Y_ST3: rba_SysElem_StartPosition=71, rba_SysElem_PackingByteOrder=mostSignificantByteLast, rba_SysElem_ISignalRef=IMU_A_AngAcc_Y_ST3_RENAME1, rba_SysElem_ISignalToPduMappingForeignRef=IMU_A_AngAcc_Y_ST3
                IMU_A_AngAcc_Z_ST3: rba_SysElem_StartPosition=87, rba_SysElem_PackingByteOrder=mostSignificantByteLast, rba_SysElem_ISignalRef=IMU_A_AngAcc_Z_ST3_RENAME1, rba_SysElem_ISignalToPduMappingForeignRef=IMU_A_AngAcc_Z_ST3
                IMU_A_AngRate_X_ST3: rba_SysElem_StartPosition=103, rba_SysElem_PackingByteOrder=mostSignificantByteLast, rba_SysElem_ISignalRef=IMU_A_AngRate_X_ST3_RENAME1, rba_SysElem_ISignalToPduMappingForeignRef=IMU_A_AngRate_X_ST3
                IMU_A_AngRate_Y_ST3: rba_SysElem_StartPosition=119, rba_SysElem_PackingByteOrder=mostSignificantByteLast, rba_SysElem_ISignalRef=IMU_A_AngRate_Y_ST3_RENAME1, rba_SysElem_ISignalToPduMappingForeignRef=IMU_A_AngRate_Y_ST3
                IMU_A_AngRate_Z_ST3: rba_SysElem_StartPosition=135, rba_SysElem_PackingByteOrder=mostSignificantByteLast, rba_SysElem_ISignalRef=IMU_A_AngRate_Z_ST3_RENAME1, rba_SysElem_ISignalToPduMappingForeignRef=IMU_A_AngRate_Z_ST3
                IMU_A_AngRates_Stat_ST3: rba_SysElem_StartPosition=30, rba_SysElem_PackingByteOrder=mostSignificantByteLast, rba_SysElem_ISignalRef=IMU_A_AngRates_Stat_ST3_RENAME1, rba_SysElem_ISignalToPduMappingForeignRef=IMU_A_AngRates_Stat_ST3
                IMU_A_SpecForce_Stat_ST3: rba_SysElem_StartPosition=36, rba_SysElem_PackingByteOrder=mostSignificantByteLast, rba_SysElem_ISignalRef=IMU_A_SpecForce_Stat_ST3_RENAME1, rba_SysElem_ISignalToPduMappingForeignRef=IMU_A_SpecForce_Stat_ST3
                IMU_A_SpecForce_X_ST3: rba_SysElem_StartPosition=151, rba_SysElem_PackingByteOrder=mostSignificantByteLast, rba_SysElem_ISignalRef=IMU_A_SpecForce_X_ST3_RENAME1, rba_SysElem_ISignalToPduMappingForeignRef=IMU_A_SpecForce_X_ST3
                IMU_A_SpecForce_Y_ST3: rba_SysElem_StartPosition=167, rba_SysElem_PackingByteOrder=mostSignificantByteLast, rba_SysElem_ISignalRef=IMU_A_SpecForce_Y_ST3_RENAME1, rba_SysElem_ISignalToPduMappingForeignRef=IMU_A_SpecForce_Y_ST3
                IMU_A_SpecForce_Z_ST3: rba_SysElem_StartPosition=183, rba_SysElem_PackingByteOrder=mostSignificantByteLast, rba_SysElem_ISignalRef=IMU_A_SpecForce_Z_ST3_RENAME1, rba_SysElem_ISignalToPduMappingForeignRef=IMU_A_SpecForce_Z_ST3
                IMU_A_Stat_ST3: rba_SysElem_StartPosition=24, rba_SysElem_PackingByteOrder=mostSignificantByteLast, rba_SysElem_ISignalRef=IMU_A_Stat_ST3_RENAME1, rba_SysElem_ISignalToPduMappingForeignRef=IMU_A_Stat_ST3
                IMU_A_Temp_ST3: rba_SysElem_StartPosition=39, rba_SysElem_PackingByteOrder=mostSignificantByteLast, rba_SysElem_ISignalRef=IMU_A_Temp_ST3_RENAME1, rba_SysElem_ISignalToPduMappingForeignRef=IMU_A_Temp_ST3
                IMU_A_TmStmp_NanoSec_ST3: rba_SysElem_StartPosition=199, rba_SysElem_PackingByteOrder=mostSignificantByteLast, rba_SysElem_ISignalRef=IMU_A_TmStmp_NanoSec_ST3_RENAME1, rba_SysElem_ISignalToPduMappingForeignRef=IMU_A_TmStmp_NanoSec_ST3
                IMU_A_TmStmp_Sec_ST3: rba_SysElem_StartPosition=231, rba_SysElem_PackingByteOrder=mostSignificantByteLast, rba_SysElem_ISignalRef=IMU_A_TmStmp_Sec_ST3_RENAME1, rba_SysElem_ISignalToPduMappingForeignRef=IMU_A_TmStmp_Sec_ST3
                IMU_A_TmSync_Stat_ST3: rba_SysElem_StartPosition=47, rba_SysElem_PackingByteOrder=mostSignificantByteLast, rba_SysElem_ISignalRef=IMU_A_TmSync_Stat_ST3_RENAME1, rba_SysElem_ISignalToPduMappingForeignRef=IMU_A_TmSync_Stat_ST3
                SQC_IMU_A_Output_Pr5_ST3: rba_SysElem_StartPosition=16, rba_SysElem_PackingByteOrder=mostSignificantByteLast, rba_SysElem_ISignalRef=SQC_IMU_A_Output_Pr5_ST3_RENAME1, rba_SysElem_ISignalToPduMappingForeignRef=SQC_IMU_A_Output_Pr5_ST3
                Rsrv01_IMU_A_Output_Pr5_ST3: rba_SysElem_StartPosition=263, rba_SysElem_PackingByteOrder=mostSignificantByteLast, rba_SysElem_ISignalRef=Rsrv01_IMU_A_Output_Pr5_ST3_RENAME1, rba_SysElem_ISignalToPduMappingForeignRef=Rsrv01_IMU_A_Output_Pr5_ST3
                Rsrv02_IMU_A_Output_Pr5_ST3: rba_SysElem_StartPosition=272, rba_SysElem_PackingByteOrder=mostSignificantByteLast, rba_SysElem_ISignalRef=Rsrv02_IMU_A_Output_Pr5_ST3_RENAME1, rba_SysElem_ISignalToPduMappingForeignRef=Rsrv02_IMU_A_Output_Pr5_ST3
                Rsrv03_IMU_A_Output_Pr5_ST3: rba_SysElem_StartPosition=280, rba_SysElem_PackingByteOrder=mostSignificantByteLast, rba_SysElem_ISignalRef=Rsrv03_IMU_A_Output_Pr5_ST3_RENAME1, rba_SysElem_ISignalToPduMappingForeignRef=Rsrv03_IMU_A_Output_Pr5_ST3
                Rsrv04_IMU_A_Output_Pr5_ST3: rba_SysElem_StartPosition=288, rba_SysElem_PackingByteOrder=mostSignificantByteLast, rba_SysElem_ISignalRef=Rsrv04_IMU_A_Output_Pr5_ST3_RENAME1, rba_SysElem_ISignalToPduMappingForeignRef=Rsrv04_IMU_A_Output_Pr5_ST3
                Rsrv05_IMU_A_Output_Pr5_ST3: rba_SysElem_StartPosition=296, rba_SysElem_PackingByteOrder=mostSignificantByteLast, rba_SysElem_ISignalRef=Rsrv05_IMU_A_Output_Pr5_ST3_RENAME1, rba_SysElem_ISignalToPduMappingForeignRef=Rsrv05_IMU_A_Output_Pr5_ST3
                Rsrv06_IMU_A_Output_Pr5_ST3: rba_SysElem_StartPosition=304, rba_SysElem_PackingByteOrder=mostSignificantByteLast, rba_SysElem_ISignalRef=Rsrv06_IMU_A_Output_Pr5_ST3_RENAME1, rba_SysElem_ISignalToPduMappingForeignRef=Rsrv06_IMU_A_Output_Pr5_ST3
                Rsrv07_IMU_A_Output_Pr5_ST3: rba_SysElem_StartPosition=33, rba_SysElem_PackingByteOrder=mostSignificantByteLast, rba_SysElem_ISignalRef=Rsrv07_IMU_A_Output_Pr5_ST3_RENAME1, rba_SysElem_ISignalToPduMappingForeignRef=Rsrv07_IMU_A_Output_Pr5_ST3
          IMU_B_Output_ST3_RENAME1
            rba_SysElem_ISignalIPdu: rba_SysElem_UseLdCom=false, rba_SysElem_Length=40, rba_SysElem_UnusedBitPattern=255
              27 x rba_SysElem_ISignalToPduMapping:
                IMU_B_Output_Pr5_ST3_8enshzy4a8xe2badcgusoewm2: rba_SysElem_ISignalGroupRef=IMU_B_Output_Pr5_ST3_8enshzy4a8xe2badcgusoewm2_RENAME1, rba_SysElem_ISignalToPduMappingForeignRef=IMU_B_Output_Pr5_ST3_8enshzy4a8xe2badcgusoewm2
                CRC_IMU_B_Output_Pr5_ST3: rba_SysElem_StartPosition=0, rba_SysElem_PackingByteOrder=mostSignificantByteLast, rba_SysElem_ISignalRef=CRC_IMU_B_Output_Pr5_ST3_RENAME1, rba_SysElem_ISignalToPduMappingForeignRef=CRC_IMU_B_Output_Pr5_ST3
                IMU_B_AngAcc_Stat_ST3: rba_SysElem_StartPosition=27, rba_SysElem_PackingByteOrder=mostSignificantByteLast, rba_SysElem_ISignalRef=IMU_B_AngAcc_Stat_ST3_RENAME1, rba_SysElem_ISignalToPduMappingForeignRef=IMU_B_AngAcc_Stat_ST3
                IMU_B_AngAcc_X_ST3: rba_SysElem_StartPosition=55, rba_SysElem_PackingByteOrder=mostSignificantByteLast, rba_SysElem_ISignalRef=IMU_B_AngAcc_X_ST3_RENAME1, rba_SysElem_ISignalToPduMappingForeignRef=IMU_B_AngAcc_X_ST3
                IMU_B_AngAcc_Y_ST3: rba_SysElem_StartPosition=71, rba_SysElem_PackingByteOrder=mostSignificantByteLast, rba_SysElem_ISignalRef=IMU_B_AngAcc_Y_ST3_RENAME1, rba_SysElem_ISignalToPduMappingForeignRef=IMU_B_AngAcc_Y_ST3
                IMU_B_AngAcc_Z_ST3: rba_SysElem_StartPosition=87, rba_SysElem_PackingByteOrder=mostSignificantByteLast, rba_SysElem_ISignalRef=IMU_B_AngAcc_Z_ST3_RENAME1, rba_SysElem_ISignalToPduMappingForeignRef=IMU_B_AngAcc_Z_ST3
                IMU_B_AngRate_X_ST3: rba_SysElem_StartPosition=103, rba_SysElem_PackingByteOrder=mostSignificantByteLast, rba_SysElem_ISignalRef=IMU_B_AngRate_X_ST3_RENAME1, rba_SysElem_ISignalToPduMappingForeignRef=IMU_B_AngRate_X_ST3
                IMU_B_AngRate_Y_ST3: rba_SysElem_StartPosition=119, rba_SysElem_PackingByteOrder=mostSignificantByteLast, rba_SysElem_ISignalRef=IMU_B_AngRate_Y_ST3_RENAME1, rba_SysElem_ISignalToPduMappingForeignRef=IMU_B_AngRate_Y_ST3
                IMU_B_AngRate_Z_ST3: rba_SysElem_StartPosition=135, rba_SysElem_PackingByteOrder=mostSignificantByteLast, rba_SysElem_ISignalRef=IMU_B_AngRate_Z_ST3_RENAME1, rba_SysElem_ISignalToPduMappingForeignRef=IMU_B_AngRate_Z_ST3
                IMU_B_AngRates_Stat_ST3: rba_SysElem_StartPosition=30, rba_SysElem_PackingByteOrder=mostSignificantByteLast, rba_SysElem_ISignalRef=IMU_B_AngRates_Stat_ST3_RENAME1, rba_SysElem_ISignalToPduMappingForeignRef=IMU_B_AngRates_Stat_ST3
                IMU_B_SpecForce_Stat_ST3: rba_SysElem_StartPosition=36, rba_SysElem_PackingByteOrder=mostSignificantByteLast, rba_SysElem_ISignalRef=IMU_B_SpecForce_Stat_ST3_RENAME1, rba_SysElem_ISignalToPduMappingForeignRef=IMU_B_SpecForce_Stat_ST3
                IMU_B_SpecForce_X_ST3: rba_SysElem_StartPosition=151, rba_SysElem_PackingByteOrder=mostSignificantByteLast, rba_SysElem_ISignalRef=IMU_B_SpecForce_X_ST3_RENAME1, rba_SysElem_ISignalToPduMappingForeignRef=IMU_B_SpecForce_X_ST3
                IMU_B_SpecForce_Y_ST3: rba_SysElem_StartPosition=167, rba_SysElem_PackingByteOrder=mostSignificantByteLast, rba_SysElem_ISignalRef=IMU_B_SpecForce_Y_ST3_RENAME1, rba_SysElem_ISignalToPduMappingForeignRef=IMU_B_SpecForce_Y_ST3
                IMU_B_SpecForce_Z_ST3: rba_SysElem_StartPosition=183, rba_SysElem_PackingByteOrder=mostSignificantByteLast, rba_SysElem_ISignalRef=IMU_B_SpecForce_Z_ST3_RENAME1, rba_SysElem_ISignalToPduMappingForeignRef=IMU_B_SpecForce_Z_ST3
                IMU_B_Stat_ST3: rba_SysElem_StartPosition=24, rba_SysElem_PackingByteOrder=mostSignificantByteLast, rba_SysElem_ISignalRef=IMU_B_Stat_ST3_RENAME1, rba_SysElem_ISignalToPduMappingForeignRef=IMU_B_Stat_ST3
                IMU_B_Temp_ST3: rba_SysElem_StartPosition=39, rba_SysElem_PackingByteOrder=mostSignificantByteLast, rba_SysElem_ISignalRef=IMU_B_Temp_ST3_RENAME1, rba_SysElem_ISignalToPduMappingForeignRef=IMU_B_Temp_ST3
                IMU_B_TmStmp_NanoSec_ST3: rba_SysElem_StartPosition=199, rba_SysElem_PackingByteOrder=mostSignificantByteLast, rba_SysElem_ISignalRef=IMU_B_TmStmp_NanoSec_ST3_RENAME1, rba_SysElem_ISignalToPduMappingForeignRef=IMU_B_TmStmp_NanoSec_ST3
                IMU_B_TmStmp_Sec_ST3: rba_SysElem_StartPosition=231, rba_SysElem_PackingByteOrder=mostSignificantByteLast, rba_SysElem_ISignalRef=IMU_B_TmStmp_Sec_ST3_RENAME1, rba_SysElem_ISignalToPduMappingForeignRef=IMU_B_TmStmp_Sec_ST3
                IMU_B_TmSync_Stat_ST3: rba_SysElem_StartPosition=47, rba_SysElem_PackingByteOrder=mostSignificantByteLast, rba_SysElem_ISignalRef=IMU_B_TmSync_Stat_ST3_RENAME1, rba_SysElem_ISignalToPduMappingForeignRef=IMU_B_TmSync_Stat_ST3
                SQC_IMU_B_Output_Pr5_ST3: rba_SysElem_StartPosition=16, rba_SysElem_PackingByteOrder=mostSignificantByteLast, rba_SysElem_ISignalRef=SQC_IMU_B_Output_Pr5_ST3_RENAME1, rba_SysElem_ISignalToPduMappingForeignRef=SQC_IMU_B_Output_Pr5_ST3
                Rsrv01_IMU_B_Output_Pr5_ST3: rba_SysElem_StartPosition=263, rba_SysElem_PackingByteOrder=mostSignificantByteLast, rba_SysElem_ISignalRef=Rsrv01_IMU_B_Output_Pr5_ST3_RENAME1, rba_SysElem_ISignalToPduMappingForeignRef=Rsrv01_IMU_B_Output_Pr5_ST3
                Rsrv02_IMU_B_Output_Pr5_ST3: rba_SysElem_StartPosition=272, rba_SysElem_PackingByteOrder=mostSignificantByteLast, rba_SysElem_ISignalRef=Rsrv02_IMU_B_Output_Pr5_ST3_RENAME1, rba_SysElem_ISignalToPduMappingForeignRef=Rsrv02_IMU_B_Output_Pr5_ST3
                Rsrv03_IMU_B_Output_Pr5_ST3: rba_SysElem_StartPosition=280, rba_SysElem_PackingByteOrder=mostSignificantByteLast, rba_SysElem_ISignalRef=Rsrv03_IMU_B_Output_Pr5_ST3_RENAME1, rba_SysElem_ISignalToPduMappingForeignRef=Rsrv03_IMU_B_Output_Pr5_ST3
                Rsrv04_IMU_B_Output_Pr5_ST3: rba_SysElem_StartPosition=288, rba_SysElem_PackingByteOrder=mostSignificantByteLast, rba_SysElem_ISignalRef=Rsrv04_IMU_B_Output_Pr5_ST3_RENAME1, rba_SysElem_ISignalToPduMappingForeignRef=Rsrv04_IMU_B_Output_Pr5_ST3
                Rsrv05_IMU_B_Output_Pr5_ST3: rba_SysElem_StartPosition=296, rba_SysElem_PackingByteOrder=mostSignificantByteLast, rba_SysElem_ISignalRef=Rsrv05_IMU_B_Output_Pr5_ST3_RENAME1, rba_SysElem_ISignalToPduMappingForeignRef=Rsrv05_IMU_B_Output_Pr5_ST3
                Rsrv06_IMU_B_Output_Pr5_ST3: rba_SysElem_StartPosition=304, rba_SysElem_PackingByteOrder=mostSignificantByteLast, rba_SysElem_ISignalRef=Rsrv06_IMU_B_Output_Pr5_ST3_RENAME1, rba_SysElem_ISignalToPduMappingForeignRef=Rsrv06_IMU_B_Output_Pr5_ST3
                Rsrv07_IMU_B_Output_Pr5_ST3: rba_SysElem_StartPosition=33, rba_SysElem_PackingByteOrder=mostSignificantByteLast, rba_SysElem_ISignalRef=Rsrv07_IMU_B_Output_Pr5_ST3_RENAME1, rba_SysElem_ISignalToPduMappingForeignRef=Rsrv07_IMU_B_Output_Pr5_ST3
          PT4_PTCoor4_ST3
            rba_SysElem_ISignalIPdu: rba_SysElem_UseLdCom=false, rba_SysElem_Length=4, rba_SysElem_UnusedBitPattern=255
              7 x rba_SysElem_ISignalToPduMapping:
                PT4_PTCoor4_Pr5_ST3_af4fxb1ykieox3itqdfzs0kpb: rba_SysElem_ISignalGroupRef=PT4_PTCoor4_Pr5_ST3_af4fxb1ykieox3itqdfzs0kpb_RENAME1, rba_SysElem_ISignalToPduMappingForeignRef=PT4_PTCoor4_Pr5_ST3_af4fxb1ykieox3itqdfzs0kpb
                CRC_PT4_PTCoor4_Pr5_ST3: rba_SysElem_StartPosition=0, rba_SysElem_PackingByteOrder=mostSignificantByteLast, rba_SysElem_ISignalRef=CRC_PT4_PTCoor4_Pr5_ST3_RENAME1, rba_SysElem_ISignalToPduMappingForeignRef=CRC_PT4_PTCoor4_Pr5_ST3
                PT4_PTCoor_EngStartPN14_Stat_ST3: rba_SysElem_StartPosition=28, rba_SysElem_PackingByteOrder=mostSignificantByteLast, rba_SysElem_ISignalRef=PT4_PTCoor_EngStartPN14_Stat_ST3_RENAME1, rba_SysElem_ISignalToPduMappingForeignRef=PT4_PTCoor_EngStartPN14_Stat_ST3
                PT4_PTCoor_PT_Rdy_ST3: rba_SysElem_StartPosition=24, rba_SysElem_PackingByteOrder=mostSignificantByteLast, rba_SysElem_ISignalRef=PT4_PTCoor_PT_Rdy_ST3_RENAME1, rba_SysElem_ISignalToPduMappingForeignRef=PT4_PTCoor_PT_Rdy_ST3
                PT4_PTCoor_SSA_EngSp_ST3: rba_SysElem_StartPosition=26, rba_SysElem_PackingByteOrder=mostSignificantByteLast, rba_SysElem_ISignalRef=PT4_PTCoor_SSA_EngSp_ST3_RENAME1, rba_SysElem_ISignalToPduMappingForeignRef=PT4_PTCoor_SSA_EngSp_ST3
                SQC_PT4_PTCoor4_Pr5_ST3: rba_SysElem_StartPosition=16, rba_SysElem_PackingByteOrder=mostSignificantByteLast, rba_SysElem_ISignalRef=SQC_PT4_PTCoor4_Pr5_ST3_RENAME1, rba_SysElem_ISignalToPduMappingForeignRef=SQC_PT4_PTCoor4_Pr5_ST3
                Rsrv1_PT4_PTCoor_PT_Rdy_Pr5_ST3: rba_SysElem_StartPosition=31, rba_SysElem_PackingByteOrder=mostSignificantByteLast, rba_SysElem_ISignalRef=Rsrv1_PT4_PTCoor_PT_Rdy_Pr5_ST3_RENAME1, rba_SysElem_ISignalToPduMappingForeignRef=Rsrv1_PT4_PTCoor_PT_Rdy_Pr5_ST3
          DI_OdoSpeedometer_ST3
            rba_SysElem_ISignalIPdu: rba_SysElem_UseLdCom=false, rba_SysElem_Length=8, rba_SysElem_UnusedBitPattern=255
              4 x rba_SysElem_ISignalToPduMapping:
                DI_Odo_Pr5_ST3_e68xmtlkywxgxsdwekdjjhw3t: rba_SysElem_ISignalGroupRef=DI_Odo_Pr5_ST3_e68xmtlkywxgxsdwekdjjhw3t_RENAME1, rba_SysElem_ISignalToPduMappingForeignRef=DI_Odo_Pr5_ST3_e68xmtlkywxgxsdwekdjjhw3t
                CRC_DI_Odo_Pr5_ST3: rba_SysElem_StartPosition=0, rba_SysElem_PackingByteOrder=mostSignificantByteLast, rba_SysElem_ISignalRef=CRC_DI_Odo_Pr5_ST3_RENAME1, rba_SysElem_ISignalToPduMappingForeignRef=CRC_DI_Odo_Pr5_ST3
                Odo_ST3: rba_SysElem_StartPosition=24, rba_SysElem_PackingByteOrder=mostSignificantByteLast, rba_SysElem_ISignalRef=Odo_ST3_RENAME1, rba_SysElem_ISignalToPduMappingForeignRef=Odo_ST3
                SQC_DI_Odo_Pr5_ST3: rba_SysElem_StartPosition=16, rba_SysElem_PackingByteOrder=mostSignificantByteLast, rba_SysElem_ISignalRef=SQC_DI_Odo_Pr5_ST3_RENAME1, rba_SysElem_ISignalToPduMappingForeignRef=SQC_DI_Odo_Pr5_ST3
      rba_SysElem_DataMappings
        4 x rba_SysElem_DataMapping:
          SR_G_Ign_Stat_Pr5_ST3_csgs1dv6drms80o1i9p49677w_IN: rba_SysElem_CommunicationDirection=in
            rba_SysElem_SenderReceiverToSignalGroupMapping:
              rba_SysElem_TopLevelTypeMapping = rba_SysElem_SenderReceiverToSignalGroupMapping/Type_Mapping_1_Record
              rba_SysElem_VariableDataPrototypeRef = Ign_Stat_Pr5_ST3
              rba_SysElem_SystemSignalGroupRef = rba_SysElem_SystemSignalGroups/Ign_Stat_Pr5_ST3_csgs1dv6drms80o1i9p49677w
              Type_Mapping_1_Record (rba_SysElem_TypeMapping)
                rba_SysElem_SenderRecRecordTypeMapping
                  REM_SySig_ISw_Stat_ST3 (rba_SysElem_RecordElementMapping):
                    rba_SysElem_ImplementationRecordElementRef = rba_SysElem_RecordImplDataType/ISw_Stat_ST3
                    rba_SysElem_SystemSignalRef = rba_SysElem_SystemSignals/ISw_Stat_ST3
          SR_G_PT4_PTCoor4_Pr5_ST3_af4fxb1ykieox3itqdfzs0kpb_IN: rba_SysElem_CommunicationDirection=in
            rba_SysElem_SenderReceiverToSignalGroupMapping:
              rba_SysElem_TopLevelTypeMapping = rba_SysElem_SenderReceiverToSignalGroupMapping/Type_Mapping_1_Record
              rba_SysElem_VariableDataPrototypeRef = PT4_PTCoor4_Pr5_ST3
              rba_SysElem_SystemSignalGroupRef = rba_SysElem_SystemSignalGroups/PT4_PTCoor4_Pr5_ST3_af4fxb1ykieox3itqdfzs0kpb
              Type_Mapping_1_Record (rba_SysElem_TypeMapping)
                rba_SysElem_SenderRecRecordTypeMapping
                  REM_SySig_PT4_PTCoor_EngStartPN14_Stat_ST3 (rba_SysElem_RecordElementMapping):
                    rba_SysElem_ImplementationRecordElementRef = rba_SysElem_RecordImplDataType/PT4_PTCoor_EngStartPN14_Stat_ST3
                    rba_SysElem_SystemSignalRef = rba_SysElem_SystemSignals/PT4_PTCoor_EngStartPN14_Stat_ST3
          SR_G_DI_Odo_Pr5_ST3_e68xmtlkywxgxsdwekdjjhw3t_IN: rba_SysElem_CommunicationDirection=in
            rba_SysElem_SenderReceiverToSignalGroupMapping:
              rba_SysElem_TopLevelTypeMapping = rba_SysElem_SenderReceiverToSignalGroupMapping/Type_Mapping_1_Record
              rba_SysElem_VariableDataPrototypeRef = DI_Odo_Pr5_ST3
              rba_SysElem_SystemSignalGroupRef = rba_SysElem_SystemSignalGroups/DI_Odo_Pr5_ST3_e68xmtlkywxgxsdwekdjjhw3t
              Type_Mapping_1_Record (rba_SysElem_TypeMapping)
                rba_SysElem_SenderRecRecordTypeMapping
                  REM_SySig_Odo_ST3 (rba_SysElem_RecordElementMapping):
                    rba_SysElem_ImplementationRecordElementRef = rba_SysElem_RecordImplDataType/Odo_ST3
                    rba_SysElem_SystemSignalRef = rba_SysElem_SystemSignals/Odo_ST3
          SR_G_IMU_A_Output_Pr5_ST3_bezr5ct33mhwxias0s8rjhbne_OUT: rba_SysElem_CommunicationDirection=out
            rba_SysElem_SenderReceiverToSignalGroupMapping:
              rba_SysElem_TopLevelTypeMapping = rba_SysElem_SenderReceiverToSignalGroupMapping/Type_Mapping_1_Record
              rba_SysElem_VariableDataPrototypeRef = IMU_A_Output_Pr5_ST3
              rba_SysElem_SystemSignalGroupRef = rba_SysElem_SystemSignalGroups/IMU_A_Output_Pr5_ST3_bezr5ct33mhwxias0s8rjhbne
              Type_Mapping_1_Record (rba_SysElem_TypeMapping)
                rba_SysElem_SenderRecRecordTypeMapping
                  26 x rba_SysElem_RecordElementMapping:
                    REM_SySig_IMU_A_AngAcc_Y_ST3: rba_SysElem_ImplementationRecordElementRef=rba_SysElem_RecordImplDataType/IMU_A_AngAcc_Y_ST3, rba_SysElem_SystemSignalRef=rba_SysElem_SystemSignals/IMU_A_AngAcc_Y_ST3
                    REM_SySig_IMU_A_AngAcc_Stat_ST3: rba_SysElem_ImplementationRecordElementRef=rba_SysElem_RecordImplDataType/IMU_A_AngAcc_Stat_ST3, rba_SysElem_SystemSignalRef=rba_SysElem_SystemSignals/IMU_A_AngAcc_Stat_ST3
                    REM_SySig_IMU_A_TmStmp_NanoSec_ST3: rba_SysElem_ImplementationRecordElementRef=rba_SysElem_RecordImplDataType/IMU_A_TmStmp_NanoSec_ST3, rba_SysElem_SystemSignalRef=rba_SysElem_SystemSignals/IMU_A_TmStmp_NanoSec_ST3
                    REM_SySig_SQC_IMU_A_Output_Pr5_ST3: rba_SysElem_ImplementationRecordElementRef=rba_SysElem_RecordImplDataType/SQC_IMU_A_Output_Pr5_ST3, rba_SysElem_SystemSignalRef=rba_SysElem_SystemSignals/SQC_IMU_A_Output_Pr5_ST3
                    REM_SySig_Rsrv07_IMU_A_Output_Pr5_ST3: rba_SysElem_ImplementationRecordElementRef=rba_SysElem_RecordImplDataType/Rsrv07_IMU_A_Output_Pr5_ST3, rba_SysElem_SystemSignalRef=rba_SysElem_SystemSignals/Rsrv07_IMU_A_Output_Pr5_ST3
                    REM_SySig_IMU_A_AngRate_Z_ST3: rba_SysElem_ImplementationRecordElementRef=rba_SysElem_RecordImplDataType/IMU_A_AngRate_Z_ST3, rba_SysElem_SystemSignalRef=rba_SysElem_SystemSignals/IMU_A_AngRate_Z_ST3
                    REM_SySig_IMU_A_TmSync_Stat_ST3: rba_SysElem_ImplementationRecordElementRef=rba_SysElem_RecordImplDataType/IMU_A_TmSync_Stat_ST3, rba_SysElem_SystemSignalRef=rba_SysElem_SystemSignals/IMU_A_TmSync_Stat_ST3
                    REM_SySig_IMU_A_Stat_ST3: rba_SysElem_ImplementationRecordElementRef=rba_SysElem_RecordImplDataType/IMU_A_Stat_ST3, rba_SysElem_SystemSignalRef=rba_SysElem_SystemSignals/IMU_A_Stat_ST3
                    REM_SySig_CRC_IMU_A_Output_Pr5_ST3: rba_SysElem_ImplementationRecordElementRef=rba_SysElem_RecordImplDataType/CRC_IMU_A_Output_Pr5_ST3, rba_SysElem_SystemSignalRef=rba_SysElem_SystemSignals/CRC_IMU_A_Output_Pr5_ST3
                    REM_SySig_IMU_A_AngAcc_Z_ST3: rba_SysElem_ImplementationRecordElementRef=rba_SysElem_RecordImplDataType/IMU_A_AngAcc_Z_ST3, rba_SysElem_SystemSignalRef=rba_SysElem_SystemSignals/IMU_A_AngAcc_Z_ST3
                    REM_SySig_Rsrv01_IMU_A_Output_Pr5_ST3: rba_SysElem_ImplementationRecordElementRef=rba_SysElem_RecordImplDataType/Rsrv01_IMU_A_Output_Pr5_ST3, rba_SysElem_SystemSignalRef=rba_SysElem_SystemSignals/Rsrv01_IMU_A_Output_Pr5_ST3
                    REM_SySig_IMU_A_SpecForce_Stat_ST3: rba_SysElem_ImplementationRecordElementRef=rba_SysElem_RecordImplDataType/IMU_A_SpecForce_Stat_ST3, rba_SysElem_SystemSignalRef=rba_SysElem_SystemSignals/IMU_A_SpecForce_Stat_ST3
                    REM_SySig_IMU_A_SpecForce_Z_ST3: rba_SysElem_ImplementationRecordElementRef=rba_SysElem_RecordImplDataType/IMU_A_SpecForce_Z_ST3, rba_SysElem_SystemSignalRef=rba_SysElem_SystemSignals/IMU_A_SpecForce_Z_ST3
                    REM_SySig_Rsrv06_IMU_A_Output_Pr5_ST3: rba_SysElem_ImplementationRecordElementRef=rba_SysElem_RecordImplDataType/Rsrv06_IMU_A_Output_Pr5_ST3, rba_SysElem_SystemSignalRef=rba_SysElem_SystemSignals/Rsrv06_IMU_A_Output_Pr5_ST3
                    REM_SySig_IMU_A_AngRate_Y_ST3: rba_SysElem_ImplementationRecordElementRef=rba_SysElem_RecordImplDataType/IMU_A_AngRate_Y_ST3, rba_SysElem_SystemSignalRef=rba_SysElem_SystemSignals/IMU_A_AngRate_Y_ST3
                    REM_SySig_Rsrv04_IMU_A_Output_Pr5_ST3: rba_SysElem_ImplementationRecordElementRef=rba_SysElem_RecordImplDataType/Rsrv04_IMU_A_Output_Pr5_ST3, rba_SysElem_SystemSignalRef=rba_SysElem_SystemSignals/Rsrv04_IMU_A_Output_Pr5_ST3
                    REM_SySig_IMU_A_AngRate_X_ST3: rba_SysElem_ImplementationRecordElementRef=rba_SysElem_RecordImplDataType/IMU_A_AngRate_X_ST3, rba_SysElem_SystemSignalRef=rba_SysElem_SystemSignals/IMU_A_AngRate_X_ST3
                    REM_SySig_IMU_A_SpecForce_Y_ST3: rba_SysElem_ImplementationRecordElementRef=rba_SysElem_RecordImplDataType/IMU_A_SpecForce_Y_ST3, rba_SysElem_SystemSignalRef=rba_SysElem_SystemSignals/IMU_A_SpecForce_Y_ST3
                    REM_SySig_IMU_A_AngRates_Stat_ST3: rba_SysElem_ImplementationRecordElementRef=rba_SysElem_RecordImplDataType/IMU_A_AngRates_Stat_ST3, rba_SysElem_SystemSignalRef=rba_SysElem_SystemSignals/IMU_A_AngRates_Stat_ST3
                    REM_SySig_IMU_A_AngAcc_X_ST3: rba_SysElem_ImplementationRecordElementRef=rba_SysElem_RecordImplDataType/IMU_A_AngAcc_X_ST3, rba_SysElem_SystemSignalRef=rba_SysElem_SystemSignals/IMU_A_AngAcc_X_ST3
                    REM_SySig_Rsrv03_IMU_A_Output_Pr5_ST3: rba_SysElem_ImplementationRecordElementRef=rba_SysElem_RecordImplDataType/Rsrv03_IMU_A_Output_Pr5_ST3, rba_SysElem_SystemSignalRef=rba_SysElem_SystemSignals/Rsrv03_IMU_A_Output_Pr5_ST3
                    REM_SySig_IMU_A_Temp_ST3: rba_SysElem_ImplementationRecordElementRef=rba_SysElem_RecordImplDataType/IMU_A_Temp_ST3, rba_SysElem_SystemSignalRef=rba_SysElem_SystemSignals/IMU_A_Temp_ST3
                    REM_SySig_Rsrv05_IMU_A_Output_Pr5_ST3: rba_SysElem_ImplementationRecordElementRef=rba_SysElem_RecordImplDataType/Rsrv05_IMU_A_Output_Pr5_ST3, rba_SysElem_SystemSignalRef=rba_SysElem_SystemSignals/Rsrv05_IMU_A_Output_Pr5_ST3
                    REM_SySig_IMU_A_TmStmp_Sec_ST3: rba_SysElem_ImplementationRecordElementRef=rba_SysElem_RecordImplDataType/IMU_A_TmStmp_Sec_ST3, rba_SysElem_SystemSignalRef=rba_SysElem_SystemSignals/IMU_A_TmStmp_Sec_ST3
                    REM_SySig_Rsrv02_IMU_A_Output_Pr5_ST3: rba_SysElem_ImplementationRecordElementRef=rba_SysElem_RecordImplDataType/Rsrv02_IMU_A_Output_Pr5_ST3, rba_SysElem_SystemSignalRef=rba_SysElem_SystemSignals/Rsrv02_IMU_A_Output_Pr5_ST3
                    REM_SySig_IMU_A_SpecForce_X_ST3: rba_SysElem_ImplementationRecordElementRef=rba_SysElem_RecordImplDataType/IMU_A_SpecForce_X_ST3, rba_SysElem_SystemSignalRef=rba_SysElem_SystemSignals/IMU_A_SpecForce_X_ST3
      rba_SysElem_PortInterfaces
        4 x rba_SysElem_PortInterface:
          IG_Ign_Stat_Pr5_ST3_8qpxphk9meu9oryi6bfj0x04b
            rba_SysElem_SenderReceiverInterface: rba_SysElem_SenderReceiverInterfaceForeignRef=IG_Ign_Stat_Pr5_ST3_8qpxphk9meu9oryi6bfj0x04b
              Ign_Stat_Pr5_ST3 (rba_SysElem_VariableDataPrototype): rba_SysElem_VariableDataPrototypeForeignRef=Ign_Stat_Pr5_ST3, rba_SysElem_DatatypeRef=REC_Ign_Stat_Pr5_ST3_b0ko81o0x5jgvwtduf99gvzi0
          IG_PT4_PTCoor4_Pr5_ST3_4jqmw0h0uwztlkj3fjsj9fpfe
            rba_SysElem_SenderReceiverInterface: rba_SysElem_SenderReceiverInterfaceForeignRef=IG_PT4_PTCoor4_Pr5_ST3_4jqmw0h0uwztlkj3fjsj9fpfe
              PT4_PTCoor4_Pr5_ST3 (rba_SysElem_VariableDataPrototype): rba_SysElem_VariableDataPrototypeForeignRef=PT4_PTCoor4_Pr5_ST3, rba_SysElem_DatatypeRef=REC_PT4_PTCoor4_Pr5_ST3_6v3sj55wsjghho72slblc9pby
          IG_DI_Odo_Pr5_ST3_dqmkbik4b90gceqe8t96kp3yd
            rba_SysElem_SenderReceiverInterface: rba_SysElem_SenderReceiverInterfaceForeignRef=IG_DI_Odo_Pr5_ST3_dqmkbik4b90gceqe8t96kp3yd
              DI_Odo_Pr5_ST3 (rba_SysElem_VariableDataPrototype): rba_SysElem_VariableDataPrototypeForeignRef=DI_Odo_Pr5_ST3, rba_SysElem_DatatypeRef=REC_DI_Odo_Pr5_ST3_9t50popkpz30is106xpis1iyh
          IG_IMU_A_Output_Pr5_ST3_4gwkumex1u1h7u3ib82wkbin0
            rba_SysElem_SenderReceiverInterface: rba_SysElem_SenderReceiverInterfaceForeignRef=IG_IMU_A_Output_Pr5_ST3_4gwkumex1u1h7u3ib82wkbin0
              IMU_A_Output_Pr5_ST3 (rba_SysElem_VariableDataPrototype): rba_SysElem_VariableDataPrototypeForeignRef=IMU_A_Output_Pr5_ST3, rba_SysElem_DatatypeRef=REC_IMU_A_Output_Pr5_ST3_8jwz874ss5g8vhbjy6lngl4uh
      rba_SysElem_ImplementationDataTypes
        22 x rba_SysElem_ImplementationDataType:
          REC_Ign_Stat_Pr5_ST3_b0ko81o0x5jgvwtduf99gvzi0
            rba_SysElem_RecordImplDataType: rba_SysElem_Category=STRUCTURE, rba_SysElem_ImplementationDataTypeForeignRef=REC_Ign_Stat_Pr5_ST3_b0ko81o0x5jgvwtduf99gvzi0
              ISw_Stat_ST3 (rba_SysElem_SubElement): rba_SysElem_Index=0, rba_SysElem_ImplDataTypeRef=c03_ISw_Stat
          c03_ISw_Stat
            rba_SysElem_PrimitiveImplDataType: rba_SysElem_BaseDataType=uint8, rba_SysElem_Category=TYPE_REFERENCE, rba_SysElem_ImplementationDataTypeForeignRef=c03_ISw_Stat
          REC_PT4_PTCoor4_Pr5_ST3_6v3sj55wsjghho72slblc9pby
            rba_SysElem_RecordImplDataType: rba_SysElem_Category=STRUCTURE, rba_SysElem_ImplementationDataTypeForeignRef=REC_PT4_PTCoor4_Pr5_ST3_6v3sj55wsjghho72slblc9pby
              PT4_PTCoor_EngStartPN14_Stat_ST3 (rba_SysElem_SubElement): rba_SysElem_Index=0, rba_SysElem_ImplDataTypeRef=c03_EngStartPN14_Stat
          c03_EngStartPN14_Stat
            rba_SysElem_PrimitiveImplDataType: rba_SysElem_BaseDataType=uint8, rba_SysElem_Category=TYPE_REFERENCE, rba_SysElem_ImplementationDataTypeForeignRef=c03_EngStartPN14_Stat
          REC_DI_Odo_Pr5_ST3_9t50popkpz30is106xpis1iyh
            rba_SysElem_RecordImplDataType: rba_SysElem_Category=STRUCTURE, rba_SysElem_ImplementationDataTypeForeignRef=REC_DI_Odo_Pr5_ST3_9t50popkpz30is106xpis1iyh
              Odo_ST3 (rba_SysElem_SubElement): rba_SysElem_Index=0, rba_SysElem_ImplDataTypeRef=c24_km_0_999999k9_0k1_Invld_SNA
          c24_km_0_999999k9_0k1_Invld_SNA
            rba_SysElem_PrimitiveImplDataType:
              rba_SysElem_BaseDataType = uint32
              rba_SysElem_Category = TYPE_REFERENCE
              rba_SysElem_ImplementationDataTypeForeignRef = c24_km_0_999999k9_0k1_Invld_SNA
          REC_IMU_A_Output_Pr5_ST3_8jwz874ss5g8vhbjy6lngl4uh
            rba_SysElem_RecordImplDataType: rba_SysElem_Category=STRUCTURE, rba_SysElem_ImplementationDataTypeForeignRef=REC_IMU_A_Output_Pr5_ST3_8jwz874ss5g8vhbjy6lngl4uh
              26 x rba_SysElem_SubElement:
                CRC_IMU_A_Output_Pr5_ST3: rba_SysElem_Index=0, rba_SysElem_ImplDataTypeRef=c16_CRC_woSNA
                IMU_A_AngAcc_Stat_ST3: rba_SysElem_Index=1, rba_SysElem_ImplDataTypeRef=c03_IMU_Force_Ang_Stat_ST3
                IMU_A_AngAcc_X_ST3: rba_SysElem_Index=2, rba_SysElem_ImplDataTypeRef=c16_deg_per_s_sq_m1200_1200_0d04
                IMU_A_AngAcc_Y_ST3: rba_SysElem_Index=3, rba_SysElem_ImplDataTypeRef=c16_deg_per_s_sq_m1200_1200_0d04
                IMU_A_AngAcc_Z_ST3: rba_SysElem_Index=4, rba_SysElem_ImplDataTypeRef=c16_deg_per_s_sq_m1200_1200_0d04
                IMU_A_AngRate_X_ST3: rba_SysElem_Index=5, rba_SysElem_ImplDataTypeRef=c16_deg_per_sec_m300_300_0d01
                IMU_A_AngRate_Y_ST3: rba_SysElem_Index=6, rba_SysElem_ImplDataTypeRef=c16_deg_per_sec_m300_300_0d01
                IMU_A_AngRate_Z_ST3: rba_SysElem_Index=7, rba_SysElem_ImplDataTypeRef=c16_deg_per_sec_m300_300_0d01
                IMU_A_AngRates_Stat_ST3: rba_SysElem_Index=8, rba_SysElem_ImplDataTypeRef=c03_IMU_Force_Ang_Stat_ST3
                IMU_A_SpecForce_Stat_ST3: rba_SysElem_Index=9, rba_SysElem_ImplDataTypeRef=c03_IMU_Force_Ang_Stat_ST3
                IMU_A_SpecForce_X_ST3: rba_SysElem_Index=10, rba_SysElem_ImplDataTypeRef=c16_m_pro_s_sq_m50_50_0d002
                IMU_A_SpecForce_Y_ST3: rba_SysElem_Index=11, rba_SysElem_ImplDataTypeRef=c16_m_pro_s_sq_m50_50_0d002
                IMU_A_SpecForce_Z_ST3: rba_SysElem_Index=12, rba_SysElem_ImplDataTypeRef=c16_m_pro_s_sq_m50_50_0d002
                IMU_A_Stat_ST3: rba_SysElem_Index=13, rba_SysElem_ImplDataTypeRef=c03_IMU_Stat_ST3
                IMU_A_Temp_ST3: rba_SysElem_Index=14, rba_SysElem_ImplDataTypeRef=c08_deg_m50_160_1
                IMU_A_TmStmp_NanoSec_ST3: rba_SysElem_Index=15, rba_SysElem_ImplDataTypeRef=c32_ns_0_4294967295_1_noSNA
                IMU_A_TmStmp_Sec_ST3: rba_SysElem_Index=16, rba_SysElem_ImplDataTypeRef=c32_s_0_4294967295_1_noSNA
                IMU_A_TmSync_Stat_ST3: rba_SysElem_Index=17, rba_SysElem_ImplDataTypeRef=c08_TmSync_Stat
                Rsrv01_IMU_A_Output_Pr5_ST3: rba_SysElem_Index=18, rba_SysElem_ImplDataTypeRef=Rsrv09
                Rsrv02_IMU_A_Output_Pr5_ST3: rba_SysElem_Index=19, rba_SysElem_ImplDataTypeRef=Rsrv08
                Rsrv03_IMU_A_Output_Pr5_ST3: rba_SysElem_Index=20, rba_SysElem_ImplDataTypeRef=Rsrv08
                Rsrv04_IMU_A_Output_Pr5_ST3: rba_SysElem_Index=21, rba_SysElem_ImplDataTypeRef=Rsrv08
                Rsrv05_IMU_A_Output_Pr5_ST3: rba_SysElem_Index=22, rba_SysElem_ImplDataTypeRef=Rsrv08
                Rsrv06_IMU_A_Output_Pr5_ST3: rba_SysElem_Index=23, rba_SysElem_ImplDataTypeRef=Rsrv16
                SQC_IMU_A_Output_Pr5_ST3: rba_SysElem_Index=24, rba_SysElem_ImplDataTypeRef=c08_0_255_1_SNA_na
                Rsrv07_IMU_A_Output_Pr5_ST3: rba_SysElem_Index=25, rba_SysElem_ImplDataTypeRef=Rsrv03
          c16_CRC_woSNA
            rba_SysElem_PrimitiveImplDataType: rba_SysElem_BaseDataType=uint16, rba_SysElem_Category=TYPE_REFERENCE, rba_SysElem_ImplementationDataTypeForeignRef=c16_CRC_woSNA
          c03_IMU_Force_Ang_Stat_ST3
            rba_SysElem_PrimitiveImplDataType: rba_SysElem_BaseDataType=uint8, rba_SysElem_Category=TYPE_REFERENCE, rba_SysElem_ImplementationDataTypeForeignRef=c03_IMU_Force_Ang_Stat_ST3
          c16_deg_per_s_sq_m1200_1200_0d04
            rba_SysElem_PrimitiveImplDataType:
              rba_SysElem_BaseDataType = uint16
              rba_SysElem_Category = TYPE_REFERENCE
              rba_SysElem_ImplementationDataTypeForeignRef = c16_deg_per_s_sq_m1200_1200_0d04
          c16_deg_per_sec_m300_300_0d01
            rba_SysElem_PrimitiveImplDataType: rba_SysElem_BaseDataType=uint16, rba_SysElem_Category=TYPE_REFERENCE, rba_SysElem_ImplementationDataTypeForeignRef=c16_deg_per_sec_m300_300_0d01
          c16_m_pro_s_sq_m50_50_0d002
            rba_SysElem_PrimitiveImplDataType: rba_SysElem_BaseDataType=uint16, rba_SysElem_Category=TYPE_REFERENCE, rba_SysElem_ImplementationDataTypeForeignRef=c16_m_pro_s_sq_m50_50_0d002
          c03_IMU_Stat_ST3
            rba_SysElem_PrimitiveImplDataType: rba_SysElem_BaseDataType=uint8, rba_SysElem_Category=TYPE_REFERENCE, rba_SysElem_ImplementationDataTypeForeignRef=c03_IMU_Stat_ST3
          c08_deg_m50_160_1
            rba_SysElem_PrimitiveImplDataType: rba_SysElem_BaseDataType=uint8, rba_SysElem_Category=TYPE_REFERENCE, rba_SysElem_ImplementationDataTypeForeignRef=c08_deg_m50_160_1
          c32_ns_0_4294967295_1_noSNA
            rba_SysElem_PrimitiveImplDataType: rba_SysElem_BaseDataType=uint32, rba_SysElem_Category=TYPE_REFERENCE, rba_SysElem_ImplementationDataTypeForeignRef=c32_ns_0_4294967295_1_noSNA
          c32_s_0_4294967295_1_noSNA
            rba_SysElem_PrimitiveImplDataType: rba_SysElem_BaseDataType=uint32, rba_SysElem_Category=TYPE_REFERENCE, rba_SysElem_ImplementationDataTypeForeignRef=c32_s_0_4294967295_1_noSNA
          c08_TmSync_Stat
            rba_SysElem_PrimitiveImplDataType: rba_SysElem_BaseDataType=uint8, rba_SysElem_Category=TYPE_REFERENCE, rba_SysElem_ImplementationDataTypeForeignRef=c08_TmSync_Stat
          Rsrv09
            rba_SysElem_PrimitiveImplDataType: rba_SysElem_BaseDataType=uint16, rba_SysElem_Category=TYPE_REFERENCE, rba_SysElem_ImplementationDataTypeForeignRef=Rsrv09
          Rsrv08
            rba_SysElem_PrimitiveImplDataType: rba_SysElem_BaseDataType=uint8, rba_SysElem_Category=TYPE_REFERENCE, rba_SysElem_ImplementationDataTypeForeignRef=Rsrv08
          Rsrv16
            rba_SysElem_PrimitiveImplDataType: rba_SysElem_BaseDataType=uint16, rba_SysElem_Category=TYPE_REFERENCE, rba_SysElem_ImplementationDataTypeForeignRef=Rsrv16
          c08_0_255_1_SNA_na
            rba_SysElem_PrimitiveImplDataType: rba_SysElem_BaseDataType=uint8, rba_SysElem_Category=TYPE_REFERENCE, rba_SysElem_ImplementationDataTypeForeignRef=c08_0_255_1_SNA_na
          Rsrv03
            rba_SysElem_PrimitiveImplDataType: rba_SysElem_BaseDataType=uint8, rba_SysElem_Category=TYPE_REFERENCE, rba_SysElem_ImplementationDataTypeForeignRef=Rsrv03
