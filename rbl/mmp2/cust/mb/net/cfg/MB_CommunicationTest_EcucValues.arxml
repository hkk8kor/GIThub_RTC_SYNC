AUTOSAR XML (schema 4-2-2)
package /RB/UBK/Project/EcucModuleConfigurationValuess
  module config Can
    CanConfigSet
      TestXMT1 (CanHardwareObject):
        CanHandleType = FULL
        CanIdType = STANDARD
        CanObjectType = TRANSMIT
        CanControllerRef = CanIfControllerConfig_1
        CanMainFunctionRWPeriodRef = CanMainFunctionRWPeriods_5ms
      TestRCV1 (CanHardwareObject):
        CanHandleType = FULL
        CanIdType = STANDARD
        CanObjectType = RECEIVE
        CanControllerRef = CanIfControllerConfig_1
        CanMainFunctionRWPeriodRef = CanMainFunctionRWPeriods_5ms
        CanHwFilter_0 (CanHwFilter): CanHwFilterCode=2016, CanHwFilterMask=2047
  module config CanIf
    CanIfInitCfg: CanIfInitCfgSet=not_supported
      CanIfBufferCfg_TestXMT1 (CanIfBufferCfg): CanIfBufferSize=0, CanIfBufferHthRef=CanIfInitHohCfg/TestXMT1
      CanIfInitHohCfg
        TestRCV1 (CanIfHrhCfg): CanIfHrhCanCtrlIdRef=CanIfControllerConfig_1, CanIfHrhIdSymRef=CanConfigSet/TestRCV1
        TestXMT1 (CanIfHthCfg): CanIfHthCanCtrlIdRef=CanIfControllerConfig_1, CanIfHthIdSymRef=CanConfigSet/TestXMT1
      TestRCV1 (CanIfRxPduCfg):
        CanIfRxPduCanId = 2016
        CanIfRxPduCanIdType = STANDARD_CAN
        CanIfRxPduReadData = false
        CanIfRxPduReadNotifyStatus = false
        CanIfRxPduUserRxIndicationName = PduR_CanIfRxIndication
        CanIfRxPduUserRxIndicationUL = PDUR
        CanIfRxPduDataLength = 0
        CanIfRxPduHrhIdRef = CanIfInitHohCfg/TestRCV1
        CanIfRxPduRef = TestRCV1_canif2Pdur
      TestXMT1 (CanIfTxPduCfg):
        CanIfTxPduCanId = 2024
        CanIfTxPduCanIdType = STANDARD_CAN
        CanIfTxPduReadNotifyStatus = false
        CanIfTxPduTruncation = false
        CanIfTxPduType = DYNAMIC
        CanIfTxPduUserTxConfirmationName = PduR_CanIfTxConfirmation
        CanIfTxPduUserTxConfirmationUL = PDUR
        CanIfTxPduBufferRef = CanIfBufferCfg_TestXMT1
        CanIfTxPduRef = TestXMT1_Pdur2canif
  module config CommunicationTest: definition=Cdd
    CddComStackContribution
      CddPduRUpperLayerContribution
        TestRCV1 (CddPduRUpperLayerRxPdu): CddPduRUpperLayerPduRef=TestRCV1_Pdur2Communicationtest
        TestXMT1 (CddPduRUpperLayerTxPdu): CddPduRUpperLayerPduRef=TestXMT1_Communicationtest2Pdur
  module config EcuC
    EcucConfigSet
      EcucPduCollection: PduIdTypeEnum=uint16, PduLengthTypeEnum=uint16
        4 x Pdu, all with PduLength=8:
          TestRCV1_Pdur2Communicationtest
          TestRCV1_canif2Pdur
          TestXMT1_Pdur2canif
          TestXMT1_Communicationtest2Pdur
  module config PduR
    PduRRoutingPaths
      PduRDestPdu_1 (PduRDestPdu): PduRDestPduDataProvision=PDUR_DIRECT, PduRDestPduRef=TestRCV1_Pdur2Communicationtest
      PduRSrcPdu_comtestrcv (PduRSrcPdu): PduRSrcPduRef=TestRCV1_canif2Pdur
      PduRDestPdu_2 (PduRDestPdu): PduRDestPduDataProvision=PDUR_DIRECT, PduRDestPduRef=TestXMT1_Pdur2canif
      PduRSrcPdu_Test1XMT (PduRSrcPdu): PduRSrcPduRef=TestXMT1_Communicationtest2Pdur
      TestRCV1_CanIf_2_Communicationtest (PduRRoutingPath): PduRTpThreshold=1, PduRSrcPduRRef=PduRSrcPdu_comtestrcv, PduRDestPduRRef=PduRDestPdu_1
      TestXMT1_Communicationtest_2_CanIf (PduRRoutingPath): PduRSrcPduRRef=PduRSrcPdu_Test1XMT, PduRDestPduRRef=PduRDestPdu_2
    CommunicationTest (PduRBswModules):
      PduRCancelReceive = false
      PduRCancelTransmit = false
      PduRCommunicationInterface = true
      PduRLowerModule = false
      PduRTransportProtocol = false
      PduRTriggertransmit = false
      PduRTxConfirmation = true
      PduRUpperModule = true
      PduRBswModuleRef = CommunicationTest
