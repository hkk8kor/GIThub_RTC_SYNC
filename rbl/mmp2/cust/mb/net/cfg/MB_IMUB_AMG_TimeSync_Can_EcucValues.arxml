AUTOSAR XML (schema 4-2-2)
package /RB/UBK/Project/EcucModuleConfigurationValuess
  module config CanTSyn: implementation-config-variant=VARIANT-PRE-COMPILE
    CanTSynGeneral: CanTSynDevErrorDetect=false, CanTSynMainFunctionPeriod=0.005, CanTSynHardwareTimestampSupport=false, CanTSynVersionInfoApi=false
    CanTSynGlobalTimeDomain_2 (CanTSynGlobalTimeDomain): CanTSynGlobalTimeDomainId=2, CanTSynUseExtendedMsgFormat=false, CanTSynSynchronizedTimeBaseRef=SynchTimeBase_1
      CanTSynGlobalTimeFupDataIDList
        16 x CanTSynGlobalTimeFupDataIDListElement:
          CanTSynGlobalTimeFupDataIDListElement_0: CanTSynGlobalTimeFupDataIDListIndex=0, CanTSynGlobalTimeFupDataIDListValue=127
          CanTSynGlobalTimeFupDataIDListElement_1: CanTSynGlobalTimeFupDataIDListIndex=1, CanTSynGlobalTimeFupDataIDListValue=229
          CanTSynGlobalTimeFupDataIDListElement_2: CanTSynGlobalTimeFupDataIDListIndex=2, CanTSynGlobalTimeFupDataIDListValue=80
          CanTSynGlobalTimeFupDataIDListElement_3: CanTSynGlobalTimeFupDataIDListIndex=3, CanTSynGlobalTimeFupDataIDListValue=182
          CanTSynGlobalTimeFupDataIDListElement_4: CanTSynGlobalTimeFupDataIDListIndex=4, CanTSynGlobalTimeFupDataIDListValue=33
          CanTSynGlobalTimeFupDataIDListElement_5: CanTSynGlobalTimeFupDataIDListIndex=5, CanTSynGlobalTimeFupDataIDListValue=135
          CanTSynGlobalTimeFupDataIDListElement_6: CanTSynGlobalTimeFupDataIDListIndex=6, CanTSynGlobalTimeFupDataIDListValue=237
          CanTSynGlobalTimeFupDataIDListElement_7: CanTSynGlobalTimeFupDataIDListIndex=7, CanTSynGlobalTimeFupDataIDListValue=88
          CanTSynGlobalTimeFupDataIDListElement_8: CanTSynGlobalTimeFupDataIDListIndex=8, CanTSynGlobalTimeFupDataIDListValue=190
          CanTSynGlobalTimeFupDataIDListElement_9: CanTSynGlobalTimeFupDataIDListIndex=9, CanTSynGlobalTimeFupDataIDListValue=41
          CanTSynGlobalTimeFupDataIDListElement_10: CanTSynGlobalTimeFupDataIDListIndex=10, CanTSynGlobalTimeFupDataIDListValue=143
          CanTSynGlobalTimeFupDataIDListElement_11: CanTSynGlobalTimeFupDataIDListIndex=11, CanTSynGlobalTimeFupDataIDListValue=245
          CanTSynGlobalTimeFupDataIDListElement_12: CanTSynGlobalTimeFupDataIDListIndex=12, CanTSynGlobalTimeFupDataIDListValue=96
          CanTSynGlobalTimeFupDataIDListElement_13: CanTSynGlobalTimeFupDataIDListIndex=13, CanTSynGlobalTimeFupDataIDListValue=198
          CanTSynGlobalTimeFupDataIDListElement_14: CanTSynGlobalTimeFupDataIDListIndex=14, CanTSynGlobalTimeFupDataIDListValue=49
          CanTSynGlobalTimeFupDataIDListElement_15: CanTSynGlobalTimeFupDataIDListIndex=15, CanTSynGlobalTimeFupDataIDListValue=151
      CanTSynGlobalTimeSlave_2 (CanTSynGlobalTimeSlave):
        CanTSynGlobalTimeFollowUpTimeout = 0.25
        CanTSynGlobalTimeSequenceCounterJumpWidth = 3
        CanTSynGlobalTimeSequenceCounterHysteresis = 0
        CanTSynRxCrcValidated = CRC_VALIDATED
        CanTSynGlobalTimeSlavePdu_2 (CanTSynGlobalTimeSlavePdu): CanTSynGlobalTimePduRef=GTS_Powertrain_CAN_ST3_GTS_Powertrain_CAN_ST3_DRIVING_DRIVING_IN
      CanTSynGlobalTimeSyncDataIDList
        16 x CanTSynGlobalTimeSyncDataIDListElement:
          CanTSynGlobalTimeSyncDataIDListElement_0: CanTSynGlobalTimeSyncDataIDListIndex=0, CanTSynGlobalTimeSyncDataIDListValue=137
          CanTSynGlobalTimeSyncDataIDListElement_1: CanTSynGlobalTimeSyncDataIDListIndex=1, CanTSynGlobalTimeSyncDataIDListValue=76
          CanTSynGlobalTimeSyncDataIDListElement_2: CanTSynGlobalTimeSyncDataIDListIndex=2, CanTSynGlobalTimeSyncDataIDListValue=15
          CanTSynGlobalTimeSyncDataIDListElement_3: CanTSynGlobalTimeSyncDataIDListIndex=3, CanTSynGlobalTimeSyncDataIDListValue=205
          CanTSynGlobalTimeSyncDataIDListElement_4: CanTSynGlobalTimeSyncDataIDListIndex=4, CanTSynGlobalTimeSyncDataIDListValue=144
          CanTSynGlobalTimeSyncDataIDListElement_5: CanTSynGlobalTimeSyncDataIDListIndex=5, CanTSynGlobalTimeSyncDataIDListValue=83
          CanTSynGlobalTimeSyncDataIDListElement_6: CanTSynGlobalTimeSyncDataIDListIndex=6, CanTSynGlobalTimeSyncDataIDListValue=22
          CanTSynGlobalTimeSyncDataIDListElement_7: CanTSynGlobalTimeSyncDataIDListIndex=7, CanTSynGlobalTimeSyncDataIDListValue=212
          CanTSynGlobalTimeSyncDataIDListElement_8: CanTSynGlobalTimeSyncDataIDListIndex=8, CanTSynGlobalTimeSyncDataIDListValue=151
          CanTSynGlobalTimeSyncDataIDListElement_9: CanTSynGlobalTimeSyncDataIDListIndex=9, CanTSynGlobalTimeSyncDataIDListValue=90
          CanTSynGlobalTimeSyncDataIDListElement_10: CanTSynGlobalTimeSyncDataIDListIndex=10, CanTSynGlobalTimeSyncDataIDListValue=29
          CanTSynGlobalTimeSyncDataIDListElement_11: CanTSynGlobalTimeSyncDataIDListIndex=11, CanTSynGlobalTimeSyncDataIDListValue=219
          CanTSynGlobalTimeSyncDataIDListElement_12: CanTSynGlobalTimeSyncDataIDListIndex=12, CanTSynGlobalTimeSyncDataIDListValue=158
          CanTSynGlobalTimeSyncDataIDListElement_13: CanTSynGlobalTimeSyncDataIDListIndex=13, CanTSynGlobalTimeSyncDataIDListValue=97
          CanTSynGlobalTimeSyncDataIDListElement_14: CanTSynGlobalTimeSyncDataIDListIndex=14, CanTSynGlobalTimeSyncDataIDListValue=36
          CanTSynGlobalTimeSyncDataIDListElement_15: CanTSynGlobalTimeSyncDataIDListIndex=15, CanTSynGlobalTimeSyncDataIDListValue=226
  module config StbM: implementation-config-variant=VARIANT-PRE-COMPILE
    StbMGeneral: StbMDevErrorDetect=true, StbMGetCurrentTimeExtendedAvailable=false, StbMMainFunctionPeriod=0.005, StbMVersionInfoApi=false
    StbMRbExternalCounter_0 (StbMRbExternalCounter):
      StbMRbExternalCounterGetCounterValueCallback = Stbm_Get_CounterValue_Cbk
      StbMRbExternalCounterGetElapsedValueCallback = Stbm_Get_ElapsedValue_Cbk
      StbMRbExternalCounterTicksTonsCallback = Stbm_Tick_To_Ns_Cbk
    SynchTimeBase_1 (StbMSynchronizedTimeBase):
      StbMClearTimeleapCount = 3
      StbMIsSystemWideGlobalTimeMaster = false
      StbMStoreTimebaseNonVolatile = NO_STORAGE
      StbMSynchronizedTimeBaseIdentifier = 2
      StbMSyncLossTimeout = 1.75
      StbMTimeLeapFutureThreshold = 0.0017
      StbMTimeLeapPastThreshold = 0.0017
      StbMNotificationInterface = CALLBACK
      StbMStatusNotificationCallback = rbl_CustIf_TiSync_eventStatusCallback_AMG
      StbMStatusNotificationMask = 1536
      StbMLocalTimeClock: StbMClockFrequency=80000000, StbMClockPrescaler=1, StbMLocalTimeHardware=StbMRbExternalCounter_0
      StbMTimeCorrection:
        StbMOffsetCorrectionAdaptionInterval = 0.5
        StbMOffsetCorrectionJumpThreshold = 0
        StbMRateCorrectionMeasurementDuration = 15
        StbMRateCorrectionsPerMeasurementDuration = 1
    PureLocalTimeBase_1 (StbMSynchronizedTimeBase):
      StbMStoreTimebaseNonVolatile = NO_STORAGE
      StbMStoreTimebaseNonVolatile = NO_STORAGE
      StbMSynchronizedTimeBaseIdentifier = 33
      StbMAllowSystemWideGlobalTimeMaster = true
      StbMAllowSystemWideGlobalTimeMaster = true
      StbMIsSystemWideGlobalTimeMaster = true
      StbMIsSystemWideGlobalTimeMaster = true
      StbMNotificationInterface = NO_NOTIFICATION
      StbMNotificationInterface = NO_NOTIFICATION
      StbMLocalTimeClock:
        StbMClockFrequency = 80000000
        StbMClockFrequency = 80000000
        StbMClockPrescaler = 1
        StbMClockPrescaler = 1
        StbMLocalTimeHardware = StbMRbExternalCounter_0
        StbMLocalTimeHardware = StbMRbExternalCounter_0
      StbMTimeCorrection:
        StbMOffsetCorrectionAdaptionInterval = 0.5
        StbMOffsetCorrectionAdaptionInterval = 0.5
        StbMOffsetCorrectionJumpThreshold = 0
        StbMOffsetCorrectionJumpThreshold = 0
        StbMRateCorrectionMeasurementDuration = 15
        StbMRateCorrectionMeasurementDuration = 15
        StbMRateCorrectionsPerMeasurementDuration = 1
        StbMRateCorrectionsPerMeasurementDuration = 1
        StbMAllowMasterRateCorrection = true
        StbMAllowMasterRateCorrection = true
