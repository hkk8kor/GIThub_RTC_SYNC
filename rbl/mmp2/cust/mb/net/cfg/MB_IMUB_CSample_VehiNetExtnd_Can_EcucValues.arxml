AUTOSAR XML (schema 4-2-2)
package /RB/UBK/Project/EcucModuleConfigurationValuess
  module config Can
    CanConfigSet
      13 x CanHardwareObject, all with CanFdPaddingValue=0:
        NM_IMU_B_ST3_NM_IMU_B_ST3_5n3tsppcblgyfz59fa3fxhygu_HAD_IMU_HAD_IMU_OUT: CanHandleType=FULL, CanIdType=EXTENDED, CanObjectType=TRANSMIT, CanControllerRef=CanIfControllerConfig_1, CanMainFunctionRWPeriodRef=CanMainFunctionRWPeriods_5ms
        NM_Dummy_ST3_NM_Dummy_ST3_4gvn7tmtsz96dqioyz0hd4kkn_HAD_IMU_HAD_IMU_IN: CanHandleType=BASIC, CanIdType=EXTENDED, CanObjectType=RECEIVE, CanControllerRef=CanIfControllerConfig_1, CanMainFunctionRWPeriodRef=CanMainFunctionRWPeriods_5ms
          CanHwFilter_339869696_339873791 (CanHwFilter): CanHwFilterCode=339869696, CanHwFilterMask=536866816
        ECU_Stat_IMU_B_HAD_IMU_ST3_ECU_Stat_IMU_B_HAD_IMU_ST3_mbloiqkdp5lb15z5me61cuqm_HAD_IMU_HAD_IMU_OUT: CanHandleType=FULL, CanIdType=EXTENDED, CanObjectType=TRANSMIT, CanControllerRef=CanIfControllerConfig_1, CanMainFunctionRWPeriodRef=CanMainFunctionRWPeriods_5ms
        GTS_Main_CAN_ST3_GTS_Main_CAN_ST3_3roc9cgit8y88llo701fz09aw_IMU_INTERNAL_IMU_INTERNAL_IN: CanHandleType=FULL, CanIdType=STANDARD, CanObjectType=RECEIVE, CanControllerRef=CanIfControllerConfig_0
          CanHwFilter_121 (CanHwFilter): CanHwFilterCode=121, CanHwFilterMask=2047
        IMU_A_Output_Fast_ST3_IMU_A_Output_Fast_ST3_woybm2rrtdhdyb4ctf76rbch_HAD_IMU_HAD_IMU_OUT: CanHandleType=FULL, CanIdType=STANDARD, CanObjectType=TRANSMIT, CanControllerRef=CanIfControllerConfig_1
        IMU_A_Output_Fast_ST3_IMU_A_Output_Fast_ST3_d33wkvtuwgnwwqqgrob3dgi12_IMU_INTERNAL_IMU_INTERNAL_IN: CanHandleType=FULL, CanIdType=STANDARD, CanObjectType=RECEIVE, CanControllerRef=CanIfControllerConfig_0
          CanHwFilter_691 (CanHwFilter): CanHwFilterCode=691, CanHwFilterMask=2047
        ECU_Stat_IMU_B_ST3_ECU_Stat_IMU_B_ST3_7e1x143vymagm1ezvyz5npfy4_IMU_INTERNAL_IMU_INTERNAL_OUT: CanHandleType=FULL, CanIdType=EXTENDED, CanObjectType=TRANSMIT, CanControllerRef=CanIfControllerConfig_0, CanMainFunctionRWPeriodRef=CanMainFunctionRWPeriods_5ms
        ROE_IMU_B_ST3_ROE_IMU_B_ST3_d4w0rsqy5i9ayk13lul7n8ule_IMU_INTERNAL_IMU_INTERNAL_OUT: CanHandleType=FULL, CanIdType=EXTENDED, CanObjectType=TRANSMIT, CanControllerRef=CanIfControllerConfig_0, CanMainFunctionRWPeriodRef=CanMainFunctionRWPeriods_5ms
        Meas_IMU_B_ST3_Meas_IMU_B_ST3_631yonlt82o11862zaahbzgn4_IMU_INTERNAL_IMU_INTERNAL_OUT: CanHandleType=FULL, CanIdType=EXTENDED, CanObjectType=TRANSMIT, CanControllerRef=CanIfControllerConfig_1, CanMainFunctionRWPeriodRef=CanMainFunctionRWPeriods_5ms
        NM_IMU_B_ST3_NM_IMU_B_ST3_6a4t4fydo7fjdt7az7m07uidc_IMU_INTERNAL_IMU_INTERNAL_OUT: CanObjectType=TRANSMIT, CanIdType=EXTENDED, CanHandleType=FULL, CanControllerRef=CanIfControllerConfig_0, CanMainFunctionRWPeriodRef=CanMainFunctionRWPeriods_5ms
        NM_Dummy_ST3_NM_Dummy_ST3_47cxd2tpch3havy6ru1a9do2q_IMU_INTERNAL_IMU_INTERNAL_IN: CanObjectType=RECEIVE, CanIdType=EXTENDED, CanHandleType=BASIC, CanControllerRef=CanIfControllerConfig_0, CanMainFunctionRWPeriodRef=CanMainFunctionRWPeriods_5ms
          CanHwFilter_339869696_339873791 (CanHwFilter): CanHwFilterMask=536866816, CanHwFilterCode=339869696
        NM_IMU_B_ST3_NM_IMU_B_ST3_cv4dtcmsty3v1eswmmt9el4ga_DRIVING_DRIVING_OUT: CanObjectType=TRANSMIT, CanHandleType=FULL, CanIdType=EXTENDED, CanControllerRef=CanIfControllerConfig_2, CanMainFunctionRWPeriodRef=CanMainFunctionRWPeriods_5ms
        NM_Dummy_ST3_NM_Dummy_ST3_9v3d1gl8vye09x8qngb7pnawb_DRIVING_DRIVING_IN: CanObjectType=RECEIVE, CanIdType=EXTENDED, CanHandleType=BASIC, CanControllerRef=CanIfControllerConfig_2, CanMainFunctionRWPeriodRef=CanMainFunctionRWPeriods_5ms
          CanHwFilter_339869696_339873791 (CanHwFilter): CanHwFilterCode=339869696, CanHwFilterMask=536866816
  module config CanIf
    CanIfInitCfg
      6 x CanIfBufferCfg, all with CanIfBufferSize=0:
        Bu_NM_IMU_B_ST3_NM_IMU_B_ST3_5n3tsppcblgyfz59fa3fxhygu_HAD_IMU_HAD_IMU_OUT: CanIfBufferHthRef=CanIfInitHohCfg/NM_IMU_B_ST3_NM_IMU_B_ST3_5n3tsppcblgyfz59fa3fxhygu_HAD_IMU_HAD_IMU_OUT
        Bu_ECU_Stat_IMU_B_HAD_IMU_ST3_ECU_Stat_IMU_B_HAD_IMU_ST3_mbloiqkdp5lb15z5me61cuqm_HAD_IMU_HAD_IMU_OUT: CanIfBufferHthRef=CanIfInitHohCfg/ECU_Stat_IMU_B_HAD_IMU_ST3_ECU_Stat_IMU_B_HAD_IMU_ST3_mbloiqkdp5lb15z5me61cuqm_HAD_IMU_HAD_IMU_OUT
        Bu_IMU_A_Output_Fast_ST3_IMU_A_Output_Fast_ST3_woybm2rrtdhdyb4ctf76rbch_HAD_IMU_HAD_IMU_OUT: CanIfBufferHthRef=CanIfInitHohCfg/IMU_A_Output_Fast_ST3_IMU_A_Output_Fast_ST3_woybm2rrtdhdyb4ctf76rbch_HAD_IMU_HAD_IMU_OUT
        Bu_ECU_Stat_IMU_B_ST3_ECU_Stat_IMU_B_ST3_7e1x143vymagm1ezvyz5npfy4_IMU_INTERNAL_IMU_INTERNAL_OUT: CanIfBufferHthRef=CanIfInitHohCfg/ECU_Stat_IMU_B_ST3_ECU_Stat_IMU_B_ST3_7e1x143vymagm1ezvyz5npfy4_IMU_INTERNAL_IMU_INTERNAL_OUT
        Bu_ROE_IMU_B_ST3_ROE_IMU_B_ST3_d4w0rsqy5i9ayk13lul7n8ule_IMU_INTERNAL_IMU_INTERNAL_OUT: CanIfBufferHthRef=CanIfInitHohCfg/ROE_IMU_B_ST3_ROE_IMU_B_ST3_d4w0rsqy5i9ayk13lul7n8ule_IMU_INTERNAL_IMU_INTERNAL_OUT
        Bu_Meas_IMU_B_ST3_Meas_IMU_B_ST3_631yonlt82o11862zaahbzgn4_IMU_INTERNAL_IMU_INTERNAL_OUT: CanIfBufferHthRef=CanIfInitHohCfg/Meas_IMU_B_ST3_Meas_IMU_B_ST3_631yonlt82o11862zaahbzgn4_IMU_INTERNAL_IMU_INTERNAL_OUT
      CanIfInitHohCfg
        3 x CanIfHrhCfg:
          NM_Dummy_ST3_NM_Dummy_ST3_4gvn7tmtsz96dqioyz0hd4kkn_HAD_IMU_HAD_IMU_IN: CanIfHrhCanCtrlIdRef=CanIfControllerConfig_1, CanIfHrhIdSymRef=CanConfigSet/NM_Dummy_ST3_NM_Dummy_ST3_4gvn7tmtsz96dqioyz0hd4kkn_HAD_IMU_HAD_IMU_IN
            CanIfHrhRangeCfg: CanIfHrhRangeRxPduLowerCanId=339869696, CanIfHrhRangeRxPduRangeCanIdType=EXTENDED, CanIfHrhRangeRxPduUpperCanId=339873791
          GTS_Main_CAN_ST3_GTS_Main_CAN_ST3_3roc9cgit8y88llo701fz09aw_IMU_INTERNAL_IMU_INTERNAL_IN: CanIfHrhCanCtrlIdRef=CanIfControllerConfig_0, CanIfHrhIdSymRef=CanConfigSet/GTS_Main_CAN_ST3_GTS_Main_CAN_ST3_3roc9cgit8y88llo701fz09aw_IMU_INTERNAL_IMU_INTERNAL_IN
          IMU_A_Output_Fast_ST3_IMU_A_Output_Fast_ST3_d33wkvtuwgnwwqqgrob3dgi12_IMU_INTERNAL_IMU_INTERNAL_IN: CanIfHrhCanCtrlIdRef=CanIfControllerConfig_0, CanIfHrhIdSymRef=CanConfigSet/IMU_A_Output_Fast_ST3_IMU_A_Output_Fast_ST3_d33wkvtuwgnwwqqgrob3dgi12_IMU_INTERNAL_IMU_INTERNAL_IN
        7 x CanIfHthCfg:
          NM_IMU_B_ST3_NM_IMU_B_ST3_5n3tsppcblgyfz59fa3fxhygu_HAD_IMU_HAD_IMU_OUT: CanIfHthCanCtrlIdRef=CanIfControllerConfig_1, CanIfHthIdSymRef=CanConfigSet/NM_IMU_B_ST3_NM_IMU_B_ST3_5n3tsppcblgyfz59fa3fxhygu_HAD_IMU_HAD_IMU_OUT
          ECU_Stat_IMU_B_HAD_IMU_ST3_ECU_Stat_IMU_B_HAD_IMU_ST3_mbloiqkdp5lb15z5me61cuqm_HAD_IMU_HAD_IMU_OUT: CanIfHthCanCtrlIdRef=CanIfControllerConfig_1, CanIfHthIdSymRef=CanConfigSet/ECU_Stat_IMU_B_HAD_IMU_ST3_ECU_Stat_IMU_B_HAD_IMU_ST3_mbloiqkdp5lb15z5me61cuqm_HAD_IMU_HAD_IMU_OUT
          IMU_A_Output_Fast_ST3_IMU_A_Output_Fast_ST3_woybm2rrtdhdyb4ctf76rbch_HAD_IMU_HAD_IMU_OUT: CanIfHthCanCtrlIdRef=CanIfControllerConfig_1, CanIfHthIdSymRef=CanConfigSet/IMU_A_Output_Fast_ST3_IMU_A_Output_Fast_ST3_woybm2rrtdhdyb4ctf76rbch_HAD_IMU_HAD_IMU_OUT
          ECU_Stat_IMU_B_ST3_ECU_Stat_IMU_B_ST3_7e1x143vymagm1ezvyz5npfy4_IMU_INTERNAL_IMU_INTERNAL_OUT: CanIfHthCanCtrlIdRef=CanIfControllerConfig_0, CanIfHthIdSymRef=CanConfigSet/ECU_Stat_IMU_B_ST3_ECU_Stat_IMU_B_ST3_7e1x143vymagm1ezvyz5npfy4_IMU_INTERNAL_IMU_INTERNAL_OUT
          ROE_IMU_B_ST3_ROE_IMU_B_ST3_d4w0rsqy5i9ayk13lul7n8ule_IMU_INTERNAL_IMU_INTERNAL_OUT: CanIfHthCanCtrlIdRef=CanIfControllerConfig_0, CanIfHthIdSymRef=CanConfigSet/ROE_IMU_B_ST3_ROE_IMU_B_ST3_d4w0rsqy5i9ayk13lul7n8ule_IMU_INTERNAL_IMU_INTERNAL_OUT
          Meas_IMU_B_ST3_Meas_IMU_B_ST3_631yonlt82o11862zaahbzgn4_IMU_INTERNAL_IMU_INTERNAL_OUT: CanIfHthCanCtrlIdRef=CanIfControllerConfig_1, CanIfHthIdSymRef=CanConfigSet/Meas_IMU_B_ST3_Meas_IMU_B_ST3_631yonlt82o11862zaahbzgn4_IMU_INTERNAL_IMU_INTERNAL_OUT
          NM_IMU_B_ST3_NM_IMU_B_ST3_6a4t4fydo7fjdt7az7m07uidc_IMU_INTERNAL_IMU_INTERNAL_OUT: CanIfHthCanCtrlIdRef=CanIfControllerConfig_0, CanIfHthIdSymRef=CanConfigSet/NM_IMU_B_ST3_NM_IMU_B_ST3_6a4t4fydo7fjdt7az7m07uidc_IMU_INTERNAL_IMU_INTERNAL_OUT
        NM_Dummy_ST3_NM_Dummy_ST3_47cxd2tpch3havy6ru1a9do2q_IMU_INTERNAL_IMU_INTERNAL_IN (CanIfHrhCfg):
          CanIfHrhIdSymRef = CanConfigSet/NM_Dummy_ST3_NM_Dummy_ST3_47cxd2tpch3havy6ru1a9do2q_IMU_INTERNAL_IMU_INTERNAL_IN
          CanIfHrhCanCtrlIdRef = CanIfControllerConfig_0
          CanIfHrhRangeCfg: CanIfHrhRangeRxPduRangeCanIdType=EXTENDED, CanIfHrhRangeRxPduUpperCanId=339873791, CanIfHrhRangeRxPduLowerCanId=339869696
      3 x CanIfRxPduCfg, all with CanIfRxPduReadData=false, CanIfRxPduReadNotifyStatus=false:
        NM_Dummy_ST3_NM_Dummy_ST3_4gvn7tmtsz96dqioyz0hd4kkn_HAD_IMU_HAD_IMU_IN: CanIfRxPduCanIdType=EXTENDED_NO_FD_CAN, CanIfRxPduUserRxIndicationName=CanNm_RxIndication, CanIfRxPduUserRxIndicationUL=CAN_NM, CanIfRxPduDataLength=8, CanIfRxPduHrhIdRef=CanIfInitHohCfg/NM_Dummy_ST3_NM_Dummy_ST3_4gvn7tmtsz96dqioyz0hd4kkn_HAD_IMU_HAD_IMU_IN, CanIfRxPduRef=NM_Dummy_ST3_CanIf2CanNm_HAD_IMU_CAN
          CanIfRxPduCanIdRange: CanIfRxPduCanIdRangeLowerCanId=339869696, CanIfRxPduCanIdRangeUpperCanId=339873791
        GTS_Main_CAN_ST3_GTS_Main_CAN_ST3_3roc9cgit8y88llo701fz09aw_IMU_INTERNAL_IMU_INTERNAL_IN: CanIfRxPduCanId=121, CanIfRxPduCanIdType=STANDARD_FD_CAN, CanIfRxPduUserRxIndicationName=CanTSyn_RxIndication, CanIfRxPduUserRxIndicationUL=CAN_TSYN, CanIfRxPduDataLength=8, CanIfRxPduHrhIdRef=CanIfInitHohCfg/GTS_Main_CAN_ST3_GTS_Main_CAN_ST3_3roc9cgit8y88llo701fz09aw_IMU_INTERNAL_IMU_INTERNAL_IN, CanIfRxPduRef=GTS_Main_CAN_ST3_CanIf2CanTSyn_IMU_INTERNAL_CAN
        IMU_A_Output_Fast_ST3_IMU_A_Output_Fast_ST3_d33wkvtuwgnwwqqgrob3dgi12_IMU_INTERNAL_IMU_INTERNAL_IN: CanIfRxPduCanId=691, CanIfRxPduCanIdType=STANDARD_FD_CAN, CanIfRxPduUserRxIndicationName=PduR_CanIfRxIndication, CanIfRxPduUserRxIndicationUL=PDUR, CanIfRxPduDataLength=44, CanIfRxPduHrhIdRef=CanIfInitHohCfg/IMU_A_Output_Fast_ST3_IMU_A_Output_Fast_ST3_d33wkvtuwgnwwqqgrob3dgi12_IMU_INTERNAL_IMU_INTERNAL_IN, CanIfRxPduRef=EcucPduCollection/IMU_A_Output_Fast_ST3_secured_CanIf2PduR_IMU_INTERNAL_CAN
      7 x CanIfTxPduCfg, all with CanIfTxPduReadNotifyStatus=false:
        NM_IMU_B_ST3_NM_IMU_B_ST3_5n3tsppcblgyfz59fa3fxhygu_HAD_IMU_HAD_IMU_OUT: CanIfTxPduCanId=339870059, CanIfTxPduCanIdType=EXTENDED_CAN, CanIfTxPduPnFilterPdu=false, CanIfTxPduTruncation=false, CanIfTxPduUserTxConfirmationName=CanNm_TxConfirmation, CanIfTxPduUserTxConfirmationUL=CAN_NM, CanIfTxPduBufferRef=Bu_NM_IMU_B_ST3_NM_IMU_B_ST3_5n3tsppcblgyfz59fa3fxhygu_HAD_IMU_HAD_IMU_OUT, CanIfTxPduRef=NM_IMU_B_ST3_CanNm2CanIf_HAD_IMU_CAN
        ECU_Stat_IMU_B_HAD_IMU_ST3_ECU_Stat_IMU_B_HAD_IMU_ST3_mbloiqkdp5lb15z5me61cuqm_HAD_IMU_HAD_IMU_OUT: CanIfTxPduCanId=373424491, CanIfTxPduCanIdType=EXTENDED_FD_CAN, CanIfTxPduTruncation=false, CanIfTxPduUserTxConfirmationName=PduR_CanIfTxConfirmation, CanIfTxPduUserTxConfirmationUL=PDUR, CanIfTxPduBufferRef=Bu_ECU_Stat_IMU_B_HAD_IMU_ST3_ECU_Stat_IMU_B_HAD_IMU_ST3_mbloiqkdp5lb15z5me61cuqm_HAD_IMU_HAD_IMU_OUT, CanIfTxPduRef=EcucPduCollection/ECU_Stat_IMU_B_HAD_IMU_ST3_PduR2CanIf_HAD_IMU_CAN
        IMU_A_Output_Fast_ST3_IMU_A_Output_Fast_ST3_woybm2rrtdhdyb4ctf76rbch_HAD_IMU_HAD_IMU_OUT: CanIfTxPduCanId=691, CanIfTxPduCanIdType=STANDARD_FD_CAN, CanIfTxPduTruncation=true, CanIfTxPduType=STATIC, CanIfTxPduUserTxConfirmationName=PduR_CanIfTxConfirmation, CanIfTxPduUserTxConfirmationUL=PDUR, CanIfTxPduBufferRef=Bu_IMU_A_Output_Fast_ST3_IMU_A_Output_Fast_ST3_woybm2rrtdhdyb4ctf76rbch_HAD_IMU_HAD_IMU_OUT, CanIfTxPduRef=EcucPduCollection/IMU_A_Output_Fast_ST3_secured_PduR2CanIf_HAD_IMU_CAN
        ECU_Stat_IMU_B_ST3_ECU_Stat_IMU_B_ST3_7e1x143vymagm1ezvyz5npfy4_IMU_INTERNAL_IMU_INTERNAL_OUT: CanIfTxPduCanId=373424491, CanIfTxPduCanIdType=EXTENDED_FD_CAN, CanIfTxPduTruncation=false, CanIfTxPduUserTxConfirmationName=PduR_CanIfTxConfirmation, CanIfTxPduUserTxConfirmationUL=PDUR, CanIfTxPduBufferRef=Bu_ECU_Stat_IMU_B_ST3_ECU_Stat_IMU_B_ST3_7e1x143vymagm1ezvyz5npfy4_IMU_INTERNAL_IMU_INTERNAL_OUT, CanIfTxPduRef=EcucPduCollection/ECU_Stat_IMU_B_ST3_PduR2CanIf_IMU_INTERNAL_CAN
        ROE_IMU_B_ST3_ROE_IMU_B_ST3_d4w0rsqy5i9ayk13lul7n8ule_IMU_INTERNAL_IMU_INTERNAL_OUT: CanIfTxPduCanId=417426176, CanIfTxPduCanIdType=EXTENDED_FD_CAN, CanIfTxPduTruncation=false, CanIfTxPduUserTxConfirmationName=PduR_CanIfTxConfirmation, CanIfTxPduUserTxConfirmationUL=PDUR, CanIfTxPduBufferRef=Bu_ROE_IMU_B_ST3_ROE_IMU_B_ST3_d4w0rsqy5i9ayk13lul7n8ule_IMU_INTERNAL_IMU_INTERNAL_OUT, CanIfTxPduRef=EcucPduCollection/ROE_IMU_B_ST3_PduR2CanIf_IMU_INTERNAL_CAN
        Meas_IMU_B_ST3_Meas_IMU_B_ST3_631yonlt82o11862zaahbzgn4_IMU_INTERNAL_IMU_INTERNAL_OUT: CanIfTxPduCanId=417426320, CanIfTxPduCanIdType=EXTENDED_FD_CAN, CanIfTxPduTruncation=false, CanIfTxPduUserTxConfirmationName=PduR_CanIfTxConfirmation, CanIfTxPduUserTxConfirmationUL=PDUR, CanIfTxPduBufferRef=Bu_Meas_IMU_B_ST3_Meas_IMU_B_ST3_631yonlt82o11862zaahbzgn4_IMU_INTERNAL_IMU_INTERNAL_OUT, CanIfTxPduRef=EcucPduCollection/Meas_IMU_B_ST3_PduR2CanIf_IMU_INTERNAL_CAN
        NM_IMU_B_ST3_NM_IMU_B_ST3_6a4t4fydo7fjdt7az7m07uidc_IMU_INTERNAL_IMU_INTERNAL_OUT: CanIfTxPduUserTxConfirmationName=CanNm_TxConfirmation, CanIfTxPduUserTxConfirmationUL=CAN_NM, CanIfTxPduCanIdType=EXTENDED_CAN, CanIfTxPduCanId=339870059, CanIfTxPduPnFilterPdu=false, CanIfTxPduTruncation=false, CanIfTxPduRef=NM_IMU_B_ST3_CanNm2CanIf_IMU_INTERNAL_CAN, CanIfTxPduBufferRef=Bu_NM_IMU_B_ST3_NM_IMU_B_ST3_6a4t4fydo7fjdt7az7m07uidc_IMU_INTERNAL_IMU_INTERNAL_OUT
      Bu_NM_IMU_B_ST3_NM_IMU_B_ST3_6a4t4fydo7fjdt7az7m07uidc_IMU_INTERNAL_IMU_INTERNAL_OUT (CanIfBufferCfg): CanIfBufferSize=0, CanIfBufferHthRef=CanIfInitHohCfg/NM_IMU_B_ST3_NM_IMU_B_ST3_6a4t4fydo7fjdt7az7m07uidc_IMU_INTERNAL_IMU_INTERNAL_OUT
      NM_Dummy_ST3_NM_Dummy_ST3_47cxd2tpch3havy6ru1a9do2q_IMU_INTERNAL_IMU_INTERNAL_IN (CanIfRxPduCfg):
        CanIfRxPduUserRxIndicationUL = CAN_NM
        CanIfRxPduDataLength = 8
        CanIfRxPduCanIdType = EXTENDED_NO_FD_CAN
        CanIfRxPduUserRxIndicationName = CanNm_RxIndication
        CanIfRxPduReadData = false
        CanIfRxPduReadNotifyStatus = false
        CanIfRxPduRef = NM_Dummy_ST3_CanIf2CanNm_IMU_INTERNAL_CAN
        CanIfRxPduHrhIdRef = CanIfInitHohCfg/NM_Dummy_ST3_NM_Dummy_ST3_47cxd2tpch3havy6ru1a9do2q_IMU_INTERNAL_IMU_INTERNAL_IN
        CanIfRxPduCanIdRange: CanIfRxPduCanIdRangeLowerCanId=339869696, CanIfRxPduCanIdRangeUpperCanId=339873791
  module config CanNm: implementation-config-variant=VARIANT-PRE-COMPILE
    CanNmGlobalConfig
      3 x CanNmChannelConfig, all with CanNmAllNmMessagesKeepAwake=true, CanNmBusLoadReductionActive=false, CanNmCarWakeUpRxEnabled=false, CanNmImmediateNmCycleTime=0.02, CanNmImmediateNmTransmissions=6, CanNmMsgCycleOffset=0.0, CanNmMsgCycleTime=1.0, CanNmMsgTimeoutTime=0.5, CanNmNodeDetectionEnabled=false, CanNmPduCbvPosition=CANNM_PDU_BYTE_0, CanNmPduNidPosition=CANNM_PDU_OFF, CanNmPnEnabled=true, CanNmRemoteSleepIndTime=2.5, CanNmRepeatMessageTime=3.0, CanNmRepeatMsgIndEnabled=false, CanNmTimeoutTime=2.5, CanNmWaitBusSleepTime=1.5, CanNmPnEraCalcEnabled=true, CanNmPnHandleMultipleNetworkRequests=true, CanNmActiveWakeupBitEnabled=true, CanNmSynchronizedPncShutdownEnabled=false:
        CanNmCC_HAD_IMU_2: CanNmNodeId=1, CanNmNodeIdEnabled=false, CanNmComMNetworkHandleRef=ComMChannel_Can1, CanNmPnEraRxNSduRef=NM_IMU_B_ST3_ERA_CanNm2PduR_HAD_IMU_CAN
          NM_Dummy_ST3_HAD_IMU (CanNmRxPdu): CanNmRxPduRef=NM_Dummy_ST3_CanIf2CanNm_HAD_IMU_CAN
          NM_IMU_B_ST3_HAD_IMU (CanNmTxPdu): CanNmTxPduRef=NM_IMU_B_ST3_CanNm2CanIf_HAD_IMU_CAN
          NM_IMU_B_ST3_UserData_HAD_IMU (CanNmUserDataTxPdu): CanNmTxUserDataPduRef=EcucPduCollection/NM_IMU_B_ST3_PduR2CanNm_HAD_IMU_CAN
        CanNmCC_IMU_INTERNAL_3: CanNmNodeIdEnabled=false, CanNmNodeId=0, CanNmComMNetworkHandleRef=ComMChannel_Can, CanNmPnEraRxNSduRef=NM_IMU_B_ST3_ERA_CanNm2PduR_INTERNAL_CAN
          NM_Dummy_ST3_IMU_INTERNAL (CanNmRxPdu): CanNmRxPduRef=NM_Dummy_ST3_CanIf2CanNm_IMU_INTERNAL_CAN
          NM_IMU_B_ST3_IMU_INTERNAL (CanNmTxPdu): CanNmTxPduRef=NM_IMU_B_ST3_CanNm2CanIf_IMU_INTERNAL_CAN
          NM_IMU_B_ST3_UserData_IMU_INTERNAL (CanNmUserDataTxPdu): CanNmTxUserDataPduRef=EcucPduCollection/NM_IMU_B_ST3_PduR2CanNm_IMU_INTERNAL_CAN
        CanNmCC_DRIVING_1: CanNmNodeIdEnabled=false, CanNmNodeIdEnabled=false, CanNmNodeId=2, CanNmComMNetworkHandleRef=ComMChannel_Can2, CanNmPnEraRxNSduRef=NM_IMU_B_ST3_ERA_CanNm2PduR_DRIVING_CAN
          NM_IMU_B_ST3_DRIVING (CanNmTxPdu): CanNmTxPduRef=NM_IMU_B_ST3_CanNm2CanIf_DRIVING_CAN
          NM_IMU_B_ST3_UserData_DRIVING (CanNmUserDataTxPdu): CanNmTxUserDataPduRef=NM_IMU_B_ST3_PduR2CanNm_DRIVING_CAN
          NM_Dummy_ST3_DRIVING (CanNmRxPdu): CanNmRxPduRef=NM_Dummy_ST3_CanIf2CanNm_DRIVING_CAN
  module config Com
    ComConfig
      5 x ComIPdu, all with ComIPduDirection=SEND, ComIPduSignalProcessing=DEFERRED, ComIPduType=NORMAL:
        IP_ECU_Stat_IMU_B_HAD_IMU_ST3_CAN_Tx: ComIPduSignalRef=S_Awake_Diag_Actv_IMU_B_ST3_HAD_IMU_CAN_Tx, ComIPduSignalRef=S_Awake_NwStart_IMU_B_ST3_HAD_IMU_CAN_Tx, ComIPduSignalRef=S_ECU_Id_IMU_B_ST3_HAD_IMU_CAN_Tx, ComIPduSignalRef=S_NwId_HAD_IMU_ST3_CAN_Tx, ComIPduSignalRef=S_WakeupRsn_IMU_B_ST3_HAD_IMU_CAN_Tx, ComPduIdRef=EcucPduCollection/ECU_Stat_IMU_B_HAD_IMU_ST3_Com2PduR_HAD_IMU_CAN, ComIPduGroupRef=IPG_IMU_B_HAD_IMU_Tx_PNC_All_Active_CAN, ComIPduGroupRef=IPG_IMU_B_HAD_IMU_Tx_PNC_20_CAN, ComIPduGroupRef=IPG_IMU_B_HAD_IMU_Tx_PNC_23_CAN
          ComTxIPdu: ComTxIPduUnusedAreasDefault=0, ComMinimumDelayTime=1.0
            ComTxModeTrue
              ComTxMode: ComTxModeMode=MIXED, ComTxModeTimeOffset=0.005, ComTxModeTimePeriod=1.0
        IP_NM_IMU_B_ST3_HAD_IMU_CAN_Tx: ComIPduSignalRef=S_NM_IMU_B_ST3_PNC_HAD_IMU_CAN_Tx, ComPduIdRef=EcucPduCollection/NM_IMU_B_ST3_Com2PduR_HAD_IMU_CAN, ComIPduGroupRef=IPG_IMU_B_NM_TX_All_CAN
          ComTxIPdu: ComTxIPduUnusedAreasDefault=0
            ComTxModeTrue
              ComTxMode: ComTxModeMode=NONE
        IP_ROE_IMU_B_ST3_IMU_INTERNAL_CAN_Tx: ComIPduGroupRef=IPG_IMU_B_IMU_INTERNAL_Tx_PNC_All_Active_CAN, ComIPduGroupRef=IPG_IMU_B_IMU_INTERNAL_Tx_PNC_20_CAN, ComIPduSignalGroupRef=SG_ROE_IMU_B_ST3_7zavpp3siu6s2eitdaqxg7lwg_IMU_INTERNAL_CAN_Tx, ComPduIdRef=EcucPduCollection/ROE_IMU_B_ST3_Com2PduR_IMU_INTERNAL_CAN
          ComTxIPdu: ComMinimumDelayTime=0.2, ComTxIPduUnusedAreasDefault=0
            ComTxModeTrue
              ComTxMode: ComTxModeMode=DIRECT, ComTxModeNumberOfRepetitions=0
        IP_Meas_IMU_B_ST3_IMU_INTERNAL_CAN_Tx: ComIPduGroupRef=IPG_IMU_B_HAD_IMU_Tx_PNC_All_Active_CAN, ComIPduGroupRef=IPG_IMU_B_HAD_IMU_Tx_PNC_20_CAN, ComIPduSignalGroupRef=SG_Meas_IMU_B_ST3_9b4k5uqw790qkzbaaznvwy423_IMU_INTERNAL_CAN_Tx, ComPduIdRef=EcucPduCollection/Meas_IMU_B_ST3_Com2PduR_IMU_INTERNAL_CAN
          ComTxIPdu: ComMinimumDelayTime=0.5, ComTxIPduUnusedAreasDefault=0
            ComTxModeTrue
              ComTxMode: ComTxModeMode=DIRECT, ComTxModeNumberOfRepetitions=0
        IP_ECU_Stat_IMU_B_ST3_IMU_INTERNAL_CAN_Tx: ComIPduSignalRef=S_Awake_Diag_Actv_IMU_B_ST3_IMU_INTERNAL_CAN_Tx, ComIPduSignalRef=S_Awake_NwStart_IMU_B_ST3_IMU_INTERNAL_CAN_Tx, ComIPduSignalRef=S_ECU_Id_IMU_B_ST3_IMU_INTERNAL_CAN_Tx, ComIPduSignalRef=S_WakeupRsn_IMU_B_ST3_IMU_INTERNAL_CAN_Tx, ComIPduSignalRef=S_NwId_Rsrv_ST3_IMU_INTERNAL_CAN_Tx, ComPduIdRef=EcucPduCollection/ECU_Stat_IMU_B_ST3_Com2PduR_IMU_INTERNAL_CAN, ComIPduGroupRef=IPG_IMU_B_IMU_INTERNAL_Tx_PNC_All_Active_CAN, ComIPduGroupRef=IPG_IMU_B_IMU_INTERNAL_Tx_PNC_20_CAN, ComIPduGroupRef=IPG_IMU_B_IMU_INTERNAL_Tx_PNC_23_CAN
          ComTxIPdu: ComTxIPduUnusedAreasDefault=0, ComMinimumDelayTime=1
            ComTxModeTrue
              ComTxMode: ComTxModeMode=MIXED, ComTxModeTimeOffset=0.005, ComTxModeTimePeriod=1.0
      5 x ComIPduGroup:
        IPG_IMU_B_HAD_IMU_Tx_PNC_All_Active_CAN
        IPG_IMU_B_HAD_IMU_Tx_PNC_20_CAN
        IPG_IMU_B_IMU_INTERNAL_Rx_PNC_All_Active_CAN
        IPG_IMU_B_NM_RX_All_CAN
        IPG_IMU_B_NM_TX_All_CAN
      3 x ComIPdu, all with ComIPduDirection=RECEIVE, ComIPduSignalProcessing=DEFERRED, ComIPduType=NORMAL, ComIPduGroupRef=IPG_IMU_B_NM_RX_All_CAN:
        IP_NmPnEraRxNSduRef_DRIVING_CAN_Rx: ComIPduSignalRef=S_NM_IMU_B_CanNmUserDataSig_Era_DRIVING_CAN_Rx, ComPduIdRef=NM_IMU_B_ST3_ERA_PduR2Com_DRIVING_CAN
        IP_NmPnEraRxNSduRef_HAD_IMU_CAN_Rx: ComIPduSignalRef=S_NM_IMU_B_CanNmUserDataSig_Era_HAD_IMU_CAN_Rx, ComPduIdRef=NM_IMU_B_ST3_ERA_PduR2Com_HAD_IMU_CAN
        IP_NmPnEraRxNSduRef_INTERNAL_CAN_Rx: ComIPduSignalRef=S_NM_IMU_B_CanNmUserDataSig_Era_INTERNAL_CAN_Rx, ComPduIdRef=NM_IMU_B_ST3_ERA_PduR2Com_INTERNAL_CAN
      4 x ComIPduGroup:
        IPG_IMU_B_IMU_INTERNAL_Rx_PNC_15_ComCtrl_CAN
        IPG_IMU_B_IMU_INTERNAL_Rx_PNC_20_CAN
        IPG_IMU_B_IMU_INTERNAL_Tx_PNC_All_Active_CAN
        IPG_IMU_B_IMU_INTERNAL_Tx_PNC_20_CAN
      ComMainFunctionRx: ComMainRxTimeBase=0.005, ComMainRxPartitionRef=EcucPartition_0
      ComMainFunctionTx: ComMainTxTimeBase=0.005, ComMainTxPartitionRef=EcucPartition_0
      S_Awake_Diag_Actv_IMU_B_ST3_HAD_IMU_CAN_Tx (ComSignal):
        ComBitPosition = 30
        ComBitSize = 1
        ComSignalEndianness = LITTLE_ENDIAN
        ComSignalType = BOOLEAN
        ComTransferProperty = TRIGGERED
        ComSignalInitValue = 0
        ComSystemTemplateSystemSignalRef = Awake_Diag_Actv_IMU_B_ST3
      3 x ComIPduGroup:
        IPG_IMU_B_HAD_IMU_Rx_PNC_All_Active_CAN
        IPG_IMU_B_HAD_IMU_Rx_PNC_20_CAN
        IPG_IMU_B_HAD_IMU_Rx_PNC_23_CAN
      10 x ComSignal:
        S_Awake_NwStart_IMU_B_ST3_HAD_IMU_CAN_Tx: ComBitPosition=31, ComBitSize=1, ComSignalEndianness=LITTLE_ENDIAN, ComSignalType=BOOLEAN, ComTransferProperty=TRIGGERED, ComSignalInitValue=0, ComSystemTemplateSystemSignalRef=Awake_NwStart_IMU_B_ST3
        S_ECU_Id_IMU_B_ST3_HAD_IMU_CAN_Tx: ComBitPosition=0, ComBitSize=12, ComSignalEndianness=LITTLE_ENDIAN, ComSignalType=UINT16, ComTransferProperty=TRIGGERED, ComSignalInitValue=363, ComSystemTemplateSystemSignalRef=ECU_Id_IMU_B_ST3
        S_NwId_HAD_IMU_ST3_CAN_Tx: ComBitPosition=12, ComBitSize=8, ComSignalEndianness=LITTLE_ENDIAN, ComSignalType=UINT8, ComTransferProperty=TRIGGERED, ComSignalInitValue=46, ComSystemTemplateSystemSignalRef=NwId_HAD_IMU_ST3
        S_WakeupRsn_IMU_B_ST3_HAD_IMU_CAN_Tx: ComBitPosition=20, ComBitSize=10, ComSignalEndianness=LITTLE_ENDIAN, ComSignalType=UINT16, ComTransferProperty=TRIGGERED, ComSignalInitValue=1023, ComSystemTemplateSystemSignalRef=WakeupRsn_IMU_B_ST3
        S_NM_IMU_B_ST3_PNC_HAD_IMU_CAN_Tx: ComBitPosition=8, ComSignalEndianness=opaque, ComSignalLength=7, ComSignalType=UINT8_N, ComBitSize=56, ComSignalInitValue=0 0 0 0 0 0 0, ComSystemTemplateSystemSignalRef=NM_IMU_B_ST3_PNC
        S_Awake_Diag_Actv_IMU_B_ST3_IMU_INTERNAL_CAN_Tx: ComBitPosition=30, ComBitSize=1, ComSignalEndianness=LITTLE_ENDIAN, ComSignalType=BOOLEAN, ComSignalInitValue=0, ComTransferProperty=TRIGGERED, ComSystemTemplateSystemSignalRef=Awake_Diag_Actv_IMU_B_ST3
        S_Awake_NwStart_IMU_B_ST3_IMU_INTERNAL_CAN_Tx: ComBitPosition=31, ComBitSize=1, ComSignalEndianness=LITTLE_ENDIAN, ComSignalType=BOOLEAN, ComSignalInitValue=0, ComTransferProperty=TRIGGERED, ComSystemTemplateSystemSignalRef=Awake_NwStart_IMU_B_ST3
        S_ECU_Id_IMU_B_ST3_IMU_INTERNAL_CAN_Tx: ComBitPosition=0, ComBitSize=12, ComSignalEndianness=LITTLE_ENDIAN, ComSignalType=UINT16, ComSignalInitValue=363, ComTransferProperty=TRIGGERED, ComSystemTemplateSystemSignalRef=ECU_Id_IMU_B_ST3
        S_WakeupRsn_IMU_B_ST3_IMU_INTERNAL_CAN_Tx: ComBitPosition=20, ComBitSize=10, ComSignalEndianness=LITTLE_ENDIAN, ComSignalType=UINT16, ComSignalInitValue=1023, ComTransferProperty=TRIGGERED, ComSystemTemplateSystemSignalRef=WakeupRsn_IMU_B_ST3
        S_NwId_Rsrv_ST3_IMU_INTERNAL_CAN_Tx: ComBitPosition=12, ComBitSize=8, ComSignalEndianness=LITTLE_ENDIAN, ComSignalType=UINT8, ComSignalInitValue=0, ComTransferProperty=TRIGGERED, ComSystemTemplateSystemSignalRef=NwId_Rsrv_ST3
      SG_ROE_IMU_B_ST3_7zavpp3siu6s2eitdaqxg7lwg_IMU_INTERNAL_CAN_Tx (ComSignalGroup): ComSignalGroupArrayAccess=false, ComTransferProperty=TRIGGERED, ComSystemTemplateSignalGroupRef=ROE_IMU_B_ST3_7zavpp3siu6s2eitdaqxg7lwg
        8 x ComGroupSignal, all with ComBitSize=8, ComSignalEndianness=LITTLE_ENDIAN, ComSignalType=UINT8, ComSignalInitValue=0:
          GS_ROE_0_IMU_B_ST3_IMU_INTERNAL_CAN_Tx: ComBitPosition=0, ComSystemTemplateSystemSignalRef=ROE_0_IMU_B_ST3
          GS_ROE_1_IMU_B_ST3_IMU_INTERNAL_CAN_Tx: ComBitPosition=8, ComSystemTemplateSystemSignalRef=ROE_1_IMU_B_ST3
          GS_ROE_2_IMU_B_ST3_IMU_INTERNAL_CAN_Tx: ComBitPosition=16, ComSystemTemplateSystemSignalRef=ROE_2_IMU_B_ST3
          GS_ROE_3_IMU_B_ST3_IMU_INTERNAL_CAN_Tx: ComBitPosition=24, ComSystemTemplateSystemSignalRef=ROE_3_IMU_B_ST3
          GS_ROE_4_IMU_B_ST3_IMU_INTERNAL_CAN_Tx: ComBitPosition=32, ComSystemTemplateSystemSignalRef=ROE_4_IMU_B_ST3
          GS_ROE_5_IMU_B_ST3_IMU_INTERNAL_CAN_Tx: ComBitPosition=40, ComSystemTemplateSystemSignalRef=ROE_5_IMU_B_ST3
          GS_ROE_6_IMU_B_ST3_IMU_INTERNAL_CAN_Tx: ComBitPosition=48, ComSystemTemplateSystemSignalRef=ROE_6_IMU_B_ST3
          GS_ROE_7_IMU_B_ST3_IMU_INTERNAL_CAN_Tx: ComBitPosition=56, ComSystemTemplateSystemSignalRef=ROE_7_IMU_B_ST3
      SG_Meas_IMU_B_ST3_9b4k5uqw790qkzbaaznvwy423_IMU_INTERNAL_CAN_Tx (ComSignalGroup): ComSignalGroupArrayAccess=false, ComTransferProperty=TRIGGERED, ComSystemTemplateSignalGroupRef=Meas_IMU_B_ST3_9b4k5uqw790qkzbaaznvwy423
        64 x ComGroupSignal, all with ComBitSize=8, ComSignalEndianness=LITTLE_ENDIAN, ComSignalType=UINT8, ComSignalInitValue=0:
          GS_Meas_IMU_B_01_ST3_IMU_INTERNAL_CAN_Tx: ComBitPosition=0, ComSystemTemplateSystemSignalRef=Meas_IMU_B_01_ST3
          GS_Meas_IMU_B_02_ST3_IMU_INTERNAL_CAN_Tx: ComBitPosition=8, ComSystemTemplateSystemSignalRef=Meas_IMU_B_02_ST3
          GS_Meas_IMU_B_03_ST3_IMU_INTERNAL_CAN_Tx: ComBitPosition=16, ComSystemTemplateSystemSignalRef=Meas_IMU_B_03_ST3
          GS_Meas_IMU_B_04_ST3_IMU_INTERNAL_CAN_Tx: ComBitPosition=24, ComSystemTemplateSystemSignalRef=Meas_IMU_B_04_ST3
          GS_Meas_IMU_B_05_ST3_IMU_INTERNAL_CAN_Tx: ComBitPosition=32, ComSystemTemplateSystemSignalRef=Meas_IMU_B_05_ST3
          GS_Meas_IMU_B_06_ST3_IMU_INTERNAL_CAN_Tx: ComBitPosition=40, ComSystemTemplateSystemSignalRef=Meas_IMU_B_06_ST3
          GS_Meas_IMU_B_07_ST3_IMU_INTERNAL_CAN_Tx: ComBitPosition=48, ComSystemTemplateSystemSignalRef=Meas_IMU_B_07_ST3
          GS_Meas_IMU_B_08_ST3_IMU_INTERNAL_CAN_Tx: ComBitPosition=56, ComSystemTemplateSystemSignalRef=Meas_IMU_B_08_ST3
          GS_Meas_IMU_B_09_ST3_IMU_INTERNAL_CAN_Tx: ComBitPosition=64, ComSystemTemplateSystemSignalRef=Meas_IMU_B_09_ST3
          GS_Meas_IMU_B_10_ST3_IMU_INTERNAL_CAN_Tx: ComBitPosition=72, ComSystemTemplateSystemSignalRef=Meas_IMU_B_10_ST3
          GS_Meas_IMU_B_11_ST3_IMU_INTERNAL_CAN_Tx: ComBitPosition=80, ComSystemTemplateSystemSignalRef=Meas_IMU_B_11_ST3
          GS_Meas_IMU_B_12_ST3_IMU_INTERNAL_CAN_Tx: ComBitPosition=88, ComSystemTemplateSystemSignalRef=Meas_IMU_B_12_ST3
          GS_Meas_IMU_B_13_ST3_IMU_INTERNAL_CAN_Tx: ComBitPosition=96, ComSystemTemplateSystemSignalRef=Meas_IMU_B_13_ST3
          GS_Meas_IMU_B_14_ST3_IMU_INTERNAL_CAN_Tx: ComBitPosition=104, ComSystemTemplateSystemSignalRef=Meas_IMU_B_14_ST3
          GS_Meas_IMU_B_15_ST3_IMU_INTERNAL_CAN_Tx: ComBitPosition=112, ComSystemTemplateSystemSignalRef=Meas_IMU_B_15_ST3
          GS_Meas_IMU_B_16_ST3_IMU_INTERNAL_CAN_Tx: ComBitPosition=120, ComSystemTemplateSystemSignalRef=Meas_IMU_B_16_ST3
          GS_Meas_IMU_B_17_ST3_IMU_INTERNAL_CAN_Tx: ComBitPosition=128, ComSystemTemplateSystemSignalRef=Meas_IMU_B_17_ST3
          GS_Meas_IMU_B_18_ST3_IMU_INTERNAL_CAN_Tx: ComBitPosition=136, ComSystemTemplateSystemSignalRef=Meas_IMU_B_18_ST3
          GS_Meas_IMU_B_19_ST3_IMU_INTERNAL_CAN_Tx: ComBitPosition=144, ComSystemTemplateSystemSignalRef=Meas_IMU_B_19_ST3
          GS_Meas_IMU_B_20_ST3_IMU_INTERNAL_CAN_Tx: ComBitPosition=152, ComSystemTemplateSystemSignalRef=Meas_IMU_B_20_ST3
          GS_Meas_IMU_B_21_ST3_IMU_INTERNAL_CAN_Tx: ComBitPosition=160, ComSystemTemplateSystemSignalRef=Meas_IMU_B_21_ST3
          GS_Meas_IMU_B_22_ST3_IMU_INTERNAL_CAN_Tx: ComBitPosition=168, ComSystemTemplateSystemSignalRef=Meas_IMU_B_22_ST3
          GS_Meas_IMU_B_23_ST3_IMU_INTERNAL_CAN_Tx: ComBitPosition=176, ComSystemTemplateSystemSignalRef=Meas_IMU_B_23_ST3
          GS_Meas_IMU_B_24_ST3_IMU_INTERNAL_CAN_Tx: ComBitPosition=184, ComSystemTemplateSystemSignalRef=Meas_IMU_B_24_ST3
          GS_Meas_IMU_B_25_ST3_IMU_INTERNAL_CAN_Tx: ComBitPosition=192, ComSystemTemplateSystemSignalRef=Meas_IMU_B_25_ST3
          GS_Meas_IMU_B_26_ST3_IMU_INTERNAL_CAN_Tx: ComBitPosition=200, ComSystemTemplateSystemSignalRef=Meas_IMU_B_26_ST3
          GS_Meas_IMU_B_27_ST3_IMU_INTERNAL_CAN_Tx: ComBitPosition=208, ComSystemTemplateSystemSignalRef=Meas_IMU_B_27_ST3
          GS_Meas_IMU_B_28_ST3_IMU_INTERNAL_CAN_Tx: ComBitPosition=216, ComSystemTemplateSystemSignalRef=Meas_IMU_B_28_ST3
          GS_Meas_IMU_B_29_ST3_IMU_INTERNAL_CAN_Tx: ComBitPosition=224, ComSystemTemplateSystemSignalRef=Meas_IMU_B_29_ST3
          GS_Meas_IMU_B_30_ST3_IMU_INTERNAL_CAN_Tx: ComBitPosition=232, ComSystemTemplateSystemSignalRef=Meas_IMU_B_30_ST3
          GS_Meas_IMU_B_31_ST3_IMU_INTERNAL_CAN_Tx: ComBitPosition=240, ComSystemTemplateSystemSignalRef=Meas_IMU_B_31_ST3
          GS_Meas_IMU_B_32_ST3_IMU_INTERNAL_CAN_Tx: ComBitPosition=248, ComSystemTemplateSystemSignalRef=Meas_IMU_B_32_ST3
          GS_Meas_IMU_B_33_ST3_IMU_INTERNAL_CAN_Tx: ComBitPosition=256, ComSystemTemplateSystemSignalRef=Meas_IMU_B_33_ST3
          GS_Meas_IMU_B_34_ST3_IMU_INTERNAL_CAN_Tx: ComBitPosition=264, ComSystemTemplateSystemSignalRef=Meas_IMU_B_34_ST3
          GS_Meas_IMU_B_35_ST3_IMU_INTERNAL_CAN_Tx: ComBitPosition=272, ComSystemTemplateSystemSignalRef=Meas_IMU_B_35_ST3
          GS_Meas_IMU_B_36_ST3_IMU_INTERNAL_CAN_Tx: ComBitPosition=280, ComSystemTemplateSystemSignalRef=Meas_IMU_B_36_ST3
          GS_Meas_IMU_B_37_ST3_IMU_INTERNAL_CAN_Tx: ComBitPosition=288, ComSystemTemplateSystemSignalRef=Meas_IMU_B_37_ST3
          GS_Meas_IMU_B_38_ST3_IMU_INTERNAL_CAN_Tx: ComBitPosition=296, ComSystemTemplateSystemSignalRef=Meas_IMU_B_38_ST3
          GS_Meas_IMU_B_39_ST3_IMU_INTERNAL_CAN_Tx: ComBitPosition=304, ComSystemTemplateSystemSignalRef=Meas_IMU_B_39_ST3
          GS_Meas_IMU_B_40_ST3_IMU_INTERNAL_CAN_Tx: ComBitPosition=312, ComSystemTemplateSystemSignalRef=Meas_IMU_B_40_ST3
          GS_Meas_IMU_B_41_ST3_IMU_INTERNAL_CAN_Tx: ComBitPosition=320, ComSystemTemplateSystemSignalRef=Meas_IMU_B_41_ST3
          GS_Meas_IMU_B_42_ST3_IMU_INTERNAL_CAN_Tx: ComBitPosition=328, ComSystemTemplateSystemSignalRef=Meas_IMU_B_42_ST3
          GS_Meas_IMU_B_43_ST3_IMU_INTERNAL_CAN_Tx: ComBitPosition=336, ComSystemTemplateSystemSignalRef=Meas_IMU_B_43_ST3
          GS_Meas_IMU_B_44_ST3_IMU_INTERNAL_CAN_Tx: ComBitPosition=344, ComSystemTemplateSystemSignalRef=Meas_IMU_B_44_ST3
          GS_Meas_IMU_B_45_ST3_IMU_INTERNAL_CAN_Tx: ComBitPosition=352, ComSystemTemplateSystemSignalRef=Meas_IMU_B_45_ST3
          GS_Meas_IMU_B_46_ST3_IMU_INTERNAL_CAN_Tx: ComBitPosition=360, ComSystemTemplateSystemSignalRef=Meas_IMU_B_46_ST3
          GS_Meas_IMU_B_47_ST3_IMU_INTERNAL_CAN_Tx: ComBitPosition=368, ComSystemTemplateSystemSignalRef=Meas_IMU_B_47_ST3
          GS_Meas_IMU_B_48_ST3_IMU_INTERNAL_CAN_Tx: ComBitPosition=376, ComSystemTemplateSystemSignalRef=Meas_IMU_B_48_ST3
          GS_Meas_IMU_B_49_ST3_IMU_INTERNAL_CAN_Tx: ComBitPosition=384, ComSystemTemplateSystemSignalRef=Meas_IMU_B_49_ST3
          GS_Meas_IMU_B_50_ST3_IMU_INTERNAL_CAN_Tx: ComBitPosition=392, ComSystemTemplateSystemSignalRef=Meas_IMU_B_50_ST3
          GS_Meas_IMU_B_51_ST3_IMU_INTERNAL_CAN_Tx: ComBitPosition=400, ComSystemTemplateSystemSignalRef=Meas_IMU_B_51_ST3
          GS_Meas_IMU_B_52_ST3_IMU_INTERNAL_CAN_Tx: ComBitPosition=408, ComSystemTemplateSystemSignalRef=Meas_IMU_B_52_ST3
          GS_Meas_IMU_B_53_ST3_IMU_INTERNAL_CAN_Tx: ComBitPosition=416, ComSystemTemplateSystemSignalRef=Meas_IMU_B_53_ST3
          GS_Meas_IMU_B_54_ST3_IMU_INTERNAL_CAN_Tx: ComBitPosition=424, ComSystemTemplateSystemSignalRef=Meas_IMU_B_54_ST3
          GS_Meas_IMU_B_55_ST3_IMU_INTERNAL_CAN_Tx: ComBitPosition=432, ComSystemTemplateSystemSignalRef=Meas_IMU_B_55_ST3
          GS_Meas_IMU_B_56_ST3_IMU_INTERNAL_CAN_Tx: ComBitPosition=440, ComSystemTemplateSystemSignalRef=Meas_IMU_B_56_ST3
          GS_Meas_IMU_B_57_ST3_IMU_INTERNAL_CAN_Tx: ComBitPosition=448, ComSystemTemplateSystemSignalRef=Meas_IMU_B_57_ST3
          GS_Meas_IMU_B_58_ST3_IMU_INTERNAL_CAN_Tx: ComBitPosition=456, ComSystemTemplateSystemSignalRef=Meas_IMU_B_58_ST3
          GS_Meas_IMU_B_59_ST3_IMU_INTERNAL_CAN_Tx: ComBitPosition=464, ComSystemTemplateSystemSignalRef=Meas_IMU_B_59_ST3
          GS_Meas_IMU_B_60_ST3_IMU_INTERNAL_CAN_Tx: ComBitPosition=472, ComSystemTemplateSystemSignalRef=Meas_IMU_B_60_ST3
          GS_Meas_IMU_B_61_ST3_IMU_INTERNAL_CAN_Tx: ComBitPosition=480, ComSystemTemplateSystemSignalRef=Meas_IMU_B_61_ST3
          GS_Meas_IMU_B_62_ST3_IMU_INTERNAL_CAN_Tx: ComBitPosition=488, ComSystemTemplateSystemSignalRef=Meas_IMU_B_62_ST3
          GS_Meas_IMU_B_63_ST3_IMU_INTERNAL_CAN_Tx: ComBitPosition=496, ComSystemTemplateSystemSignalRef=Meas_IMU_B_63_ST3
          GS_Meas_IMU_B_64_ST3_IMU_INTERNAL_CAN_Tx: ComBitPosition=504, ComSystemTemplateSystemSignalRef=Meas_IMU_B_64_ST3
      IP_NM_IMU_B_ST3_IMU_INTERNAL_CAN_Tx (ComIPdu):
        ComIPduDirection = SEND
        ComIPduType = NORMAL
        ComIPduSignalProcessing = DEFERRED
        ComIPduSignalRef = S_NM_IMU_B_ST3_PNC_IMU_INTERNAL_CAN_Tx
        ComPduIdRef = EcucPduCollection/NM_IMU_B_ST3_Com2PduR_IMU_INTERNAL_CAN
        ComIPduGroupRef = IPG_IMU_B_NM_TX_All_CAN
        ComTxIPdu: ComTxIPduUnusedAreasDefault=0
          ComTxModeTrue
            ComTxMode: ComTxModeMode=NONE
      S_NM_IMU_B_ST3_PNC_IMU_INTERNAL_CAN_Tx (ComSignal):
        ComSignalLength = 7
        ComSignalType = UINT8_N
        ComSignalEndianness = opaque
        ComBitPosition = 8
        ComBitSize = 56
        ComSignalInitValue = 0 0 0 0 0 0 0
        ComSystemTemplateSystemSignalRef = NM_IMU_B_ST3_PNC
      IP_NM_IMU_B_ST3_DRIVING_CAN_Tx (ComIPdu):
        ComIPduDirection = SEND
        ComIPduType = NORMAL
        ComIPduSignalRef = S_NM_IMU_B_ST3_PNC_DRIVING_CAN_Tx
        ComPduIdRef = NM_IMU_B_ST3_Com2PduR_DRIVING_CAN
        ComIPduGroupRef = IPG_IMU_B_NM_TX_All_CAN
        ComTxIPdu: ComTxIPduUnusedAreasDefault=0
          ComTxModeTrue
            ComTxMode: ComTxModeMode=NONE
      5 x ComSignal, all with ComSignalEndianness=opaque, ComSignalLength=7, ComSignalType=UINT8_N:
        S_NM_IMU_B_ST3_PNC_CAN_Rx: ComBitPosition=0
        S_NM_IMU_B_CanNmUserDataSig_Era_DRIVING_CAN_Rx: ComBitPosition=8, ComSignalInitValue=0 0 0 0 0 0 0, ComBitSize=56
        S_NM_IMU_B_CanNmUserDataSig_Era_HAD_IMU_CAN_Rx: ComBitPosition=8, ComSignalInitValue=0 0 0 0 0 0 0, ComBitSize=56
        S_NM_IMU_B_CanNmUserDataSig_Era_INTERNAL_CAN_Rx: ComBitPosition=8, ComSignalInitValue=0 0 0 0 0 0 0, ComBitSize=56
        S_NM_IMU_B_ST3_PNC_DRIVING_CAN_Tx: ComBitPosition=8, ComBitSize=56, ComSignalInitValue=0 0 0 0 0 0 0, ComSystemTemplateSystemSignalRef=NM_IMU_B_ST3_PNC
      IP_NmPnEiraRxNSduRef_CAN_Rx (ComIPdu):
        ComIPduDirection = RECEIVE
        ComIPduType = NORMAL
        ComIPduSignalProcessing = DEFERRED
        ComPduIdRef = EcucPduCollection/NmPnEiraRxNSduRef_CAN_PduR2Com_IMU_INTERNAL_CAN
        ComIPduSignalRef = S_NM_IMU_B_ST3_PNC_CAN_Rx
  module config EcuC
    EcucConfigSet
      EcucPduCollection: PduIdTypeEnum=uint16, PduLengthTypeEnum=uint16
        29 x Pdu:
          IMU_A_Output_ST3_secured_PduR2CanIf_HAD_IMU_CAN: PduLength=44, SysTPduToPduTriggeringRef=IMU_A_Output_ST3_4p41nkf2z59zgonuonq95qlpd
          IMU_A_Output_ST3_secured_SecOC2PduR_HAD_IMU_CAN: PduLength=44, SysTPduToPduTriggeringRef=IMU_A_Output_ST3_4p41nkf2z59zgonuonq95qlpd
          IMU_A_Output_ST3_Com2PduR_HAD_IMU_CAN: PduLength=40, SysTPduToPduTriggeringRef=IMU_A_Output_ST3_9cxzvqfu45tng6sbgbrg6amrj
          IMU_A_Output_ST3_PduR2SecOC_HAD_IMU_CAN: PduLength=40, SysTPduToPduTriggeringRef=IMU_A_Output_ST3_9cxzvqfu45tng6sbgbrg6amrj
          NM_IMU_B_ST3_CanNm2CanIf_HAD_IMU_CAN: PduLength=8, SysTPduToFrameTriggeringRef=NM_IMU_B_ST3_5n3tsppcblgyfz59fa3fxhygu
          NM_Dummy_ST3_CanIf2CanNm_HAD_IMU_CAN: PduLength=8, SysTPduToFrameTriggeringRef=NM_Dummy_ST3_4gvn7tmtsz96dqioyz0hd4kkn
          ECU_Stat_IMU_B_HAD_IMU_ST3_Com2PduR_HAD_IMU_CAN: PduLength=8, SysTPduToPduTriggeringRef=ECU_Stat_IMU_B_HAD_IMU_ST3_88u6ujntcym4u4ntb27fc40ar
          ECU_Stat_IMU_B_HAD_IMU_ST3_PduR2CanIf_HAD_IMU_CAN: PduLength=8, SysTPduToPduTriggeringRef=ECU_Stat_IMU_B_HAD_IMU_ST3_88u6ujntcym4u4ntb27fc40ar
          NM_IMU_B_ST3_Com2PduR_HAD_IMU_CAN: PduLength=8, SysTPduToFrameTriggeringRef=NM_IMU_B_ST3_5n3tsppcblgyfz59fa3fxhygu
          NM_IMU_B_ST3_PduR2CanNm_HAD_IMU_CAN: PduLength=8, SysTPduToFrameTriggeringRef=NM_IMU_B_ST3_5n3tsppcblgyfz59fa3fxhygu
          IMU_A_Output_ST3_secured_CanIf2PduR_IMU_INTERNAL_CAN: PduLength=44, SysTPduToPduTriggeringRef=IMU_A_Output_ST3_6l4id86kym3ykh1x8fnhhai2g
          IMU_A_Output_ST3_secured_PduR2SecOC_IMU_INTERNAL_CAN: PduLength=44, SysTPduToPduTriggeringRef=IMU_A_Output_ST3_6l4id86kym3ykh1x8fnhhai2g
          IMU_A_Output_ST3_SecOC2PduR_IMU_INTERNAL_CAN: PduLength=40, SysTPduToPduTriggeringRef=IMU_A_Output_ST3_1s7p55wldfbcir6iy5a616rwn
          IMU_A_Output_ST3_PduR2Com_IMU_INTERNAL_CAN: PduLength=40, SysTPduToPduTriggeringRef=IMU_A_Output_ST3_1s7p55wldfbcir6iy5a616rwn
          NM_Dummy_ST3_CanIf2CanNm_IMU_INTERNAL_CAN: PduLength=8, SysTPduToFrameTriggeringRef=NM_Dummy_ST3_47cxd2tpch3havy6ru1a9do2q
          NmPnEiraRxNSduRef_CAN_CanNm2PduR_IMU_INTERNAL_CAN: PduLength=8, SysTPduToFrameTriggeringRef=NM_Dummy_ST3_47cxd2tpch3havy6ru1a9do2q
          NmPnEiraRxNSduRef_CAN_PduR2Com_IMU_INTERNAL_CAN: PduLength=8, SysTPduToFrameTriggeringRef=NM_Dummy_ST3_47cxd2tpch3havy6ru1a9do2q
          NM_IMU_B_ST3_CanNm2CanIf_IMU_INTERNAL_CAN: PduLength=8, SysTPduToFrameTriggeringRef=NM_IMU_B_ST3_6a4t4fydo7fjdt7az7m07uidc
          NM_IMU_B_ST3_Com2PduR_IMU_INTERNAL_CAN: PduLength=8, SysTPduToFrameTriggeringRef=NM_IMU_B_ST3_6a4t4fydo7fjdt7az7m07uidc
          NM_IMU_B_ST3_PduR2CanNm_IMU_INTERNAL_CAN: PduLength=8, SysTPduToFrameTriggeringRef=NM_IMU_B_ST3_6a4t4fydo7fjdt7az7m07uidc
          GTS_Main_CAN_ST3_CanIf2CanTSyn_IMU_INTERNAL_CAN: PduLength=8
          IMU_A_Output_Fast_ST3_secured_PduR2CanIf_HAD_IMU_CAN: PduLength=44, SysTPduToPduTriggeringRef=IMU_A_Output_Fast_ST3_e7odpk6vjunqxpvwrebb25okg
          IMU_A_Output_Fast_ST3_secured_CanIf2PduR_IMU_INTERNAL_CAN: PduLength=44, SysTPduToPduTriggeringRef=IMU_A_Output_Fast_ST3_bqi5o7xakr4svvuyh363ta1md
          ECU_Stat_IMU_B_ST3_Com2PduR_IMU_INTERNAL_CAN: PduLength=8, SysTPduToPduTriggeringRef=ECU_Stat_IMU_B_ST3_1l9xnste3w36iapn7j8fv2gjj
          ECU_Stat_IMU_B_ST3_PduR2CanIf_IMU_INTERNAL_CAN: PduLength=8, SysTPduToPduTriggeringRef=ECU_Stat_IMU_B_ST3_1l9xnste3w36iapn7j8fv2gjj
          ROE_IMU_B_ST3_Com2PduR_IMU_INTERNAL_CAN: PduLength=8, SysTPduToPduTriggeringRef=ROE_IMU_B_ST3_ybki1p1g4q0gpufyixy3mote
          ROE_IMU_B_ST3_PduR2CanIf_IMU_INTERNAL_CAN: PduLength=8, SysTPduToPduTriggeringRef=ROE_IMU_B_ST3_ybki1p1g4q0gpufyixy3mote
          Meas_IMU_B_ST3_Com2PduR_IMU_INTERNAL_CAN: PduLength=64, SysTPduToPduTriggeringRef=Meas_IMU_B_ST3_7dez5xihv0f0h9rjimq9zmqis
          Meas_IMU_B_ST3_PduR2CanIf_IMU_INTERNAL_CAN: PduLength=64, SysTPduToPduTriggeringRef=Meas_IMU_B_ST3_7dez5xihv0f0h9rjimq9zmqis
  module config PduR
    IpduM (PduRBswModules):
      PduRCancelReceive = false
      PduRCancelTransmit = false
      PduRCommunicationInterface = true
      PduRLowerModule = true
      PduRTransportProtocol = false
      PduRTriggertransmit = true
      PduRTxConfirmation = true
      PduRUpperModule = true
      PduRBswModuleRef = IpduM
    PduRGeneral:
      PduRDevErrorDetect = false
      PduRVersionInfoApi = false
      PduRZeroCostOperation = false
      PduRRbDsmReInitEnabled = false
      PduRRbGwTpWithLimitedBuffer = false
      PduRRbIFGatewayOperation = true
      PduRRbMulticastToIfSupport = true
      PduRRbQueueingSupport = false
    PduRRoutingPaths
      20 x PduRDestPdu, all with PduRDestPduDataProvision=PDUR_DIRECT:
        ECU_Stat_IMU_B_HAD_IMU_ST3_PduR2CanIf_HAD_IMU_CAN: PduRDestPduRef=EcucPduCollection/ECU_Stat_IMU_B_HAD_IMU_ST3_PduR2CanIf_HAD_IMU_CAN
        NM_IMU_B_ST3_PduR2CanNm_HAD_IMU_CAN: PduRDestPduRef=EcucPduCollection/NM_IMU_B_ST3_PduR2CanNm_HAD_IMU_CAN
        ROE_IMU_B_ST3_PduR2CanIf_IMU_INTERNAL_CAN: PduRDestPduRef=EcucPduCollection/ROE_IMU_B_ST3_PduR2CanIf_IMU_INTERNAL_CAN
        Meas_IMU_B_ST3_PduR2CanIf_IMU_INTERNAL_CAN: PduRDestPduRef=EcucPduCollection/Meas_IMU_B_ST3_PduR2CanIf_IMU_INTERNAL_CAN
        ECU_Stat_IMU_B_ST3_PduR2CanIf_IMU_INTERNAL_CAN: PduRDestPduRef=EcucPduCollection/ECU_Stat_IMU_B_ST3_PduR2CanIf_IMU_INTERNAL_CAN
        IMU_A_Output_Fast_ST3_secured_PduR2CanIf_HAD_IMU_CAN: PduRDestPduRef=EcucPduCollection/IMU_A_Output_Fast_ST3_secured_PduR2CanIf_HAD_IMU_CAN
        NM_IMU_B_ST3_PduR2CanNm_IMU_INTERNAL_CAN: PduRDestPduRef=EcucPduCollection/NM_IMU_B_ST3_PduR2CanNm_IMU_INTERNAL_CAN
        NM_IMU_B_ST3_PduR2CanNm_DRIVING_CAN: PduRDestPduRef=NM_IMU_B_ST3_PduR2CanNm_DRIVING_CAN
        NM_IMU_B_ST3_ERA_PduR2Com_DRIVING_CAN: PduRDestPduRef=NM_IMU_B_ST3_ERA_PduR2Com_DRIVING_CAN
        NM_IMU_B_ST3_ERA_PduR2Com_INTERNAL_CAN: PduRDestPduRef=NM_IMU_B_ST3_ERA_PduR2Com_INTERNAL_CAN
        NM_IMU_B_ST3_ERA_PduR2Com_HAD_IMU_CAN: PduRDestPduRef=NM_IMU_B_ST3_ERA_PduR2Com_HAD_IMU_CAN
        NmPnEiraRxNSduRef_CAN_PduR2Com_IMU_INTERNAL_CAN: PduRDestPduRef=EcucPduCollection/NmPnEiraRxNSduRef_CAN_PduR2Com_IMU_INTERNAL_CAN
        IMU_B_HAD_IMU_GW_Container_ST3_DI_OdoSpeedometer_ST3_PduR2IpduM: PduRDestPduRef=IMU_B_HAD_IMU_GW_Container_ST3_DI_OdoSpeedometer_ST3_PduR2IpduM
        IMU_B_HAD_IMU_GW_Container_ST3_IMU_B_HAD_IMU_GW_Container_ST3_Ign_Stat_ST3_secured_PduR2IpduM: PduRDestPduRef=IMU_B_HAD_IMU_GW_Container_ST3_IMU_B_HAD_IMU_GW_Container_ST3_Ign_Stat_ST3_secured_PduR2IpduM
        IMU_B_HAD_IMU_GW_Container_ST3_IMU_B_HAD_IMU_GW_Container_ST3_PN14_Master_Stat1_ST3_secured_PduR2IpduM: PduRDestPduRef=IMU_B_HAD_IMU_GW_Container_ST3_IMU_B_HAD_IMU_GW_Container_ST3_PN14_Master_Stat1_ST3_secured_PduR2IpduM
        IMU_B_HAD_IMU_GW_Container_ST3_VSS_TP_Auth_ST3_PduR2IpduM: PduRDestPduRef=IMU_B_HAD_IMU_GW_Container_ST3_VSS_TP_Auth_ST3_PduR2IpduM
        IMU_B_HAD_IMU_GW_Container_ST3_VSS_TP_RealTmOffset_ST3_PduR2IpduM: PduRDestPduRef=IMU_B_HAD_IMU_GW_Container_ST3_VSS_TP_RealTmOffset_ST3_PduR2IpduM
        IMU_B_HAD_IMU_GW_Container_ST3_VSS_TP_SecTickCount_Lvl1_ST3_PduR2IpduM: PduRDestPduRef=IMU_B_HAD_IMU_GW_Container_ST3_VSS_TP_SecTickCount_Lvl1_ST3_PduR2IpduM
        IMU_B_HAD_IMU_GW_Container_ST3_VSS_TP_SharedSecret_ST3_PduR2IpduM: PduRDestPduRef=IMU_B_HAD_IMU_GW_Container_ST3_VSS_TP_SharedSecret_ST3_PduR2IpduM
        IMU_B_HAD_IMU_GW_Container_ST3_VSS_TP_VIN_ST3_PduR2IpduM: PduRDestPduRef=IMU_B_HAD_IMU_GW_Container_ST3_VSS_TP_VIN_ST3_PduR2IpduM
      20 x PduRRoutingPath:
        ECU_Stat_IMU_B_HAD_IMU_ST3_Com2CanIf_HAD_IMU_CAN: PduRDestPduRRef=PduRRoutingPaths/ECU_Stat_IMU_B_HAD_IMU_ST3_PduR2CanIf_HAD_IMU_CAN, PduRSrcPduRRef=PduRRoutingPaths/ECU_Stat_IMU_B_HAD_IMU_ST3_Com2PduR_HAD_IMU_CAN
        NM_IMU_B_ST3_Com2CanNm_HAD_IMU_CAN: PduRDestPduRRef=PduRRoutingPaths/NM_IMU_B_ST3_PduR2CanNm_HAD_IMU_CAN, PduRSrcPduRRef=PduRRoutingPaths/NM_IMU_B_ST3_Com2PduR_HAD_IMU_CAN
        ROE_IMU_B_ST3_Com2CanIf_IMU_INTERNAL_CAN: PduRDestPduRRef=PduRRoutingPaths/ROE_IMU_B_ST3_PduR2CanIf_IMU_INTERNAL_CAN, PduRSrcPduRRef=PduRRoutingPaths/ROE_IMU_B_ST3_Com2PduR_IMU_INTERNAL_CAN
        Meas_IMU_B_ST3_Com2CanIf_IMU_INTERNAL_CAN: PduRDestPduRRef=PduRRoutingPaths/Meas_IMU_B_ST3_PduR2CanIf_IMU_INTERNAL_CAN, PduRSrcPduRRef=PduRRoutingPaths/Meas_IMU_B_ST3_Com2PduR_IMU_INTERNAL_CAN
        ECU_Stat_IMU_B_ST3_Com2CanIf_IMU_INTERNAL_CAN: PduRDestPduRRef=PduRRoutingPaths/ECU_Stat_IMU_B_ST3_PduR2CanIf_IMU_INTERNAL_CAN, PduRSrcPduRRef=PduRRoutingPaths/ECU_Stat_IMU_B_ST3_Com2PduR_IMU_INTERNAL_CAN
        IMU_A_Output_Fast_ST3_secured_GATEWAY_IMU_INTERNAL_CAN: PduRDestPduRRef=PduRRoutingPaths/IMU_A_Output_Fast_ST3_secured_PduR2CanIf_HAD_IMU_CAN, PduRSrcPduRRef=PduRRoutingPaths/IMU_A_Output_Fast_ST3_secured_CanIf2PduR_IMU_INTERNAL_CAN
        NM_IMU_B_ST3_Com2CanNm_IMU_INTERNAL_CAN: PduRDestPduRRef=PduRRoutingPaths/NM_IMU_B_ST3_PduR2CanNm_IMU_INTERNAL_CAN, PduRSrcPduRRef=PduRRoutingPaths/NM_IMU_B_ST3_Com2PduR_IMU_INTERNAL_CAN
        NM_IMU_B_ST3_Com2CanNm_DRIVING_CAN: PduRSrcPduRRef=NM_IMU_B_ST3_Com2PduR_DRIVING_CAN, PduRDestPduRRef=NM_IMU_B_ST3_PduR2CanNm_DRIVING_CAN
        NM_IMU_B_ST3_ERA_CanNm2Com_INTERNAL_CAN: PduRDestPduRRef=NM_IMU_B_ST3_ERA_PduR2Com_INTERNAL_CAN, PduRSrcPduRRef=NM_IMU_B_ST3_ERA_CanNm2PduR_INTERNAL_CAN
        NM_IMU_B_ST3_ERA_CanNm2Com_DRIVING_CAN: PduRDestPduRRef=NM_IMU_B_ST3_ERA_PduR2Com_DRIVING_CAN, PduRSrcPduRRef=NM_IMU_B_ST3_ERA_CanNm2PduR_DRIVING_CAN
        NM_IMU_B_ST3_ERA_CanNm2Com_HAD_IMU_CAN: PduRDestPduRRef=NM_IMU_B_ST3_ERA_PduR2Com_HAD_IMU_CAN, PduRSrcPduRRef=NM_IMU_B_ST3_ERA_CanNm2PduR_HAD_IMU_CAN
        NmPnEiraRxNSduRef_CAN_CanNm2Com_IMU_INTERNAL_CAN: PduRDestPduRRef=PduRRoutingPaths/NmPnEiraRxNSduRef_CAN_PduR2Com_IMU_INTERNAL_CAN, PduRSrcPduRRef=PduRRoutingPaths/NmPnEiraRxNSduRef_CAN_CanNm2PduR_IMU_INTERNAL_CAN
        IMU_B_HAD_IMU_GW_Container_ST3_DI_OdoSpeedometer_ST3_CanIf2IpduM: PduRDestPduRRef=IMU_B_HAD_IMU_GW_Container_ST3_DI_OdoSpeedometer_ST3_PduR2IpduM, PduRSrcPduRRef=PduRSrcPdu_DI_OdoSpeedometer_ST3_CanIf2PduR
        IMU_B_HAD_IMU_GW_Container_ST3_IMU_B_HAD_IMU_GW_Container_ST3_Ign_Stat_ST3_secured_CanIf2IpduM: PduRDestPduRRef=IMU_B_HAD_IMU_GW_Container_ST3_IMU_B_HAD_IMU_GW_Container_ST3_Ign_Stat_ST3_secured_PduR2IpduM, PduRSrcPduRRef=PduRSrcPdu_Ign_Stat_ST3_secured_CanIf2PduR
        IMU_B_HAD_IMU_GW_Container_ST3_IMU_B_HAD_IMU_GW_Container_ST3_PN14_Master_Stat1_ST3_secured_CanIf2IpduM: PduRDestPduRRef=IMU_B_HAD_IMU_GW_Container_ST3_IMU_B_HAD_IMU_GW_Container_ST3_PN14_Master_Stat1_ST3_secured_PduR2IpduM, PduRSrcPduRRef=PduRSrcPdu_PN14_Master_Stat1_ST3_secured_CanIf2PduR
        IMU_B_HAD_IMU_GW_Container_ST3_VSS_TP_Auth_ST3_CanIf2IpduM: PduRDestPduRRef=IMU_B_HAD_IMU_GW_Container_ST3_VSS_TP_Auth_ST3_PduR2IpduM, PduRSrcPduRRef=PduRSrcPdu_VSS_TP_Auth_ST3_CanIf2PduR
        IMU_B_HAD_IMU_GW_Container_ST3_VSS_TP_RealTmOffset_ST3_CanIf2IpduM: PduRDestPduRRef=IMU_B_HAD_IMU_GW_Container_ST3_VSS_TP_RealTmOffset_ST3_PduR2IpduM, PduRSrcPduRRef=PduRSrcPdu_VSS_TP_RealTmOffset_ST3_CanIf2PduR
        IMU_B_HAD_IMU_GW_Container_ST3_VSS_TP_SecTickCount_Lvl1_ST3_CanIf2IpduM: PduRDestPduRRef=IMU_B_HAD_IMU_GW_Container_ST3_VSS_TP_SecTickCount_Lvl1_ST3_PduR2IpduM, PduRSrcPduRRef=PduRSrcPdu_VSS_TP_SecTickCount_Lvl1_ST3_CanIf2PduR
        IMU_B_HAD_IMU_GW_Container_ST3_VSS_TP_SharedSecret_ST3_CanIf2IpduM: PduRDestPduRRef=IMU_B_HAD_IMU_GW_Container_ST3_VSS_TP_SharedSecret_ST3_PduR2IpduM, PduRSrcPduRRef=PduRSrcPdu_VSS_TP_SharedSecret_ST3_CanIf2PduR
        IMU_B_HAD_IMU_GW_Container_ST3_VSS_TP_VIN_ST3_CanIf2IpduM: PduRDestPduRRef=IMU_B_HAD_IMU_GW_Container_ST3_VSS_TP_VIN_ST3_PduR2IpduM, PduRSrcPduRRef=PduRSrcPdu_VSS_TP_VIN_ST3_CanIf2PduR
      12 x PduRSrcPdu:
        ECU_Stat_IMU_B_HAD_IMU_ST3_Com2PduR_HAD_IMU_CAN: PduRSrcPduRef=EcucPduCollection/ECU_Stat_IMU_B_HAD_IMU_ST3_Com2PduR_HAD_IMU_CAN
        NM_IMU_B_ST3_Com2PduR_HAD_IMU_CAN: PduRSrcPduRef=EcucPduCollection/NM_IMU_B_ST3_Com2PduR_HAD_IMU_CAN
        ROE_IMU_B_ST3_Com2PduR_IMU_INTERNAL_CAN: PduRSrcPduRef=EcucPduCollection/ROE_IMU_B_ST3_Com2PduR_IMU_INTERNAL_CAN
        Meas_IMU_B_ST3_Com2PduR_IMU_INTERNAL_CAN: PduRSrcPduRef=EcucPduCollection/Meas_IMU_B_ST3_Com2PduR_IMU_INTERNAL_CAN
        ECU_Stat_IMU_B_ST3_Com2PduR_IMU_INTERNAL_CAN: PduRSrcPduRef=EcucPduCollection/ECU_Stat_IMU_B_ST3_Com2PduR_IMU_INTERNAL_CAN
        IMU_A_Output_Fast_ST3_secured_CanIf2PduR_IMU_INTERNAL_CAN: PduRSrcPduRef=EcucPduCollection/IMU_A_Output_Fast_ST3_secured_CanIf2PduR_IMU_INTERNAL_CAN
        NM_IMU_B_ST3_Com2PduR_IMU_INTERNAL_CAN: PduRSrcPduRef=EcucPduCollection/NM_IMU_B_ST3_Com2PduR_IMU_INTERNAL_CAN
        NM_IMU_B_ST3_Com2PduR_DRIVING_CAN: PduRSrcPduRef=NM_IMU_B_ST3_Com2PduR_DRIVING_CAN
        NM_IMU_B_ST3_ERA_CanNm2PduR_DRIVING_CAN: PduRSrcPduRef=NM_IMU_B_ST3_ERA_CanNm2PduR_DRIVING_CAN
        NM_IMU_B_ST3_ERA_CanNm2PduR_INTERNAL_CAN: PduRSrcPduRef=NM_IMU_B_ST3_ERA_CanNm2PduR_INTERNAL_CAN
        NM_IMU_B_ST3_ERA_CanNm2PduR_HAD_IMU_CAN: PduRSrcPduRef=NM_IMU_B_ST3_ERA_CanNm2PduR_HAD_IMU_CAN
        NmPnEiraRxNSduRef_CAN_CanNm2PduR_IMU_INTERNAL_CAN: PduRSrcPduRef=EcucPduCollection/NmPnEiraRxNSduRef_CAN_CanNm2PduR_IMU_INTERNAL_CAN
  module config rba_SysElem
    rba_SysElem_SystemModel
      rba_SysElem_ISignalGroups
        5 x rba_SysElem_ISignalGroup:
          IMU_A_Output_Pr5_ST3_bezr5ct33mhwxias0s8rjhbne: rba_SysElem_ISignalGroupForeignRef=IMU_A_Output_Pr5_ST3_bezr5ct33mhwxias0s8rjhbne, rba_SysElem_ComBasedSignalGroupTransformationRef=BaseTrans_Profile_5_40, rba_SysElem_ISignalRef=rba_SysElem_ISignals/CRC_IMU_A_Output_Pr5_ST3, rba_SysElem_ISignalRef=rba_SysElem_ISignals/IMU_A_AngAcc_Stat_ST3, rba_SysElem_ISignalRef=rba_SysElem_ISignals/IMU_A_AngAcc_X_ST3, rba_SysElem_ISignalRef=rba_SysElem_ISignals/IMU_A_AngAcc_Y_ST3, rba_SysElem_ISignalRef=rba_SysElem_ISignals/IMU_A_AngAcc_Z_ST3, rba_SysElem_ISignalRef=rba_SysElem_ISignals/IMU_A_AngRate_X_ST3, rba_SysElem_ISignalRef=rba_SysElem_ISignals/IMU_A_AngRate_Y_ST3, rba_SysElem_ISignalRef=rba_SysElem_ISignals/IMU_A_AngRate_Z_ST3, rba_SysElem_ISignalRef=rba_SysElem_ISignals/IMU_A_AngRates_Stat_ST3, rba_SysElem_ISignalRef=rba_SysElem_ISignals/IMU_A_SpecForce_Stat_ST3, rba_SysElem_ISignalRef=rba_SysElem_ISignals/IMU_A_SpecForce_X_ST3, rba_SysElem_ISignalRef=rba_SysElem_ISignals/IMU_A_SpecForce_Y_ST3, rba_SysElem_ISignalRef=rba_SysElem_ISignals/IMU_A_SpecForce_Z_ST3, rba_SysElem_ISignalRef=rba_SysElem_ISignals/IMU_A_Stat_ST3, rba_SysElem_ISignalRef=rba_SysElem_ISignals/IMU_A_Temp_ST3, rba_SysElem_ISignalRef=rba_SysElem_ISignals/IMU_A_TmStmp_NanoSec_ST3, rba_SysElem_ISignalRef=rba_SysElem_ISignals/IMU_A_TmStmp_Sec_ST3, rba_SysElem_ISignalRef=rba_SysElem_ISignals/IMU_A_TmSync_Stat_ST3, rba_SysElem_ISignalRef=rba_SysElem_ISignals/Rsrv01_IMU_A_Output_Pr5_ST3, rba_SysElem_ISignalRef=rba_SysElem_ISignals/Rsrv02_IMU_A_Output_Pr5_ST3, rba_SysElem_ISignalRef=rba_SysElem_ISignals/Rsrv03_IMU_A_Output_Pr5_ST3, rba_SysElem_ISignalRef=rba_SysElem_ISignals/Rsrv04_IMU_A_Output_Pr5_ST3, rba_SysElem_ISignalRef=rba_SysElem_ISignals/Rsrv05_IMU_A_Output_Pr5_ST3, rba_SysElem_ISignalRef=rba_SysElem_ISignals/Rsrv06_IMU_A_Output_Pr5_ST3, rba_SysElem_ISignalRef=rba_SysElem_ISignals/Rsrv07_IMU_A_Output_Pr5_ST3, rba_SysElem_ISignalRef=rba_SysElem_ISignals/SQC_IMU_A_Output_Pr5_ST3, rba_SysElem_SystemSignalGroupRef=rba_SysElem_SystemSignalGroups/IMU_A_Output_Pr5_ST3_bezr5ct33mhwxias0s8rjhbne
            E2E_Profile_5 (rba_SysElem_TransformationISignalProps)
              rba_SysElem_EndToEndTransformationISignalProps: rba_SysElem_DataID=844, rba_SysElem_DataLength=320, rba_SysElem_TransformationTechnologyRef=rba_SysElem_TransformationTechnologies/E2E_Profile_5
          Ign_Stat_Pr5_ST3_csgs1dv6drms80o1i9p49677w: rba_SysElem_ISignalGroupForeignRef=Ign_Stat_Pr5_ST3_csgs1dv6drms80o1i9p49677w, rba_SysElem_ComBasedSignalGroupTransformationRef=BaseTrans_Profile_5_4, rba_SysElem_ISignalRef=rba_SysElem_ISignals/CRC_Ign_Stat_Pr5_ST3, rba_SysElem_ISignalRef=rba_SysElem_ISignals/ISw_Stat_ST3, rba_SysElem_ISignalRef=rba_SysElem_ISignals/KG_StartSw_Psd_ST3, rba_SysElem_ISignalRef=rba_SysElem_ISignals/SQC_Ign_Stat_Pr5_ST3, rba_SysElem_ISignalRef=rba_SysElem_ISignals/Veh_Op_Mode_ST3, rba_SysElem_SystemSignalGroupRef=rba_SysElem_SystemSignalGroups/Ign_Stat_Pr5_ST3_csgs1dv6drms80o1i9p49677w
            E2E_Profile_5 (rba_SysElem_TransformationISignalProps)
              rba_SysElem_EndToEndTransformationISignalProps: rba_SysElem_DataID=51, rba_SysElem_DataLength=32, rba_SysElem_TransformationTechnologyRef=rba_SysElem_TransformationTechnologies/E2E_Profile_5
          IMU_A_Output_Pr5_ST3_bezr5ct33mhwxias0s8rjhbne_RENAME1: rba_SysElem_ISignalGroupForeignRef=IMU_A_Output_Pr5_ST3_bezr5ct33mhwxias0s8rjhbne, rba_SysElem_ComBasedSignalGroupTransformationRef=BaseTrans_Profile_5_40, rba_SysElem_ISignalRef=CRC_IMU_A_Output_Pr5_ST3_RENAME1, rba_SysElem_ISignalRef=IMU_A_AngAcc_Stat_ST3_RENAME1, rba_SysElem_ISignalRef=IMU_A_AngAcc_X_ST3_RENAME1, rba_SysElem_ISignalRef=IMU_A_AngAcc_Y_ST3_RENAME1, rba_SysElem_ISignalRef=IMU_A_AngAcc_Z_ST3_RENAME1, rba_SysElem_ISignalRef=IMU_A_AngRate_X_ST3_RENAME1, rba_SysElem_ISignalRef=IMU_A_AngRate_Y_ST3_RENAME1, rba_SysElem_ISignalRef=IMU_A_AngRate_Z_ST3_RENAME1, rba_SysElem_ISignalRef=IMU_A_AngRates_Stat_ST3_RENAME1, rba_SysElem_ISignalRef=IMU_A_SpecForce_Stat_ST3_RENAME1, rba_SysElem_ISignalRef=IMU_A_SpecForce_X_ST3_RENAME1, rba_SysElem_ISignalRef=IMU_A_SpecForce_Y_ST3_RENAME1, rba_SysElem_ISignalRef=IMU_A_SpecForce_Z_ST3_RENAME1, rba_SysElem_ISignalRef=IMU_A_Stat_ST3_RENAME1, rba_SysElem_ISignalRef=IMU_A_Temp_ST3_RENAME1, rba_SysElem_ISignalRef=IMU_A_TmStmp_NanoSec_ST3_RENAME1, rba_SysElem_ISignalRef=IMU_A_TmStmp_Sec_ST3_RENAME1, rba_SysElem_ISignalRef=IMU_A_TmSync_Stat_ST3_RENAME1, rba_SysElem_ISignalRef=Rsrv01_IMU_A_Output_Pr5_ST3_RENAME1, rba_SysElem_ISignalRef=Rsrv02_IMU_A_Output_Pr5_ST3_RENAME1, rba_SysElem_ISignalRef=Rsrv03_IMU_A_Output_Pr5_ST3_RENAME1, rba_SysElem_ISignalRef=Rsrv04_IMU_A_Output_Pr5_ST3_RENAME1, rba_SysElem_ISignalRef=Rsrv05_IMU_A_Output_Pr5_ST3_RENAME1, rba_SysElem_ISignalRef=Rsrv06_IMU_A_Output_Pr5_ST3_RENAME1, rba_SysElem_ISignalRef=Rsrv07_IMU_A_Output_Pr5_ST3_RENAME1, rba_SysElem_ISignalRef=SQC_IMU_A_Output_Pr5_ST3_RENAME1, rba_SysElem_SystemSignalGroupRef=rba_SysElem_SystemSignalGroups/IMU_A_Output_Pr5_ST3_bezr5ct33mhwxias0s8rjhbne
            E2E_Profile_5 (rba_SysElem_TransformationISignalProps)
              rba_SysElem_EndToEndTransformationISignalProps: rba_SysElem_DataID=844, rba_SysElem_DataLength=320, rba_SysElem_TransformationTechnologyRef=rba_SysElem_TransformationTechnologies/E2E_Profile_5
          PT4_PTCoor4_Pr5_ST3_af4fxb1ykieox3itqdfzs0kpb: rba_SysElem_ISignalGroupForeignRef=PT4_PTCoor4_Pr5_ST3_af4fxb1ykieox3itqdfzs0kpb, rba_SysElem_ComBasedSignalGroupTransformationRef=BaseTrans_Profile_5_4, rba_SysElem_ISignalRef=rba_SysElem_ISignals/CRC_PT4_PTCoor4_Pr5_ST3, rba_SysElem_ISignalRef=rba_SysElem_ISignals/PT4_PTCoor_EngStartPN14_Stat_ST3, rba_SysElem_ISignalRef=rba_SysElem_ISignals/PT4_PTCoor_PT_Rdy_ST3, rba_SysElem_ISignalRef=rba_SysElem_ISignals/PT4_PTCoor_SSA_EngSp_ST3, rba_SysElem_ISignalRef=rba_SysElem_ISignals/Rsrv1_PT4_PTCoor_PT_Rdy_Pr5_ST3, rba_SysElem_ISignalRef=rba_SysElem_ISignals/SQC_PT4_PTCoor4_Pr5_ST3, rba_SysElem_SystemSignalGroupRef=rba_SysElem_SystemSignalGroups/PT4_PTCoor4_Pr5_ST3_af4fxb1ykieox3itqdfzs0kpb
            E2E_Profile_5 (rba_SysElem_TransformationISignalProps)
              rba_SysElem_EndToEndTransformationISignalProps: rba_SysElem_DataID=196, rba_SysElem_DataLength=32, rba_SysElem_TransformationTechnologyRef=rba_SysElem_TransformationTechnologies/E2E_Profile_5
          DI_Odo_Pr5_ST3_e68xmtlkywxgxsdwekdjjhw3t: rba_SysElem_ISignalGroupForeignRef=DI_Odo_Pr5_ST3_e68xmtlkywxgxsdwekdjjhw3t, rba_SysElem_ComBasedSignalGroupTransformationRef=BaseTrans_Profile_5_6, rba_SysElem_ISignalRef=rba_SysElem_ISignals/CRC_DI_Odo_Pr5_ST3, rba_SysElem_ISignalRef=rba_SysElem_ISignals/Odo_ST3, rba_SysElem_ISignalRef=rba_SysElem_ISignals/SQC_DI_Odo_Pr5_ST3, rba_SysElem_SystemSignalGroupRef=rba_SysElem_SystemSignalGroups/DI_Odo_Pr5_ST3_e68xmtlkywxgxsdwekdjjhw3t
            E2E_Profile_5 (rba_SysElem_TransformationISignalProps)
              rba_SysElem_EndToEndTransformationISignalProps: rba_SysElem_DataID=186, rba_SysElem_DataLength=48, rba_SysElem_TransformationTechnologyRef=rba_SysElem_TransformationTechnologies/E2E_Profile_5
      rba_SysElem_ISignals
        66 x rba_SysElem_ISignal, all with rba_SysElem_DataTypePolicy=override:
          CRC_IMU_A_Output_Pr5_ST3: rba_SysElem_Length=16, rba_SysElem_ISignalForeignRef=CRC_IMU_A_Output_Pr5_ST3, rba_SysElem_SystemSignalRef=rba_SysElem_SystemSignals/CRC_IMU_A_Output_Pr5_ST3
            rba_SysElem_InitValue
              rba_SysElem_NumericalValueSpecification: rba_SysElem_NumericalValue=19347
          IMU_A_AngAcc_Stat_ST3: rba_SysElem_Length=3, rba_SysElem_ISignalForeignRef=IMU_A_AngAcc_Stat_ST3, rba_SysElem_SystemSignalRef=rba_SysElem_SystemSignals/IMU_A_AngAcc_Stat_ST3
            rba_SysElem_InitValue
              rba_SysElem_NumericalValueSpecification: rba_SysElem_NumericalValue=0
          IMU_A_AngAcc_X_ST3: rba_SysElem_Length=16, rba_SysElem_ISignalForeignRef=IMU_A_AngAcc_X_ST3, rba_SysElem_SystemSignalRef=rba_SysElem_SystemSignals/IMU_A_AngAcc_X_ST3
            rba_SysElem_InitValue
              rba_SysElem_NumericalValueSpecification: rba_SysElem_NumericalValue=65535
          IMU_A_AngAcc_Y_ST3: rba_SysElem_Length=16, rba_SysElem_ISignalForeignRef=IMU_A_AngAcc_Y_ST3, rba_SysElem_SystemSignalRef=rba_SysElem_SystemSignals/IMU_A_AngAcc_Y_ST3
            rba_SysElem_InitValue
              rba_SysElem_NumericalValueSpecification: rba_SysElem_NumericalValue=65535
          IMU_A_AngAcc_Z_ST3: rba_SysElem_Length=16, rba_SysElem_ISignalForeignRef=IMU_A_AngAcc_Z_ST3, rba_SysElem_SystemSignalRef=rba_SysElem_SystemSignals/IMU_A_AngAcc_Z_ST3
            rba_SysElem_InitValue
              rba_SysElem_NumericalValueSpecification: rba_SysElem_NumericalValue=65535
          IMU_A_AngRate_X_ST3: rba_SysElem_Length=16, rba_SysElem_ISignalForeignRef=IMU_A_AngRate_X_ST3, rba_SysElem_SystemSignalRef=rba_SysElem_SystemSignals/IMU_A_AngRate_X_ST3
            rba_SysElem_InitValue
              rba_SysElem_NumericalValueSpecification: rba_SysElem_NumericalValue=65535
          IMU_A_AngRate_Y_ST3: rba_SysElem_Length=16, rba_SysElem_ISignalForeignRef=IMU_A_AngRate_Y_ST3, rba_SysElem_SystemSignalRef=rba_SysElem_SystemSignals/IMU_A_AngRate_Y_ST3
            rba_SysElem_InitValue
              rba_SysElem_NumericalValueSpecification: rba_SysElem_NumericalValue=65535
          IMU_A_AngRate_Z_ST3: rba_SysElem_Length=16, rba_SysElem_ISignalForeignRef=IMU_A_AngRate_Z_ST3, rba_SysElem_SystemSignalRef=rba_SysElem_SystemSignals/IMU_A_AngRate_Z_ST3
            rba_SysElem_InitValue
              rba_SysElem_NumericalValueSpecification: rba_SysElem_NumericalValue=65535
          IMU_A_AngRates_Stat_ST3: rba_SysElem_Length=3, rba_SysElem_ISignalForeignRef=IMU_A_AngRates_Stat_ST3, rba_SysElem_SystemSignalRef=rba_SysElem_SystemSignals/IMU_A_AngRates_Stat_ST3
            rba_SysElem_InitValue
              rba_SysElem_NumericalValueSpecification: rba_SysElem_NumericalValue=0
          IMU_A_SpecForce_Stat_ST3: rba_SysElem_Length=3, rba_SysElem_ISignalForeignRef=IMU_A_SpecForce_Stat_ST3, rba_SysElem_SystemSignalRef=rba_SysElem_SystemSignals/IMU_A_SpecForce_Stat_ST3
            rba_SysElem_InitValue
              rba_SysElem_NumericalValueSpecification: rba_SysElem_NumericalValue=0
          IMU_A_SpecForce_X_ST3: rba_SysElem_Length=16, rba_SysElem_ISignalForeignRef=IMU_A_SpecForce_X_ST3, rba_SysElem_SystemSignalRef=rba_SysElem_SystemSignals/IMU_A_SpecForce_X_ST3
            rba_SysElem_InitValue
              rba_SysElem_NumericalValueSpecification: rba_SysElem_NumericalValue=65535
          IMU_A_SpecForce_Y_ST3: rba_SysElem_Length=16, rba_SysElem_ISignalForeignRef=IMU_A_SpecForce_Y_ST3, rba_SysElem_SystemSignalRef=rba_SysElem_SystemSignals/IMU_A_SpecForce_Y_ST3
            rba_SysElem_InitValue
              rba_SysElem_NumericalValueSpecification: rba_SysElem_NumericalValue=65535
          IMU_A_SpecForce_Z_ST3: rba_SysElem_Length=16, rba_SysElem_ISignalForeignRef=IMU_A_SpecForce_Z_ST3, rba_SysElem_SystemSignalRef=rba_SysElem_SystemSignals/IMU_A_SpecForce_Z_ST3
            rba_SysElem_InitValue
              rba_SysElem_NumericalValueSpecification: rba_SysElem_NumericalValue=65535
          IMU_A_Stat_ST3: rba_SysElem_Length=3, rba_SysElem_ISignalForeignRef=IMU_A_Stat_ST3, rba_SysElem_SystemSignalRef=rba_SysElem_SystemSignals/IMU_A_Stat_ST3
            rba_SysElem_InitValue
              rba_SysElem_NumericalValueSpecification: rba_SysElem_NumericalValue=0
          IMU_A_Temp_ST3: rba_SysElem_Length=8, rba_SysElem_ISignalForeignRef=IMU_A_Temp_ST3, rba_SysElem_SystemSignalRef=rba_SysElem_SystemSignals/IMU_A_Temp_ST3
            rba_SysElem_InitValue
              rba_SysElem_NumericalValueSpecification: rba_SysElem_NumericalValue=255
          IMU_A_TmStmp_NanoSec_ST3: rba_SysElem_Length=32, rba_SysElem_ISignalForeignRef=IMU_A_TmStmp_NanoSec_ST3, rba_SysElem_SystemSignalRef=rba_SysElem_SystemSignals/IMU_A_TmStmp_NanoSec_ST3
            rba_SysElem_InitValue
              rba_SysElem_NumericalValueSpecification: rba_SysElem_NumericalValue=0
          IMU_A_TmStmp_Sec_ST3: rba_SysElem_Length=32, rba_SysElem_ISignalForeignRef=IMU_A_TmStmp_Sec_ST3, rba_SysElem_SystemSignalRef=rba_SysElem_SystemSignals/IMU_A_TmStmp_Sec_ST3
            rba_SysElem_InitValue
              rba_SysElem_NumericalValueSpecification: rba_SysElem_NumericalValue=0
          IMU_A_TmSync_Stat_ST3: rba_SysElem_Length=8, rba_SysElem_ISignalForeignRef=IMU_A_TmSync_Stat_ST3, rba_SysElem_SystemSignalRef=rba_SysElem_SystemSignals/IMU_A_TmSync_Stat_ST3
            rba_SysElem_InitValue
              rba_SysElem_NumericalValueSpecification: rba_SysElem_NumericalValue=128
          Rsrv01_IMU_A_Output_Pr5_ST3: rba_SysElem_Length=9, rba_SysElem_ISignalForeignRef=Rsrv01_IMU_A_Output_Pr5_ST3, rba_SysElem_SystemSignalRef=rba_SysElem_SystemSignals/Rsrv01_IMU_A_Output_Pr5_ST3
            rba_SysElem_InitValue
              rba_SysElem_NumericalValueSpecification: rba_SysElem_NumericalValue=511
          Rsrv02_IMU_A_Output_Pr5_ST3: rba_SysElem_Length=8, rba_SysElem_ISignalForeignRef=Rsrv02_IMU_A_Output_Pr5_ST3, rba_SysElem_SystemSignalRef=rba_SysElem_SystemSignals/Rsrv02_IMU_A_Output_Pr5_ST3
            rba_SysElem_InitValue
              rba_SysElem_NumericalValueSpecification: rba_SysElem_NumericalValue=255
          Rsrv03_IMU_A_Output_Pr5_ST3: rba_SysElem_Length=8, rba_SysElem_ISignalForeignRef=Rsrv03_IMU_A_Output_Pr5_ST3, rba_SysElem_SystemSignalRef=rba_SysElem_SystemSignals/Rsrv03_IMU_A_Output_Pr5_ST3
            rba_SysElem_InitValue
              rba_SysElem_NumericalValueSpecification: rba_SysElem_NumericalValue=255
          Rsrv04_IMU_A_Output_Pr5_ST3: rba_SysElem_Length=8, rba_SysElem_ISignalForeignRef=Rsrv04_IMU_A_Output_Pr5_ST3, rba_SysElem_SystemSignalRef=rba_SysElem_SystemSignals/Rsrv04_IMU_A_Output_Pr5_ST3
            rba_SysElem_InitValue
              rba_SysElem_NumericalValueSpecification: rba_SysElem_NumericalValue=255
          Rsrv05_IMU_A_Output_Pr5_ST3: rba_SysElem_Length=8, rba_SysElem_ISignalForeignRef=Rsrv05_IMU_A_Output_Pr5_ST3, rba_SysElem_SystemSignalRef=rba_SysElem_SystemSignals/Rsrv05_IMU_A_Output_Pr5_ST3
            rba_SysElem_InitValue
              rba_SysElem_NumericalValueSpecification: rba_SysElem_NumericalValue=255
          Rsrv06_IMU_A_Output_Pr5_ST3: rba_SysElem_Length=16, rba_SysElem_ISignalForeignRef=Rsrv06_IMU_A_Output_Pr5_ST3, rba_SysElem_SystemSignalRef=rba_SysElem_SystemSignals/Rsrv06_IMU_A_Output_Pr5_ST3
            rba_SysElem_InitValue
              rba_SysElem_NumericalValueSpecification: rba_SysElem_NumericalValue=65535
          Rsrv07_IMU_A_Output_Pr5_ST3: rba_SysElem_Length=3, rba_SysElem_ISignalForeignRef=Rsrv07_IMU_A_Output_Pr5_ST3, rba_SysElem_SystemSignalRef=rba_SysElem_SystemSignals/Rsrv07_IMU_A_Output_Pr5_ST3
            rba_SysElem_InitValue
              rba_SysElem_NumericalValueSpecification: rba_SysElem_NumericalValue=7
          SQC_IMU_A_Output_Pr5_ST3: rba_SysElem_Length=8, rba_SysElem_ISignalForeignRef=SQC_IMU_A_Output_Pr5_ST3, rba_SysElem_SystemSignalRef=rba_SysElem_SystemSignals/SQC_IMU_A_Output_Pr5_ST3
            rba_SysElem_InitValue
              rba_SysElem_NumericalValueSpecification: rba_SysElem_NumericalValue=0
          CRC_IMU_A_Output_Pr5_ST3_RENAME1: rba_SysElem_Length=16, rba_SysElem_ISignalForeignRef=CRC_IMU_A_Output_Pr5_ST3, rba_SysElem_SystemSignalRef=rba_SysElem_SystemSignals/CRC_IMU_A_Output_Pr5_ST3
            rba_SysElem_InitValue
              rba_SysElem_NumericalValueSpecification: rba_SysElem_NumericalValue=19347
          IMU_A_AngAcc_Stat_ST3_RENAME1: rba_SysElem_Length=3, rba_SysElem_ISignalForeignRef=IMU_A_AngAcc_Stat_ST3, rba_SysElem_SystemSignalRef=rba_SysElem_SystemSignals/IMU_A_AngAcc_Stat_ST3
            rba_SysElem_InitValue
              rba_SysElem_NumericalValueSpecification: rba_SysElem_NumericalValue=0
          IMU_A_AngAcc_X_ST3_RENAME1: rba_SysElem_Length=16, rba_SysElem_ISignalForeignRef=IMU_A_AngAcc_X_ST3, rba_SysElem_SystemSignalRef=rba_SysElem_SystemSignals/IMU_A_AngAcc_X_ST3
            rba_SysElem_InitValue
              rba_SysElem_NumericalValueSpecification: rba_SysElem_NumericalValue=65535
          IMU_A_AngAcc_Y_ST3_RENAME1: rba_SysElem_Length=16, rba_SysElem_ISignalForeignRef=IMU_A_AngAcc_Y_ST3, rba_SysElem_SystemSignalRef=rba_SysElem_SystemSignals/IMU_A_AngAcc_Y_ST3
            rba_SysElem_InitValue
              rba_SysElem_NumericalValueSpecification: rba_SysElem_NumericalValue=65535
          IMU_A_AngAcc_Z_ST3_RENAME1: rba_SysElem_Length=16, rba_SysElem_ISignalForeignRef=IMU_A_AngAcc_Z_ST3, rba_SysElem_SystemSignalRef=rba_SysElem_SystemSignals/IMU_A_AngAcc_Z_ST3
            rba_SysElem_InitValue
              rba_SysElem_NumericalValueSpecification: rba_SysElem_NumericalValue=65535
          IMU_A_AngRate_X_ST3_RENAME1: rba_SysElem_Length=16, rba_SysElem_ISignalForeignRef=IMU_A_AngRate_X_ST3, rba_SysElem_SystemSignalRef=rba_SysElem_SystemSignals/IMU_A_AngRate_X_ST3
            rba_SysElem_InitValue
              rba_SysElem_NumericalValueSpecification: rba_SysElem_NumericalValue=65535
          IMU_A_AngRate_Y_ST3_RENAME1: rba_SysElem_Length=16, rba_SysElem_ISignalForeignRef=IMU_A_AngRate_Y_ST3, rba_SysElem_SystemSignalRef=rba_SysElem_SystemSignals/IMU_A_AngRate_Y_ST3
            rba_SysElem_InitValue
              rba_SysElem_NumericalValueSpecification: rba_SysElem_NumericalValue=65535
          IMU_A_AngRate_Z_ST3_RENAME1: rba_SysElem_Length=16, rba_SysElem_ISignalForeignRef=IMU_A_AngRate_Z_ST3, rba_SysElem_SystemSignalRef=rba_SysElem_SystemSignals/IMU_A_AngRate_Z_ST3
            rba_SysElem_InitValue
              rba_SysElem_NumericalValueSpecification: rba_SysElem_NumericalValue=65535
          IMU_A_AngRates_Stat_ST3_RENAME1: rba_SysElem_Length=3, rba_SysElem_ISignalForeignRef=IMU_A_AngRates_Stat_ST3, rba_SysElem_SystemSignalRef=rba_SysElem_SystemSignals/IMU_A_AngRates_Stat_ST3
            rba_SysElem_InitValue
              rba_SysElem_NumericalValueSpecification: rba_SysElem_NumericalValue=0
          IMU_A_SpecForce_Stat_ST3_RENAME1: rba_SysElem_Length=3, rba_SysElem_ISignalForeignRef=IMU_A_SpecForce_Stat_ST3, rba_SysElem_SystemSignalRef=rba_SysElem_SystemSignals/IMU_A_SpecForce_Stat_ST3
            rba_SysElem_InitValue
              rba_SysElem_NumericalValueSpecification: rba_SysElem_NumericalValue=0
          IMU_A_SpecForce_X_ST3_RENAME1: rba_SysElem_Length=16, rba_SysElem_ISignalForeignRef=IMU_A_SpecForce_X_ST3, rba_SysElem_SystemSignalRef=rba_SysElem_SystemSignals/IMU_A_SpecForce_X_ST3
            rba_SysElem_InitValue
              rba_SysElem_NumericalValueSpecification: rba_SysElem_NumericalValue=65535
          IMU_A_SpecForce_Y_ST3_RENAME1: rba_SysElem_Length=16, rba_SysElem_ISignalForeignRef=IMU_A_SpecForce_Y_ST3, rba_SysElem_SystemSignalRef=rba_SysElem_SystemSignals/IMU_A_SpecForce_Y_ST3
            rba_SysElem_InitValue
              rba_SysElem_NumericalValueSpecification: rba_SysElem_NumericalValue=65535
          IMU_A_SpecForce_Z_ST3_RENAME1: rba_SysElem_Length=16, rba_SysElem_ISignalForeignRef=IMU_A_SpecForce_Z_ST3, rba_SysElem_SystemSignalRef=rba_SysElem_SystemSignals/IMU_A_SpecForce_Z_ST3
            rba_SysElem_InitValue
              rba_SysElem_NumericalValueSpecification: rba_SysElem_NumericalValue=65535
          IMU_A_Stat_ST3_RENAME1: rba_SysElem_Length=3, rba_SysElem_ISignalForeignRef=IMU_A_Stat_ST3, rba_SysElem_SystemSignalRef=rba_SysElem_SystemSignals/IMU_A_Stat_ST3
            rba_SysElem_InitValue
              rba_SysElem_NumericalValueSpecification: rba_SysElem_NumericalValue=0
          IMU_A_Temp_ST3_RENAME1: rba_SysElem_Length=8, rba_SysElem_ISignalForeignRef=IMU_A_Temp_ST3, rba_SysElem_SystemSignalRef=rba_SysElem_SystemSignals/IMU_A_Temp_ST3
            rba_SysElem_InitValue
              rba_SysElem_NumericalValueSpecification: rba_SysElem_NumericalValue=255
          IMU_A_TmStmp_NanoSec_ST3_RENAME1: rba_SysElem_Length=32, rba_SysElem_ISignalForeignRef=IMU_A_TmStmp_NanoSec_ST3, rba_SysElem_SystemSignalRef=rba_SysElem_SystemSignals/IMU_A_TmStmp_NanoSec_ST3
            rba_SysElem_InitValue
              rba_SysElem_NumericalValueSpecification: rba_SysElem_NumericalValue=0
          IMU_A_TmStmp_Sec_ST3_RENAME1: rba_SysElem_Length=32, rba_SysElem_ISignalForeignRef=IMU_A_TmStmp_Sec_ST3, rba_SysElem_SystemSignalRef=rba_SysElem_SystemSignals/IMU_A_TmStmp_Sec_ST3
            rba_SysElem_InitValue
              rba_SysElem_NumericalValueSpecification: rba_SysElem_NumericalValue=0
          IMU_A_TmSync_Stat_ST3_RENAME1: rba_SysElem_Length=8, rba_SysElem_ISignalForeignRef=IMU_A_TmSync_Stat_ST3, rba_SysElem_SystemSignalRef=rba_SysElem_SystemSignals/IMU_A_TmSync_Stat_ST3
            rba_SysElem_InitValue
              rba_SysElem_NumericalValueSpecification: rba_SysElem_NumericalValue=128
          Rsrv01_IMU_A_Output_Pr5_ST3_RENAME1: rba_SysElem_Length=9, rba_SysElem_ISignalForeignRef=Rsrv01_IMU_A_Output_Pr5_ST3, rba_SysElem_SystemSignalRef=rba_SysElem_SystemSignals/Rsrv01_IMU_A_Output_Pr5_ST3
            rba_SysElem_InitValue
              rba_SysElem_NumericalValueSpecification: rba_SysElem_NumericalValue=511
          Rsrv02_IMU_A_Output_Pr5_ST3_RENAME1: rba_SysElem_Length=8, rba_SysElem_ISignalForeignRef=Rsrv02_IMU_A_Output_Pr5_ST3, rba_SysElem_SystemSignalRef=rba_SysElem_SystemSignals/Rsrv02_IMU_A_Output_Pr5_ST3
            rba_SysElem_InitValue
              rba_SysElem_NumericalValueSpecification: rba_SysElem_NumericalValue=255
          Rsrv03_IMU_A_Output_Pr5_ST3_RENAME1: rba_SysElem_Length=8, rba_SysElem_ISignalForeignRef=Rsrv03_IMU_A_Output_Pr5_ST3, rba_SysElem_SystemSignalRef=rba_SysElem_SystemSignals/Rsrv03_IMU_A_Output_Pr5_ST3
            rba_SysElem_InitValue
              rba_SysElem_NumericalValueSpecification: rba_SysElem_NumericalValue=255
          Rsrv04_IMU_A_Output_Pr5_ST3_RENAME1: rba_SysElem_Length=8, rba_SysElem_ISignalForeignRef=Rsrv04_IMU_A_Output_Pr5_ST3, rba_SysElem_SystemSignalRef=rba_SysElem_SystemSignals/Rsrv04_IMU_A_Output_Pr5_ST3
            rba_SysElem_InitValue
              rba_SysElem_NumericalValueSpecification: rba_SysElem_NumericalValue=255
          Rsrv05_IMU_A_Output_Pr5_ST3_RENAME1: rba_SysElem_Length=8, rba_SysElem_ISignalForeignRef=Rsrv05_IMU_A_Output_Pr5_ST3, rba_SysElem_SystemSignalRef=rba_SysElem_SystemSignals/Rsrv05_IMU_A_Output_Pr5_ST3
            rba_SysElem_InitValue
              rba_SysElem_NumericalValueSpecification: rba_SysElem_NumericalValue=255
          Rsrv06_IMU_A_Output_Pr5_ST3_RENAME1: rba_SysElem_Length=16, rba_SysElem_ISignalForeignRef=Rsrv06_IMU_A_Output_Pr5_ST3, rba_SysElem_SystemSignalRef=rba_SysElem_SystemSignals/Rsrv06_IMU_A_Output_Pr5_ST3
            rba_SysElem_InitValue
              rba_SysElem_NumericalValueSpecification: rba_SysElem_NumericalValue=65535
          Rsrv07_IMU_A_Output_Pr5_ST3_RENAME1: rba_SysElem_Length=3, rba_SysElem_ISignalForeignRef=Rsrv07_IMU_A_Output_Pr5_ST3, rba_SysElem_SystemSignalRef=rba_SysElem_SystemSignals/Rsrv07_IMU_A_Output_Pr5_ST3
            rba_SysElem_InitValue
              rba_SysElem_NumericalValueSpecification: rba_SysElem_NumericalValue=7
          SQC_IMU_A_Output_Pr5_ST3_RENAME1: rba_SysElem_Length=8, rba_SysElem_ISignalForeignRef=SQC_IMU_A_Output_Pr5_ST3, rba_SysElem_SystemSignalRef=rba_SysElem_SystemSignals/SQC_IMU_A_Output_Pr5_ST3
            rba_SysElem_InitValue
              rba_SysElem_NumericalValueSpecification: rba_SysElem_NumericalValue=0
          CRC_Ign_Stat_Pr5_ST3: rba_SysElem_Length=16, rba_SysElem_ISignalForeignRef=CRC_Ign_Stat_Pr5_ST3, rba_SysElem_SystemSignalRef=rba_SysElem_SystemSignals/CRC_Ign_Stat_Pr5_ST3
            rba_SysElem_InitValue
              rba_SysElem_NumericalValueSpecification: rba_SysElem_NumericalValue=20886
          ISw_Stat_ST3: rba_SysElem_Length=3, rba_SysElem_ISignalForeignRef=ISw_Stat_ST3, rba_SysElem_SystemSignalRef=rba_SysElem_SystemSignals/ISw_Stat_ST3
            rba_SysElem_InitValue
              rba_SysElem_NumericalValueSpecification: rba_SysElem_NumericalValue=7
          KG_StartSw_Psd_ST3: rba_SysElem_Length=1, rba_SysElem_ISignalForeignRef=KG_StartSw_Psd_ST3, rba_SysElem_SystemSignalRef=rba_SysElem_SystemSignals/KG_StartSw_Psd_ST3
            rba_SysElem_InitValue
              rba_SysElem_NumericalValueSpecification: rba_SysElem_NumericalValue=0
          SQC_Ign_Stat_Pr5_ST3: rba_SysElem_Length=8, rba_SysElem_ISignalForeignRef=SQC_Ign_Stat_Pr5_ST3, rba_SysElem_SystemSignalRef=rba_SysElem_SystemSignals/SQC_Ign_Stat_Pr5_ST3
            rba_SysElem_InitValue
              rba_SysElem_NumericalValueSpecification: rba_SysElem_NumericalValue=0
          Veh_Op_Mode_ST3: rba_SysElem_Length=4, rba_SysElem_ISignalForeignRef=Veh_Op_Mode_ST3, rba_SysElem_SystemSignalRef=rba_SysElem_SystemSignals/Veh_Op_Mode_ST3
            rba_SysElem_InitValue
              rba_SysElem_NumericalValueSpecification: rba_SysElem_NumericalValue=0
          CRC_PT4_PTCoor4_Pr5_ST3: rba_SysElem_Length=16, rba_SysElem_ISignalForeignRef=CRC_PT4_PTCoor4_Pr5_ST3, rba_SysElem_SystemSignalRef=rba_SysElem_SystemSignals/CRC_PT4_PTCoor4_Pr5_ST3
            rba_SysElem_InitValue
              rba_SysElem_NumericalValueSpecification: rba_SysElem_NumericalValue=4203
          PT4_PTCoor_EngStartPN14_Stat_ST3: rba_SysElem_Length=3, rba_SysElem_ISignalForeignRef=PT4_PTCoor_EngStartPN14_Stat_ST3, rba_SysElem_SystemSignalRef=rba_SysElem_SystemSignals/PT4_PTCoor_EngStartPN14_Stat_ST3
            rba_SysElem_InitValue
              rba_SysElem_NumericalValueSpecification: rba_SysElem_NumericalValue=0
          PT4_PTCoor_PT_Rdy_ST3: rba_SysElem_Length=2, rba_SysElem_ISignalForeignRef=PT4_PTCoor_PT_Rdy_ST3, rba_SysElem_SystemSignalRef=rba_SysElem_SystemSignals/PT4_PTCoor_PT_Rdy_ST3
            rba_SysElem_InitValue
              rba_SysElem_NumericalValueSpecification: rba_SysElem_NumericalValue=0
          PT4_PTCoor_SSA_EngSp_ST3: rba_SysElem_Length=2, rba_SysElem_ISignalForeignRef=PT4_PTCoor_SSA_EngSp_ST3, rba_SysElem_SystemSignalRef=rba_SysElem_SystemSignals/PT4_PTCoor_SSA_EngSp_ST3
            rba_SysElem_InitValue
              rba_SysElem_NumericalValueSpecification: rba_SysElem_NumericalValue=3
          Rsrv1_PT4_PTCoor_PT_Rdy_Pr5_ST3: rba_SysElem_Length=1, rba_SysElem_ISignalForeignRef=Rsrv1_PT4_PTCoor_PT_Rdy_Pr5_ST3, rba_SysElem_SystemSignalRef=rba_SysElem_SystemSignals/Rsrv1_PT4_PTCoor_PT_Rdy_Pr5_ST3
            rba_SysElem_InitValue
              rba_SysElem_NumericalValueSpecification: rba_SysElem_NumericalValue=1
          SQC_PT4_PTCoor4_Pr5_ST3: rba_SysElem_Length=8, rba_SysElem_ISignalForeignRef=SQC_PT4_PTCoor4_Pr5_ST3, rba_SysElem_SystemSignalRef=rba_SysElem_SystemSignals/SQC_PT4_PTCoor4_Pr5_ST3
            rba_SysElem_InitValue
              rba_SysElem_NumericalValueSpecification: rba_SysElem_NumericalValue=0
          CRC_DI_Odo_Pr5_ST3: rba_SysElem_Length=16, rba_SysElem_ISignalForeignRef=CRC_DI_Odo_Pr5_ST3, rba_SysElem_SystemSignalRef=rba_SysElem_SystemSignals/CRC_DI_Odo_Pr5_ST3
            rba_SysElem_InitValue
              rba_SysElem_NumericalValueSpecification: rba_SysElem_NumericalValue=8633
          Odo_ST3: rba_SysElem_Length=24, rba_SysElem_ISignalForeignRef=Odo_ST3, rba_SysElem_SystemSignalRef=rba_SysElem_SystemSignals/Odo_ST3
            rba_SysElem_InitValue
              rba_SysElem_NumericalValueSpecification: rba_SysElem_NumericalValue=16777215
          SQC_DI_Odo_Pr5_ST3: rba_SysElem_Length=8, rba_SysElem_ISignalForeignRef=SQC_DI_Odo_Pr5_ST3, rba_SysElem_SystemSignalRef=rba_SysElem_SystemSignals/SQC_DI_Odo_Pr5_ST3
            rba_SysElem_InitValue
              rba_SysElem_NumericalValueSpecification: rba_SysElem_NumericalValue=0
      rba_SysElem_SystemSignals
        40 x rba_SysElem_SystemSignal, all with rba_SysElem_DynamicLength=false:
          CRC_IMU_A_Output_Pr5_ST3: rba_SysElem_SystemSignalForeignRef=CRC_IMU_A_Output_Pr5_ST3
          IMU_A_AngAcc_Stat_ST3: rba_SysElem_SystemSignalForeignRef=IMU_A_AngAcc_Stat_ST3
          IMU_A_AngAcc_X_ST3: rba_SysElem_SystemSignalForeignRef=IMU_A_AngAcc_X_ST3
          IMU_A_AngAcc_Y_ST3: rba_SysElem_SystemSignalForeignRef=IMU_A_AngAcc_Y_ST3
          IMU_A_AngAcc_Z_ST3: rba_SysElem_SystemSignalForeignRef=IMU_A_AngAcc_Z_ST3
          IMU_A_AngRate_X_ST3: rba_SysElem_SystemSignalForeignRef=IMU_A_AngRate_X_ST3
          IMU_A_AngRate_Y_ST3: rba_SysElem_SystemSignalForeignRef=IMU_A_AngRate_Y_ST3
          IMU_A_AngRate_Z_ST3: rba_SysElem_SystemSignalForeignRef=IMU_A_AngRate_Z_ST3
          IMU_A_AngRates_Stat_ST3: rba_SysElem_SystemSignalForeignRef=IMU_A_AngRates_Stat_ST3
          IMU_A_SpecForce_Stat_ST3: rba_SysElem_SystemSignalForeignRef=IMU_A_SpecForce_Stat_ST3
          IMU_A_SpecForce_X_ST3: rba_SysElem_SystemSignalForeignRef=IMU_A_SpecForce_X_ST3
          IMU_A_SpecForce_Y_ST3: rba_SysElem_SystemSignalForeignRef=IMU_A_SpecForce_Y_ST3
          IMU_A_SpecForce_Z_ST3: rba_SysElem_SystemSignalForeignRef=IMU_A_SpecForce_Z_ST3
          IMU_A_Stat_ST3: rba_SysElem_SystemSignalForeignRef=IMU_A_Stat_ST3
          IMU_A_Temp_ST3: rba_SysElem_SystemSignalForeignRef=IMU_A_Temp_ST3
          IMU_A_TmStmp_NanoSec_ST3: rba_SysElem_SystemSignalForeignRef=IMU_A_TmStmp_NanoSec_ST3
          IMU_A_TmStmp_Sec_ST3: rba_SysElem_SystemSignalForeignRef=IMU_A_TmStmp_Sec_ST3
          IMU_A_TmSync_Stat_ST3: rba_SysElem_SystemSignalForeignRef=IMU_A_TmSync_Stat_ST3
          Rsrv{01..07}_IMU_A_Output_Pr5_ST3: rba_SysElem_SystemSignalForeignRef=Rsrv{01..07}_IMU_A_Output_Pr5_ST3
          SQC_IMU_A_Output_Pr5_ST3: rba_SysElem_SystemSignalForeignRef=SQC_IMU_A_Output_Pr5_ST3
          CRC_Ign_Stat_Pr5_ST3: rba_SysElem_SystemSignalForeignRef=CRC_Ign_Stat_Pr5_ST3
          ISw_Stat_ST3: rba_SysElem_SystemSignalForeignRef=ISw_Stat_ST3
          KG_StartSw_Psd_ST3: rba_SysElem_SystemSignalForeignRef=KG_StartSw_Psd_ST3
          SQC_Ign_Stat_Pr5_ST3: rba_SysElem_SystemSignalForeignRef=SQC_Ign_Stat_Pr5_ST3
          Veh_Op_Mode_ST3: rba_SysElem_SystemSignalForeignRef=Veh_Op_Mode_ST3
          CRC_PT4_PTCoor4_Pr5_ST3: rba_SysElem_SystemSignalForeignRef=CRC_PT4_PTCoor4_Pr5_ST3
          PT4_PTCoor_EngStartPN14_Stat_ST3: rba_SysElem_SystemSignalForeignRef=PT4_PTCoor_EngStartPN14_Stat_ST3
          PT4_PTCoor_PT_Rdy_ST3: rba_SysElem_SystemSignalForeignRef=PT4_PTCoor_PT_Rdy_ST3
          PT4_PTCoor_SSA_EngSp_ST3: rba_SysElem_SystemSignalForeignRef=PT4_PTCoor_SSA_EngSp_ST3
          Rsrv1_PT4_PTCoor_PT_Rdy_Pr5_ST3: rba_SysElem_SystemSignalForeignRef=Rsrv1_PT4_PTCoor_PT_Rdy_Pr5_ST3
          SQC_PT4_PTCoor4_Pr5_ST3: rba_SysElem_SystemSignalForeignRef=SQC_PT4_PTCoor4_Pr5_ST3
          CRC_DI_Odo_Pr5_ST3: rba_SysElem_SystemSignalForeignRef=CRC_DI_Odo_Pr5_ST3
          Odo_ST3: rba_SysElem_SystemSignalForeignRef=Odo_ST3
          SQC_DI_Odo_Pr5_ST3: rba_SysElem_SystemSignalForeignRef=SQC_DI_Odo_Pr5_ST3
      rba_SysElem_SystemSignalGroups
        4 x rba_SysElem_SystemSignalGroup:
          IMU_A_Output_Pr5_ST3_bezr5ct33mhwxias0s8rjhbne: rba_SysElem_SystemSignalGroupForeignRef=IMU_A_Output_Pr5_ST3_bezr5ct33mhwxias0s8rjhbne, rba_SysElem_SystemSignal=rba_SysElem_SystemSignals/CRC_IMU_A_Output_Pr5_ST3, rba_SysElem_SystemSignal=rba_SysElem_SystemSignals/IMU_A_AngAcc_Stat_ST3, rba_SysElem_SystemSignal=rba_SysElem_SystemSignals/IMU_A_AngAcc_X_ST3, rba_SysElem_SystemSignal=rba_SysElem_SystemSignals/IMU_A_AngAcc_Y_ST3, rba_SysElem_SystemSignal=rba_SysElem_SystemSignals/IMU_A_AngAcc_Z_ST3, rba_SysElem_SystemSignal=rba_SysElem_SystemSignals/IMU_A_AngRate_X_ST3, rba_SysElem_SystemSignal=rba_SysElem_SystemSignals/IMU_A_AngRate_Y_ST3, rba_SysElem_SystemSignal=rba_SysElem_SystemSignals/IMU_A_AngRate_Z_ST3, rba_SysElem_SystemSignal=rba_SysElem_SystemSignals/IMU_A_AngRates_Stat_ST3, rba_SysElem_SystemSignal=rba_SysElem_SystemSignals/IMU_A_SpecForce_Stat_ST3, rba_SysElem_SystemSignal=rba_SysElem_SystemSignals/IMU_A_SpecForce_X_ST3, rba_SysElem_SystemSignal=rba_SysElem_SystemSignals/IMU_A_SpecForce_Y_ST3, rba_SysElem_SystemSignal=rba_SysElem_SystemSignals/IMU_A_SpecForce_Z_ST3, rba_SysElem_SystemSignal=rba_SysElem_SystemSignals/IMU_A_Stat_ST3, rba_SysElem_SystemSignal=rba_SysElem_SystemSignals/IMU_A_Temp_ST3, rba_SysElem_SystemSignal=rba_SysElem_SystemSignals/IMU_A_TmStmp_NanoSec_ST3, rba_SysElem_SystemSignal=rba_SysElem_SystemSignals/IMU_A_TmStmp_Sec_ST3, rba_SysElem_SystemSignal=rba_SysElem_SystemSignals/IMU_A_TmSync_Stat_ST3, rba_SysElem_SystemSignal=rba_SysElem_SystemSignals/Rsrv01_IMU_A_Output_Pr5_ST3, rba_SysElem_SystemSignal=rba_SysElem_SystemSignals/Rsrv02_IMU_A_Output_Pr5_ST3, rba_SysElem_SystemSignal=rba_SysElem_SystemSignals/Rsrv03_IMU_A_Output_Pr5_ST3, rba_SysElem_SystemSignal=rba_SysElem_SystemSignals/Rsrv04_IMU_A_Output_Pr5_ST3, rba_SysElem_SystemSignal=rba_SysElem_SystemSignals/Rsrv05_IMU_A_Output_Pr5_ST3, rba_SysElem_SystemSignal=rba_SysElem_SystemSignals/Rsrv06_IMU_A_Output_Pr5_ST3, rba_SysElem_SystemSignal=rba_SysElem_SystemSignals/Rsrv07_IMU_A_Output_Pr5_ST3, rba_SysElem_SystemSignal=rba_SysElem_SystemSignals/SQC_IMU_A_Output_Pr5_ST3
          Ign_Stat_Pr5_ST3_csgs1dv6drms80o1i9p49677w: rba_SysElem_SystemSignalGroupForeignRef=Ign_Stat_Pr5_ST3_csgs1dv6drms80o1i9p49677w, rba_SysElem_SystemSignal=rba_SysElem_SystemSignals/CRC_Ign_Stat_Pr5_ST3, rba_SysElem_SystemSignal=rba_SysElem_SystemSignals/ISw_Stat_ST3, rba_SysElem_SystemSignal=rba_SysElem_SystemSignals/KG_StartSw_Psd_ST3, rba_SysElem_SystemSignal=rba_SysElem_SystemSignals/SQC_Ign_Stat_Pr5_ST3, rba_SysElem_SystemSignal=rba_SysElem_SystemSignals/Veh_Op_Mode_ST3
          PT4_PTCoor4_Pr5_ST3_af4fxb1ykieox3itqdfzs0kpb: rba_SysElem_SystemSignalGroupForeignRef=PT4_PTCoor4_Pr5_ST3_af4fxb1ykieox3itqdfzs0kpb, rba_SysElem_SystemSignal=rba_SysElem_SystemSignals/CRC_PT4_PTCoor4_Pr5_ST3, rba_SysElem_SystemSignal=rba_SysElem_SystemSignals/PT4_PTCoor_EngStartPN14_Stat_ST3, rba_SysElem_SystemSignal=rba_SysElem_SystemSignals/PT4_PTCoor_PT_Rdy_ST3, rba_SysElem_SystemSignal=rba_SysElem_SystemSignals/PT4_PTCoor_SSA_EngSp_ST3, rba_SysElem_SystemSignal=rba_SysElem_SystemSignals/Rsrv1_PT4_PTCoor_PT_Rdy_Pr5_ST3, rba_SysElem_SystemSignal=rba_SysElem_SystemSignals/SQC_PT4_PTCoor4_Pr5_ST3
          DI_Odo_Pr5_ST3_e68xmtlkywxgxsdwekdjjhw3t: rba_SysElem_SystemSignalGroupForeignRef=DI_Odo_Pr5_ST3_e68xmtlkywxgxsdwekdjjhw3t, rba_SysElem_SystemSignal=rba_SysElem_SystemSignals/CRC_DI_Odo_Pr5_ST3, rba_SysElem_SystemSignal=rba_SysElem_SystemSignals/Odo_ST3, rba_SysElem_SystemSignal=rba_SysElem_SystemSignals/SQC_DI_Odo_Pr5_ST3
      rba_SysElem_DataTransformations
        3 x rba_SysElem_DataTransformation, all with rba_SysElem_Direction=out, rba_SysElem_ExecuteDespiteDataUnavailability=true:
          BaseTrans_Profile_5_40
            ComBasedTransformer40 (rba_SysElem_TransformationTechnology): rba_SysElem_Index=0, rba_SysElem_TransformationTechnologyRef=rba_SysElem_TransformationTechnologies/ComBasedTransformer40
            E2E_Profile_5 (rba_SysElem_TransformationTechnology): rba_SysElem_Index=1, rba_SysElem_TransformationTechnologyRef=rba_SysElem_TransformationTechnologies/E2E_Profile_5
          BaseTrans_Profile_5_4
            ComBasedTransformer4 (rba_SysElem_TransformationTechnology): rba_SysElem_Index=0, rba_SysElem_TransformationTechnologyRef=rba_SysElem_TransformationTechnologies/ComBasedTransformer4
            E2E_Profile_5 (rba_SysElem_TransformationTechnology): rba_SysElem_Index=1, rba_SysElem_TransformationTechnologyRef=rba_SysElem_TransformationTechnologies/E2E_Profile_5
          BaseTrans_Profile_5_6
            ComBasedTransformer6 (rba_SysElem_TransformationTechnology): rba_SysElem_Index=0, rba_SysElem_TransformationTechnologyRef=rba_SysElem_TransformationTechnologies/ComBasedTransformer6
            E2E_Profile_5 (rba_SysElem_TransformationTechnology): rba_SysElem_Index=1, rba_SysElem_TransformationTechnologyRef=rba_SysElem_TransformationTechnologies/E2E_Profile_5
      rba_SysElem_TransformationTechnologies
        4 x rba_SysElem_TransformationTechnology, all with rba_SysElem_Version=1:
          ComBasedTransformer40: rba_SysElem_Protocol=COMBased, rba_SysElem_TransformerClass=serializer, rba_SysElem_TransformationTechnologyForeignRef=ComBasedTransformer40
            rba_SysElem_BufferProperties: rba_SysElem_InPlace=false, rba_SysElem_HeaderLength=0
              rba_SysElem_CompuScale: rba_SysElem_Denominator=1, rba_SysElem_Numerator2=0, rba_SysElem_Numerator1=40
          E2E_Profile_5: rba_SysElem_Protocol=E2E, rba_SysElem_NeedsOriginalData=false, rba_SysElem_TransformerClass=safety, rba_SysElem_TransformationTechnologyForeignRef=E2E_Profile_5
            rba_SysElem_BufferProperties: rba_SysElem_InPlace=true, rba_SysElem_HeaderLength=0
            rba_SysElem_TransformationDescription
              rba_SysElem_EndToEndTransformationDescription:
                rba_SysElem_MaxDeltaCounter = 3
                rba_SysElem_MaxErrorStateValid = 0
                rba_SysElem_MinOkStateInvalid = 1
                rba_SysElem_MaxErrorStateInit = 0
                rba_SysElem_UpperHeaderBitsToShift = 0
                rba_SysElem_MinOkStateInit = 1
                rba_SysElem_Offset = 0
                rba_SysElem_ProfileName = PROFILE_05
                rba_SysElem_MaxErrorStateInvalid = 0
                rba_SysElem_MinOkStateValid = 1
          ComBasedTransformer4: rba_SysElem_Protocol=COMBased, rba_SysElem_TransformerClass=serializer, rba_SysElem_TransformationTechnologyForeignRef=ComBasedTransformer4
            rba_SysElem_BufferProperties: rba_SysElem_InPlace=false, rba_SysElem_HeaderLength=0
              rba_SysElem_CompuScale: rba_SysElem_Denominator=1, rba_SysElem_Numerator2=0, rba_SysElem_Numerator1=4
          ComBasedTransformer6: rba_SysElem_Protocol=COMBased, rba_SysElem_TransformerClass=serializer, rba_SysElem_TransformationTechnologyForeignRef=ComBasedTransformer6
            rba_SysElem_BufferProperties: rba_SysElem_InPlace=false, rba_SysElem_HeaderLength=0
              rba_SysElem_CompuScale: rba_SysElem_Denominator=1, rba_SysElem_Numerator2=0, rba_SysElem_Numerator1=6
      rba_SysElem_IPdus
        5 x rba_SysElem_IPdu:
          IMU_A_Output_ST3
            rba_SysElem_ISignalIPdu: rba_SysElem_UseLdCom=false, rba_SysElem_Length=40, rba_SysElem_UnusedBitPattern=255
              27 x rba_SysElem_ISignalToPduMapping:
                IMU_A_Output_Pr5_ST3_bezr5ct33mhwxias0s8rjhbne: rba_SysElem_ISignalGroupRef=rba_SysElem_ISignalGroups/IMU_A_Output_Pr5_ST3_bezr5ct33mhwxias0s8rjhbne, rba_SysElem_ISignalToPduMappingForeignRef=IMU_A_Output_Pr5_ST3_bezr5ct33mhwxias0s8rjhbne
                CRC_IMU_A_Output_Pr5_ST3: rba_SysElem_StartPosition=0, rba_SysElem_PackingByteOrder=mostSignificantByteLast, rba_SysElem_ISignalRef=rba_SysElem_ISignals/CRC_IMU_A_Output_Pr5_ST3, rba_SysElem_ISignalToPduMappingForeignRef=CRC_IMU_A_Output_Pr5_ST3
                IMU_A_AngAcc_Stat_ST3: rba_SysElem_StartPosition=27, rba_SysElem_PackingByteOrder=mostSignificantByteLast, rba_SysElem_ISignalRef=rba_SysElem_ISignals/IMU_A_AngAcc_Stat_ST3, rba_SysElem_ISignalToPduMappingForeignRef=IMU_A_AngAcc_Stat_ST3
                IMU_A_AngAcc_X_ST3: rba_SysElem_StartPosition=55, rba_SysElem_PackingByteOrder=mostSignificantByteLast, rba_SysElem_ISignalRef=rba_SysElem_ISignals/IMU_A_AngAcc_X_ST3, rba_SysElem_ISignalToPduMappingForeignRef=IMU_A_AngAcc_X_ST3
                IMU_A_AngAcc_Y_ST3: rba_SysElem_StartPosition=71, rba_SysElem_PackingByteOrder=mostSignificantByteLast, rba_SysElem_ISignalRef=rba_SysElem_ISignals/IMU_A_AngAcc_Y_ST3, rba_SysElem_ISignalToPduMappingForeignRef=IMU_A_AngAcc_Y_ST3
                IMU_A_AngAcc_Z_ST3: rba_SysElem_StartPosition=87, rba_SysElem_PackingByteOrder=mostSignificantByteLast, rba_SysElem_ISignalRef=rba_SysElem_ISignals/IMU_A_AngAcc_Z_ST3, rba_SysElem_ISignalToPduMappingForeignRef=IMU_A_AngAcc_Z_ST3
                IMU_A_AngRate_X_ST3: rba_SysElem_StartPosition=103, rba_SysElem_PackingByteOrder=mostSignificantByteLast, rba_SysElem_ISignalRef=rba_SysElem_ISignals/IMU_A_AngRate_X_ST3, rba_SysElem_ISignalToPduMappingForeignRef=IMU_A_AngRate_X_ST3
                IMU_A_AngRate_Y_ST3: rba_SysElem_StartPosition=119, rba_SysElem_PackingByteOrder=mostSignificantByteLast, rba_SysElem_ISignalRef=rba_SysElem_ISignals/IMU_A_AngRate_Y_ST3, rba_SysElem_ISignalToPduMappingForeignRef=IMU_A_AngRate_Y_ST3
                IMU_A_AngRate_Z_ST3: rba_SysElem_StartPosition=135, rba_SysElem_PackingByteOrder=mostSignificantByteLast, rba_SysElem_ISignalRef=rba_SysElem_ISignals/IMU_A_AngRate_Z_ST3, rba_SysElem_ISignalToPduMappingForeignRef=IMU_A_AngRate_Z_ST3
                IMU_A_AngRates_Stat_ST3: rba_SysElem_StartPosition=30, rba_SysElem_PackingByteOrder=mostSignificantByteLast, rba_SysElem_ISignalRef=rba_SysElem_ISignals/IMU_A_AngRates_Stat_ST3, rba_SysElem_ISignalToPduMappingForeignRef=IMU_A_AngRates_Stat_ST3
                IMU_A_SpecForce_Stat_ST3: rba_SysElem_StartPosition=36, rba_SysElem_PackingByteOrder=mostSignificantByteLast, rba_SysElem_ISignalRef=rba_SysElem_ISignals/IMU_A_SpecForce_Stat_ST3, rba_SysElem_ISignalToPduMappingForeignRef=IMU_A_SpecForce_Stat_ST3
                IMU_A_SpecForce_X_ST3: rba_SysElem_StartPosition=151, rba_SysElem_PackingByteOrder=mostSignificantByteLast, rba_SysElem_ISignalRef=rba_SysElem_ISignals/IMU_A_SpecForce_X_ST3, rba_SysElem_ISignalToPduMappingForeignRef=IMU_A_SpecForce_X_ST3
                IMU_A_SpecForce_Y_ST3: rba_SysElem_StartPosition=167, rba_SysElem_PackingByteOrder=mostSignificantByteLast, rba_SysElem_ISignalRef=rba_SysElem_ISignals/IMU_A_SpecForce_Y_ST3, rba_SysElem_ISignalToPduMappingForeignRef=IMU_A_SpecForce_Y_ST3
                IMU_A_SpecForce_Z_ST3: rba_SysElem_StartPosition=183, rba_SysElem_PackingByteOrder=mostSignificantByteLast, rba_SysElem_ISignalRef=rba_SysElem_ISignals/IMU_A_SpecForce_Z_ST3, rba_SysElem_ISignalToPduMappingForeignRef=IMU_A_SpecForce_Z_ST3
                IMU_A_Stat_ST3: rba_SysElem_StartPosition=24, rba_SysElem_PackingByteOrder=mostSignificantByteLast, rba_SysElem_ISignalRef=rba_SysElem_ISignals/IMU_A_Stat_ST3, rba_SysElem_ISignalToPduMappingForeignRef=IMU_A_Stat_ST3
                IMU_A_Temp_ST3: rba_SysElem_StartPosition=39, rba_SysElem_PackingByteOrder=mostSignificantByteLast, rba_SysElem_ISignalRef=rba_SysElem_ISignals/IMU_A_Temp_ST3, rba_SysElem_ISignalToPduMappingForeignRef=IMU_A_Temp_ST3
                IMU_A_TmStmp_NanoSec_ST3: rba_SysElem_StartPosition=199, rba_SysElem_PackingByteOrder=mostSignificantByteLast, rba_SysElem_ISignalRef=rba_SysElem_ISignals/IMU_A_TmStmp_NanoSec_ST3, rba_SysElem_ISignalToPduMappingForeignRef=IMU_A_TmStmp_NanoSec_ST3
                IMU_A_TmStmp_Sec_ST3: rba_SysElem_StartPosition=231, rba_SysElem_PackingByteOrder=mostSignificantByteLast, rba_SysElem_ISignalRef=rba_SysElem_ISignals/IMU_A_TmStmp_Sec_ST3, rba_SysElem_ISignalToPduMappingForeignRef=IMU_A_TmStmp_Sec_ST3
                IMU_A_TmSync_Stat_ST3: rba_SysElem_StartPosition=47, rba_SysElem_PackingByteOrder=mostSignificantByteLast, rba_SysElem_ISignalRef=rba_SysElem_ISignals/IMU_A_TmSync_Stat_ST3, rba_SysElem_ISignalToPduMappingForeignRef=IMU_A_TmSync_Stat_ST3
                SQC_IMU_A_Output_Pr5_ST3: rba_SysElem_StartPosition=16, rba_SysElem_PackingByteOrder=mostSignificantByteLast, rba_SysElem_ISignalRef=rba_SysElem_ISignals/SQC_IMU_A_Output_Pr5_ST3, rba_SysElem_ISignalToPduMappingForeignRef=SQC_IMU_A_Output_Pr5_ST3
                Rsrv01_IMU_A_Output_Pr5_ST3: rba_SysElem_StartPosition=263, rba_SysElem_PackingByteOrder=mostSignificantByteLast, rba_SysElem_ISignalRef=rba_SysElem_ISignals/Rsrv01_IMU_A_Output_Pr5_ST3, rba_SysElem_ISignalToPduMappingForeignRef=Rsrv01_IMU_A_Output_Pr5_ST3
                Rsrv02_IMU_A_Output_Pr5_ST3: rba_SysElem_StartPosition=272, rba_SysElem_PackingByteOrder=mostSignificantByteLast, rba_SysElem_ISignalRef=rba_SysElem_ISignals/Rsrv02_IMU_A_Output_Pr5_ST3, rba_SysElem_ISignalToPduMappingForeignRef=Rsrv02_IMU_A_Output_Pr5_ST3
                Rsrv03_IMU_A_Output_Pr5_ST3: rba_SysElem_StartPosition=280, rba_SysElem_PackingByteOrder=mostSignificantByteLast, rba_SysElem_ISignalRef=rba_SysElem_ISignals/Rsrv03_IMU_A_Output_Pr5_ST3, rba_SysElem_ISignalToPduMappingForeignRef=Rsrv03_IMU_A_Output_Pr5_ST3
                Rsrv04_IMU_A_Output_Pr5_ST3: rba_SysElem_StartPosition=288, rba_SysElem_PackingByteOrder=mostSignificantByteLast, rba_SysElem_ISignalRef=rba_SysElem_ISignals/Rsrv04_IMU_A_Output_Pr5_ST3, rba_SysElem_ISignalToPduMappingForeignRef=Rsrv04_IMU_A_Output_Pr5_ST3
                Rsrv05_IMU_A_Output_Pr5_ST3: rba_SysElem_StartPosition=296, rba_SysElem_PackingByteOrder=mostSignificantByteLast, rba_SysElem_ISignalRef=rba_SysElem_ISignals/Rsrv05_IMU_A_Output_Pr5_ST3, rba_SysElem_ISignalToPduMappingForeignRef=Rsrv05_IMU_A_Output_Pr5_ST3
                Rsrv06_IMU_A_Output_Pr5_ST3: rba_SysElem_StartPosition=304, rba_SysElem_PackingByteOrder=mostSignificantByteLast, rba_SysElem_ISignalRef=rba_SysElem_ISignals/Rsrv06_IMU_A_Output_Pr5_ST3, rba_SysElem_ISignalToPduMappingForeignRef=Rsrv06_IMU_A_Output_Pr5_ST3
                Rsrv07_IMU_A_Output_Pr5_ST3: rba_SysElem_StartPosition=33, rba_SysElem_PackingByteOrder=mostSignificantByteLast, rba_SysElem_ISignalRef=rba_SysElem_ISignals/Rsrv07_IMU_A_Output_Pr5_ST3, rba_SysElem_ISignalToPduMappingForeignRef=Rsrv07_IMU_A_Output_Pr5_ST3
          Ign_Stat_ST3
            rba_SysElem_ISignalIPdu: rba_SysElem_UseLdCom=false, rba_SysElem_Length=4, rba_SysElem_UnusedBitPattern=255
              6 x rba_SysElem_ISignalToPduMapping:
                Ign_Stat_Pr5_ST3_csgs1dv6drms80o1i9p49677w: rba_SysElem_ISignalGroupRef=rba_SysElem_ISignalGroups/Ign_Stat_Pr5_ST3_csgs1dv6drms80o1i9p49677w, rba_SysElem_ISignalToPduMappingForeignRef=Ign_Stat_Pr5_ST3_csgs1dv6drms80o1i9p49677w
                ISw_Stat_ST3: rba_SysElem_StartPosition=24, rba_SysElem_PackingByteOrder=mostSignificantByteLast, rba_SysElem_ISignalRef=rba_SysElem_ISignals/ISw_Stat_ST3, rba_SysElem_ISignalToPduMappingForeignRef=ISw_Stat_ST3
                CRC_Ign_Stat_Pr5_ST3: rba_SysElem_StartPosition=0, rba_SysElem_PackingByteOrder=mostSignificantByteLast, rba_SysElem_ISignalRef=rba_SysElem_ISignals/CRC_Ign_Stat_Pr5_ST3, rba_SysElem_ISignalToPduMappingForeignRef=CRC_Ign_Stat_Pr5_ST3
                KG_StartSw_Psd_ST3: rba_SysElem_StartPosition=31, rba_SysElem_PackingByteOrder=mostSignificantByteLast, rba_SysElem_ISignalRef=rba_SysElem_ISignals/KG_StartSw_Psd_ST3, rba_SysElem_ISignalToPduMappingForeignRef=KG_StartSw_Psd_ST3
                SQC_Ign_Stat_Pr5_ST3: rba_SysElem_StartPosition=16, rba_SysElem_PackingByteOrder=mostSignificantByteLast, rba_SysElem_ISignalRef=rba_SysElem_ISignals/SQC_Ign_Stat_Pr5_ST3, rba_SysElem_ISignalToPduMappingForeignRef=SQC_Ign_Stat_Pr5_ST3
                Veh_Op_Mode_ST3: rba_SysElem_StartPosition=27, rba_SysElem_PackingByteOrder=mostSignificantByteLast, rba_SysElem_ISignalRef=rba_SysElem_ISignals/Veh_Op_Mode_ST3, rba_SysElem_ISignalToPduMappingForeignRef=Veh_Op_Mode_ST3
          IMU_A_Output_ST3_RENAME1
            rba_SysElem_ISignalIPdu: rba_SysElem_UseLdCom=false, rba_SysElem_Length=40, rba_SysElem_UnusedBitPattern=255
              27 x rba_SysElem_ISignalToPduMapping:
                IMU_A_Output_Pr5_ST3_bezr5ct33mhwxias0s8rjhbne: rba_SysElem_ISignalGroupRef=IMU_A_Output_Pr5_ST3_bezr5ct33mhwxias0s8rjhbne_RENAME1, rba_SysElem_ISignalToPduMappingForeignRef=IMU_A_Output_Pr5_ST3_bezr5ct33mhwxias0s8rjhbne
                CRC_IMU_A_Output_Pr5_ST3: rba_SysElem_StartPosition=0, rba_SysElem_PackingByteOrder=mostSignificantByteLast, rba_SysElem_ISignalRef=CRC_IMU_A_Output_Pr5_ST3_RENAME1, rba_SysElem_ISignalToPduMappingForeignRef=CRC_IMU_A_Output_Pr5_ST3
                IMU_A_AngAcc_Stat_ST3: rba_SysElem_StartPosition=27, rba_SysElem_PackingByteOrder=mostSignificantByteLast, rba_SysElem_ISignalRef=IMU_A_AngAcc_Stat_ST3_RENAME1, rba_SysElem_ISignalToPduMappingForeignRef=IMU_A_AngAcc_Stat_ST3
                IMU_A_AngAcc_X_ST3: rba_SysElem_StartPosition=55, rba_SysElem_PackingByteOrder=mostSignificantByteLast, rba_SysElem_ISignalRef=IMU_A_AngAcc_X_ST3_RENAME1, rba_SysElem_ISignalToPduMappingForeignRef=IMU_A_AngAcc_X_ST3
                IMU_A_AngAcc_Y_ST3: rba_SysElem_StartPosition=71, rba_SysElem_PackingByteOrder=mostSignificantByteLast, rba_SysElem_ISignalRef=IMU_A_AngAcc_Y_ST3_RENAME1, rba_SysElem_ISignalToPduMappingForeignRef=IMU_A_AngAcc_Y_ST3
                IMU_A_AngAcc_Z_ST3: rba_SysElem_StartPosition=87, rba_SysElem_PackingByteOrder=mostSignificantByteLast, rba_SysElem_ISignalRef=IMU_A_AngAcc_Z_ST3_RENAME1, rba_SysElem_ISignalToPduMappingForeignRef=IMU_A_AngAcc_Z_ST3
                IMU_A_AngRate_X_ST3: rba_SysElem_StartPosition=103, rba_SysElem_PackingByteOrder=mostSignificantByteLast, rba_SysElem_ISignalRef=IMU_A_AngRate_X_ST3_RENAME1, rba_SysElem_ISignalToPduMappingForeignRef=IMU_A_AngRate_X_ST3
                IMU_A_AngRate_Y_ST3: rba_SysElem_StartPosition=119, rba_SysElem_PackingByteOrder=mostSignificantByteLast, rba_SysElem_ISignalRef=IMU_A_AngRate_Y_ST3_RENAME1, rba_SysElem_ISignalToPduMappingForeignRef=IMU_A_AngRate_Y_ST3
                IMU_A_AngRate_Z_ST3: rba_SysElem_StartPosition=135, rba_SysElem_PackingByteOrder=mostSignificantByteLast, rba_SysElem_ISignalRef=IMU_A_AngRate_Z_ST3_RENAME1, rba_SysElem_ISignalToPduMappingForeignRef=IMU_A_AngRate_Z_ST3
                IMU_A_AngRates_Stat_ST3: rba_SysElem_StartPosition=30, rba_SysElem_PackingByteOrder=mostSignificantByteLast, rba_SysElem_ISignalRef=IMU_A_AngRates_Stat_ST3_RENAME1, rba_SysElem_ISignalToPduMappingForeignRef=IMU_A_AngRates_Stat_ST3
                IMU_A_SpecForce_Stat_ST3: rba_SysElem_StartPosition=36, rba_SysElem_PackingByteOrder=mostSignificantByteLast, rba_SysElem_ISignalRef=IMU_A_SpecForce_Stat_ST3_RENAME1, rba_SysElem_ISignalToPduMappingForeignRef=IMU_A_SpecForce_Stat_ST3
                IMU_A_SpecForce_X_ST3: rba_SysElem_StartPosition=151, rba_SysElem_PackingByteOrder=mostSignificantByteLast, rba_SysElem_ISignalRef=IMU_A_SpecForce_X_ST3_RENAME1, rba_SysElem_ISignalToPduMappingForeignRef=IMU_A_SpecForce_X_ST3
                IMU_A_SpecForce_Y_ST3: rba_SysElem_StartPosition=167, rba_SysElem_PackingByteOrder=mostSignificantByteLast, rba_SysElem_ISignalRef=IMU_A_SpecForce_Y_ST3_RENAME1, rba_SysElem_ISignalToPduMappingForeignRef=IMU_A_SpecForce_Y_ST3
                IMU_A_SpecForce_Z_ST3: rba_SysElem_StartPosition=183, rba_SysElem_PackingByteOrder=mostSignificantByteLast, rba_SysElem_ISignalRef=IMU_A_SpecForce_Z_ST3_RENAME1, rba_SysElem_ISignalToPduMappingForeignRef=IMU_A_SpecForce_Z_ST3
                IMU_A_Stat_ST3: rba_SysElem_StartPosition=24, rba_SysElem_PackingByteOrder=mostSignificantByteLast, rba_SysElem_ISignalRef=IMU_A_Stat_ST3_RENAME1, rba_SysElem_ISignalToPduMappingForeignRef=IMU_A_Stat_ST3
                IMU_A_Temp_ST3: rba_SysElem_StartPosition=39, rba_SysElem_PackingByteOrder=mostSignificantByteLast, rba_SysElem_ISignalRef=IMU_A_Temp_ST3_RENAME1, rba_SysElem_ISignalToPduMappingForeignRef=IMU_A_Temp_ST3
                IMU_A_TmStmp_NanoSec_ST3: rba_SysElem_StartPosition=199, rba_SysElem_PackingByteOrder=mostSignificantByteLast, rba_SysElem_ISignalRef=IMU_A_TmStmp_NanoSec_ST3_RENAME1, rba_SysElem_ISignalToPduMappingForeignRef=IMU_A_TmStmp_NanoSec_ST3
                IMU_A_TmStmp_Sec_ST3: rba_SysElem_StartPosition=231, rba_SysElem_PackingByteOrder=mostSignificantByteLast, rba_SysElem_ISignalRef=IMU_A_TmStmp_Sec_ST3_RENAME1, rba_SysElem_ISignalToPduMappingForeignRef=IMU_A_TmStmp_Sec_ST3
                IMU_A_TmSync_Stat_ST3: rba_SysElem_StartPosition=47, rba_SysElem_PackingByteOrder=mostSignificantByteLast, rba_SysElem_ISignalRef=IMU_A_TmSync_Stat_ST3_RENAME1, rba_SysElem_ISignalToPduMappingForeignRef=IMU_A_TmSync_Stat_ST3
                SQC_IMU_A_Output_Pr5_ST3: rba_SysElem_StartPosition=16, rba_SysElem_PackingByteOrder=mostSignificantByteLast, rba_SysElem_ISignalRef=SQC_IMU_A_Output_Pr5_ST3_RENAME1, rba_SysElem_ISignalToPduMappingForeignRef=SQC_IMU_A_Output_Pr5_ST3
                Rsrv01_IMU_A_Output_Pr5_ST3: rba_SysElem_StartPosition=263, rba_SysElem_PackingByteOrder=mostSignificantByteLast, rba_SysElem_ISignalRef=Rsrv01_IMU_A_Output_Pr5_ST3_RENAME1, rba_SysElem_ISignalToPduMappingForeignRef=Rsrv01_IMU_A_Output_Pr5_ST3
                Rsrv02_IMU_A_Output_Pr5_ST3: rba_SysElem_StartPosition=272, rba_SysElem_PackingByteOrder=mostSignificantByteLast, rba_SysElem_ISignalRef=Rsrv02_IMU_A_Output_Pr5_ST3_RENAME1, rba_SysElem_ISignalToPduMappingForeignRef=Rsrv02_IMU_A_Output_Pr5_ST3
                Rsrv03_IMU_A_Output_Pr5_ST3: rba_SysElem_StartPosition=280, rba_SysElem_PackingByteOrder=mostSignificantByteLast, rba_SysElem_ISignalRef=Rsrv03_IMU_A_Output_Pr5_ST3_RENAME1, rba_SysElem_ISignalToPduMappingForeignRef=Rsrv03_IMU_A_Output_Pr5_ST3
                Rsrv04_IMU_A_Output_Pr5_ST3: rba_SysElem_StartPosition=288, rba_SysElem_PackingByteOrder=mostSignificantByteLast, rba_SysElem_ISignalRef=Rsrv04_IMU_A_Output_Pr5_ST3_RENAME1, rba_SysElem_ISignalToPduMappingForeignRef=Rsrv04_IMU_A_Output_Pr5_ST3
                Rsrv05_IMU_A_Output_Pr5_ST3: rba_SysElem_StartPosition=296, rba_SysElem_PackingByteOrder=mostSignificantByteLast, rba_SysElem_ISignalRef=Rsrv05_IMU_A_Output_Pr5_ST3_RENAME1, rba_SysElem_ISignalToPduMappingForeignRef=Rsrv05_IMU_A_Output_Pr5_ST3
                Rsrv06_IMU_A_Output_Pr5_ST3: rba_SysElem_StartPosition=304, rba_SysElem_PackingByteOrder=mostSignificantByteLast, rba_SysElem_ISignalRef=Rsrv06_IMU_A_Output_Pr5_ST3_RENAME1, rba_SysElem_ISignalToPduMappingForeignRef=Rsrv06_IMU_A_Output_Pr5_ST3
                Rsrv07_IMU_A_Output_Pr5_ST3: rba_SysElem_StartPosition=33, rba_SysElem_PackingByteOrder=mostSignificantByteLast, rba_SysElem_ISignalRef=Rsrv07_IMU_A_Output_Pr5_ST3_RENAME1, rba_SysElem_ISignalToPduMappingForeignRef=Rsrv07_IMU_A_Output_Pr5_ST3
          PT4_PTCoor4_ST3
            rba_SysElem_ISignalIPdu: rba_SysElem_UseLdCom=false, rba_SysElem_Length=4, rba_SysElem_UnusedBitPattern=255
              7 x rba_SysElem_ISignalToPduMapping:
                PT4_PTCoor4_Pr5_ST3_af4fxb1ykieox3itqdfzs0kpb: rba_SysElem_ISignalGroupRef=rba_SysElem_ISignalGroups/PT4_PTCoor4_Pr5_ST3_af4fxb1ykieox3itqdfzs0kpb, rba_SysElem_ISignalToPduMappingForeignRef=PT4_PTCoor4_Pr5_ST3_af4fxb1ykieox3itqdfzs0kpb
                PT4_PTCoor_EngStartPN14_Stat_ST3: rba_SysElem_StartPosition=28, rba_SysElem_PackingByteOrder=mostSignificantByteLast, rba_SysElem_ISignalRef=rba_SysElem_ISignals/PT4_PTCoor_EngStartPN14_Stat_ST3, rba_SysElem_ISignalToPduMappingForeignRef=PT4_PTCoor_EngStartPN14_Stat_ST3
                CRC_PT4_PTCoor4_Pr5_ST3: rba_SysElem_StartPosition=0, rba_SysElem_PackingByteOrder=mostSignificantByteLast, rba_SysElem_ISignalRef=rba_SysElem_ISignals/CRC_PT4_PTCoor4_Pr5_ST3, rba_SysElem_ISignalToPduMappingForeignRef=CRC_PT4_PTCoor4_Pr5_ST3
                PT4_PTCoor_PT_Rdy_ST3: rba_SysElem_StartPosition=24, rba_SysElem_PackingByteOrder=mostSignificantByteLast, rba_SysElem_ISignalRef=rba_SysElem_ISignals/PT4_PTCoor_PT_Rdy_ST3, rba_SysElem_ISignalToPduMappingForeignRef=PT4_PTCoor_PT_Rdy_ST3
                PT4_PTCoor_SSA_EngSp_ST3: rba_SysElem_StartPosition=26, rba_SysElem_PackingByteOrder=mostSignificantByteLast, rba_SysElem_ISignalRef=rba_SysElem_ISignals/PT4_PTCoor_SSA_EngSp_ST3, rba_SysElem_ISignalToPduMappingForeignRef=PT4_PTCoor_SSA_EngSp_ST3
                Rsrv1_PT4_PTCoor_PT_Rdy_Pr5_ST3: rba_SysElem_StartPosition=31, rba_SysElem_PackingByteOrder=mostSignificantByteLast, rba_SysElem_ISignalRef=rba_SysElem_ISignals/Rsrv1_PT4_PTCoor_PT_Rdy_Pr5_ST3, rba_SysElem_ISignalToPduMappingForeignRef=Rsrv1_PT4_PTCoor_PT_Rdy_Pr5_ST3
                SQC_PT4_PTCoor4_Pr5_ST3: rba_SysElem_StartPosition=16, rba_SysElem_PackingByteOrder=mostSignificantByteLast, rba_SysElem_ISignalRef=rba_SysElem_ISignals/SQC_PT4_PTCoor4_Pr5_ST3, rba_SysElem_ISignalToPduMappingForeignRef=SQC_PT4_PTCoor4_Pr5_ST3
          DI_OdoSpeedometer_ST3
            rba_SysElem_ISignalIPdu: rba_SysElem_UseLdCom=false, rba_SysElem_Length=8, rba_SysElem_UnusedBitPattern=255
              4 x rba_SysElem_ISignalToPduMapping:
                DI_Odo_Pr5_ST3_e68xmtlkywxgxsdwekdjjhw3t: rba_SysElem_ISignalGroupRef=rba_SysElem_ISignalGroups/DI_Odo_Pr5_ST3_e68xmtlkywxgxsdwekdjjhw3t, rba_SysElem_ISignalToPduMappingForeignRef=DI_Odo_Pr5_ST3_e68xmtlkywxgxsdwekdjjhw3t
                Odo_ST3: rba_SysElem_StartPosition=24, rba_SysElem_PackingByteOrder=mostSignificantByteLast, rba_SysElem_ISignalRef=rba_SysElem_ISignals/Odo_ST3, rba_SysElem_ISignalToPduMappingForeignRef=Odo_ST3
                CRC_DI_Odo_Pr5_ST3: rba_SysElem_StartPosition=0, rba_SysElem_PackingByteOrder=mostSignificantByteLast, rba_SysElem_ISignalRef=rba_SysElem_ISignals/CRC_DI_Odo_Pr5_ST3, rba_SysElem_ISignalToPduMappingForeignRef=CRC_DI_Odo_Pr5_ST3
                SQC_DI_Odo_Pr5_ST3: rba_SysElem_StartPosition=16, rba_SysElem_PackingByteOrder=mostSignificantByteLast, rba_SysElem_ISignalRef=rba_SysElem_ISignals/SQC_DI_Odo_Pr5_ST3, rba_SysElem_ISignalToPduMappingForeignRef=SQC_DI_Odo_Pr5_ST3
      rba_SysElem_DataMappings
        3 x rba_SysElem_DataMapping, all with rba_SysElem_CommunicationDirection=in:
          SR_G_Ign_Stat_Pr5_ST3_csgs1dv6drms80o1i9p49677w_IN
            rba_SysElem_SenderReceiverToSignalGroupMapping:
              rba_SysElem_TopLevelTypeMapping = rba_SysElem_SenderReceiverToSignalGroupMapping/Type_Mapping_1_Record
              rba_SysElem_VariableDataPrototypeRef = Ign_Stat_Pr5_ST3
              rba_SysElem_SystemSignalGroupRef = rba_SysElem_SystemSignalGroups/Ign_Stat_Pr5_ST3_csgs1dv6drms80o1i9p49677w
              Type_Mapping_1_Record (rba_SysElem_TypeMapping)
                rba_SysElem_SenderRecRecordTypeMapping
                  REM_SySig_ISw_Stat_ST3 (rba_SysElem_RecordElementMapping):
                    rba_SysElem_ImplementationRecordElementRef = rba_SysElem_RecordImplDataType/ISw_Stat_ST3
                    rba_SysElem_SystemSignalRef = rba_SysElem_SystemSignals/ISw_Stat_ST3
          SR_G_PT4_PTCoor4_Pr5_ST3_af4fxb1ykieox3itqdfzs0kpb_IN
            rba_SysElem_SenderReceiverToSignalGroupMapping:
              rba_SysElem_TopLevelTypeMapping = rba_SysElem_SenderReceiverToSignalGroupMapping/Type_Mapping_1_Record
              rba_SysElem_VariableDataPrototypeRef = PT4_PTCoor4_Pr5_ST3
              rba_SysElem_SystemSignalGroupRef = rba_SysElem_SystemSignalGroups/PT4_PTCoor4_Pr5_ST3_af4fxb1ykieox3itqdfzs0kpb
              Type_Mapping_1_Record (rba_SysElem_TypeMapping)
                rba_SysElem_SenderRecRecordTypeMapping
                  REM_SySig_PT4_PTCoor_EngStartPN14_Stat_ST3 (rba_SysElem_RecordElementMapping):
                    rba_SysElem_ImplementationRecordElementRef = rba_SysElem_RecordImplDataType/PT4_PTCoor_EngStartPN14_Stat_ST3
                    rba_SysElem_SystemSignalRef = rba_SysElem_SystemSignals/PT4_PTCoor_EngStartPN14_Stat_ST3
          SR_G_DI_Odo_Pr5_ST3_e68xmtlkywxgxsdwekdjjhw3t_IN
            rba_SysElem_SenderReceiverToSignalGroupMapping:
              rba_SysElem_TopLevelTypeMapping = rba_SysElem_SenderReceiverToSignalGroupMapping/Type_Mapping_1_Record
              rba_SysElem_VariableDataPrototypeRef = DI_Odo_Pr5_ST3
              rba_SysElem_SystemSignalGroupRef = rba_SysElem_SystemSignalGroups/DI_Odo_Pr5_ST3_e68xmtlkywxgxsdwekdjjhw3t
              Type_Mapping_1_Record (rba_SysElem_TypeMapping)
                rba_SysElem_SenderRecRecordTypeMapping
                  REM_SySig_Odo_ST3 (rba_SysElem_RecordElementMapping):
                    rba_SysElem_ImplementationRecordElementRef = rba_SysElem_RecordImplDataType/Odo_ST3
                    rba_SysElem_SystemSignalRef = rba_SysElem_SystemSignals/Odo_ST3
      rba_SysElem_PortInterfaces
        3 x rba_SysElem_PortInterface:
          IG_Ign_Stat_Pr5_ST3_8qpxphk9meu9oryi6bfj0x04b
            rba_SysElem_SenderReceiverInterface: rba_SysElem_SenderReceiverInterfaceForeignRef=IG_Ign_Stat_Pr5_ST3_8qpxphk9meu9oryi6bfj0x04b
              Ign_Stat_Pr5_ST3 (rba_SysElem_VariableDataPrototype): rba_SysElem_VariableDataPrototypeForeignRef=Ign_Stat_Pr5_ST3, rba_SysElem_DatatypeRef=REC_Ign_Stat_Pr5_ST3_b0ko81o0x5jgvwtduf99gvzi0
          IG_PT4_PTCoor4_Pr5_ST3_4jqmw0h0uwztlkj3fjsj9fpfe
            rba_SysElem_SenderReceiverInterface: rba_SysElem_SenderReceiverInterfaceForeignRef=IG_PT4_PTCoor4_Pr5_ST3_4jqmw0h0uwztlkj3fjsj9fpfe
              PT4_PTCoor4_Pr5_ST3 (rba_SysElem_VariableDataPrototype): rba_SysElem_VariableDataPrototypeForeignRef=PT4_PTCoor4_Pr5_ST3, rba_SysElem_DatatypeRef=REC_PT4_PTCoor4_Pr5_ST3_6v3sj55wsjghho72slblc9pby
          IG_DI_Odo_Pr5_ST3_dqmkbik4b90gceqe8t96kp3yd
            rba_SysElem_SenderReceiverInterface: rba_SysElem_SenderReceiverInterfaceForeignRef=IG_DI_Odo_Pr5_ST3_dqmkbik4b90gceqe8t96kp3yd
              DI_Odo_Pr5_ST3 (rba_SysElem_VariableDataPrototype): rba_SysElem_VariableDataPrototypeForeignRef=DI_Odo_Pr5_ST3, rba_SysElem_DatatypeRef=REC_DI_Odo_Pr5_ST3_9t50popkpz30is106xpis1iyh
      rba_SysElem_ImplementationDataTypes
        6 x rba_SysElem_ImplementationDataType:
          REC_Ign_Stat_Pr5_ST3_b0ko81o0x5jgvwtduf99gvzi0
            rba_SysElem_RecordImplDataType: rba_SysElem_Category=STRUCTURE, rba_SysElem_ImplementationDataTypeForeignRef=REC_Ign_Stat_Pr5_ST3_b0ko81o0x5jgvwtduf99gvzi0
              ISw_Stat_ST3 (rba_SysElem_SubElement): rba_SysElem_Index=0, rba_SysElem_ImplDataTypeRef=c03_ISw_Stat
          c03_ISw_Stat
            rba_SysElem_PrimitiveImplDataType: rba_SysElem_BaseDataType=uint8, rba_SysElem_Category=TYPE_REFERENCE, rba_SysElem_ImplementationDataTypeForeignRef=c03_ISw_Stat
          REC_PT4_PTCoor4_Pr5_ST3_6v3sj55wsjghho72slblc9pby
            rba_SysElem_RecordImplDataType: rba_SysElem_Category=STRUCTURE, rba_SysElem_ImplementationDataTypeForeignRef=REC_PT4_PTCoor4_Pr5_ST3_6v3sj55wsjghho72slblc9pby
              PT4_PTCoor_EngStartPN14_Stat_ST3 (rba_SysElem_SubElement): rba_SysElem_Index=0, rba_SysElem_ImplDataTypeRef=c03_EngStartPN14_Stat
          c03_EngStartPN14_Stat
            rba_SysElem_PrimitiveImplDataType: rba_SysElem_BaseDataType=uint8, rba_SysElem_Category=TYPE_REFERENCE, rba_SysElem_ImplementationDataTypeForeignRef=c03_EngStartPN14_Stat
          REC_DI_Odo_Pr5_ST3_9t50popkpz30is106xpis1iyh
            rba_SysElem_RecordImplDataType: rba_SysElem_Category=STRUCTURE, rba_SysElem_ImplementationDataTypeForeignRef=REC_DI_Odo_Pr5_ST3_9t50popkpz30is106xpis1iyh
              Odo_ST3 (rba_SysElem_SubElement): rba_SysElem_Index=0, rba_SysElem_ImplDataTypeRef=c24_km_0_999999k9_0k1_Invld_SNA
          c24_km_0_999999k9_0k1_Invld_SNA
            rba_SysElem_PrimitiveImplDataType:
              rba_SysElem_BaseDataType = uint32
              rba_SysElem_Category = TYPE_REFERENCE
              rba_SysElem_ImplementationDataTypeForeignRef = c24_km_0_999999k9_0k1_Invld_SNA
  module config IpduM
    IpduMGeneral:
      IpduMDevErrorDetect = false
      IpduMMetaDataSupport = false
      IpduMHeaderByteOrder = IPDUM_BIG_ENDIAN
      IpduMContainedTxPduPriorityHandling = false
      IpduMTxTimeBase = 0.005
      IpduMRxTimeBase = 0.005
      IpduMVersionInfoApi = false
      IpduMStaticPartExists = true
    IpduMPublishedInformation: IpduMRxDirectComInvocation=false
    IpduMConfig
      IpduMMainFunctionTx_0 (IpduMMainFunctionTx): IpduMMainTxTimeBase=0.005, IpduMMainTxPartitionRef=EcucPartition_0
