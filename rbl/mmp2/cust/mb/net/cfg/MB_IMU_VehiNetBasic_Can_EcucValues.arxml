AUTOSAR XML (schema 4-2-2)
package /RB/UBK/Project/EcucModuleConfigurationValuess
  module config Can
    CanConfigSet
      CanIfControllerConfig_0 (CanController):
        CanBusoffProcessing = POLLING
        CanControllerId = 0
        CanFDIsoOperation = true
        CanHardwareNodeId = TTCAN_0
        CanControllerDefaultBaudrate = CanControllerBaudrateConfig_0
        CanControllerBaudrateConfig_0 (CanControllerBaudrateConfig):
          CanBrp = 4
          CanControllerBaudRate = 500
          CanControllerBaudRateConfigID = 0
          CanControllerPropSeg = 23
          CanControllerSeg1 = 8
          CanControllerSeg2 = 8
          CanControllerSyncJumpWidth = 4
          CanControllerFdBaudrateConfig_0 (CanControllerFdBaudrateConfig):
            CanBrp = 4
            CanControllerFdBaudRate = 1000
            CanControllerPropSeg = 8
            CanControllerSeg1 = 6
            CanControllerSeg2 = 5
            CanControllerSyncJumpWidth = 4
            CanControllerTxBitRateSwitch = true
      CanIfControllerConfig_1 (CanController):
        CanBusoffProcessing = POLLING
        CanControllerId = 1
        CanFDIsoOperation = true
        CanHardwareNodeId = MCAN_0
        CanControllerDefaultBaudrate = CanControllerBaudrateConfig_1
        CanControllerBaudrateConfig_1 (CanControllerBaudrateConfig):
          CanBrp = 4
          CanControllerBaudRate = 500
          CanControllerBaudRateConfigID = 1
          CanControllerPropSeg = 23
          CanControllerSeg1 = 8
          CanControllerSeg2 = 8
          CanControllerSyncJumpWidth = 4
          CanControllerFdBaudrateConfig_1 (CanControllerFdBaudrateConfig):
            CanBrp = 4
            CanControllerFdBaudRate = 1000
            CanControllerPropSeg = 8
            CanControllerSeg1 = 6
            CanControllerSeg2 = 5
            CanControllerSyncJumpWidth = 4
            CanControllerTxBitRateSwitch = true
    CanGeneral:
      CanDevErrorDetection = false
      CanDynamicMCANIpDetection = true
      CanErrorPassiveProcessing = OFF
      CanIndex = 0
      CanLiteConfiguration = false
      CanMainFunctionBusoffPeriod = 0.005
      CanMainFunctionModePeriod = 0.005
      CanVersionInfoApi = false
      CanDemEventParameterRefs: CAN_E_TIMEOUT=CAN_E_TIME_OUT
      CanMainFunctionRWPeriods_5ms (CanMainFunctionRWPeriods): CanMainFunctionPeriod=0.005
  module config CanIf
    CanIfPublicCfg:
      CanIfPublicBusoffRecoveryfromRxIndication = true
      CanIfPublicCancelTransmitSupport = false
      CanIfPublicCanIfLiteConfiguration = false
      CanIfPublicCddHeaderFile = cdd_header
      CanIfPublicDevErrorDetect = false
      CanIfPublicErrorPassiveSupport = false
      CanIfPublicHandleTypeEnum = UINT8
      CanIfPublicMultipleDrvSupport = false
      CanIfPublicPnSupport = false
      CanIfPublicReadRxPduDataApi = false
      CanIfPublicReadRxPduNotifyStatusApi = true
      CanIfPublicReadTxPduNotifyStatusApi = true
      CanIfPublicSetDynamicTxIdApi = true
      CanIfPublicTxBuffering = false
      CanIfPublicTxConfirmPollingSupport = false
      CanIfPublicUserTpTxInOfflineMode = true
      CanIfPublicVersionInfoApi = false
      CanIfPublicWakeupCheckValidSupport = false
      CanIfTriggerTransmitSupport = true
      CanIfTxOfflineActiveSupport = false
      CanIfWakeupSupport = false
    CanIfTrcvDrvCfg_0 (CanIfTrcvDrvCfg)
      CanIfTrcvCfg_1 (CanIfTrcvCfg): CanIfTrcvWakeupSupport=false, CanIfTrcvCanTrcvRef=CanTrcvChannel_0
    CanIfDispatchCfg:
      CanIfDispatchUserCtrlBusOffName = CanSM_ControllerBusOff
      CanIfDispatchUserCtrlBusOffUL = CAN_SM
      CanIfDispatchUserCtrlModeIndicationUL = CAN_SM
      CanIfDispatchUserTrcvModeIndicationUL = CAN_SM
    CanIfPrivateCfg: CanIfPrivateDlcCheck=false
    CanIfCtrlDrvCfg_0 (CanIfCtrlDrvCfg): CanIfCtrlDrvInitHohConfigRef=CanIfInitHohCfg, CanIfCtrlDrvNameRef=CanGeneral
      CanIfControllerConfig_0 (CanIfCtrlCfg): CanIfCtrlId=0, CanIfCtrlWakeupSupport=false, CanIfCtrlCanCtrlRef=CanConfigSet/CanIfControllerConfig_0
      CanIfControllerConfig_1 (CanIfCtrlCfg): CanIfCtrlId=1, CanIfCtrlWakeupSupport=false, CanIfCtrlCanCtrlRef=CanConfigSet/CanIfControllerConfig_1, CanIfCtrlTrcvRef=CanIfTrcvCfg_1
  module config CanSM
    CanSMConfiguration: CanSMModeRequestRepetitionMax=5, CanSMModeRequestRepetitionTime=0.01
      IMU_A_HAD_BACKUP (CanSMManagerNetwork):
        CanSMBorCounterL1ToL2 = 3
        CanSMBorTimeL1 = 0.05
        CanSMBorTimeL2 = 0.1
        CanSMBorTimeTxEnsured = 0.05
        CanSMBorTxConfirmationPolling = false
        CanSMComMNetworkHandleRef = ComMChannel_Can1
        CanSMTransceiverId = CanIfTrcvCfg_1
        IMU_A_HAD_BACKUP (CanSMController): CanSMControllerId=CanIfCtrlDrvCfg_0/CanIfControllerConfig_1
        CanSMDemEventParameterRefs: CanSMRbDynCreate_CANSM_E_BUS_OFF=Disabled, CANSM_E_BUS_OFF=CANSM_E_BUSOFF_NETWORK_1
      IMU_INTERNAL_CAN (CanSMManagerNetwork):
        CanSMBorCounterL1ToL2 = 3
        CanSMBorTimeL1 = 0.05
        CanSMBorTimeL2 = 0.1
        CanSMBorTimeTxEnsured = 0.05
        CanSMBorTxConfirmationPolling = false
        CanSMComMNetworkHandleRef = ComMChannel_Can
        IMU_A_HAD_IMU (CanSMController): CanSMControllerId=CanIfCtrlDrvCfg_0/CanIfControllerConfig_0
        CanSMDemEventParameterRefs: CanSMRbDynCreate_CANSM_E_BUS_OFF=Disabled, CANSM_E_BUS_OFF=CANSM_E_BUSOFF_NETWORK_0
    CanSMGeneral: CanSMDevErrorDetect=false, CanSMMainFunctionTimePeriod=0.005, CanSMPncSupport=false, CanSMSetBaudrateApi=false, CanSMVersionInfoApi=false
  module config Com: implementation-config-variant=VARIANT-PRE-COMPILE
    ComConfig
      ComTimeBase: ComGwTimeBase=0.005, ComRxTimeBase=0.005, ComTxTimeBase=0.005
    ComGeneral:
      ComCancellationSupport = false
      ComCommonIPduTxPeriodFeature = false
      ComConfigurationUseDet = false
      ComEnableJitterFilter = false
      ComEnableSignalGroupArrayApi = true
      ComIPduControlViaCalibration = false
      ComMultiCoreSwitch = false
      ComProvideIpduStatusAPI = false
      ComReadRxIPduLength = false
      ComRetryFailedTransmitRequests = true
      ComRTESpecificSymbolicNames = false
      ComTxScheduledInDiffTimebase = false
      ComVersionInfoApi = false
  module config ComM: implementation-config-variant=VARIANT-PRE-COMPILE
    ComMConfigSet
      ComMChannel_Can (ComMChannel):
        ComMBusType = COMM_BUS_TYPE_CAN
        ComMFullCommRequestNotificationEnabled = false
        ComMMainFunctionPeriod = 0.01
        ComMNoCom = false
        ComMNoWakeup = false
        ComMNoWakeUpInhibitionNvmStorage = false
        ComMNetworkManagement: ComMNmLightTimeout=10.0, ComMNmVariant=LIGHT, ComMPncNmRequest=false
        ComMUser_HAD_IMU_INTERNAL (ComMUserPerChannel): ComMUserChannel=ComMUser_Can
      ComMChannel_Can1 (ComMChannel):
        ComMBusType = COMM_BUS_TYPE_CAN
        ComMFullCommRequestNotificationEnabled = false
        ComMMainFunctionPeriod = 0.01
        ComMNoCom = false
        ComMNoWakeup = false
        ComMNoWakeUpInhibitionNvmStorage = false
        ComMNetworkManagement: ComMNmLightTimeout=10.0, ComMNmVariant=LIGHT, ComMPncNmRequest=false
        ComMUser_HAD_BACKUP (ComMUserPerChannel): ComMUserChannel=ComMUser_Can1
      ComMUser_Can (ComMUser)
      ComMUser_Can1 (ComMUser)
    ComMGeneral:
      ComMDevErrorDetect = false
      ComMEcuGroupClassification = 0
      ComMModeLimitationEnabled = false
      ComMPncGatewayEnabled = false
      ComMPncSupport = false
      ComMResetAfterForcingNoComm = false
      ComMRteEnabled = false
      ComMSynchronousWakeUp = true
      ComMTMinFullComModeDuration = 5.0
      ComMVersionInfoApi = true
      ComMWakeupInhibitionEnabled = false
  module config PduR: implementation-config-variant=VARIANT-PRE-COMPILE
    Com (PduRBswModules):
      PduRCancelReceive = false
      PduRCancelTransmit = false
      PduRChangeParameterApi = false
      PduRCommunicationInterface = true
      PduRLowerModule = false
      PduRRetransmission = false
      PduRTransportProtocol = false
      PduRTriggertransmit = true
      PduRTxConfirmation = true
      PduRUpperModule = true
      PduRUseTag = false
      PduRBswModuleRef = Com
    PduRGeneral:
      PduRDevErrorDetect = false
      PduRDSMReInitEnabled = false
      PduRGwTpWithLimitedBuffer = false
      PduRIFGatewayOperation = true
      PduRQueueingSupport = false
      PduRVersionInfoApi = true
      PduRZeroCostOperation = false
  module config rba_ComDrv
    rba_ComDrvGeneral: ComDrvCpuCanType=MCU_RB_REN_RH850_P1MC_D3V2, ComDrvCpuType=MCU_RB_REN_RH850_P1MC_D3V2
