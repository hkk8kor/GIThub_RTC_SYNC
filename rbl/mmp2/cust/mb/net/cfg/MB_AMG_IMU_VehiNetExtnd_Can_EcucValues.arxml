AUTOSAR XML (schema 4-2-2)
package /RB/UBK/Project/EcucModuleConfigurationValuess
  module config Can
    CanConfigSet
      3 x CanController, all with CanBusoffProcessing=POLLING, CanRbFDIsoOperation=true:
        CanIfControllerConfig_0: CanControllerId=0, CanRbHardwareNodeId=TTCAN_0, CanRbSwPollingFifoSize=500, CanControllerDefaultBaudrate=CanControllerBaudrateConfig_0
          CanControllerBaudrateConfig_0 (CanControllerBaudrateConfig):
            CanControllerBaudRate = 500
            CanControllerBaudRateConfigID = 0
            CanControllerPropSeg = 47
            CanControllerSeg1 = 16
            CanControllerSeg2 = 16
            CanControllerSyncJumpWidth = 16
            CanRbBrp = 2
            CanControllerFdBaudrateConfig_0 (CanControllerFdBaudrateConfig):
              CanControllerFdBaudRate = 1000
              CanControllerPropSeg = 19
              CanControllerSeg1 = 10
              CanControllerSeg2 = 10
              CanControllerSyncJumpWidth = 10
              CanControllerTxBitRateSwitch = true
              CanRbBrp = 2
        CanIfControllerConfig_1: CanControllerId=1, CanRbHardwareNodeId=MCAN_0, CanRbSwPollingFifoSize=500, CanControllerDefaultBaudrate=CanControllerBaudrateConfig_1
          CanControllerBaudrateConfig_1 (CanControllerBaudrateConfig):
            CanControllerBaudRate = 500
            CanControllerBaudRateConfigID = 1
            CanControllerPropSeg = 47
            CanControllerSeg1 = 16
            CanControllerSeg2 = 16
            CanControllerSyncJumpWidth = 16
            CanRbBrp = 2
            CanControllerFdBaudrateConfig_1 (CanControllerFdBaudrateConfig):
              CanControllerFdBaudRate = 1000
              CanControllerSeg1 = 10
              CanControllerSeg2 = 10
              CanControllerSyncJumpWidth = 10
              CanControllerTxBitRateSwitch = true
              CanRbBrp = 2
              CanControllerPropSeg = 19
        CanIfControllerConfig_2: CanControllerId=2, CanRbHardwareNodeId=MCAN_1, CanControllerDefaultBaudrate=CanControllerBaudrateConfig_2
          CanControllerBaudrateConfig_2 (CanControllerBaudrateConfig):
            CanControllerBaudRate = 500
            CanControllerBaudRateConfigID = 1
            CanControllerPropSeg = 49
            CanControllerSeg1 = 15
            CanControllerSeg2 = 15
            CanControllerSyncJumpWidth = 15
            CanRbBrp = 2
            CanControllerFdBaudrateConfig_2 (CanControllerFdBaudrateConfig):
              CanControllerFdBaudRate = 2000
              CanControllerPropSeg = 7
              CanControllerSeg1 = 4
              CanControllerSeg2 = 8
              CanControllerSyncJumpWidth = 4
              CanControllerTxBitRateSwitch = true
              CanControllerSspOffset = 12
              CanRbBrp = 2
    CanGeneral:
      CanIndex = 0
      CanMainFunctionBusoffPeriod = 0.005
      CanMainFunctionModePeriod = 0.005
      CanVersionInfoApi = false
      CanDevErrorDetect = false
      CanRbLiteConfiguration = false
      CanRbDynamicMCANIpDetection = true
      CanDemEventParameterRefs: CAN_E_TIMEOUT=CAN_E_TIMEOUT
      CanMainFunctionRWPeriods_5ms (CanMainFunctionRWPeriods): CanMainFunctionPeriod=0.005
  module config CanIf
    CanIfCtrlDrvCfg_0 (CanIfCtrlDrvCfg): CanIfCtrlDrvInitHohConfigRef=CanIfInitHohCfg, CanIfCtrlDrvNameRef=CanGeneral
      3 x CanIfCtrlCfg, all with CanIfCtrlWakeupSupport=false:
        CanIfControllerConfig_0: CanIfCtrlId=0, CanIfCtrlCanCtrlRef=CanConfigSet/CanIfControllerConfig_0
        CanIfControllerConfig_1: CanIfCtrlId=1, CanIfCtrlCanCtrlRef=CanConfigSet/CanIfControllerConfig_1, CanIfCtrlTrcvRef=CanIfTrcvCfg_1
        CanIfControllerConfig_2: CanIfCtrlId=2, CanIfCtrlCanCtrlRef=CanConfigSet/CanIfControllerConfig_2, CanIfCtrlTrcvRef=CanIfTrcvCfg_2
    CanIfTrcvDrvCfg_0 (CanIfTrcvDrvCfg)
      CanIfTrcvCfg_1 (CanIfTrcvCfg): CanIfTrcvId=0, CanIfTrcvWakeupSupport=false, CanIfTrcvCanTrcvRef=CanTrcvChannel_0
      CanIfTrcvCfg_2 (CanIfTrcvCfg): CanIfTrcvId=1, CanIfTrcvWakeupSupport=false, CanIfTrcvCanTrcvRef=CanTrcvChannel_1
    CanIfPublicCfg:
      CanIfPublicBusoffRecoveryfromRxIndication = true
      CanIfPublicCancelTransmitSupport = false
      CanIfPublicCanIfLiteConfiguration = false
      CanIfPublicCddHeaderFile = cdd_header
      CanIfPublicErrorPassiveSupport = false
      CanIfPublicHandleTypeEnum = UINT8
      CanIfPublicMultipleDrvSupport = false
      CanIfPublicPnSupport = false
      CanIfPublicReadRxPduDataApi = false
      CanIfPublicReadRxPduNotifyStatusApi = true
      CanIfPublicReadTxPduNotifyStatusApi = true
      CanIfPublicSetDynamicTxIdApi = true
      CanIfPublicTxBuffering = false
      CanIfPublicTxConfirmPollingSupport = false
      CanIfPublicUserTpTxInOfflineMode = true
      CanIfPublicWakeupCheckValidSupport = false
      CanIfTriggerTransmitSupport = true
      CanIfTxOfflineActiveSupport = false
      CanIfWakeupSupport = true
      CanIfDevErrorDetect = false
      CanIfVersionInfoApi = false
    CanIfDispatchCfg:
      CanIfDispatchUserCheckTrcvWakeFlagIndicationName = CanSM_CheckTransceiverWakeFlagIndication
      CanIfDispatchUserCheckTrcvWakeFlagIndicationUL = CAN_SM
      CanIfDispatchUserClearTrcvWufFlagIndicationName = CanSM_ClearTrcvWufFlagIndication
      CanIfDispatchUserClearTrcvWufFlagIndicationUL = CAN_SM
      CanIfDispatchUserConfirmPnAvailabilityName = CanSM_ConfirmPnAvailability
      CanIfDispatchUserConfirmPnAvailabilityUL = CAN_SM
      CanIfDispatchUserCtrlBusOffName = CanSM_ControllerBusOff
      CanIfDispatchUserCtrlBusOffUL = CAN_SM
      CanIfDispatchUserCtrlModeIndicationUL = CAN_SM
      CanIfDispatchUserTrcvModeIndicationUL = CAN_SM
    CanIfPrivateCfg: CanIfPrivateDataLengthCheck=false
  module config CanNm
    CanNmGlobalConfig:
      CanNmBusLoadReductionEnabled = false
      CanNmBusSynchronizationEnabled = false
      CanNmComControlEnabled = true
      CanNmComUserDataSupport = true
      CanNmCoordinatorSyncSupport = false
      CanNmDevErrorDetect = true
      CanNmImmediateRestartEnabled = false
      CanNmImmediateTxconfEnabled = false
      CanNmMainFunctionPeriod = 0.005
      CanNmPassiveModeEnabled = false
      CanNmPduRxIndicationEnabled = true
      CanNmRemoteSleepIndEnabled = true
      CanNmStateChangeIndEnabled = true
      CanNmUserDataEnabled = true
      CanNmVersionInfoApi = false
      CanNmGlobalPnSupport = true
      CanNmPnSyncShutdownErrorReactionEnabled = false
      CanNmPnInfo: CanNmPnInfoLength=7, CanNmPnInfoOffset=1
        7 x CanNmPnFilterMaskByte:
          CanNmPnFilterMaskByte_0: CanNmPnFilterMaskByteIndex=0, CanNmPnFilterMaskByteValue=1
          CanNmPnFilterMaskByte_1: CanNmPnFilterMaskByteIndex=1, CanNmPnFilterMaskByteValue=128
          CanNmPnFilterMaskByte_2: CanNmPnFilterMaskByteIndex=2, CanNmPnFilterMaskByteValue=16
          CanNmPnFilterMaskByte_{3..6}: CanNmPnFilterMaskByteIndex={3..6}, CanNmPnFilterMaskByteValue=0
  module config CanSM
    CanSMConfiguration: CanSMModeRequestRepetitionMax=10, CanSMModeRequestRepetitionTime=0.01
      3 x CanSMManagerNetwork, all with CanSMBorCounterL1ToL2=20, CanSMBorTimeL1=0.05, CanSMBorTimeL2=1, CanSMBorTimeTxEnsured=1, CanSMBorTxConfirmationPolling=false:
        IMU_Can: CanSMComMNetworkHandleRef=ComMChannel_Can
          IMU_A_HAD_IMU (CanSMController): CanSMControllerId=CanIfCtrlDrvCfg_0/CanIfControllerConfig_0
          CanSMDemEventParameterRefs: CanSMRbDynCreate_CANSM_E_BUS_OFF=Disabled, CANSM_E_BUS_OFF=CANSM_E_BUSOFF_NETWORK_0
        IMU_Can1: CanSMComMNetworkHandleRef=ComMChannel_Can1, CanSMTransceiverId=CanIfTrcvCfg_1
          IMU_A_HAD_BACKUP (CanSMController): CanSMControllerId=CanIfCtrlDrvCfg_0/CanIfControllerConfig_1
          CanSMDemEventParameterRefs: CanSMRbDynCreate_CANSM_E_BUS_OFF=Disabled, CANSM_E_BUS_OFF=CANSM_E_BUSOFF_NETWORK_1
        IMU_Can2: CanSMComMNetworkHandleRef=ComMChannel_Can2, CanSMTransceiverId=CanIfTrcvCfg_2
          IMU_B_DRIVING_CAN (CanSMController): CanSMControllerId=CanIfCtrlDrvCfg_0/CanIfControllerConfig_2
          CanSMDemEventParameterRefs: CanSMRbDynCreate_CANSM_E_BUS_OFF=Disabled, CANSM_E_BUS_OFF=CANSM_E_BUSOFF_NETWORK_2
    CanSMGeneral: CanSMDevErrorDetect=false, CanSMMainFunctionTimePeriod=0.005, CanSMPncSupport=true, CanSMSetBaudrateApi=false, CanSMVersionInfoApi=false
  module config CanTrcv_0: definition=CanTrcv
    CanTrcvConfigSet
      CanTrcvChannel_0 (CanTrcvChannel):
        CanTrcvChannelId = 0
        CanTrcvChannelUsed = true
        CanTrcvControlsPowerSupply = true
        CanTrcvHwPnSupport = true
        CanTrcvInitState = CANTRCV_OP_MODE_STANDBY
        CanTrcvMaxBaudrate = 500
        CanTrcvWakeupByBusUsed = true
        CanTrcvWakeupSourceRef = ECUM_WKSOURCE_CAN1
        CanTrcvDemEventParameterRefs: CanTrcvRbDynCreate_CANTRCV_X_Y_E_NO_TRCV_CONTROL_Z=Disabled, CANTRCV_X_Y_E_NO_TRCV_CONTROL_Z=CANTRCV_TJA_E_NO_TRCV_CONTROL_CH0
        CanTrcvPartialNetwork:
          CanTrcvBaudRate = 500
          CanTrcvBusErrFlag = true
          CanTrcvPnCanIdIsExtended = true
          CanTrcvPnEnabled = true
          CanTrcvPnFrameCanId = 339869696
          CanTrcvPnFrameCanIdMask = 4095
          CanTrcvPnFrameDlc = 8
          CanTrcvPowerOnFlag = true
          8 x CanTrcvPnFrameDataMaskSpec:
            CanTrcvPnFrameDataMaskSpec_0: CanTrcvPnFrameDataMask=255, CanTrcvPnFrameDataMaskIndex=0
            CanTrcvPnFrameDataMaskSpec_1: CanTrcvPnFrameDataMask=1, CanTrcvPnFrameDataMaskIndex=1
            CanTrcvPnFrameDataMaskSpec_2: CanTrcvPnFrameDataMask=128, CanTrcvPnFrameDataMaskIndex=2
            CanTrcvPnFrameDataMaskSpec_3: CanTrcvPnFrameDataMask=16, CanTrcvPnFrameDataMaskIndex=3
            CanTrcvPnFrameDataMaskSpec_{4..7}: CanTrcvPnFrameDataMask=0, CanTrcvPnFrameDataMaskIndex={4..7}
      CanTrcvChannel_1 (CanTrcvChannel):
        CanTrcvChannelId = 1
        CanTrcvChannelUsed = true
        CanTrcvControlsPowerSupply = false
        CanTrcvHwPnSupport = false
        CanTrcvInitState = CANTRCV_OP_MODE_STANDBY
        CanTrcvMaxBaudrate = 500
        CanTrcvWakeupByBusUsed = false
        CanTrcvRbHardwareType = TJA1043
    CanTrcvGeneral:
      CanTrcvDevErrorDetect = true
      CanTrcvIndex = 0
      CanTrcvMainFunctionPeriod = 0.005
      CanTrcvWakeUpSupport = CANTRCV_WAKEUP_BY_POLLING
      CanTrcvVersionInfoApi = true
  module config Com: implementation-config-variant=VARIANT-PRE-COMPILE
    ComConfig
      ComTimeBase: ComGwTimeBase=0.005
    ComGeneral:
      ComCancellationSupport = false
      ComCommonIPduTxPeriodFeature = false
      ComConfigurationUseDet = false
      ComEnableJitterFilter = false
      ComEnableSignalGroupArrayApi = true
      ComIPduControlViaCalibration = false
      ComMultiCoreSwitch = false
      ComProvideIpduStatusAPI = false
      ComReadRxIPduLength = false
      ComRetryFailedTransmitRequests = true
      ComRTESpecificSymbolicNames = false
      ComTxScheduledInDiffTimebase = true
      ComVersionInfoApi = false
  module config ComM: implementation-config-variant=VARIANT-PRE-COMPILE
    ComMConfigSet
      3 x ComMChannel, all with ComMBusType=COMM_BUS_TYPE_CAN, ComMFullCommRequestNotificationEnabled=false, ComMMainFunctionPeriod=0.01, ComMNoWakeUpInhibitionNvmStorage=false:
        ComMChannel_Can: ComMChannelId=0, ComMNoCom=false, ComMNoWakeup=false
          ComMNetworkManagement: ComMNmLightTimeout=0.01, ComMNmVariant=LIGHT, ComMPncNmRequest=false
          ComMUserPerChannel_0 (ComMUserPerChannel): ComMUserChannel=ComMUser_Can
        ComMChannel_Can1: ComMChannelId=1, ComMNoCom=true, ComMNoWakeup=true
          ComMNetworkManagement: ComMNmLightTimeout=0.01, ComMNmVariant=FULL, ComMPncNmRequest=true
          ComMUserPerChannel_0 (ComMUserPerChannel): ComMUserChannel=ComMUser_Can1
        ComMChannel_Can2: ComMChannelId=2, ComMNoCom=false, ComMNoWakeup=false
          ComMNetworkManagement: ComMNmLightTimeout=0.01, ComMNmVariant=LIGHT, ComMPncNmRequest=false
          ComMUserPerChannel_0 (ComMUserPerChannel): ComMUserChannel=ComMUser_Can
      3 x ComMPnc, all with ComMPncMainFunctionPeriod=0.01, ComMChannelPerPnc=ComMChannel_Can:
        Id_8: ComMPncId=8, ComMChannelPerPnc=ComMChannel_Can1, ComMChannelPerPnc=ComMChannel_Can2
        Id_23: ComMPncId=23
        Id_28: ComMPncId=28, ComMChannelPerPnc=ComMChannel_Can1, ComMChannelPerPnc=ComMChannel_Can2
      3 x ComMUser:
        ComMUser_Can
        ComMUser_Can1
        ComMUser_Can2
    ComMGeneral:
      ComMDevErrorDetect = false
      ComMEcuGroupClassification = 0
      ComMModeLimitationEnabled = false
      ComMPncGatewayEnabled = false
      ComMPncPrepareSleepTimer = 1.3
      ComMPncSupport = true
      ComMResetAfterForcingNoComm = false
      ComMRteEnabled = false
      ComMSynchronousWakeUp = true
      ComMTMinFullComModeDuration = 0.01
      ComMVersionInfoApi = true
      ComMWakeupInhibitionEnabled = false
  module config Nm: implementation-config-variant=VARIANT-PRE-COMPILE
    NmChannelConfig_Can1 (NmChannelConfig):
      NmChannelSleepMaster = false
      NmShutdownDelayTimer = 0
      NmStateReportEnabled = false
      NmSynchronizingNetwork = false
      NmPassiveModeEnabled = false
      NmComUserDataSupport = true
      NmComMChannelRef = ComMChannel_Can1
      NmBusType
        NmStandardBusNmConfig: NmStandardBusType=NM_BUSNM_CANNM
    NmGlobalConfig
      NmGlobalConstants: NmNumberOfChannels=1, NmStateChangeIndCallback=RBEMM_NmCtrl_NMStateChangeIndication_Cbk
      NmGlobalFeatures:
        NmBusSynchronizationEnabled = false
        NmCarWakeUpRxEnabled = false
        NmComControlEnabled = true
        NmCoordinatorSupportEnabled = false
        NmCoordinatorSyncSupport = false
        NmPduRxIndicationEnabled = true
        NmRemoteSleepIndEnabled = true
        NmStateChangeIndEnabled = true
        NmUserDataEnabled = true
      NmGlobalProperties: NmCycletimeMainFunction=0.01, NmDevErrorDetect=false, NmVersionInfoApi=false
  module config PduR: implementation-config-variant=VARIANT-PRE-COMPILE
    Com (PduRBswModules):
      PduRCancelReceive = false
      PduRCancelTransmit = false
      PduRChangeParameterApi = false
      PduRCommunicationInterface = true
      PduRLowerModule = false
      PduRRetransmission = false
      PduRTransportProtocol = false
      PduRTriggertransmit = true
      PduRTxConfirmation = true
      PduRUpperModule = true
      PduRUseTag = false
      PduRBswModuleRef = Com
    CanNm (PduRBswModules):
      PduRCancelReceive = false
      PduRCancelTransmit = false
      PduRChangeParameterApi = false
      PduRCommunicationInterface = true
      PduRLowerModule = true
      PduRRetransmission = false
      PduRTransportProtocol = false
      PduRTriggertransmit = true
      PduRTxConfirmation = true
      PduRUpperModule = false
      PduRUseTag = false
      PduRBswModuleRef = CanNm
    PduRGeneral:
      PduRDevErrorDetect = false
      PduRDSMReInitEnabled = false
      PduRGwTpWithLimitedBuffer = false
      PduRIFGatewayOperation = true
      PduRQueueingSupport = false
      PduRVersionInfoApi = true
      PduRZeroCostOperation = false
  module config rba_ComDrv
    rba_ComDrvGeneral: ComDrvCpuCanType=MCU_RB_REN_RH850_P1MC_D3V2, ComDrvCpuType=MCU_RB_REN_RH850_P1MC_D3V2
