AUTOSAR XML (schema 4-0-2)
package /RB/UBK/Project/EcucModuleConfigurationValuess
  module config EcuM: implementation-config-variant=VARIANT-POST-BUILD
    EcuMConfiguration
      EcuMCommonConfiguration: EcuMDefaultAppMode=OSDEFAULTAPPMODE
        EcuMDefaultShutdownTarget: EcuMDefaultState=EcuMStateOff
      EcuMFlexConfiguration
        EcuMFlexUser_BswM (EcuMFlexUserConfig): EcuMFlexUser=0
        EcuMGoDownAllowedUsers: EcuMGoDownAllowedUserRef=EcuMFlexUser_BswM
        3 x EcuMResetMode:
          ECUM_RESET_MCU: EcuMResetModeId=0
          ECUM_RESET_WDGM: EcuMResetModeId=1
          ECUM_RESET_IO: EcuMResetModeId=2
        4 x EcuMShutdownCause:
          ECUM_CAUSE_ECU_STATE: EcuMShutdownCauseId=1
          ECUM_CAUSE_WDGM: EcuMShutdownCauseId=2
          ECUM_CAUSE_DCM: EcuMShutdownCauseId=3
          ECUM_CAUSE_CFG_TBD: EcuMShutdownCauseId=4
    EcuMGeneral: EcuMDevErrorDetect=false, EcuMIncludeDet=false, EcuMMainFunctionPeriod=0.01, EcuMRbConfigCCASInit=true, EcuMRbDisableNvM=true, EcuMVersionInfoApi=true
      EcuMRbIncludeHeaderList: EcuMRbModuleHeader=CanIf
  module config Os
    OSDEFAULTAPPMODE (OsAppMode)
  module config rba_EcuM
    rba_EcuMGeneral:
      rba_EcuM_AppModeUserID = 25
      rba_EcuMRunMinimumDuration = 10
      rba_EcuMMainFunctionPeriod = 0.01
      rba_EcuMDevErrorDetect = false
      rba_EcuMVersionInfoApi = false
      rba_EcuMUserConfig_BswM (rba_EcuMUserConfig): rba_EcuMUser=0
    rba_EcuMConfiguration
