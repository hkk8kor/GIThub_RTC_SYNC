AUTOSAR XML (schema 4-2-2)
package /RB/UBK/Project/EcucModuleConfigurationValuess
  module config Can
    CanConfigSet
  module config CanIf
    CanIfInitCfg
  module config Com
    ComConfig
  module config EcuC
    EcucConfigSet
      EcucPduCollection
  module config IpduM
    IpduMConfig
  module config PduR
    SecOC (PduRBswModules):
      PduRCancelReceive = false
      PduRCancelTransmit = false
      PduRCommunicationInterface = true
      PduRLowerModule = true
      PduRTransportProtocol = true
      PduRTriggertransmit = true
      PduRTxConfirmation = true
      PduRUpperModule = true
      PduRBswModuleRef = SecOC
  module config SecOC
    Tx_IMU_A_Output_ST3_secured_HAD_BACKUP_CAN (SecOCTxPduProcessing):
      SecOCAuthenticationBuildAttempts = 0
      SecOCAuthInfoTruncLength = 24
      SecOCDataId = 38014
      SecOCFreshnessValueId = 1
      SecOCFreshnessValueLength = 40
      SecOCFreshnessValueTruncLength = 8
      SecOCProvideTxTruncatedFreshnessValue = true
      SecOCRbClearBufferAfterTransmit = true
      SecOCRbTxCryptAlgoFamily = AES
      SecOCRbTxCryptAlgoMode = CMAC
      SecOCRbTxCryptAlgoSecondFamily = AES
      SecOCRbTxCryptMode = synchronous
      SecOCRbTxPduCryptIF = Csm_rba_CryptoHSM
      SecOCTxPduUnusedAreasDefault = 0
      SecOCReAuthenticateAfterTriggerTransmit = false
      SecOCUseTxConfirmation = true
      SecOCReAuthenticateAfterTriggerTransmit = false
      IMU_A_Output_ST3_PduR2SecOC_HAD_BACKUP_CAN (SecOCTxAuthenticPduLayer): SecOCTxAuthenticLayerPduRef=IMU_A_Output_ST3_PduR2SecOC
      SecOCTxSecuredPduLayer
        SecOCTxSecuredPdu: SecOCTxSecuredLayerPduRef=IMU_A_Output_ST3_secured_SecOC2PduR
    Tx_IMU_A_Output_Fast_ST3_secured_IMU_INTERNAL_CAN (SecOCTxPduProcessing):
      SecOCAuthenticationBuildAttempts = 0
      SecOCAuthInfoTruncLength = 24
      SecOCDataId = 38379
      SecOCFreshnessValueId = 1
      SecOCFreshnessValueLength = 40
      SecOCFreshnessValueTruncLength = 8
      SecOCProvideTxTruncatedFreshnessValue = true
      SecOCRbClearBufferAfterTransmit = true
      SecOCRbTxCryptAlgoFamily = AES
      SecOCRbTxCryptAlgoMode = CMAC
      SecOCRbTxCryptAlgoSecondFamily = AES
      SecOCRbTxCryptMode = synchronous
      SecOCRbTxPduCryptIF = Csm_rba_CryptoHSM
      SecOCTxPduUnusedAreasDefault = 0
      SecOCReAuthenticateAfterTriggerTransmit = false
      SecOCUseTxConfirmation = true
      SecOCReAuthenticateAfterTriggerTransmit = false
      IMU_A_Output_Fast_ST3_PduR2SecOC_IMU_INTERNAL_CAN (SecOCTxAuthenticPduLayer): SecOCTxAuthenticLayerPduRef=IMU_A_Output_Fast_ST3_PduR2SecOC
      SecOCTxSecuredPduLayer
        SecOCTxSecuredPdu: SecOCTxSecuredLayerPduRef=IMU_A_Output_Fast_ST3_secured_SecOC2PduR
    6 x SecOCRxPduProcessing, all with SecOCAuthenticationVerifyAttempts=0, SecOCAuthInfoTruncLength=24, SecOCFreshnessValueId=1, SecOCFreshnessValueLength=40, SecOCFreshnessValueTruncLength=8, SecOCRbRxCryptAlgoFamily=AES, SecOCRbRxCryptAlgoMode=CMAC, SecOCRbRxCryptAlgoSecondFamily=AES, SecOCRbRxCryptMode=synchronous, SecOCReceptionOverflowStrategy=QUEUE, SecOCReceptionQueueSize=1, SecOCUseAuthDataFreshness=false, SecOCVerificationStatusPropagationMode=FAILURE_ONLY, SecOCRbRxPduCryptIF=Csm_rba_CryptoHSM:
      Rx_ESP_HAD_BACKUP_COM_Container1_ST3_ESP_HAD_BACKUP_COM_Container1_ST3_BCS_Whl_Msg1_BTC_ST3_secured_HAD_BACKUP_CAN: SecOCDataId=1270
        ESP_HAD_BACKUP_COM_Container1_ST3_BCS_Whl_Msg1_BTC_ST3_SecOC2PduR_HAD_BACKUP_CAN (SecOCRxAuthenticPduLayer): SecOCPduType=SECOC_IFPDU, SecOCRxAuthenticLayerPduRef=ESP_HAD_BACKUP_COM_Container1_ST3_BCS_Whl_Msg1_BTC_ST3_SecOC2PduR
        SecOCRxSecuredPduLayer
          SecOCRxSecuredPdu:
            SecOCSecuredRxPduVerification = true
            SecOCRxSecuredLayerPduRef = ESP_HAD_BACKUP_COM_Container1_ST3_ESP_HAD_BACKUP_COM_Container1_ST3_BCS_Whl_Msg1_BTC_ST3_secured_PduR2SecOC
      Rx_ESP_HAD_BACKUP_GW_Container2_ST3_ESP_HAD_BACKUP_GW_Container2_ST3_Ign_Stat_ST3_secured_HAD_BACKUP_CAN: SecOCDataId=28212
        ESP_HAD_BACKUP_GW_Container2_ST3_Ign_Stat_ST3_SecOC2PduR_HAD_BACKUP_CAN (SecOCRxAuthenticPduLayer): SecOCPduType=SECOC_IFPDU, SecOCRxAuthenticLayerPduRef=ESP_HAD_BACKUP_GW_Container2_ST3_Ign_Stat_ST3_SecOC2PduR
        SecOCRxSecuredPduLayer
          SecOCRxSecuredPdu:
            SecOCSecuredRxPduVerification = true
            SecOCRxSecuredLayerPduRef = ESP_HAD_BACKUP_GW_Container2_ST3_ESP_HAD_BACKUP_GW_Container2_ST3_Ign_Stat_ST3_secured_PduR2SecOC
      Rx_ESP_HAD_BACKUP_GW_Container2_ST3_ESP_HAD_BACKUP_GW_Container2_ST3_PT4_PTCoor4_ST3_secured_HAD_BACKUP_CAN: SecOCDataId=26743
        ESP_HAD_BACKUP_GW_Container2_ST3_PT4_PTCoor4_ST3_SecOC2PduR_HAD_BACKUP_CAN (SecOCRxAuthenticPduLayer): SecOCPduType=SECOC_IFPDU, SecOCRxAuthenticLayerPduRef=ESP_HAD_BACKUP_GW_Container2_ST3_PT4_PTCoor4_ST3_SecOC2PduR
        SecOCRxSecuredPduLayer
          SecOCRxSecuredPdu:
            SecOCSecuredRxPduVerification = true
            SecOCRxSecuredLayerPduRef = ESP_HAD_BACKUP_GW_Container2_ST3_ESP_HAD_BACKUP_GW_Container2_ST3_PT4_PTCoor4_ST3_secured_PduR2SecOC
      Rx_IDC_S_FSI_HAD_BACKUP_Cnt_ST3_IDC_S_FSI_HAD_BACKUP_Cnt_ST3_ADAS_HAD_Stat_IDC_S_FSI_Bckp_ST3_secured_HAD_BACKUP_CAN: SecOCDataId=9163
        IDC_S_FSI_HAD_BACKUP_Container_ST3_ADAS_HAD_Stat_IDC_S_FSI_Bckp_ST3_SecOC2PduR_HAD_BACKUP_CAN (SecOCRxAuthenticPduLayer): SecOCPduType=SECOC_IFPDU, SecOCRxAuthenticLayerPduRef=IDC_S_FSI_HAD_BACKUP_Container_ST3_ADAS_HAD_Stat_IDC_S_FSI_Bckp_ST3_SecOC2PduR
        SecOCRxSecuredPduLayer
          SecOCRxSecuredPdu:
            SecOCSecuredRxPduVerification = true
            SecOCRxSecuredLayerPduRef = IDC_S_FSI_HAD_BACKUP_Container_ST3_IDC_S_FSI_HAD_BACKUP_Container_ST3_ADAS_HAD_Stat_IDC_S_FSI_Bckp_ST3_secured_PduR2SecOC
      Rx_ESP_HAD_BACKUP_GW_Container4_ST3_ESP_HAD_BACKUP_GW_Container4_ST3_DI_OdoSpeedometer_ST3_secured_HAD_BACKUP_CAN: SecOCDataId=64886
        ESP_HAD_BACKUP_GW_Container4_ST3_DI_OdoSpeedometer_ST3_SecOC2PduR_HAD_BACKUP_CAN (SecOCRxAuthenticPduLayer): SecOCPduType=SECOC_IFPDU, SecOCRxAuthenticLayerPduRef=ESP_HAD_BACKUP_GW_Container4_ST3_DI_OdoSpeedometer_ST3_SecOC2PduR
        SecOCRxSecuredPduLayer
          SecOCRxSecuredPdu:
            SecOCSecuredRxPduVerification = true
            SecOCRxSecuredLayerPduRef = ESP_HAD_BACKUP_GW_Container4_ST3_ESP_HAD_BACKUP_GW_Container4_ST3_DI_OdoSpeedometer_ST3_secured_PduR2SecOC
      Rx_ESP_HAD_BACKUP_GW_Container4_ST3_ESP_HAD_BACKUP_GW_Container4_ST3_PN14_Master_Stat1_ST3_secured_HAD_BACKUP_CAN: SecOCDataId=57668
        ESP_HAD_BACKUP_GW_Container4_ST3_PN14_Master_Stat1_ST3_SecOC2PduR_HAD_BACKUP_CAN (SecOCRxAuthenticPduLayer): SecOCPduType=SECOC_IFPDU, SecOCRxAuthenticLayerPduRef=ESP_HAD_BACKUP_GW_Container4_ST3_PN14_Master_Stat1_ST3_SecOC2PduR
        SecOCRxSecuredPduLayer
          SecOCRxSecuredPdu:
            SecOCSecuredRxPduVerification = true
            SecOCRxSecuredLayerPduRef = ESP_HAD_BACKUP_GW_Container4_ST3_ESP_HAD_BACKUP_GW_Container4_ST3_PN14_Master_Stat1_ST3_secured_PduR2SecOC
