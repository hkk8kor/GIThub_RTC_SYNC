AUTOSAR XML (schema 4-2-2)
package /RB/UBK/Project/EcucModuleConfigurationValuess
  module config Can
    CanConfigSet
      3 x CanController, all with CanBusoffProcessing=POLLING, CanRbFDIsoOperation=true, CanRbSwPollingFifoSize=500:
        CanIfControllerConfig_0: CanControllerId=0, CanRbHardwareNodeId=TTCAN_0, CanControllerDefaultBaudrate=CanControllerBaudrateConfig_0
          CanControllerBaudrateConfig_0 (CanControllerBaudrateConfig):
            CanControllerBaudRate = 500
            CanControllerBaudRateConfigID = 0
            CanControllerPropSeg = 47
            CanControllerSeg1 = 16
            CanControllerSeg2 = 16
            CanControllerSyncJumpWidth = 16
            CanRbBrp = 2
            CanControllerFdBaudrateConfig_0 (CanControllerFdBaudrateConfig):
              CanControllerFdBaudRate = 1000
              CanControllerPropSeg = 19
              CanControllerSeg1 = 10
              CanControllerSeg2 = 10
              CanControllerSyncJumpWidth = 10
              CanControllerTxBitRateSwitch = true
              CanRbBrp = 2
        CanIfControllerConfig_1: CanControllerId=1, CanRbHardwareNodeId=MCAN_0, CanControllerDefaultBaudrate=CanControllerBaudrateConfig_1
          CanControllerBaudrateConfig_1 (CanControllerBaudrateConfig):
            CanControllerBaudRate = 500
            CanControllerBaudRateConfigID = 1
            CanControllerPropSeg = 47
            CanControllerSeg1 = 16
            CanControllerSeg2 = 16
            CanControllerSyncJumpWidth = 16
            CanRbBrp = 2
            CanControllerFdBaudrateConfig_1 (CanControllerFdBaudrateConfig):
              CanControllerFdBaudRate = 1000
              CanControllerSeg1 = 10
              CanControllerSeg2 = 10
              CanControllerSyncJumpWidth = 10
              CanControllerTxBitRateSwitch = true
              CanRbBrp = 2
              CanControllerPropSeg = 19
        CanIfControllerConfig_2: CanControllerId=2, CanRbHardwareNodeId=MCAN_1, CanControllerDefaultBaudrate=CanControllerBaudrateConfig_2
          CanControllerBaudrateConfig_2 (CanControllerBaudrateConfig):
            CanControllerBaudRate = 500
            CanControllerBaudRateConfigID = 1
            CanControllerPropSeg = 49
            CanControllerSeg1 = 15
            CanControllerSeg2 = 15
            CanControllerSyncJumpWidth = 15
            CanRbBrp = 2
            CanControllerFdBaudrateConfig_2 (CanControllerFdBaudrateConfig):
              CanControllerFdBaudRate = 2000
              CanControllerPropSeg = 7
              CanControllerSeg1 = 4
              CanControllerSeg2 = 8
              CanControllerSyncJumpWidth = 4
              CanControllerTxBitRateSwitch = true
              CanControllerSspOffset = 12
              CanRbBrp = 2
    CanGeneral:
      CanIndex = 0
      CanMainFunctionBusoffPeriod = 0.005
      CanMainFunctionModePeriod = 0.005
      CanVersionInfoApi = false
      CanDevErrorDetect = false
      CanGlobalTimeSupport = false
      CanRbLiteConfiguration = false
      CanRbDynamicMCANIpDetection = true
      CanGlobalTimeSupport = false
      CanDemEventParameterRefs: CAN_E_TIMEOUT=CAN_E_TIMEOUT
      CanMainFunctionRWPeriods_5ms (CanMainFunctionRWPeriods): CanMainFunctionPeriod=0.005
  module config CanIf
    CanIfCtrlDrvCfg_0 (CanIfCtrlDrvCfg): CanIfCtrlDrvInitHohConfigRef=CanIfInitHohCfg, CanIfCtrlDrvNameRef=CanGeneral
      3 x CanIfCtrlCfg, all with CanIfCtrlWakeupSupport=false:
        CanIfControllerConfig_0: CanIfCtrlId=0, CanIfCtrlCanCtrlRef=CanConfigSet/CanIfControllerConfig_0
        CanIfControllerConfig_1: CanIfCtrlId=1, CanIfCtrlCanCtrlRef=CanConfigSet/CanIfControllerConfig_1, CanIfCtrlTrcvRef=CanIfTrcvCfg_1
        CanIfControllerConfig_2: CanIfCtrlId=2, CanIfCtrlCanCtrlRef=CanConfigSet/CanIfControllerConfig_2, CanIfCtrlTrcvRef=CanIfTrcvCfg_2
    CanIfTrcvDrvCfg_0 (CanIfTrcvDrvCfg)
      CanIfTrcvCfg_1 (CanIfTrcvCfg): CanIfTrcvId=0, CanIfTrcvWakeupSupport=false, CanIfTrcvCanTrcvRef=CanTrcvChannel_0
      CanIfTrcvCfg_2 (CanIfTrcvCfg): CanIfTrcvId=1, CanIfTrcvWakeupSupport=false, CanIfTrcvCanTrcvRef=CanTrcvChannel_1
    CanIfPublicCfg:
      CanIfPublicBusoffRecoveryfromRxIndication = true
      CanIfPublicCancelTransmitSupport = false
      CanIfPublicCanIfLiteConfiguration = false
      CanIfPublicCddHeaderFile = cdd_header
      CanIfPublicErrorPassiveSupport = false
      CanIfPublicHandleTypeEnum = UINT8
      CanIfPublicMultipleDrvSupport = false
      CanIfPublicPnSupport = false
      CanIfPublicReadRxPduDataApi = false
      CanIfPublicReadRxPduNotifyStatusApi = true
      CanIfPublicReadTxPduNotifyStatusApi = true
      CanIfPublicSetDynamicTxIdApi = true
      CanIfPublicTxBuffering = false
      CanIfPublicTxConfirmPollingSupport = false
      CanIfPublicUserTpTxInOfflineMode = true
      CanIfPublicWakeupCheckValidSupport = false
      CanIfTriggerTransmitSupport = true
      CanIfGlobalTimeSupport = false
      CanIfTxOfflineActiveSupport = false
      CanIfWakeupSupport = true
      CanIfDevErrorDetect = false
      CanIfVersionInfoApi = false
    CanIfDispatchCfg:
      CanIfDispatchUserCheckTrcvWakeFlagIndicationName = CanSM_CheckTransceiverWakeFlagIndication
      CanIfDispatchUserCheckTrcvWakeFlagIndicationUL = CAN_SM
      CanIfDispatchUserClearTrcvWufFlagIndicationName = CanSM_ClearTrcvWufFlagIndication
      CanIfDispatchUserClearTrcvWufFlagIndicationUL = CAN_SM
      CanIfDispatchUserConfirmPnAvailabilityName = CanSM_ConfirmPnAvailability
      CanIfDispatchUserConfirmPnAvailabilityUL = CAN_SM
      CanIfDispatchUserCtrlBusOffName = CanSM_ControllerBusOff
      CanIfDispatchUserCtrlBusOffUL = CAN_SM
      CanIfDispatchUserCtrlModeIndicationUL = CAN_SM
      CanIfDispatchUserTrcvModeIndicationUL = CAN_SM
    CanIfPrivateCfg: CanIfPrivateDataLengthCheck=false
  module config CanNm: implementation-config-variant=VARIANT-PRE-COMPILE
    CanNmGlobalConfig:
      CanNmBusLoadReductionEnabled = false
      CanNmBusSynchronizationEnabled = false
      CanNmComControlEnabled = true
      CanNmComUserDataSupport = true
      CanNmCoordinatorSyncSupport = false
      CanNmDevErrorDetect = true
      CanNmImmediateRestartEnabled = false
      CanNmImmediateTxconfEnabled = false
      CanNmMainFunctionPeriod = 0.005
      CanNmPassiveModeEnabled = false
      CanNmPduRxIndicationEnabled = true
      CanNmRemoteSleepIndEnabled = true
      CanNmStateChangeIndEnabled = true
      CanNmUserDataEnabled = true
      CanNmVersionInfoApi = false
      CanNmGlobalPnSupport = true
      CanNmPnSyncShutdownErrorReactionEnabled = false
      CanNmPnResetTime = 1.1
      CanNmPnEiraCalcEnabled = true
      CanNmPnEiraRxNSduRef = NmPnEiraRxNSduRef_CAN_CanNm2PduR_IMU_INTERNAL_CAN
      CanNmPnInfo: CanNmPnInfoLength=7, CanNmPnInfoOffset=1
        7 x CanNmPnFilterMaskByte:
          CanNmPnFilterMaskByte_0: CanNmPnFilterMaskByteIndex=0, CanNmPnFilterMaskByteValue=1
          CanNmPnFilterMaskByte_1: CanNmPnFilterMaskByteIndex=1, CanNmPnFilterMaskByteValue=128
          CanNmPnFilterMaskByte_2: CanNmPnFilterMaskByteIndex=2, CanNmPnFilterMaskByteValue=144
          CanNmPnFilterMaskByte_{3..6}: CanNmPnFilterMaskByteIndex={3..6}, CanNmPnFilterMaskByteValue=0
  module config CanSM
    CanSMConfiguration: CanSMModeRequestRepetitionMax=10, CanSMModeRequestRepetitionTime=0.01
      3 x CanSMManagerNetwork, all with CanSMBorCounterL1ToL2=20, CanSMBorTimeL1=0.05, CanSMBorTimeL2=1, CanSMBorTimeTxEnsured=1, CanSMBorTxConfirmationPolling=false:
        IMU_Can: CanSMComMNetworkHandleRef=ComMChannel_Can
          IMU_A_HAD_IMU (CanSMController): CanSMControllerId=CanIfCtrlDrvCfg_0/CanIfControllerConfig_0
          CanSMDemEventParameterRefs: CanSMRbDynCreate_CANSM_E_BUS_OFF=Disabled, CANSM_E_BUS_OFF=CANSM_E_BUSOFF_NETWORK_0
        IMU_Can1: CanSMComMNetworkHandleRef=ComMChannel_Can1, CanSMTransceiverId=CanIfTrcvCfg_1
          IMU_A_HAD_BACKUP (CanSMController): CanSMControllerId=CanIfCtrlDrvCfg_0/CanIfControllerConfig_1
          CanSMDemEventParameterRefs: CanSMRbDynCreate_CANSM_E_BUS_OFF=Disabled, CANSM_E_BUS_OFF=CANSM_E_BUSOFF_NETWORK_1
        IMU_Can2: CanSMComMNetworkHandleRef=ComMChannel_Can2, CanSMTransceiverId=CanIfTrcvCfg_2
          IMU_B_DRIVING_CAN (CanSMController): CanSMControllerId=CanIfCtrlDrvCfg_0/CanIfControllerConfig_2
          CanSMDemEventParameterRefs: CanSMRbDynCreate_CANSM_E_BUS_OFF=Disabled, CANSM_E_BUS_OFF=CANSM_E_BUSOFF_NETWORK_2
    CanSMGeneral: CanSMDevErrorDetect=false, CanSMMainFunctionTimePeriod=0.005, CanSMPncSupport=false, CanSMSetBaudrateApi=false, CanSMVersionInfoApi=false
  module config CanTrcv_0: definition=CanTrcv
    CanTrcvConfigSet
      CanTrcvChannel_0 (CanTrcvChannel):
        CanTrcvChannelId = 0
        CanTrcvChannelUsed = true
        CanTrcvControlsPowerSupply = true
        CanTrcvHwPnSupport = false
        CanTrcvInitState = CANTRCV_OP_MODE_STANDBY
        CanTrcvMaxBaudrate = 500
        CanTrcvWakeupByBusUsed = true
        CanTrcvRbHardwareType = TJA1043
        CanTrcvWakeupSourceRef = ECUM_WKSOURCE_CAN1
        CanTrcvAccess
          CanTrcvDioAccess
            4 x CanTrcvDioChannelAccess:
              CanTrcvDioChannelAccess_EN: CanTrcvHardwareInterfaceName=RBDIO_EN_CAN2, CanTrcvRbDioHardwareInterfaceType=Enable, CanTrcvDioSymNameRef=RBDIO_EN_CAN2_UC
              CanTrcvDioChannelAccess_STBY: CanTrcvHardwareInterfaceName=RBDIO_STBY_CAN2, CanTrcvRbDioHardwareInterfaceType=Standby, CanTrcvDioSymNameRef=RBDIO_STB_CAN2_UC
              CanTrcvDioChannelAccess_ERR: CanTrcvHardwareInterfaceName=RBDIO_ERR_CAN2, CanTrcvRbDioHardwareInterfaceType=ErrorPin, CanTrcvDioSymNameRef=RBDIO_ERR_CAN2_UC
              CanTrcvDioChannelAccess_WAU: CanTrcvHardwareInterfaceName=RBDIO_RXCAN2, CanTrcvRbDioHardwareInterfaceType=WakeupSignalisation, CanTrcvDioSymNameRef=RBDIO_RXCAN2
      CanTrcvChannel_1 (CanTrcvChannel):
        CanTrcvChannelId = 1
        CanTrcvChannelUsed = true
        CanTrcvControlsPowerSupply = false
        CanTrcvHwPnSupport = false
        CanTrcvInitState = CANTRCV_OP_MODE_STANDBY
        CanTrcvMaxBaudrate = 500
        CanTrcvWakeupByBusUsed = true
        CanTrcvRbHardwareType = TJA1043
        CanTrcvWakeupSourceRef = ECUM_WKSOURCE_CAN2
        CanTrcvAccess
          CanTrcvDioAccess
            4 x CanTrcvDioChannelAccess:
              CanTrcvDioChannelAccess_EN: CanTrcvHardwareInterfaceName=RBDIO_EN_CAN3_UC, CanTrcvRbDioHardwareInterfaceType=Enable, CanTrcvDioSymNameRef=RBDIO_EN_CAN3_UC
              CanTrcvDioChannelAccess_STBY: CanTrcvHardwareInterfaceName=RBDIO_STBY_CAN3_UC, CanTrcvRbDioHardwareInterfaceType=Standby, CanTrcvDioSymNameRef=RBDIO_STB_CAN3_UC
              CanTrcvDioChannelAccess_ERR: CanTrcvHardwareInterfaceName=RBDIO_ERR_CAN3_UC, CanTrcvRbDioHardwareInterfaceType=ErrorPin, CanTrcvDioSymNameRef=RBDIO_ERR_CAN3_UC
              CanTrcvDioChannelAccess_WAU: CanTrcvHardwareInterfaceName=RBDIO_RXCAN3, CanTrcvRbDioHardwareInterfaceType=WakeupSignalisation, CanTrcvDioSymNameRef=RBDIO_RXCAN3
    CanTrcvGeneral:
      CanTrcvDevErrorDetect = true
      CanTrcvIndex = 0
      CanTrcvMainFunctionPeriod = 0.005
      CanTrcvWakeUpSupport = CANTRCV_WAKEUP_BY_POLLING
      CanTrcvVersionInfoApi = true
  module config Com: implementation-config-variant=VARIANT-PRE-COMPILE
    ComGeneral:
      ComCancellationSupport = false
      ComCommonIPduTxPeriodFeature = false
      ComConfigurationUseDet = false
      ComEnableJitterFilter = false
      ComEnableSignalGroupArrayApi = true
      ComIPduControlViaCalibration = false
      ComMultiCoreSwitch = false
      ComProvideIpduStatusAPI = false
      ComReadRxIPduLength = false
      ComRetryFailedTransmitRequests = true
      ComRTESpecificSymbolicNames = false
      ComTxScheduledInDiffTimebase = true
      ComVersionInfoApi = false
  module config ComM: implementation-config-variant=VARIANT-PRE-COMPILE
    ComMConfigSet
      3 x ComMChannel, all with ComMBusType=COMM_BUS_TYPE_CAN, ComMFullCommRequestNotificationEnabled=false, ComMMainFunctionPeriod=0.01, ComMNoWakeUpInhibitionNvmStorage=false:
        ComMChannel_Can: ComMChannelId=0, ComMNoCom=false, ComMNoWakeup=false, ComMPncGatewayType=COMM_GATEWAY_TYPE_PASSIVE
          ComMNetworkManagement: ComMNmLightTimeout=0.01, ComMNmVariant=FULL, ComMPncNmRequest=true
          ComMUserPerChannel_0 (ComMUserPerChannel): ComMUserChannel=ComMUser_Can
        ComMChannel_Can1: ComMChannelId=1, ComMNoCom=false, ComMNoWakeup=false, ComMPncGatewayType=COMM_GATEWAY_TYPE_ACTIVE
          ComMNetworkManagement: ComMNmLightTimeout=0.01, ComMNmVariant=FULL, ComMPncNmRequest=true
          ComMUserPerChannel_0 (ComMUserPerChannel): ComMUserChannel=ComMUser_Can1
        ComMChannel_Can2: ComMChannelId=2, ComMNoCom=true, ComMNoWakeup=true, ComMPncGatewayType=COMM_GATEWAY_TYPE_PASSIVE
          ComMNetworkManagement: ComMNmLightTimeout=0.01, ComMNmVariant=FULL, ComMPncNmRequest=true
          ComMUserPerChannel_0 (ComMUserPerChannel): ComMUserChannel=ComMUser_Can2
      4 x ComMPnc, all with ComMPncMainFunctionPeriod=0.01, ComMChannelPerPnc=ComMChannel_Can:
        Id_8: ComMPncId=8, ComMChannelPerPnc=ComMChannel_Can1, ComMChannelPerPnc=ComMChannel_Can2
          6 x ComMPncComSignal:
            ComMPncComSignal_ERA_DRIVING_CAN_Rx: ComMPncComSignalDirection=RX, ComMPncComSignalKind=ERA, ComMPncComSignalChannelRef=ComMChannel_Can2, ComMPncComSignalRef=S_NM_IMU_B_CanNmUserDataSig_Era_DRIVING_CAN_Rx
            ComMPncComSignal_ERA_INTERNAL_CAN_Rx: ComMPncComSignalDirection=RX, ComMPncComSignalKind=ERA, ComMPncComSignalChannelRef=ComMChannel_Can, ComMPncComSignalRef=S_NM_IMU_B_CanNmUserDataSig_Era_INTERNAL_CAN_Rx
            ComMPncComSignal_ERA_HAD_IMU_CAN_Rx: ComMPncComSignalDirection=RX, ComMPncComSignalKind=ERA, ComMPncComSignalRef=S_NM_IMU_B_CanNmUserDataSig_Era_HAD_IMU_CAN_Rx, ComMPncComSignalChannelRef=ComMChannel_Can1
            ComMPncComSignal_EIRA_DRIVING_CAN_Tx: ComMPncComSignalDirection=TX, ComMPncComSignalChannelRef=ComMChannel_Can2, ComMPncComSignalRef=S_NM_IMU_B_ST3_PNC_DRIVING_CAN_Tx
            ComMPncComSignal_EIRA_INTERNAL_CAN_Tx: ComMPncComSignalDirection=TX, ComMPncComSignalChannelRef=ComMChannel_Can, ComMPncComSignalRef=S_NM_IMU_B_ST3_PNC_IMU_INTERNAL_CAN_Tx
            ComMPncComSignal_EIRA_HAD_IMU_CAN_Tx: ComMPncComSignalDirection=TX, ComMPncComSignalChannelRef=ComMChannel_Can1, ComMPncComSignalRef=S_NM_IMU_B_ST3_PNC_HAD_IMU_CAN_Tx
        Id_23: ComMPncId=23
          ComMPncComSignal_ERA_INTERNAL_CAN_Rx (ComMPncComSignal):
            ComMPncComSignalDirection = RX
            ComMPncComSignalKind = ERA
            ComMPncComSignalChannelRef = ComMChannel_Can
            ComMPncComSignalRef = S_NM_IMU_B_CanNmUserDataSig_Era_INTERNAL_CAN_Rx
          ComMPncComSignal_EIRA_INTERNAL_CAN_Tx (ComMPncComSignal): ComMPncComSignalDirection=TX, ComMPncComSignalChannelRef=ComMChannel_Can, ComMPncComSignalRef=S_NM_IMU_B_ST3_PNC_IMU_INTERNAL_CAN_Tx
        Id_28: ComMPncId=28, ComMChannelPerPnc=ComMChannel_Can1, ComMChannelPerPnc=ComMChannel_Can2
          6 x ComMPncComSignal:
            ComMPncComSignal_ERA_DRIVING_CAN_Rx: ComMPncComSignalDirection=RX, ComMPncComSignalKind=ERA, ComMPncComSignalChannelRef=ComMChannel_Can2, ComMPncComSignalRef=S_NM_IMU_B_CanNmUserDataSig_Era_DRIVING_CAN_Rx
            ComMPncComSignal_ERA_INTERNAL_CAN_Rx: ComMPncComSignalDirection=RX, ComMPncComSignalKind=ERA, ComMPncComSignalChannelRef=ComMChannel_Can, ComMPncComSignalRef=S_NM_IMU_B_CanNmUserDataSig_Era_INTERNAL_CAN_Rx
            ComMPncComSignal_ERA_HAD_IMU_CAN_Rx: ComMPncComSignalDirection=RX, ComMPncComSignalKind=ERA, ComMPncComSignalRef=S_NM_IMU_B_CanNmUserDataSig_Era_HAD_IMU_CAN_Rx, ComMPncComSignalChannelRef=ComMChannel_Can1
            ComMPncComSignal_EIRA_HAD_IMU_CAN_Tx: ComMPncComSignalDirection=TX, ComMPncComSignalChannelRef=ComMChannel_Can1, ComMPncComSignalRef=S_NM_IMU_B_ST3_PNC_HAD_IMU_CAN_Tx
            ComMPncComSignal_EIRA_INTERNAL_CAN_Tx: ComMPncComSignalDirection=TX, ComMPncComSignalChannelRef=ComMChannel_Can, ComMPncComSignalRef=S_NM_IMU_B_ST3_PNC_IMU_INTERNAL_CAN_Tx
            ComMPncComSignal_EIRA_DRIVING_CAN_Tx: ComMPncComSignalDirection=TX, ComMPncComSignalChannelRef=ComMChannel_Can2, ComMPncComSignalRef=S_NM_IMU_B_ST3_PNC_DRIVING_CAN_Tx
        Id_31: ComMPncId=31, ComMChannelPerPnc=ComMChannel_Can1, ComMChannelPerPnc=ComMChannel_Can2
          6 x ComMPncComSignal:
            ComMPncComSignal_ERA_DRIVING_CAN_Rx: ComMPncComSignalDirection=RX, ComMPncComSignalKind=ERA, ComMPncComSignalChannelRef=ComMChannel_Can2, ComMPncComSignalRef=S_NM_IMU_B_CanNmUserDataSig_Era_DRIVING_CAN_Rx
            ComMPncComSignal_ERA_INTERNAL_CAN_Rx: ComMPncComSignalDirection=RX, ComMPncComSignalKind=ERA, ComMPncComSignalChannelRef=ComMChannel_Can, ComMPncComSignalRef=S_NM_IMU_B_CanNmUserDataSig_Era_INTERNAL_CAN_Rx
            ComMPncComSignal_ERA_HAD_IMU_CAN_Rx: ComMPncComSignalDirection=RX, ComMPncComSignalKind=ERA, ComMPncComSignalRef=S_NM_IMU_B_CanNmUserDataSig_Era_HAD_IMU_CAN_Rx, ComMPncComSignalChannelRef=ComMChannel_Can1
            ComMPncComSignal_EIRA_HAD_IMU_CAN_Tx: ComMPncComSignalDirection=TX, ComMPncComSignalChannelRef=ComMChannel_Can1, ComMPncComSignalRef=S_NM_IMU_B_ST3_PNC_HAD_IMU_CAN_Tx
            ComMPncComSignal_EIRA_INTERNAL_CAN_Tx: ComMPncComSignalDirection=TX, ComMPncComSignalChannelRef=ComMChannel_Can, ComMPncComSignalRef=S_NM_IMU_B_ST3_PNC_IMU_INTERNAL_CAN_Tx
            ComMPncComSignal_EIRA_DRIVING_CAN_Tx: ComMPncComSignalDirection=TX, ComMPncComSignalChannelRef=ComMChannel_Can2, ComMPncComSignalRef=S_NM_IMU_B_ST3_PNC_DRIVING_CAN_Tx
      3 x ComMUser:
        ComMUser_Can
        ComMUser_Can1
        ComMUser_Can2
    ComMGeneral:
      ComMDevErrorDetect = false
      ComMEcuGroupClassification = 0
      ComMModeLimitationEnabled = false
      ComMPncGatewayEnabled = true
      ComMPncSupport = true
      ComMResetAfterForcingNoComm = false
      ComMRteEnabled = false
      ComMSynchronousWakeUp = true
      ComMTMinFullComModeDuration = 3
      ComMVersionInfoApi = true
      ComMWakeupInhibitionEnabled = false
      ComMPncPrepareSleepTimer = 1.3
  module config Nm: implementation-config-variant=VARIANT-PRE-COMPILE
    3 x NmChannelConfig, all with NmChannelSleepMaster=false, NmShutdownDelayTimer=0, NmStateReportEnabled=false, NmSynchronizingNetwork=false, NmPassiveModeEnabled=false, NmComUserDataSupport=true:
      NmChannelConfig_Can1: NmComMChannelRef=ComMChannel_Can1
        NmBusType
          NmStandardBusNmConfig: NmStandardBusType=NM_BUSNM_CANNM
      NmChannelConfig_Can2: NmComMChannelRef=ComMChannel_Can2
        NmBusType
          NmStandardBusNmConfig: NmStandardBusType=NM_BUSNM_CANNM
      NmChannelConfig_Can: NmComMChannelRef=ComMChannel_Can
        NmBusType
          NmStandardBusNmConfig: NmStandardBusType=NM_BUSNM_CANNM
    NmGlobalConfig
      NmGlobalConstants: NmNumberOfChannels=3, NmStateChangeIndCallback=RBEMM_NmCtrl_NMStateChangeIndication_Cbk
      NmGlobalFeatures:
        NmBusSynchronizationEnabled = false
        NmCarWakeUpRxEnabled = false
        NmComControlEnabled = true
        NmCoordinatorSupportEnabled = false
        NmCoordinatorSyncSupport = false
        NmPduRxIndicationEnabled = true
        NmRemoteSleepIndEnabled = true
        NmStateChangeIndEnabled = true
        NmUserDataEnabled = true
      NmGlobalProperties: NmCycletimeMainFunction=0.01, NmDevErrorDetect=false, NmVersionInfoApi=false
  module config PduR: implementation-config-variant=VARIANT-PRE-COMPILE
    Com (PduRBswModules):
      PduRCancelReceive = false
      PduRCancelTransmit = false
      PduRCommunicationInterface = true
      PduRLowerModule = false
      PduRTransportProtocol = false
      PduRTriggertransmit = true
      PduRTxConfirmation = true
      PduRUpperModule = true
      PduRBswModuleRef = Com
    CanNm (PduRBswModules):
      PduRCancelReceive = false
      PduRCancelTransmit = false
      PduRCommunicationInterface = true
      PduRLowerModule = true
      PduRTransportProtocol = false
      PduRTriggertransmit = true
      PduRTxConfirmation = true
      PduRUpperModule = false
      PduRBswModuleRef = CanNm
    PduRGeneral:
      PduRDevErrorDetect = false
      PduRZeroCostOperation = false
      PduRRbDsmReInitEnabled = false
      PduRRbGwTpWithLimitedBuffer = false
      PduRRbIFGatewayOperation = true
      PduRRbQueueingSupport = false
      PduRVersionInfoApi = false
  module config rba_ComDrv
    rba_ComDrvGeneral: ComDrvCpuCanType=MCU_RB_REN_RH850_P1MC_D3V2, ComDrvCpuType=MCU_RB_REN_RH850_P1MC_D3V2
