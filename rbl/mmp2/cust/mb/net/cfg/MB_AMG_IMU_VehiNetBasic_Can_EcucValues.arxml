AUTOSAR XML (schema 4-2-2)
package /RB/UBK/Project/EcucModuleConfigurationValuess
  module config Can
    CanConfigSet
      3 x CanController, all with CanBusoffProcessing=POLLING, CanFDIsoOperation=true:
        CanIfControllerConfig_0: CanControllerId=0, CanHardwareNodeId=TTCAN_0, CanControllerDefaultBaudrate=CanControllerBaudrateConfig_0
          CanControllerBaudrateConfig_0 (CanControllerBaudrateConfig):
            CanBrp = 4
            CanControllerBaudRate = 500
            CanControllerBaudRateConfigID = 0
            CanControllerPropSeg = 23
            CanControllerSeg1 = 8
            CanControllerSeg2 = 8
            CanControllerSyncJumpWidth = 4
            CanControllerFdBaudrateConfig_0 (CanControllerFdBaudrateConfig):
              CanBrp = 4
              CanControllerFdBaudRate = 1000
              CanControllerPropSeg = 8
              CanControllerSeg1 = 6
              CanControllerSeg2 = 5
              CanControllerSyncJumpWidth = 4
              CanControllerTxBitRateSwitch = true
        CanIfControllerConfig_1: CanControllerId=1, CanHardwareNodeId=MCAN_0, CanControllerDefaultBaudrate=CanControllerBaudrateConfig_1
          CanControllerBaudrateConfig_1 (CanControllerBaudrateConfig):
            CanBrp = 4
            CanControllerBaudRate = 500
            CanControllerBaudRateConfigID = 1
            CanControllerPropSeg = 23
            CanControllerSeg1 = 8
            CanControllerSeg2 = 8
            CanControllerSyncJumpWidth = 4
            CanControllerFdBaudrateConfig_1 (CanControllerFdBaudrateConfig):
              CanBrp = 4
              CanControllerFdBaudRate = 1000
              CanControllerPropSeg = 8
              CanControllerSeg1 = 6
              CanControllerSeg2 = 5
              CanControllerSyncJumpWidth = 4
              CanControllerTxBitRateSwitch = true
        CanIfControllerConfig_2: CanControllerId=2, CanHardwareNodeId=MCAN_1, CanControllerDefaultBaudrate=CanControllerBaudrateConfig_2
          CanControllerBaudrateConfig_2 (CanControllerBaudrateConfig):
            CanBrp = 4
            CanControllerBaudRate = 500
            CanControllerBaudRateConfigID = 1
            CanControllerPropSeg = 23
            CanControllerSeg1 = 8
            CanControllerSeg2 = 8
            CanControllerSyncJumpWidth = 15
            CanControllerFdBaudrateConfig_2 (CanControllerFdBaudrateConfig):
              CanBrp = 2
              CanControllerFdBaudRate = 2000
              CanControllerPropSeg = 6
              CanControllerSeg1 = 5
              CanControllerSeg2 = 8
              CanControllerSyncJumpWidth = 4
              CanControllerTxBitRateSwitch = true
    CanGeneral:
      CanDevErrorDetection = false
      CanDynamicMCANIpDetection = true
      CanErrorPassiveProcessing = OFF
      CanIndex = 0
      CanLiteConfiguration = false
      CanMainFunctionBusoffPeriod = 0.005
      CanMainFunctionModePeriod = 0.005
      CanVersionInfoApi = false
      CanDemEventParameterRefs: CAN_E_TIMEOUT=CAN_E_TIME_OUT
      CanMainFunctionRWPeriods_5ms (CanMainFunctionRWPeriods): CanMainFunctionPeriod=0.005
  module config CanIf
    CanIfCtrlDrvCfg_0 (CanIfCtrlDrvCfg): CanIfCtrlDrvInitHohConfigRef=CanIfInitHohCfg, CanIfCtrlDrvNameRef=CanGeneral
      3 x CanIfCtrlCfg, all with CanIfCtrlWakeupSupport=false:
        CanIfControllerConfig_0: CanIfCtrlId=0, CanIfCtrlCanCtrlRef=CanConfigSet/CanIfControllerConfig_0
        CanIfControllerConfig_1: CanIfCtrlId=1, CanIfCtrlCanCtrlRef=CanConfigSet/CanIfControllerConfig_1, CanIfCtrlTrcvRef=CanIfTrcvCfg_1
        CanIfControllerConfig_2: CanIfCtrlId=2, CanIfCtrlCanCtrlRef=CanConfigSet/CanIfControllerConfig_2, CanIfCtrlTrcvRef=CanIfTrcvCfg_2
    CanIfTrcvDrvCfg_0 (CanIfTrcvDrvCfg)
      CanIfTrcvCfg_1 (CanIfTrcvCfg): CanIfTrcvWakeupSupport=false, CanIfTrcvCanTrcvRef=CanTrcvChannel_0
      CanIfTrcvCfg_2 (CanIfTrcvCfg): CanIfTrcvWakeupSupport=false, CanIfTrcvCanTrcvRef=CanTrcvChannel_1
    CanIfPublicCfg:
      CanIfPublicBusoffRecoveryfromRxIndication = true
      CanIfPublicCancelTransmitSupport = false
      CanIfPublicCanIfLiteConfiguration = false
      CanIfPublicCddHeaderFile = cdd_header
      CanIfPublicDevErrorDetect = false
      CanIfPublicErrorPassiveSupport = false
      CanIfPublicHandleTypeEnum = UINT8
      CanIfPublicMultipleDrvSupport = false
      CanIfPublicPnSupport = false
      CanIfPublicReadRxPduDataApi = false
      CanIfPublicReadRxPduNotifyStatusApi = true
      CanIfPublicReadTxPduNotifyStatusApi = true
      CanIfPublicSetDynamicTxIdApi = true
      CanIfPublicTxBuffering = false
      CanIfPublicTxConfirmPollingSupport = false
      CanIfPublicUserTpTxInOfflineMode = true
      CanIfPublicVersionInfoApi = false
      CanIfPublicWakeupCheckValidSupport = false
      CanIfTriggerTransmitSupport = true
      CanIfTxOfflineActiveSupport = false
      CanIfWakeupSupport = false
    CanIfDispatchCfg:
      CanIfDispatchUserCtrlBusOffName = CanSM_ControllerBusOff
      CanIfDispatchUserCtrlBusOffUL = CAN_SM
      CanIfDispatchUserCtrlModeIndicationUL = CAN_SM
      CanIfDispatchUserTrcvModeIndicationUL = CAN_SM
    CanIfPrivateCfg: CanIfPrivateDlcCheck=false
  module config CanSM
    CanSMConfiguration: CanSMModeRequestRepetitionMax=5, CanSMModeRequestRepetitionTime=0.01
      3 x CanSMManagerNetwork, all with CanSMBorCounterL1ToL2=3, CanSMBorTimeL1=0.05, CanSMBorTimeL2=0.1, CanSMBorTimeTxEnsured=0.05, CanSMBorTxConfirmationPolling=false:
        IMU_INTERNAL_CAN: CanSMComMNetworkHandleRef=ComMChannel_Can
          IMU_A_HAD_IMU (CanSMController): CanSMControllerId=CanIfCtrlDrvCfg_0/CanIfControllerConfig_0
          CanSMDemEventParameterRefs: CanSMRbDynCreate_CANSM_E_BUS_OFF=Disabled, CANSM_E_BUS_OFF=CANSM_E_BUSOFF_NETWORK_0
        IMU_A_HAD_BACKUP: CanSMComMNetworkHandleRef=ComMChannel_Can1, CanSMTransceiverId=CanIfTrcvCfg_1
          IMU_A_HAD_BACKUP (CanSMController): CanSMControllerId=CanIfCtrlDrvCfg_0/CanIfControllerConfig_1
          CanSMDemEventParameterRefs: CanSMRbDynCreate_CANSM_E_BUS_OFF=Disabled, CANSM_E_BUS_OFF=CANSM_E_BUSOFF_NETWORK_1
        IMU_B_DRIVING_CAN: CanSMComMNetworkHandleRef=ComMChannel_Can2, CanSMTransceiverId=CanIfTrcvCfg_2
          IMU_B_DRIVING_CAN (CanSMController): CanSMControllerId=CanIfCtrlDrvCfg_0/CanIfControllerConfig_2
          CanSMDemEventParameterRefs: CanSMRbDynCreate_CANSM_E_BUS_OFF=Disabled, CANSM_E_BUS_OFF=CANSM_E_BUSOFF_NETWORK_2
    CanSMGeneral: CanSMDevErrorDetect=false, CanSMMainFunctionTimePeriod=0.005, CanSMPncSupport=false, CanSMSetBaudrateApi=false, CanSMVersionInfoApi=false
  module config CanTrcv_0: definition=CanTrcv
    CanTrcvConfigSet
      CanTrcvChannel_0 (CanTrcvChannel):
        CanTrcvChannelId = 0
        CanTrcvChannelUsed = true
        CanTrcvControlsPowerSupply = true
        CanTrcvHardwareType = TJA1145
        CanTrcvHwPnSupport = false
        CanTrcvInitState = CANTRCV_OP_MODE_STANDBY
        CanTrcvMaxBaudrate = 500
        CanTrcvWakeupByBusUsed = true
        CanTrcvAccess
          CanTrcvDioAccess
            CanTrcvDioChannelAccess_1 (CanTrcvDioChannelAccess): CanTrcvDioHardwareInterfaceType=WakeupSignalisation, CanTrcvHardwareInterfaceName=RBDIO_RXCAN2, CanTrcvRbDioSymName=RBDIO_RXCAN2
          CanTrcvSpiAccess
            CanTrcvSpiSequence_1 (CanTrcvSpiSequence): CanTrcvSpiSequenceName=CanTrcv_Seq0
        CanTrcvDemEventParameterRefs: CanTrcvRbDynCreate_CANTRCV_X_Y_E_NO_TRCV_CONTROL_Z=Disabled, CANTRCV_X_Y_E_NO_TRCV_CONTROL_Z=CANTRCV_TJA_E_NO_TRCV_CONTROL_CH0
        CanTrcvTja1145Param:
          CanTrcvTja1145CBSE = false
          CanTrcvTja1145CFE = true
          CanTrcvTja1145CMC = false
          CanTrcvTja1145Diag01ModeControl = false
          CanTrcvTja1145Diag03MainStatus = false
          CanTrcvTja1145Diag04SystemEventEnable = false
          CanTrcvTja1145Diag06Memory0 = false
          CanTrcvTja1145Diag07Memory1 = false
          CanTrcvTja1145Diag08Memory2 = false
          CanTrcvTja1145Diag09Memory3 = false
          CanTrcvTja1145Diag0ALockControl = false
          CanTrcvTja1145Diag20CANControl = false
          CanTrcvTja1145Diag22TransceiverStatus = false
          CanTrcvTja1145Diag23TransceiverEventEnable = false
          CanTrcvTja1145Diag26DataRate = false
          CanTrcvTja1145Diag27Identifier0 = false
          CanTrcvTja1145Diag28Identifier1 = false
          CanTrcvTja1145Diag29Identifier2 = false
          CanTrcvTja1145Diag2AIdentifier3 = false
          CanTrcvTja1145Diag2BMask0 = false
          CanTrcvTja1145Diag2CMask1 = false
          CanTrcvTja1145Diag2DMask2 = false
          CanTrcvTja1145Diag2EMask3 = false
          CanTrcvTja1145Diag2FFrameControl = false
          CanTrcvTja1145Diag4BWakePinStatus = false
          CanTrcvTja1145Diag4CWakePinEnable = false
          CanTrcvTja1145Diag60EventCaptureStatus = false
          CanTrcvTja1145Diag61SystemEventStatus = false
          CanTrcvTja1145Diag63TransceiverEventStatus = false
          CanTrcvTja1145Diag64WakePinEventStatus = false
          CanTrcvTja1145Diag68DataMask0 = false
          CanTrcvTja1145Diag69DataMask1 = false
          CanTrcvTja1145Diag6ADataMask2 = false
          CanTrcvTja1145Diag6BDataMask3 = false
          CanTrcvTja1145Diag6CDataMask4 = false
          CanTrcvTja1145Diag6DDataMask5 = false
          CanTrcvTja1145Diag6EDataMask6 = false
          CanTrcvTja1145Diag6FDataMask7 = false
          CanTrcvTja1145Diag7EIdentification = false
          CanTrcvTja1145OTWE = false
          CanTrcvTja1145SPIFE = false
          CanTrcvTja1145WPFE = true
          CanTrcvTja1145WPRE = true
      CanTrcvChannel_1 (CanTrcvChannel):
        CanTrcvChannelId = 1
        CanTrcvChannelUsed = true
        CanTrcvControlsPowerSupply = false
        CanTrcvHardwareType = TJA1043
        CanTrcvHwPnSupport = false
        CanTrcvInitState = CANTRCV_OP_MODE_NORMAL
        CanTrcvMaxBaudrate = 500
        CanTrcvWakeupByBusUsed = true
        CanTrcvAccess
          CanTrcvDioAccess
            4 x CanTrcvDioChannelAccess:
              CanTrcvDioChannelAccess_EN: CanTrcvDioHardwareInterfaceType=Enable, CanTrcvHardwareInterfaceName=RBDIO_EN_CAN3_UC, CanTrcvDioSymNameRef=RBDIO_EN_CAN3_UC
              CanTrcvDioChannelAccess_STBY: CanTrcvDioHardwareInterfaceType=Standby, CanTrcvHardwareInterfaceName=RBDIO_STBY_CAN3_UC, CanTrcvDioSymNameRef=RBDIO_STB_CAN3_UC
              CanTrcvDioChannelAccess_ERR: CanTrcvDioHardwareInterfaceType=ErrorPin, CanTrcvHardwareInterfaceName=RBDIO_ERR_CAN3_UC, CanTrcvDioSymNameRef=RBDIO_ERR_CAN3_UC
              CanTrcvDioChannelAccess_WAU: CanTrcvDioHardwareInterfaceType=WakeupSignalisation, CanTrcvHardwareInterfaceName=RBDIO_RXCAN3, CanTrcvDioSymNameRef=RBDIO_RXCAN3
  module config Com: implementation-config-variant=VARIANT-PRE-COMPILE
    ComConfig
      ComTimeBase: ComGwTimeBase=0.005, ComRxTimeBase=0.005, ComTxTimeBase=0.005
    ComGeneral:
      ComCancellationSupport = false
      ComCommonIPduTxPeriodFeature = false
      ComConfigurationUseDet = false
      ComEnableJitterFilter = false
      ComEnableSignalGroupArrayApi = true
      ComIPduControlViaCalibration = false
      ComMultiCoreSwitch = false
      ComProvideIpduStatusAPI = false
      ComReadRxIPduLength = false
      ComRetryFailedTransmitRequests = true
      ComRTESpecificSymbolicNames = false
      ComTxScheduledInDiffTimebase = false
      ComVersionInfoApi = false
  module config ComM: implementation-config-variant=VARIANT-PRE-COMPILE
    ComMConfigSet
      3 x ComMChannel, all with ComMBusType=COMM_BUS_TYPE_CAN, ComMFullCommRequestNotificationEnabled=false, ComMMainFunctionPeriod=0.01, ComMNoWakeUpInhibitionNvmStorage=false:
        ComMChannel_Can: ComMNoCom=false, ComMNoWakeup=false
          ComMNetworkManagement: ComMNmLightTimeout=10.0, ComMNmVariant=LIGHT, ComMPncNmRequest=false
          ComMUser_HAD_IMU_INTERNAL (ComMUserPerChannel): ComMUserChannel=ComMUser_Can
        ComMChannel_Can1: ComMNoCom=false, ComMNoWakeup=false
          ComMNetworkManagement: ComMNmLightTimeout=10.0, ComMNmVariant=LIGHT, ComMPncNmRequest=false
          ComMUser_HAD_BACKUP (ComMUserPerChannel): ComMUserChannel=ComMUser_Can1
        ComMChannel_Can2: ComMNoCom=true, ComMNoWakeup=true
          ComMNetworkManagement: ComMNmLightTimeout=10.0, ComMNmVariant=LIGHT, ComMPncNmRequest=false
          ComMUser_IMU_B_DRIVING_CAN (ComMUserPerChannel): ComMUserChannel=ComMUser_Can2
      3 x ComMUser:
        ComMUser_Can
        ComMUser_Can1
        ComMUser_Can2
    ComMGeneral:
      ComMDevErrorDetect = false
      ComMEcuGroupClassification = 0
      ComMModeLimitationEnabled = false
      ComMPncGatewayEnabled = false
      ComMPncSupport = false
      ComMResetAfterForcingNoComm = false
      ComMRteEnabled = false
      ComMSynchronousWakeUp = true
      ComMTMinFullComModeDuration = 5.0
      ComMVersionInfoApi = true
      ComMWakeupInhibitionEnabled = false
  module config PduR: implementation-config-variant=VARIANT-PRE-COMPILE
    Com (PduRBswModules):
      PduRCancelReceive = false
      PduRCancelTransmit = false
      PduRChangeParameterApi = false
      PduRCommunicationInterface = true
      PduRLowerModule = false
      PduRRetransmission = false
      PduRTransportProtocol = false
      PduRTriggertransmit = true
      PduRTxConfirmation = true
      PduRUpperModule = true
      PduRUseTag = false
      PduRBswModuleRef = Com
    PduRGeneral:
      PduRDevErrorDetect = false
      PduRDSMReInitEnabled = false
      PduRGwTpWithLimitedBuffer = false
      PduRIFGatewayOperation = true
      PduRQueueingSupport = false
      PduRVersionInfoApi = true
      PduRZeroCostOperation = false
  module config rba_ComDrv
    rba_ComDrvGeneral: ComDrvCpuCanType=MCU_RB_REN_RH850_P1MC_D3V2, ComDrvCpuType=MCU_RB_REN_RH850_P1MC_D3V2
