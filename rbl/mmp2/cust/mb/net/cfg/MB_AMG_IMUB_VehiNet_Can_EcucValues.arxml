AUTOSAR XML (schema 4-2-2)
package /RB/UBK/Project/EcucModuleConfigurationValuess
  module config Can
    CanConfigSet
      ECU_Stat_IMU_B_DRIVING_ST3_ECU_Stat_IMU_B_DRIVING_ST3_9gx75oerwjcv2p44te3ujb3i6_DRIVING_DRIVING_OUT (CanHardwareObject):
        CanFdPaddingValue = 0
        CanHandleType = FULL
        CanIdType = EXTENDED
        CanObjectType = TRANSMIT
        CanControllerRef = CanIfControllerConfig_2
        CanMainFunctionRWPeriodRef = CanMainFunctionRWPeriods_5ms
  module config CanIf
    CanIfInitCfg
      Bu_ECU_Stat_IMU_B_DRIVING_ST3_ECU_Stat_IMU_B_DRIVING_ST3_9gx75oerwjcv2p44te3ujb3i6_DRIVING_DRIVING_OUT (CanIfBufferCfg):
        CanIfBufferSize = 0
        CanIfBufferHthRef = CanIfInitHohCfg/ECU_Stat_IMU_B_DRIVING_ST3_ECU_Stat_IMU_B_DRIVING_ST3_9gx75oerwjcv2p44te3ujb3i6_DRIVING_DRIVING_OUT
      CanIfInitHohCfg
        ECU_Stat_IMU_B_DRIVING_ST3_ECU_Stat_IMU_B_DRIVING_ST3_9gx75oerwjcv2p44te3ujb3i6_DRIVING_DRIVING_OUT (CanIfHthCfg):
          CanIfHthCanCtrlIdRef = CanIfControllerConfig_2
          CanIfHthIdSymRef = CanConfigSet/ECU_Stat_IMU_B_DRIVING_ST3_ECU_Stat_IMU_B_DRIVING_ST3_9gx75oerwjcv2p44te3ujb3i6_DRIVING_DRIVING_OUT
      ECU_Stat_IMU_B_DRIVING_ST3_ECU_Stat_IMU_B_DRIVING_ST3_9gx75oerwjcv2p44te3ujb3i6_DRIVING_DRIVING_OUT (CanIfTxPduCfg):
        CanIfTxPduCanId = 373424491
        CanIfTxPduCanIdType = EXTENDED_FD_CAN
        CanIfTxPduReadNotifyStatus = false
        CanIfTxPduTruncation = false
        CanIfTxPduUserTxConfirmationName = PduR_CanIfTxConfirmation
        CanIfTxPduUserTxConfirmationUL = PDUR
        CanIfTxPduBufferRef = Bu_ECU_Stat_IMU_B_DRIVING_ST3_ECU_Stat_IMU_B_DRIVING_ST3_9gx75oerwjcv2p44te3ujb3i6_DRIVING_DRIVING_OUT
        CanIfTxPduRef = ECU_Stat_IMU_B_DRIVING_ST3_PduR2CanIf_DRIVING_CAN
  module config Com
    ComConfig
      IP_ECU_Stat_IMU_B_DRIVING_ST3_CAN_Tx (ComIPdu):
        ComIPduDirection = SEND
        ComIPduSignalProcessing = DEFERRED
        ComIPduType = NORMAL
        ComIPduGroupRef = IPG_IMU_B_IMU_B_DRIVING_CAN_Tx_PNC_All_Active_CAN
        ComIPduGroupRef = IPG_IMU_B_IMU_B_DRIVING_CAN_Tx_PNC_20_CAN
        ComIPduSignalRef = S_Awake_Diag_Actv_IMU_B_ST3_DRIVING_CAN_Tx
        ComIPduSignalRef = S_Awake_NwStart_IMU_B_ST3_DRIVING_CAN_Tx
        ComIPduSignalRef = S_ECU_Id_IMU_B_ST3_DRIVING_CAN_Tx
        ComIPduSignalRef = S_NwId_Rsrv_ST3_DRIVING_CAN_Tx
        ComIPduSignalRef = S_WakeupRsn_IMU_B_ST3_DRIVING_CAN_Tx
        ComPduIdRef = ECU_Stat_IMU_B_DRIVING_ST3_Com2PduR_DRIVING_CAN
        ComTxIPdu: ComTxIPduUnusedAreasDefault=0
          ComTxModeTrue
            ComTxMode: ComTxModeMode=PERIODIC, ComTxModeTimeOffset=0.005, ComTxModeTimePeriod=1.0
      7 x ComIPduGroup:
        IPG_IMU_B_IMU_B_DRIVING_CAN_Tx_PNC_All_Active_CAN
        IPG_IMU_B_IMU_B_DRIVING_CAN_Tx_PNC_20_CAN
        IPG_IMU_B_IMU_INTERNAL_Rx_PNC_All_Active_CAN
        IPG_IMU_B_IMU_INTERNAL_Rx_PNC_15_ComCtrl_CAN
        IPG_IMU_B_IMU_INTERNAL_Rx_PNC_20_CAN
        IPG_IMU_B_IMU_INTERNAL_Tx_PNC_All_Active_CAN
        IPG_IMU_B_IMU_INTERNAL_Tx_PNC_20_CAN
      5 x ComSignal, all with ComInitialValueOnly=false, ComSignalEndianness=LITTLE_ENDIAN, ComTransferProperty=PENDING:
        S_Awake_Diag_Actv_IMU_B_ST3_DRIVING_CAN_Tx: ComBitPosition=30, ComBitSize=1, ComSignalInitValue=0, ComSignalType=BOOLEAN, ComSystemTemplateSystemSignalRef=Awake_Diag_Actv_IMU_B_ST3
        S_Awake_NwStart_IMU_B_ST3_DRIVING_CAN_Tx: ComBitPosition=31, ComBitSize=1, ComSignalInitValue=0, ComSignalType=BOOLEAN, ComSystemTemplateSystemSignalRef=Awake_NwStart_IMU_B_ST3
        S_ECU_Id_IMU_B_ST3_DRIVING_CAN_Tx: ComBitPosition=0, ComBitSize=12, ComSignalInitValue=363, ComSignalType=UINT16, ComSystemTemplateSystemSignalRef=ECU_Id_IMU_B_ST3
        S_NwId_Rsrv_ST3_DRIVING_CAN_Tx: ComBitPosition=12, ComBitSize=8, ComSignalInitValue=46, ComSignalType=UINT8, ComSystemTemplateSystemSignalRef=NwId_IMU_B_DRIVING_CAN_ST3
        S_WakeupRsn_IMU_B_ST3_DRIVING_CAN_Tx: ComBitPosition=20, ComBitSize=10, ComSignalInitValue=1023, ComSignalType=UINT16, ComSystemTemplateSystemSignalRef=WakeupRsn_IMU_B_ST3
  module config EcuC
    EcucConfigSet
      EcucPduCollection: PduIdTypeEnum=uint16, PduLengthTypeEnum=uint16
        ECU_Stat_IMU_B_DRIVING_ST3_Com2PduR_DRIVING_CAN (Pdu): PduLength=8, SysTPduToPduTriggeringRef=ECU_Stat_IMU_B_IMU_B_DRIVING_CAN_ST3_88u6ujntcym4u4ntb27fc40ar
        ECU_Stat_IMU_B_DRIVING_ST3_PduR2CanIf_DRIVING_CAN (Pdu): PduLength=8, SysTPduToPduTriggeringRef=ECU_Stat_IMU_B_IMU_B_DRIVING_CAN_ST3_88u6ujntcym4u4ntb27fc40ar
  module config PduR
    PduRRoutingTables
      PduRRoutingTable
        ECU_Stat_IMU_B_DRIVING_ST3_Com2CanIf_DRIVING_CAN (PduRRoutingPath)
          ECU_Stat_IMU_B_IMU_B_DRIVING_CAN_ST3_PduR2CanIf_IMU_B_DRIVING_CAN_CAN (PduRDestPdu): PduRDestPduRef=ECU_Stat_IMU_B_DRIVING_ST3_PduR2CanIf_DRIVING_CAN
          ECU_Stat_IMU_B_IMU_B_DRIVING_CAN_ST3_Com2PduR_IMU_B_DRIVING_CAN_CAN (PduRSrcPdu): PduRSrcPduRef=ECU_Stat_IMU_B_DRIVING_ST3_Com2PduR_DRIVING_CAN
