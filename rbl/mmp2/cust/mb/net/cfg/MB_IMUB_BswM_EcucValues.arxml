AUTOSAR XML (schema 4-1-1)
package /RB/UBK/Project/EcucModuleConfigurationValuess
  module config BswM
    BswMConfig_0 (BswMConfig)
      BswMArbitration
        12 x BswMLogicalExpression:
          BswMLogicalExpressionEMM_Transition2RunState: BswMArgumentRef=BswMModeConditionEMM_Transition2RunState
          BswMLogicalExpressionEMM_Transition2ApplPostRunState: BswMArgumentRef=BswMModeConditionEMM_Transition2ApplPostRunState
          BswMLogicalExpression_DcmService28_EnableRxEnableTx: BswMLogicalOperator=BSWM_OR, BswMArgumentRef=BswMModeCondition_DCM_ENABLE_RX_TX_NORM
          BswMLogicalExpression_DcmService28_EnableRxDisableTx: BswMLogicalOperator=BSWM_OR, BswMArgumentRef=BswMModeCondition_DCM_ENABLE_RX_DISABLE_TX_NORM
          BswMLogicalExpression_CANSM1_FULLCOM: BswMArgumentRef=BswMModeCondition_CANSM1_FULLCOM
          BswMLogicalExpression_CANSM1_NOCOM: BswMArgumentRef=BswMModeCondition_CANSM1_NOCOM
          BswMLogicalExpression_CANSM2_FULLCOM: BswMArgumentRef=BswMModeCondition_CANSM2_FULLCOM
          BswMLogicalExpression_CANSM0_FULLCOM: BswMArgumentRef=BswMModeCondition_CANSM0_FULLCOM
          BswMLogicalExpression_CANSM2_NOCOM: BswMArgumentRef=BswMModeCondition_CANSM2_NOCOM
          BswMLogicalExpression_CANSM0_NOCOM: BswMArgumentRef=BswMModeCondition_CANSM0_NOCOM
          BswMLogicalExpression_WakeupValidation_CAN1: BswMArgumentRef=BswMModeCondition_WakeupValidation_CAN1
          BswMLogicalExpression_WakeupValidation_CAN2: BswMArgumentRef=BswMModeCondition_WakeupValidation_CAN2
        12 x BswMModeCondition, all with BswMConditionType=BSWM_EQUALS:
          BswMModeCondition_WakeupValidation_CAN1: BswMConditionMode=BswMModeRequestPort_WakeupValidated_CAN1
            BswMConditionValue
              BswMBswMode: BswMBswRequestedMode=ECUM_WKSTATUS_VALIDATED
          BswMModeConditionEMM_Transition2RunState: BswMConditionMode=BswMModeRequestPort_EMMExtended
            BswMConditionValue
              BswMBswMode: BswMBswRequestedMode=EMM_TransitionToRunState
          BswMModeConditionEMM_Transition2ApplPostRunState: BswMConditionMode=BswMModeRequestPort_EMMExtended
            BswMConditionValue
              BswMBswMode: BswMBswRequestedMode=EMM_TransitionToApplPostRunState
          BswMModeCondition_DCM_ENABLE_RX_TX_NORM: BswMConditionMode=BswMModeRequestPort_Dcm
            BswMConditionValue
              BswMBswMode: BswMBswRequestedMode=DCM_ENABLE_RX_TX_NORM
          BswMModeCondition_DCM_ENABLE_RX_DISABLE_TX_NORM: BswMConditionMode=BswMModeRequestPort_Dcm
            BswMConditionValue
              BswMBswMode: BswMBswRequestedMode=DCM_ENABLE_RX_DISABLE_TX_NORM
          BswMModeCondition_CANSM1_FULLCOM: BswMConditionMode=BswMModeRequestPort_CanSM1
            BswMConditionValue
              BswMBswMode: BswMBswRequestedMode=CANSM_BSM_S_FULLCOM
          BswMModeCondition_CANSM1_NOCOM: BswMConditionMode=BswMModeRequestPort_CanSM1
            BswMConditionValue
              BswMBswMode: BswMBswRequestedMode=CANSM_BSM_S_NOCOM
          BswMModeCondition_CANSM2_FULLCOM: BswMConditionMode=BswMModeRequestPort_CanSM2
            BswMConditionValue
              BswMBswMode: BswMBswRequestedMode=CANSM_BSM_S_FULLCOM
          BswMModeCondition_CANSM0_FULLCOM: BswMConditionMode=BswMModeRequestPort_CanSM
            BswMConditionValue
              BswMBswMode: BswMBswRequestedMode=CANSM_BSM_S_FULLCOM
          BswMModeCondition_CANSM2_NOCOM: BswMConditionMode=BswMModeRequestPort_CanSM2
            BswMConditionValue
              BswMBswMode: BswMBswRequestedMode=CANSM_BSM_S_NOCOM
          BswMModeCondition_CANSM0_NOCOM: BswMConditionMode=BswMModeRequestPort_CanSM
            BswMConditionValue
              BswMBswMode: BswMBswRequestedMode=CANSM_BSM_S_NOCOM
          BswMModeCondition_WakeupValidation_CAN2: BswMConditionMode=BswMModeRequestPort_WakeupValidated_CAN2
            BswMConditionValue
              BswMBswMode: BswMBswRequestedMode=ECUM_WKSTATUS_VALIDATED
        7 x BswMModeRequestPort, all with BswMRequestProcessing=BSWM_IMMEDIATE:
          BswMModeRequestPort_WakeupValidated_CAN1
            BswMModeRequestSource
              BswMEcuMWakeupSource: BswMEcuMWakeupSrcRef=ECUM_WKSOURCE_CAN1
          BswMModeRequestPort_EMMExtended
            BswMModeRequestSource
              BswMGenericRequest: BswMModeRequesterId=0, BswMRbRequestType=BSW, BswMRequestedModeMax=4
          BswMModeRequestPort_Dcm
            BswMModeRequestSource
              BswMDcmComModeRequest: BswMDcmComMChannelRef=ComMChannel_Can
          BswMModeRequestPort_CanSM1
            BswMModeRequestSource
              BswMCanSMIndication: BswMCanSMChannelRef=ComMChannel_Can1
          BswMModeRequestPort_CanSM
            BswMModeRequestSource
              BswMCanSMIndication: BswMCanSMChannelRef=ComMChannel_Can
          BswMModeRequestPort_CanSM2
            BswMModeRequestSource
              BswMCanSMIndication: BswMCanSMChannelRef=ComMChannel_Can2
          BswMModeRequestPort_WakeupValidated_CAN2
            BswMModeRequestSource
              BswMEcuMWakeupSource: BswMEcuMWakeupSrcRef=ECUM_WKSOURCE_CAN2
        14 x BswMRule, all with BswMRuleInitState=BSWM_FALSE:
          BswMRule_WakeupValidation_CAN1: BswMRuleTrueActionList=BswMModeControl/BswMActionList_EMM_Reqst_NetOn_CAN1, BswMRuleExpressionRef=BswMLogicalExpression_WakeupValidation_CAN1
          BswMRule_WakeupClearing_CAN1: BswMRuleExpressionRef=BswMLogicalExpression_CANSM1_NOCOM, BswMRuleTrueActionList=BswMModeControl/BswMActionList_ClearWakeupEvent_CAN1
          BswMRuleEMM_Transition2RunState: BswMRuleExpressionRef=BswMLogicalExpressionEMM_Transition2RunState, BswMRuleTrueActionList=BswMActionList_EMM_TransitionToRunState
          BswMRuleEMM_Transition2ApplPostRunState: BswMRuleExpressionRef=BswMLogicalExpressionEMM_Transition2ApplPostRunState, BswMRuleTrueActionList=BswMActionList_EMM_TransitionToApplPostRunState
          BswMRule_DcmService28_EnableRxEnableTx: BswMRuleExpressionRef=BswMLogicalExpression_DcmService28_EnableRxEnableTx, BswMRuleTrueActionList=BswMActionList_DcmService28_EnableRxEnableTx
          BswMRule_DcmService28_EnableRxDisableTx: BswMRuleExpressionRef=BswMLogicalExpression_DcmService28_EnableRxDisableTx, BswMRuleTrueActionList=BswMActionList_DcmService28_EnableRxDisableTx
          BswMRule_CANSM1_FULLCOM: BswMRuleExpressionRef=BswMLogicalExpression_CANSM1_FULLCOM, BswMRuleTrueActionList=BswMActionList_CANSM1_FULLCOM
          BswMRule_CANSM1_NOCOM: BswMRuleExpressionRef=BswMLogicalExpression_CANSM1_NOCOM, BswMRuleTrueActionList=BswMModeControl/BswMActionList_CANSM1_NOCOM
          BswMRule_CANSM2_FULLCOM: BswMRuleExpressionRef=BswMLogicalExpression_CANSM2_FULLCOM, BswMRuleTrueActionList=BswMActionList_CANSM2_FULLCOM
          BswMRule_CANSM0_FULLCOM: BswMRuleExpressionRef=BswMLogicalExpression_CANSM0_FULLCOM, BswMRuleTrueActionList=BswMActionList_CANSM0_FULLCOM
          BswMRule_CANSM2_NOCOM: BswMRuleExpressionRef=BswMLogicalExpression_CANSM2_NOCOM, BswMRuleTrueActionList=BswMModeControl/BswMActionList_CANSM2_NOCOM
          BswMRule_CANSM0_NOCOM: BswMRuleExpressionRef=BswMLogicalExpression_CANSM0_NOCOM, BswMRuleTrueActionList=BswMModeControl/BswMActionList_CANSM0_NOCOM
          BswMRule_WakeupClearing_CAN2: BswMRuleExpressionRef=BswMLogicalExpression_CANSM2_NOCOM, BswMRuleTrueActionList=BswMModeControl/BswMActionList_ClearWakeupEvent_CAN2
          BswMRule_WakeupValidation_CAN2: BswMRuleExpressionRef=BswMLogicalExpression_WakeupValidation_CAN2, BswMRuleTrueActionList=BswMModeControl/BswMActionList_EMM_Reqst_NetOn_CAN2
      BswMModeControl
        26 x BswMAction:
          BswMAction_EMM_Reqst_NetOn_CAN1
            BswMAvailableActions
              BswMUserCallout: BswMUserCalloutFunction=RBEMM_ExtRequestNetOn_ECUM_WKSOURCE_CAN_Callout();
          BswMAction_EnableIpduGroupTx_CAN0
            BswMAvailableActions
              BswMPduGroupSwitch: BswMPduGroupSwitchReinit=false, BswMEnabledPduGroupRef=IPG_IMU_B_IMU_INTERNAL_Tx_PNC_All_Active_CAN
          BswMAction_DisableIpduGroupTx_CAN0
            BswMAvailableActions
              BswMPduGroupSwitch: BswMPduGroupSwitchReinit=false, BswMDisabledPduGroupRef=IPG_IMU_B_IMU_INTERNAL_Tx_PNC_All_Active_CAN
          BswMAction_EnableIpduGroupRx_CAN0
            BswMAvailableActions
              BswMPduGroupSwitch: BswMPduGroupSwitchReinit=false, BswMEnabledPduGroupRef=IPG_IMU_B_IMU_INTERNAL_Rx_PNC_All_Active_CAN
          BswMAction_DisableIpduGroupRx_CAN0
            BswMAvailableActions
              BswMPduGroupSwitch: BswMPduGroupSwitchReinit=false, BswMDisabledPduGroupRef=IPG_IMU_B_IMU_INTERNAL_Rx_PNC_All_Active_CAN
          BswMAction_EnableIpduGroupTx_CAN1
            BswMAvailableActions
              BswMPduGroupSwitch: BswMPduGroupSwitchReinit=false, BswMEnabledPduGroupRef=IPG_IMU_B_HAD_IMU_Tx_PNC_All_Active_CAN
          BswMAction_DisableIpduGroupTx_CAN1
            BswMAvailableActions
              BswMPduGroupSwitch: BswMPduGroupSwitchReinit=false, BswMDisabledPduGroupRef=IPG_IMU_B_HAD_IMU_Tx_PNC_All_Active_CAN
          BswMAction_EnableIpduGroupTx_CAN2
            BswMAvailableActions
              BswMPduGroupSwitch: BswMPduGroupSwitchReinit=false, BswMEnabledPduGroupRef=IPG_IMU_B_IMU_B_DRIVING_CAN_Tx_PNC_All_Active_CAN
          BswMAction_DisableIpduGroupTx_CAN2
            BswMAvailableActions
              BswMPduGroupSwitch: BswMPduGroupSwitchReinit=false, BswMDisabledPduGroupRef=IPG_IMU_B_IMU_B_DRIVING_CAN_Tx_PNC_All_Active_CAN
          BswMAction_ClearWakeupEvent_CAN1
            BswMAvailableActions
              BswMUserCallout: BswMUserCalloutFunction=EcuM_ClearWakeupEvent(EcuMConf_EcuMWakeupSource_ECUM_WKSOURCE_CAN1)
          BswMAction_Reqst_FullCom_CAN0
            BswMAvailableActions
              BswMComMModeSwitch: BswMComMRequestedMode=BSWM_COMM_FULL_COMMUNICATION, BswMComMUserRef=ComMUser_Can
          BswMAction_Reqst_NoCom_CAN0
            BswMAvailableActions
              BswMComMModeSwitch: BswMComMRequestedMode=BSWM_COMM_NO_COMMUNICATION, BswMComMUserRef=ComMUser_Can
          BswMAction_ComMAllowTrue_CAN0
            BswMAvailableActions
              BswMComMAllowCom: BswMComAllowed=true, BswMComMAllowChannelRef=ComMChannel_Can
          BswMAction_ComMAllowFalse_CAN0
            BswMAvailableActions
              BswMComMAllowCom: BswMComAllowed=false, BswMComMAllowChannelRef=ComMChannel_Can
          BswMAction_Reqst_FullCom_CAN2
            BswMAvailableActions
              BswMComMModeSwitch: BswMComMRequestedMode=BSWM_COMM_FULL_COMMUNICATION, BswMComMUserRef=ComMUser_Can2
          BswMAction_Reqst_NoCom_CAN2
            BswMAvailableActions
              BswMComMModeSwitch: BswMComMRequestedMode=BSWM_COMM_NO_COMMUNICATION, BswMComMUserRef=ComMUser_Can2
          BswMAction_ComMAllowTrue_CAN1
            BswMAvailableActions
              BswMComMAllowCom: BswMComAllowed=true, BswMComMAllowChannelRef=ComMChannel_Can1
          BswMAction_ComMAllowTrue_CAN2
            BswMAvailableActions
              BswMComMAllowCom: BswMComAllowed=true, BswMComMAllowChannelRef=ComMChannel_Can2
          BswMAction_ComMAllowFalse_CAN2
            BswMAvailableActions
              BswMComMAllowCom: BswMComAllowed=false, BswMComMAllowChannelRef=ComMChannel_Can2
          BswMAction_ClearWakeupEvent_CAN2
            BswMAvailableActions
              BswMUserCallout: BswMUserCalloutFunction=EcuM_ClearWakeupEvent(EcuMConf_EcuMWakeupSource_ECUM_WKSOURCE_CAN2)
          BswMAction_EMM_Reqst_NetOn_CAN2
            BswMAvailableActions
              BswMUserCallout: BswMUserCalloutFunction=RBEMM_ExtRequestNetOn_ECUM_WKSOURCE_CAN_Callout();
          BswMAction_EnableIpduGroupNm_RxTx_All_CAN
            BswMAvailableActions
              BswMPduGroupSwitch: BswMPduGroupSwitchReinit=false, BswMEnabledPduGroupRef=IPG_IMU_B_NM_RX_All_CAN, BswMEnabledPduGroupRef=IPG_IMU_B_NM_TX_All_CAN
          BswMAction_EnableIpduGroup_Non_PNC_TX
            BswMAvailableActions
              BswMPduGroupSwitch: BswMPduGroupSwitchReinit=false, BswMEnabledPduGroupRef=IPG_TxMess_IMU_B_DRIVING_CAN, BswMEnabledPduGroupRef=IPG_TxMess_IMU_B_IMU_INTERNAL_CAN
          BswMAction_ComMAllowFalse_CAN1
            BswMAvailableActions
              BswMComMAllowCom: BswMComAllowed=false, BswMComMAllowChannelRef=ComMChannel_Can1
          BswMAction_Reqst_NoCom_CAN1
            BswMAvailableActions
              BswMComMModeSwitch: BswMComMRequestedMode=BSWM_COMM_NO_COMMUNICATION, BswMComMUserRef=ComMUser_Can1
          BswMAction_Reqst_FullCom_CAN1
            BswMAvailableActions
              BswMComMModeSwitch: BswMComMRequestedMode=BSWM_COMM_FULL_COMMUNICATION, BswMComMUserRef=ComMUser_Can1
        14 x BswMActionList:
          BswMActionList_EMM_Reqst_NetOn_CAN1: BswMActionListExecution=BSWM_TRIGGER
            BswMActionList_EMM_Reqst_NetOn_CAN1 (BswMActionListItem): BswMAbortOnFail=false, BswMActionListItemIndex=0, BswMActionListItemRef=BswMAction_EMM_Reqst_NetOn_CAN1
          BswMActionList_EMM_TransitionToRunState: BswMActionListExecution=BSWM_TRIGGER
            3 x BswMActionListItem, all with BswMAbortOnFail=false:
              BswMActionList_ComMAllowTrue_CAN0: BswMActionListItemIndex=0, BswMActionListItemRef=BswMAction_ComMAllowTrue_CAN0
              BswMActionList_ComMAllowTrue_CAN2: BswMActionListItemIndex=1, BswMActionListItemRef=BswMAction_ComMAllowTrue_CAN2
              BswMActionList_ComMAllowTrue_CAN1: BswMActionListItemIndex=2, BswMActionListItemRef=BswMAction_ComMAllowTrue_CAN1
          BswMActionList_EMM_TransitionToApplPostRunState: BswMActionListExecution=BSWM_TRIGGER
            6 x BswMActionListItem, all with BswMAbortOnFail=false:
              BswMActionList_Reqst_NoCom_CAN0: BswMActionListItemIndex=3, BswMActionListItemRef=BswMAction_Reqst_NoCom_CAN0
              BswMActionList_Reqst_NoCom_CAN2: BswMActionListItemIndex=5, BswMActionListItemRef=BswMAction_Reqst_NoCom_CAN2
              BswMActionList_ComMAllowFalse_CAN2: BswMActionListItemIndex=2, BswMActionListItemRef=BswMAction_ComMAllowFalse_CAN2
              BswMActionList_ComMAllowFalse_CAN0: BswMActionListItemIndex=0, BswMActionListItemRef=BswMAction_ComMAllowFalse_CAN0
              BswMActionList_ComMAllowFalse_CAN1: BswMActionListItemIndex=1, BswMActionListItemRef=BswMAction_ComMAllowFalse_CAN1
              BswMActionList_Reqst_NoCom_CAN1: BswMActionListItemIndex=4, BswMActionListItemRef=BswMAction_Reqst_NoCom_CAN1
          BswMActionList_ClearWakeupEvent_CAN1: BswMActionListExecution=BSWM_TRIGGER
            BswMActionList_ClearWakeupEvent_CAN1 (BswMActionListItem): BswMAbortOnFail=false, BswMActionListItemIndex=0, BswMActionListItemRef=BswMAction_ClearWakeupEvent_CAN1
          BswMActionList_DcmService28_EnableRxEnableTx: BswMActionListExecution=BSWM_CONDITION
            5 x BswMActionListItem, all with BswMAbortOnFail=false:
              BswMActionList_EnableRx_CAN0: BswMActionListItemIndex=0, BswMActionListItemRef=BswMAction_EnableIpduGroupRx_CAN0
              BswMActionList_EnableRx_CAN1: BswMActionListItemIndex=2, BswMActionListItemRef=BswMAction_EnableIpduGroupTx_CAN2
              BswMActionList_EnableTx_CAN0: BswMActionListItemIndex=1, BswMActionListItemRef=BswMAction_EnableIpduGroupTx_CAN0
              BswMActionList_EnableTx_CAN1: BswMActionListItemIndex=3, BswMActionListItemRef=BswMAction_EnableIpduGroupTx_CAN1
              BswMActionList_EnableTx_CAN2: BswMActionListItemIndex=4, BswMActionListItemRef=BswMAction_EnableIpduGroupTx_CAN2
          BswMActionList_DcmService28_EnableRxDisableTx: BswMActionListExecution=BSWM_CONDITION
            5 x BswMActionListItem, all with BswMAbortOnFail=false:
              BswMActionList_EnableRx_CAN0: BswMActionListItemIndex=0, BswMActionListItemRef=BswMAction_EnableIpduGroupRx_CAN0
              BswMActionList_EnableRx_CAN1: BswMActionListItemIndex=2, BswMActionListItemRef=BswMAction_EnableIpduGroupTx_CAN2
              BswMActionList_DisableTx_CAN0: BswMActionListItemIndex=1, BswMActionListItemRef=BswMAction_DisableIpduGroupTx_CAN0
              BswMActionList_DisableTx_CAN1: BswMActionListItemIndex=3, BswMActionListItemRef=BswMAction_DisableIpduGroupTx_CAN1
              BswMActionList_DisableTx_CAN2: BswMActionListItemIndex=4, BswMActionListItemRef=BswMAction_DisableIpduGroupTx_CAN2
          BswMActionList_CANSM1_NOCOM: BswMActionListExecution=BSWM_TRIGGER
            BswMActionList_CANSM1_NOCOM (BswMActionListItem): BswMAbortOnFail=false, BswMActionListItemIndex=0, BswMActionListItemRef=BswMAction_Reqst_NoCom_CAN1
          BswMActionList_CANSM1_FULLCOM: BswMActionListExecution=BSWM_TRIGGER
            BswMActionList_EnableIpduGroupNm_RxTx_All_CAN (BswMActionListItem): BswMAbortOnFail=false, BswMActionListItemIndex=0, BswMActionListItemRef=BswMAction_EnableIpduGroupNm_RxTx_All_CAN
            BswMActionList_EnableIpduGroup_Non_PNC_Tx (BswMActionListItem): BswMAbortOnFail=false, BswMActionListItemIndex=1, BswMActionListItemRef=BswMAction_EnableIpduGroup_Non_PNC_TX
          BswMActionList_CANSM0_NOCOM: BswMActionListExecution=BSWM_TRIGGER
            BswMActionList_CANSM0_NOCOM (BswMActionListItem): BswMAbortOnFail=false, BswMActionListItemIndex=0, BswMActionListItemRef=BswMAction_Reqst_NoCom_CAN0
          BswMActionList_CANSM0_FULLCOM: BswMActionListExecution=BSWM_TRIGGER
            BswMActionList_EnableIpduGroupNm_RxTx_All_CAN (BswMActionListItem): BswMAbortOnFail=false, BswMActionListItemIndex=0, BswMActionListItemRef=BswMAction_EnableIpduGroupNm_RxTx_All_CAN
            BswMActionList_EnableIpduGroup_Non_PNC_Tx (BswMActionListItem): BswMAbortOnFail=false, BswMActionListItemIndex=1, BswMActionListItemRef=BswMAction_EnableIpduGroup_Non_PNC_TX
          BswMActionList_CANSM2_NOCOM: BswMActionListExecution=BSWM_TRIGGER
            BswMActionList_CANSM2_NOCOM (BswMActionListItem): BswMAbortOnFail=false, BswMActionListItemIndex=0, BswMActionListItemRef=BswMAction_Reqst_NoCom_CAN2
          BswMActionList_CANSM2_FULLCOM: BswMActionListExecution=BSWM_TRIGGER
            BswMActionList_EnableIpduGroupNm_RxTx_All_CAN (BswMActionListItem): BswMAbortOnFail=false, BswMActionListItemIndex=0, BswMActionListItemRef=BswMAction_EnableIpduGroupNm_RxTx_All_CAN
            BswMActionList_EnableIpduGroup_Non_PNC_Tx (BswMActionListItem): BswMAbortOnFail=false, BswMActionListItemIndex=1, BswMActionListItemRef=BswMAction_EnableIpduGroup_Non_PNC_TX
          BswMActionList_ClearWakeupEvent_CAN2: BswMActionListExecution=BSWM_TRIGGER
            BswMActionList_ClearWakeupEvent_CAN2 (BswMActionListItem): BswMActionListItemIndex=0, BswMAbortOnFail=false, BswMActionListItemRef=BswMAction_ClearWakeupEvent_CAN2
          BswMActionList_EMM_Reqst_NetOn_CAN2: BswMActionListExecution=BSWM_TRIGGER
            BswMActionList_EMM_Reqst_NetOn_CAN2 (BswMActionListItem): BswMActionListItemIndex=0, BswMAbortOnFail=false, BswMActionListItemRef=BswMAction_EMM_Reqst_NetOn_CAN2
    BswMGeneral:
      BswMCanSMEnabled = true
      BswMComMEnabled = true
      BswMDcmEnabled = true
      BswMDevErrorDetect = false
      BswMEcuMEnabled = true
      BswMEthIfEnabled = false
      BswMEthSMEnabled = false
      BswMFrSMEnabled = false
      BswMGenericRequestEnabled = true
      BswMJ1939DcmEnabled = false
      BswMJ1939NmEnabled = false
      BswMLinSMEnabled = false
      BswMLinTPEnabled = false
      BswMMainFunctionPeriod = 0.01
      BswMNmEnabled = false
      BswMNvMEnabled = true
      BswMRbComEnabled = true
      BswMRbDebugEnable = false
      BswMRbMaxNumOfRules = 50
      BswMSchMEnabled = false
      BswMSdEnabled = false
      BswMVersionInfoApi = true
      BswMUserIncludeFiles: BswMUserIncludeFile=RBEMM_Project.h, BswMUserIncludeFile=RBEMM_Types.h, BswMUserIncludeFile=CanSM.h, BswMUserIncludeFile=RBEMM_Extended_Callouts.h
