AUTOSAR XML (schema 4-0-2)
package /RB/UBK/Project/EcucModuleConfigurationValuess
  module config Os
    OSDEFAULTAPPMODE (OsAppMode)
    OsOS:
      OsNumberOfCores = 1
      OsScalabilityClass = SC2
      OsStackMonitoring = false
      OsStatus = EXTENDED
      OsUseGetServiceId = true
      OsUseParameterAccess = true
      OsUseResScheduler = true
      OsHooks: OsErrorHook=true, OsPostTaskHook=false, OsPreTaskHook=false, OsProtectionHook=false, OsShutdownHook=true, OsStartupHook=true
