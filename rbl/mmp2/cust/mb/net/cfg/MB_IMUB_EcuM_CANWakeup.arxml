AUTOSAR XML (schema 4-1-1)
package /RB/UBK/Project/EcucModuleConfigurationValuess
  module config EcuM
    EcuMConfiguration
      EcuMCommonConfiguration: EcuMDefaultAppMode=OSDEFAULTAPPMODE
        ECUM_WKSOURCE_CAN1 (EcuMWakeupSource): EcuMValidationTimeout=0.0, EcuMWakeupSourcePolling=false, EcuMComMChannelRef=ComMChannel_Can1
        ECUM_WKSOURCE_CAN2 (EcuMWakeupSource): EcuMValidationTimeout=0.0, EcuMWakeupSourcePolling=false, EcuMComMChannelRef=ComMChannel_Can2
