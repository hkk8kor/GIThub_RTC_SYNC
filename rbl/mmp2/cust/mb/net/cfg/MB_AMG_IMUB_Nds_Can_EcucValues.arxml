AUTOSAR XML (schema 4-2-2)
package /RB/UBK/Project/EcucModuleConfigurationValuess
  module config rba_Nds: implementation-config-variant=VARIANT-PRE-COMPILE
    rba_Nds_Communication
      rba_Nds_Frame_IMU_D_Driving_Container1_ST3 (rba_Nds_Frame): rba_Nds_Name=IMU_D_Driving_Container1_ST3_IMU_D_Stat_ST3, rba_Nds_Length=64
        rba_Nds_PduInst_IMU_D_Driving_Container1_ST3_ContainerIPdu (rba_Nds_PduInstance): rba_Nds_BitPosition=0, rba_Nds_ByteOrder=INTEL, rba_Nds_PduRef=rba_Nds_Pdu_IMU_D_Driving_Container1_ST3_IMU_D_Stat_ST3
      rba_Nds_Frame_IMU_D_DRIVING_Container_Det05_ST3 (rba_Nds_Frame): rba_Nds_Description=IMU_D_DRIVING_Container_Det05_ST3, rba_Nds_Length=64, rba_Nds_Name=IMU_D_DRIVING_Container_Det05_ST3
        rba_Nds_PduInst_IMU_D_DRIVING_Container_Det05_ST3_ContainerIPdu (rba_Nds_PduInstance): rba_Nds_BitPosition=0, rba_Nds_ByteOrder=INTEL, rba_Nds_PduRef=rba_Nds_Pdu_IMU_D_DRIVING_Container_Det05_ST3_ContainerIPdu
      rba_Nds_Networks
        3 x rba_Nds_CanNetwork:
          rba_Nds_CanNetwork_INTERNAL_CAN: rba_Nds_Name=CanIfControllerConfig_0
          rba_Nds_CanNetwork_IMU_B_HAD_BACKUP: rba_Nds_Name=CanIfControllerConfig_1
          rba_Nds_CanNetwork_DRIVING: rba_Nds_Name=CanIfControllerConfig_2
            rba_Nds_CanFrameTriggering_IMU_D_Driving_Container1_ST3_cezoqmepfi10b8h1n4t3o34x6 (rba_Nds_CanFrameTriggering): rba_Nds_CanIdentifierType=CAN_STANDARD, rba_Nds_IdentifierValue=180, rba_Nds_FrameRef=rba_Nds_Frame_IMU_D_Driving_Container1_ST3
            rba_Nds_CanFrameTriggering_IMU_D_DRIVING_Container_Det05_ST3_ed1rm8scgsl20exhxfn2srlnq (rba_Nds_CanFrameTriggering): rba_Nds_CanIdentifierType=CAN_STANDARD, rba_Nds_IdentifierValue=642, rba_Nds_FrameRef=rba_Nds_Frame_IMU_D_DRIVING_Container_Det05_ST3
            5 x rba_Nds_CanPduTriggering:
              rba_Nds_CanPduTriggering_IMU_D_Driving_Container1_ST3_IMU_D_Driving_Container1_ST3_IMU_D_Stat_ST3_7r5emjrjqifhmoluyjdx39vet: rba_Nds_PduRef=rba_Nds_Pdu_IMU_D_Driving_Container1_ST3_IMU_D_Stat_ST3
              rba_Nds_CanPduTriggering_IMU_D_DRIVING_Container_Det05_ST3_IMU_D_DRIVING_Container_Det05_ST3_PT4_Det05_IMU_D_Ctrl_ST3_23jvaq3ummpy3hlk0oahpkf34: rba_Nds_PduRef=rba_Nds_Pdu_IMU_D_DRIVING_Container_Det05_ST3_PT4_Det05_IMU_D_Ctrl_ST3
              rba_Nds_CanPduTriggering_IMU_D_DRIVING_Container_Det05_ST3_IMU_D_DRIVING_Container_Det05_ST3_PT4_Det05_IMU_D_Ctrl_ST3_1joxqmpavt6pujhrm2rp8u71k: rba_Nds_PduRef=rba_Nds_Pdu_IMU_D_DRIVING_Container_Det05_ST3_IMU_D_DRIVING_Container_Det05_ST3_PT4_Det05_IMU_D_Ctrl_ST3_secured
              rba_Nds_CanPduTriggering_IMU_D_DRIVING_Container_Det05_ST3_dy2d9b7s08zan5fawxjxn67da: rba_Nds_PduRef=rba_Nds_Pdu_IMU_D_DRIVING_Container_Det05_ST3_ContainerIPdu
              rba_Nds_CanPduTriggering_IMU_D_Driving_Container1_ST3_8jj3uqqyg57q3fi1o8xl6in62: rba_Nds_PduRef=rba_Nds_Pdu_IMU_D_Driving_Container1_ST3_ContainerIPdu
      5 x rba_Nds_Pdu:
        rba_Nds_Pdu_IMU_D_Driving_Container1_ST3_IMU_D_Stat_ST3
          rba_Nds_SignalPdu:
            rba_Nds_Description = Status Inertialsensorik
            rba_Nds_Length = 20
            rba_Nds_Name = IMU_D_Driving_Container1_ST3_IMU_D_Stat_ST3
            rba_Nds_UnusedAreasDefault = 255
            rba_Nds_PduTiming
              rba_Nds_TransmissionModeDeclaration
                rba_Nds_TransmissionModeTrueTiming: rba_Nds_CycleTime=100.0, rba_Nds_StartDelay=50.0
            rba_Nds_SignalGroupInstance_IMU_D_Stat_ST3_axy9lqt6gl1tcwttoyfd136l6 (rba_Nds_SignalGroupInstance): rba_Nds_SignalGroupRef=rba_Nds_SignalGroup_IMU_D_Stat_ST3_axy9lqt6gl1tcwttoyfd136l6
            rba_Nds_SignalInstance_IMU_D_Id_ST3 (rba_Nds_SignalInstance): rba_Nds_BitPosition=0, rba_Nds_ByteOrder=INTEL, rba_Nds_SignalRef=rba_Nds_Signal_IMU_D_Id_ST3
            rba_Nds_SignalInstance_IMU_D_VehYawRateSens_Temp_ST3 (rba_Nds_SignalInstance): rba_Nds_BitPosition=32, rba_Nds_ByteOrder=INTEL, rba_Nds_SignalRef=rba_Nds_Signal_IMU_D_VehYawRateSens_Temp_ST3
            rba_Nds_ContainedPduProperties: rba_Nds_HeaderIdShortHeader=3749633
        rba_Nds_Pdu_IMU_D_DRIVING_Container_Det05_ST3_PT4_Det05_IMU_D_Ctrl_ST3
          rba_Nds_SignalPdu:
            rba_Nds_Description = Deterministisches Timing Konzept Powertrain (5ms) - IMUD
            rba_Nds_Length = 34
            rba_Nds_Name = IMU_D_DRIVING_Container_Det05_ST3_PT4_Det05_IMU_D_Ctrl_ST3
            rba_Nds_UnusedAreasDefault = 255
            rba_Nds_PduTiming
              rba_Nds_TransmissionModeDeclaration
                rba_Nds_TransmissionModeTrueTiming: rba_Nds_CycleTime=5.0, rba_Nds_StartDelay=0.0
            rba_Nds_SignalGroupInstance_PT4_Det05_IMU_D_Ctrl_Pr5_ST3_9ibx3pdl90d59keo4mo66if6x (rba_Nds_SignalGroupInstance): rba_Nds_SignalGroupRef=rba_Nds_SignalGroup_PT4_Det05_IMU_D_Ctrl_Pr5_ST3_9ibx3pdl90d59keo4mo66if6x
            23 x rba_Nds_SignalInstance, all with rba_Nds_ByteOrder=INTEL:
              rba_Nds_SignalInstance_CRC_PT4_Det05_IMU_D_Ctrl_Pr5_ST3: rba_Nds_BitPosition=0, rba_Nds_SignalRef=rba_Nds_Signal_CRC_PT4_Det05_IMU_D_Ctrl_Pr5_ST3
              rba_Nds_SignalInstance_IMU_D_VehAccel_X_ST3: rba_Nds_BitPosition=59, rba_Nds_SignalRef=rba_Nds_Signal_IMU_D_VehAccel_X_ST3
              rba_Nds_SignalInstance_IMU_D_VehAccel_X_Stat_ST3: rba_Nds_BitPosition=32, rba_Nds_SignalRef=rba_Nds_Signal_IMU_D_VehAccel_X_Stat_ST3
              rba_Nds_SignalInstance_IMU_D_VehAccel_Y_ST3: rba_Nds_BitPosition=107, rba_Nds_SignalRef=rba_Nds_Signal_IMU_D_VehAccel_Y_ST3
              rba_Nds_SignalInstance_IMU_D_VehAccel_Y_Stat_ST3: rba_Nds_BitPosition=41, rba_Nds_SignalRef=rba_Nds_Signal_IMU_D_VehAccel_Y_Stat_ST3
              rba_Nds_SignalInstance_IMU_D_VehAccel_Z_ST3: rba_Nds_BitPosition=155, rba_Nds_SignalRef=rba_Nds_Signal_IMU_D_VehAccel_Z_ST3
              rba_Nds_SignalInstance_IMU_D_VehAccel_Z_Stat_ST3: rba_Nds_BitPosition=50, rba_Nds_SignalRef=rba_Nds_Signal_IMU_D_VehAccel_Z_Stat_ST3
              rba_Nds_SignalInstance_IMU_D_VehDynData_TmSyncStat_ST3: rba_Nds_BitPosition=203, rba_Nds_SignalRef=rba_Nds_Signal_IMU_D_VehDynData_TmSyncStat_ST3
              rba_Nds_SignalInstance_IMU_D_VehPitch_Accel_ST3: rba_Nds_BitPosition=187, rba_Nds_SignalRef=rba_Nds_Signal_IMU_D_VehPitch_Accel_ST3
              rba_Nds_SignalInstance_IMU_D_VehPitchAccel_Stat_ST3: rba_Nds_BitPosition=56, rba_Nds_SignalRef=rba_Nds_Signal_IMU_D_VehPitchAccel_Stat_ST3
              rba_Nds_SignalInstance_IMU_D_VehPitchRate_ST3: rba_Nds_BitPosition=171, rba_Nds_SignalRef=rba_Nds_Signal_IMU_D_VehPitchRate_ST3
              rba_Nds_SignalInstance_IMU_D_VehPitchRate_Stat_ST3: rba_Nds_BitPosition=53, rba_Nds_SignalRef=rba_Nds_Signal_IMU_D_VehPitchRate_Stat_ST3
              rba_Nds_SignalInstance_IMU_D_VehRollAccel_ST3: rba_Nds_BitPosition=91, rba_Nds_SignalRef=rba_Nds_Signal_IMU_D_VehRollAccel_ST3
              rba_Nds_SignalInstance_IMU_D_VehRollAccel_Stat_ST3: rba_Nds_BitPosition=38, rba_Nds_SignalRef=rba_Nds_Signal_IMU_D_VehRollAccel_Stat_ST3
              rba_Nds_SignalInstance_IMU_D_VehRollRate_ST3: rba_Nds_BitPosition=75, rba_Nds_SignalRef=rba_Nds_Signal_IMU_D_VehRollRate_ST3
              rba_Nds_SignalInstance_IMU_D_VehRollRate_Stat_ST3: rba_Nds_BitPosition=35, rba_Nds_SignalRef=rba_Nds_Signal_IMU_D_VehRollRate_Stat_ST3
              rba_Nds_SignalInstance_IMU_D_VehYawAccel_ST3: rba_Nds_BitPosition=139, rba_Nds_SignalRef=rba_Nds_Signal_IMU_D_VehYawAccel_ST3
              rba_Nds_SignalInstance_IMU_D_VehYawAccel_Stat_ST3: rba_Nds_BitPosition=47, rba_Nds_SignalRef=rba_Nds_Signal_IMU_D_VehYawAccel_Stat_ST3
              rba_Nds_SignalInstance_IMU_D_VehYawRate_ST3: rba_Nds_BitPosition=123, rba_Nds_SignalRef=rba_Nds_Signal_IMU_D_VehYawRate_ST3
              rba_Nds_SignalInstance_IMU_D_VehYawRate_Stat_ST3: rba_Nds_BitPosition=44, rba_Nds_SignalRef=rba_Nds_Signal_IMU_D_VehYawRate_Stat_ST3
              rba_Nds_SignalInstance_SQC_PT4_Det05_IMU_D_Ctrl_Pr5_ST3: rba_Nds_BitPosition=16, rba_Nds_SignalRef=rba_Nds_Signal_SQC_PT4_Det05_IMU_D_Ctrl_Pr5_ST3
              rba_Nds_SignalInstance_Rsrv01_PT4_Det05_IMU_D_Ctrl_Pr5_ST3: rba_Nds_BitPosition=205, rba_Nds_SignalRef=rba_Nds_Signal_Rsrv01_PT4_Det05_IMU_D_Ctrl_Pr5_ST3
              rba_Nds_SignalInstance_Rsrv02_PT4_Det05_IMU_D_Ctrl_Pr5_ST3: rba_Nds_BitPosition=24, rba_Nds_SignalRef=rba_Nds_Signal_Rsrv02_PT4_Det05_IMU_D_Ctrl_Pr5_ST3
            rba_Nds_ContainedPduProperties: rba_Nds_ByteOffset=0
            rba_Nds_SignalInstance_IMU_D_VehDynData_TmStmp_Sec_ST3 (rba_Nds_SignalInstance): rba_Nds_ByteOrder=INTEL, rba_Nds_BitPosition=208, rba_Nds_SignalRef=rba_Nds_Signal_IMU_D_VehDynData_TmStmp_Sec_ST3
            rba_Nds_SignalInstance_IMU_D_VehDynData_TmStmp_NanoSec_ST3 (rba_Nds_SignalInstance): rba_Nds_BitPosition=240, rba_Nds_ByteOrder=INTEL, rba_Nds_SignalRef=rba_Nds_Signal_IMU_D_VehDynData_TmStmp_NanoSec_ST3
        rba_Nds_Pdu_IMU_D_DRIVING_Container_Det05_ST3_IMU_D_DRIVING_Container_Det05_ST3_PT4_Det05_IMU_D_Ctrl_ST3_secured
          rba_Nds_SecuredPdu:
            rba_Nds_Description = IMU_D_DRIVING_Container_Det05_ST3_IMU_D_DRIVING_Container_Det05_ST3_PT4_Det05_IMU_D_Ctrl_ST3_secured
            rba_Nds_Length = 38
            rba_Nds_Name = IMU_D_DRIVING_Container_Det05_ST3_IMU_D_DRIVING_Container_Det05_ST3_PT4_Det05_IMU_D_Ctrl_ST3_secured
            rba_Nds_AuthenticPduTriggeringRef = rba_Nds_CanPduTriggering_IMU_D_DRIVING_Container_Det05_ST3_IMU_D_DRIVING_Container_Det05_ST3_PT4_Det05_IMU_D_Ctrl_ST3_23jvaq3ummpy3hlk0oahpkf34
            rba_Nds_ContainedPduProperties: rba_Nds_ByteOffset=0, rba_Nds_UpdateBitPosition=511
        rba_Nds_Pdu_IMU_D_DRIVING_Container_Det05_ST3_ContainerIPdu
          rba_Nds_ContainerPdu:
            rba_Nds_Description = IMU_D_DRIVING_Container_Det05_ST3_ContainerIPdu
            rba_Nds_HeaderType = NO_HEADER
            rba_Nds_Length = 64
            rba_Nds_Name = IMU_D_DRIVING_Container_Det05_ST3_ContainerIPdu
            rba_Nds_UnusedAreasDefault = 0
            rba_Nds_ContainedPduTriggering = rba_Nds_CanPduTriggering_IMU_D_DRIVING_Container_Det05_ST3_IMU_D_DRIVING_Container_Det05_ST3_PT4_Det05_IMU_D_Ctrl_ST3_1joxqmpavt6pujhrm2rp8u71k
        rba_Nds_Pdu_IMU_D_Driving_Container1_ST3_ContainerIPdu
          rba_Nds_ContainerPdu:
            rba_Nds_Description = IMU_D_Driving_Container1_ST3_ContainerIPdu
            rba_Nds_HeaderType = SHORT_HEADER
            rba_Nds_Length = 64
            rba_Nds_Name = IMU_D_Driving_Container1_ST3_ContainerIPdu
            rba_Nds_UnusedAreasDefault = 0
            rba_Nds_ContainedPduTriggering = rba_Nds_CanPduTriggering_IMU_D_Driving_Container1_ST3_IMU_D_Driving_Container1_ST3_IMU_D_Stat_ST3_7r5emjrjqifhmoluyjdx39vet
      27 x rba_Nds_Signal:
        rba_Nds_Signal_IMU_D_Id_ST3: rba_Nds_BitSize=32, rba_Nds_Description=Identifikation Inertialsensorik 3, rba_Nds_Encoding=FLOAT32, rba_Nds_Name=IMU_D_Id_ST3
          rba_Nds_NetworkRepresentation_0_IMU_D_Id_ST3 (rba_Nds_NetworkRepresentation)
            rba_Nds_DirectRepresentation
        rba_Nds_Signal_IMU_D_VehYawRateSens_Temp_ST3: rba_Nds_BitSize=8, rba_Nds_Description=Fahrzeuggierrate-Sensortemperatur, rba_Nds_Encoding=UNSIGNED, rba_Nds_Name=IMU_D_VehYawRateSens_Temp_ST3
          rba_Nds_NetworkRepresentation_0_IMU_D_VehYawRateSens_Temp_ST3 (rba_Nds_NetworkRepresentation)
            rba_Nds_DirectRepresentation
        rba_Nds_Signal_Rsrv01_PT4_Det05_IMU_D_Ctrl_Pr5_ST3: rba_Nds_BitSize=3, rba_Nds_Description=Reserviert für zukünftige Verwendung, rba_Nds_Encoding=UNSIGNED, rba_Nds_Name=Rsrv01_PT4_Det05_IMU_D_Ctrl_Pr5_ST3
          rba_Nds_NetworkRepresentation_0 (rba_Nds_NetworkRepresentation)
            rba_Nds_DirectRepresentation
        rba_Nds_Signal_Rsrv02_PT4_Det05_IMU_D_Ctrl_Pr5_ST3: rba_Nds_BitSize=8, rba_Nds_Description=Reserviert für zukünftige Verwendung, rba_Nds_Encoding=UNSIGNED, rba_Nds_Name=Rsrv02_PT4_Det05_IMU_D_Ctrl_Pr5_ST3
          rba_Nds_NetworkRepresentation_0 (rba_Nds_NetworkRepresentation)
            rba_Nds_DirectRepresentation
        rba_Nds_Signal_CRC_PT4_Det05_IMU_D_Ctrl_Pr5_ST3: rba_Nds_BitSize=16, rba_Nds_Description=CRC-Checksumme der Signal Gruppe gemäß AUTOSAR Profil 5, rba_Nds_Encoding=UNSIGNED, rba_Nds_Name=CRC_PT4_Det05_IMU_D_Ctrl_Pr5_ST3, rba_Nds_SignalType=CHECKSUM
          rba_Nds_NetworkRepresentation_0 (rba_Nds_NetworkRepresentation)
            rba_Nds_DirectRepresentation
        rba_Nds_Signal_IMU_D_VehAccel_X_ST3: rba_Nds_BitSize=16, rba_Nds_Description=Summe aus Gravitations- und Fahrzeuglängsbeschleunigung (+ = vorwärts), rba_Nds_Encoding=UNSIGNED, rba_Nds_Name=IMU_D_VehAccel_X_ST3
          rba_Nds_NetworkRepresentation_0_IMU_D_VehAccel_X_ST3 (rba_Nds_NetworkRepresentation)
            rba_Nds_DirectRepresentation
        rba_Nds_Signal_IMU_D_VehAccel_X_Stat_ST3: rba_Nds_BitSize=3, rba_Nds_Description=Status Fahrzeuglängsbeschleunigung, rba_Nds_Encoding=UNSIGNED, rba_Nds_Name=IMU_D_VehAccel_X_Stat_ST3
          rba_Nds_NetworkRepresentation_0_IMU_D_VehAccel_X_Stat_ST3 (rba_Nds_NetworkRepresentation)
            rba_Nds_DirectRepresentation
        rba_Nds_Signal_IMU_D_VehAccel_Y_ST3: rba_Nds_BitSize=16, rba_Nds_Description=Summe aus Gravitations- und Fahrzeugquerbeschleunigung (+ = links), rba_Nds_Encoding=UNSIGNED, rba_Nds_Name=IMU_D_VehAccel_Y_ST3
          rba_Nds_NetworkRepresentation_0_IMU_D_VehAccel_Y_ST3 (rba_Nds_NetworkRepresentation)
            rba_Nds_DirectRepresentation
        rba_Nds_Signal_IMU_D_VehAccel_Y_Stat_ST3: rba_Nds_BitSize=3, rba_Nds_Description=Status Fahrzeugquerbeschleunigung, rba_Nds_Encoding=UNSIGNED, rba_Nds_Name=IMU_D_VehAccel_Y_Stat_ST3
          rba_Nds_NetworkRepresentation_0_IMU_D_VehAccel_Y_Stat_ST3 (rba_Nds_NetworkRepresentation)
            rba_Nds_DirectRepresentation
        rba_Nds_Signal_IMU_D_VehAccel_Z_ST3: rba_Nds_BitSize=16, rba_Nds_Description=Summe aus Gravitations- und Fahrzeugvertikalbeschleunigung - 1g (+ = aufwärts), rba_Nds_Encoding=UNSIGNED, rba_Nds_Name=IMU_D_VehAccel_Z_ST3
          rba_Nds_NetworkRepresentation_1_IMU_D_VehAccel_Z_ST3 (rba_Nds_NetworkRepresentation)
            rba_Nds_DirectRepresentation
        rba_Nds_Signal_IMU_D_VehAccel_Z_Stat_ST3: rba_Nds_BitSize=3, rba_Nds_Description=Status Fahrzeugvertikalbeschleunigung, rba_Nds_Encoding=UNSIGNED, rba_Nds_Name=IMU_D_VehAccel_Z_Stat_ST3
          rba_Nds_NetworkRepresentation_0_IMU_D_VehAccel_Z_Stat_ST3 (rba_Nds_NetworkRepresentation)
            rba_Nds_DirectRepresentation
        rba_Nds_Signal_IMU_D_VehDynData_TmSyncStat_ST3: rba_Nds_BitSize=2, rba_Nds_Description=Synchronisationsstatus des globalen Zeitstempels der Komponente IMU_D, rba_Nds_Encoding=UNSIGNED, rba_Nds_Name=IMU_D_VehDynData_TmSyncStat_ST3
          rba_Nds_NetworkRepresentation_0_IMU_D_VehDynData_TmSyncStat_ST3 (rba_Nds_NetworkRepresentation)
            rba_Nds_DirectRepresentation
        rba_Nds_Signal_IMU_D_VehPitch_Accel_ST3: rba_Nds_BitSize=16, rba_Nds_Description=Fahrzeug-Nickbeschleunigung (ThetaPP), rba_Nds_Encoding=UNSIGNED, rba_Nds_Name=IMU_D_VehPitch_Accel_ST3
          rba_Nds_NetworkRepresentation_0_IMU_D_VehPitch_Accel_ST3 (rba_Nds_NetworkRepresentation)
            rba_Nds_DirectRepresentation
        rba_Nds_Signal_IMU_D_VehPitchAccel_Stat_ST3: rba_Nds_BitSize=3, rba_Nds_Description=Status Fahrzeug-Nickbeschleunigung, rba_Nds_Encoding=UNSIGNED, rba_Nds_Name=IMU_D_VehPitchAccel_Stat_ST3
          rba_Nds_NetworkRepresentation_0_IMU_D_VehPitchAccel_Stat_ST3 (rba_Nds_NetworkRepresentation)
            rba_Nds_DirectRepresentation
        rba_Nds_Signal_IMU_D_VehPitchRate_ST3: rba_Nds_BitSize=16, rba_Nds_Description=Fahrzeugnickrate (ThetaP, + = vorne runter), rba_Nds_Encoding=UNSIGNED, rba_Nds_Name=IMU_D_VehPitchRate_ST3
          rba_Nds_NetworkRepresentation_0_IMU_D_VehPitchRate_ST3 (rba_Nds_NetworkRepresentation)
            rba_Nds_DirectRepresentation
        rba_Nds_Signal_IMU_D_VehPitchRate_Stat_ST3: rba_Nds_BitSize=3, rba_Nds_Description=Status Fahrzeugnickrate, rba_Nds_Encoding=UNSIGNED, rba_Nds_Name=IMU_D_VehPitchRate_Stat_ST3
          rba_Nds_NetworkRepresentation_0_IMU_D_VehPitchRate_Stat_ST3 (rba_Nds_NetworkRepresentation)
            rba_Nds_DirectRepresentation
        rba_Nds_Signal_IMU_D_VehRollAccel_ST3: rba_Nds_BitSize=16, rba_Nds_Description=Fahrzeug-Wankbeschleunigung (PhiPP), rba_Nds_Encoding=UNSIGNED, rba_Nds_Name=IMU_D_VehRollAccel_ST3
          rba_Nds_NetworkRepresentation_0_IMU_D_VehRollAccel_ST3 (rba_Nds_NetworkRepresentation)
            rba_Nds_DirectRepresentation
        rba_Nds_Signal_IMU_D_VehRollAccel_Stat_ST3: rba_Nds_BitSize=3, rba_Nds_Description=Status Fahrzeug-Wankbeschleunigung, rba_Nds_Encoding=UNSIGNED, rba_Nds_Name=IMU_D_VehRollAccel_Stat_ST3
          rba_Nds_NetworkRepresentation_0_IMU_D_VehRollAccel_Stat_ST3 (rba_Nds_NetworkRepresentation)
            rba_Nds_DirectRepresentation
        rba_Nds_Signal_IMU_D_VehRollRate_ST3: rba_Nds_BitSize=16, rba_Nds_Description=Fahrzeugwankrate (PhiP, + = links rauf), rba_Nds_Encoding=UNSIGNED, rba_Nds_Name=IMU_D_VehRollRate_ST3
          rba_Nds_NetworkRepresentation_0_IMU_D_VehRollRate_ST3 (rba_Nds_NetworkRepresentation)
            rba_Nds_DirectRepresentation
        rba_Nds_Signal_IMU_D_VehRollRate_Stat_ST3: rba_Nds_BitSize=3, rba_Nds_Description=Status Fahrzeugwankrate, rba_Nds_Encoding=UNSIGNED, rba_Nds_Name=IMU_D_VehRollRate_Stat_ST3
          rba_Nds_NetworkRepresentation_0_IMU_D_VehRollRate_Stat_ST3 (rba_Nds_NetworkRepresentation)
            rba_Nds_DirectRepresentation
        rba_Nds_Signal_IMU_D_VehYawAccel_ST3: rba_Nds_BitSize=16, rba_Nds_Description=Fahrzeug-Gierbeschleunigung (PsiPP), rba_Nds_Encoding=UNSIGNED, rba_Nds_Name=IMU_D_VehYawAccel_ST3
          rba_Nds_NetworkRepresentation_0_IMU_D_VehYawAccel_ST3 (rba_Nds_NetworkRepresentation)
            rba_Nds_DirectRepresentation
        rba_Nds_Signal_IMU_D_VehYawAccel_Stat_ST3: rba_Nds_BitSize=3, rba_Nds_Description=Status Fahrzeug-Gierbeschleunigung, rba_Nds_Encoding=UNSIGNED, rba_Nds_Name=IMU_D_VehYawAccel_Stat_ST3
          rba_Nds_NetworkRepresentation_0_IMU_D_VehYawAccel_Stat_ST3 (rba_Nds_NetworkRepresentation)
            rba_Nds_DirectRepresentation
        rba_Nds_Signal_IMU_D_VehYawRate_ST3: rba_Nds_BitSize=16, rba_Nds_Description=Fahrzeuggierrate (PsiP, + = links), rba_Nds_Encoding=UNSIGNED, rba_Nds_Name=IMU_D_VehYawRate_ST3
          rba_Nds_NetworkRepresentation_0_IMU_D_VehYawRate_ST3 (rba_Nds_NetworkRepresentation)
            rba_Nds_DirectRepresentation
        rba_Nds_Signal_IMU_D_VehYawRate_Stat_ST3: rba_Nds_BitSize=3, rba_Nds_Description=Status Fahrzeuggierrate, rba_Nds_Encoding=UNSIGNED, rba_Nds_Name=IMU_D_VehYawRate_Stat_ST3
          rba_Nds_NetworkRepresentation_0_IMU_D_VehYawRate_Stat_ST3 (rba_Nds_NetworkRepresentation)
            rba_Nds_DirectRepresentation
        rba_Nds_Signal_SQC_PT4_Det05_IMU_D_Ctrl_Pr5_ST3: rba_Nds_BitSize=8, rba_Nds_Description=Sequenzzähler, rba_Nds_Encoding=UNSIGNED, rba_Nds_Name=SQC_PT4_Det05_IMU_D_Ctrl_Pr5_ST3, rba_Nds_SignalType=ALIVECOUNTER
          rba_Nds_NetworkRepresentation_SQC_PT4_Det05_IMU_D_Ctrl_Pr5_ST3_none_1_0 (rba_Nds_NetworkRepresentation)
            rba_Nds_DirectRepresentation: rba_Nds_MaxValue=255, rba_Nds_MinValue=0
        rba_Nds_Signal_IMU_D_VehDynData_TmStmp_Sec_ST3: rba_Nds_Description=IMU_D_VehDynData_TmStmp_Sec_ST3, rba_Nds_BitSize=32, rba_Nds_Name=IMU_D_VehDynData_TmStmp_Sec_ST3, rba_Nds_Encoding=UNSIGNED
          rba_Nds_NetworkRepresentation_0 (rba_Nds_NetworkRepresentation)
            rba_Nds_DirectRepresentation
        rba_Nds_Signal_IMU_D_VehDynData_TmStmp_NanoSec_ST3: rba_Nds_Description=IMU_D_VehDynData_TmStmp_NanoSec_ST3, rba_Nds_Name=IMU_D_VehDynData_TmStmp_NanoSec_ST3, rba_Nds_Encoding=UNSIGNED, rba_Nds_BitSize=32
          rba_Nds_NetworkRepresentation_0 (rba_Nds_NetworkRepresentation)
            rba_Nds_DirectRepresentation
      rba_Nds_SignalGroup_IMU_D_Stat_ST3_axy9lqt6gl1tcwttoyfd136l6 (rba_Nds_SignalGroup):
        rba_Nds_Name = IMU_D_Stat_ST3_axy9lqt6gl1tcwttoyfd136l6
        rba_Nds_SignalRef = rba_Nds_Signal_IMU_D_Id_ST3
        rba_Nds_SignalRef = rba_Nds_Signal_IMU_D_VehYawRateSens_Temp_ST3
      rba_Nds_SignalGroup_PT4_Det05_IMU_D_Ctrl_Pr5_ST3_9ibx3pdl90d59keo4mo66if6x (rba_Nds_SignalGroup):
        rba_Nds_Name = PT4_Det05_IMU_D_Ctrl_Pr5_ST3_9ibx3pdl90d59keo4mo66if6x
        rba_Nds_SignalRef = rba_Nds_Signal_CRC_PT4_Det05_IMU_D_Ctrl_Pr5_ST3
        rba_Nds_SignalRef = rba_Nds_Signal_IMU_D_VehAccel_X_ST3
        rba_Nds_SignalRef = rba_Nds_Signal_IMU_D_VehAccel_X_Stat_ST3
        rba_Nds_SignalRef = rba_Nds_Signal_IMU_D_VehAccel_Y_ST3
        rba_Nds_SignalRef = rba_Nds_Signal_IMU_D_VehAccel_Y_Stat_ST3
        rba_Nds_SignalRef = rba_Nds_Signal_IMU_D_VehAccel_Z_ST3
        rba_Nds_SignalRef = rba_Nds_Signal_IMU_D_VehAccel_Z_Stat_ST3
        rba_Nds_SignalRef = rba_Nds_Signal_IMU_D_VehDynData_TmSyncStat_ST3
        rba_Nds_SignalRef = rba_Nds_Signal_IMU_D_VehPitch_Accel_ST3
        rba_Nds_SignalRef = rba_Nds_Signal_IMU_D_VehPitchAccel_Stat_ST3
        rba_Nds_SignalRef = rba_Nds_Signal_IMU_D_VehPitchRate_ST3
        rba_Nds_SignalRef = rba_Nds_Signal_IMU_D_VehPitchRate_Stat_ST3
        rba_Nds_SignalRef = rba_Nds_Signal_IMU_D_VehRollAccel_ST3
        rba_Nds_SignalRef = rba_Nds_Signal_IMU_D_VehRollAccel_Stat_ST3
        rba_Nds_SignalRef = rba_Nds_Signal_IMU_D_VehRollRate_ST3
        rba_Nds_SignalRef = rba_Nds_Signal_IMU_D_VehRollRate_Stat_ST3
        rba_Nds_SignalRef = rba_Nds_Signal_IMU_D_VehYawAccel_ST3
        rba_Nds_SignalRef = rba_Nds_Signal_IMU_D_VehYawAccel_Stat_ST3
        rba_Nds_SignalRef = rba_Nds_Signal_IMU_D_VehYawRate_ST3
        rba_Nds_SignalRef = rba_Nds_Signal_IMU_D_VehYawRate_Stat_ST3
        rba_Nds_SignalRef = rba_Nds_Signal_Rsrv01_PT4_Det05_IMU_D_Ctrl_Pr5_ST3
        rba_Nds_SignalRef = rba_Nds_Signal_Rsrv02_PT4_Det05_IMU_D_Ctrl_Pr5_ST3
        rba_Nds_SignalRef = rba_Nds_Signal_SQC_PT4_Det05_IMU_D_Ctrl_Pr5_ST3
        rba_Nds_SignalRef = rba_Nds_Signal_IMU_D_VehDynData_TmStmp_Sec_ST3
        rba_Nds_SignalRef = rba_Nds_Signal_IMU_D_VehDynData_TmStmp_NanoSec_ST3
    rba_Nds_Ecu: rba_Nds_Name=IMU_B
      rba_Nds_ApplicationPorts_IMU_B_Output_ST3 (rba_Nds_ApplicationPorts)
        rba_Nds_TransmitSignalGroupApplicationPort_PT4_Det05_IMU_D_Ctrl_ST3 (rba_Nds_TransmitSignalGroupApplicationPort): rba_Nds_Name=rbl_CustIf_IMU_D_Det05_CtrlMsg_ST3, rba_Nds_PortType=rbl_CustIf_IMU_D_Det05_ST3_PT4_st
          25 x rba_Nds_TransmitGroupSignalApplicationPort:
            rba_Nds_TransmitGroupSignalApplicationPort_CRC_PT4_Det05_IMU_D_Ctrl_Pr5_ST3: rba_Nds_DataType=UINT16, rba_Nds_Name=CRC_PT4_Det05_IMU_D_Ctrl_Pr5_ST3
              rba_Nds_ApplicationRepresentation_0 (rba_Nds_ApplicationRepresentation)
            rba_Nds_TransmitGroupSignalApplicationPort_SQC_PT4_Det05_IMU_D_Ctrl_Pr5_ST3: rba_Nds_DataType=UINT8, rba_Nds_Name=SQC_PT4_Det05_IMU_D_Ctrl_Pr5_ST3
              rba_Nds_ApplicationRepresentation_0 (rba_Nds_ApplicationRepresentation)
            rba_Nds_TransmitGroupSignalApplicationPort_IMU_D_VehAccel_X_Stat_ST3: rba_Nds_DataType=UINT8, rba_Nds_Name=IMU_D_VehAccel_X_Stat_ST3
              rba_Nds_ApplicationRepresentation_0 (rba_Nds_ApplicationRepresentation)
            rba_Nds_TransmitGroupSignalApplicationPort_IMU_D_VehRollRate_Stat_ST3: rba_Nds_DataType=UINT8, rba_Nds_Name=IMU_D_VehRollRate_Stat_ST3
              rba_Nds_ApplicationRepresentation_0 (rba_Nds_ApplicationRepresentation)
            rba_Nds_TransmitGroupSignalApplicationPort_IMU_D_VehRollAccel_Stat_ST3: rba_Nds_DataType=UINT8, rba_Nds_Name=IMU_D_VehRollAccel_Stat_ST3
              rba_Nds_ApplicationRepresentation_0 (rba_Nds_ApplicationRepresentation)
            rba_Nds_TransmitGroupSignalApplicationPort_IMU_D_VehAccel_Y_Stat_ST3: rba_Nds_DataType=UINT8, rba_Nds_Name=IMU_D_VehAccel_Y_Stat_ST3
              rba_Nds_ApplicationRepresentation_0 (rba_Nds_ApplicationRepresentation)
            rba_Nds_TransmitGroupSignalApplicationPort_IMU_D_VehYawRate_Stat_ST3: rba_Nds_DataType=UINT8, rba_Nds_Name=IMU_D_VehYawRate_Stat_ST3
              rba_Nds_ApplicationRepresentation_0 (rba_Nds_ApplicationRepresentation)
            rba_Nds_TransmitGroupSignalApplicationPort_IMU_D_VehYawAccel_Stat_ST3: rba_Nds_DataType=UINT8, rba_Nds_Name=IMU_D_VehYawAccel_Stat_ST3
              rba_Nds_ApplicationRepresentation_0 (rba_Nds_ApplicationRepresentation)
            rba_Nds_TransmitGroupSignalApplicationPort_IMU_D_VehAccel_Z_Stat_ST3: rba_Nds_DataType=UINT8, rba_Nds_Name=IMU_D_VehAccel_Z_Stat_ST3
              rba_Nds_ApplicationRepresentation_0 (rba_Nds_ApplicationRepresentation)
            rba_Nds_TransmitGroupSignalApplicationPort_IMU_D_VehPitchRate_Stat_ST3: rba_Nds_DataType=UINT8, rba_Nds_Name=IMU_D_VehPitchRate_Stat_ST3
              rba_Nds_ApplicationRepresentation_0 (rba_Nds_ApplicationRepresentation)
            rba_Nds_TransmitGroupSignalApplicationPort_IMU_D_VehPitchAccel_Stat_ST3: rba_Nds_DataType=UINT8, rba_Nds_Name=IMU_D_VehPitchAccel_Stat_ST3
              rba_Nds_ApplicationRepresentation_0 (rba_Nds_ApplicationRepresentation)
            rba_Nds_TransmitGroupSignalApplicationPort_IMU_D_VehAccel_X_ST3: rba_Nds_DataType=UINT16, rba_Nds_Name=IMU_D_VehAccel_X_ST3
              rba_Nds_ApplicationRepresentation_0 (rba_Nds_ApplicationRepresentation)
            rba_Nds_TransmitGroupSignalApplicationPort_IMU_D_VehRollRate_ST3: rba_Nds_DataType=UINT16, rba_Nds_Name=IMU_D_VehRollRate_ST3
              rba_Nds_ApplicationRepresentation_0 (rba_Nds_ApplicationRepresentation)
            rba_Nds_TransmitGroupSignalApplicationPort_IMU_D_VehRollAccel_ST3: rba_Nds_DataType=UINT16, rba_Nds_Name=IMU_D_VehRollAccel_ST3
              rba_Nds_ApplicationRepresentation_0 (rba_Nds_ApplicationRepresentation)
            rba_Nds_TransmitGroupSignalApplicationPort_IMU_D_VehAccel_Y_ST3: rba_Nds_DataType=UINT16, rba_Nds_Name=IMU_D_VehAccel_Y_ST3
              rba_Nds_ApplicationRepresentation_0 (rba_Nds_ApplicationRepresentation)
            rba_Nds_TransmitGroupSignalApplicationPort_IMU_D_VehYawRate_ST3: rba_Nds_DataType=UINT16, rba_Nds_Name=IMU_D_VehYawRate_ST3
              rba_Nds_ApplicationRepresentation_0 (rba_Nds_ApplicationRepresentation)
            rba_Nds_TransmitGroupSignalApplicationPort_IMU_D_VehYawAccel_ST3: rba_Nds_DataType=UINT16, rba_Nds_Name=IMU_D_VehYawAccel_ST3
              rba_Nds_ApplicationRepresentation_0 (rba_Nds_ApplicationRepresentation)
            rba_Nds_TransmitGroupSignalApplicationPort_IMU_D_VehAccel_Z_ST3: rba_Nds_DataType=UINT16, rba_Nds_Name=IMU_D_VehAccel_Z_ST3
              rba_Nds_ApplicationRepresentation_0 (rba_Nds_ApplicationRepresentation)
            rba_Nds_TransmitGroupSignalApplicationPort_IMU_D_VehPitchRate_ST3: rba_Nds_DataType=UINT16, rba_Nds_Name=IMU_D_VehPitchRate_ST3
              rba_Nds_ApplicationRepresentation_0 (rba_Nds_ApplicationRepresentation)
            rba_Nds_TransmitGroupSignalApplicationPort_IMU_D_VehPitch_Accel_ST3: rba_Nds_DataType=UINT16, rba_Nds_Name=IMU_D_VehPitch_Accel_ST3
              rba_Nds_ApplicationRepresentation_0 (rba_Nds_ApplicationRepresentation)
            rba_Nds_TransmitGroupSignalApplicationPort_IMU_D_VehDynData_TmSyncStat_ST3: rba_Nds_DataType=UINT8, rba_Nds_Name=IMU_D_VehDynData_TmSyncStat_ST3
              rba_Nds_ApplicationRepresentation_0 (rba_Nds_ApplicationRepresentation)
            rba_Nds_TransmitGroupSignalApplicationPort_Rsrv01_PT4_Det05_IMU_D_Ctrl_Pr5_ST3: rba_Nds_DataType=UINT8, rba_Nds_Name=Rsrv01_PT4_Det05_IMU_D_Ctrl_Pr5_ST3
              rba_Nds_ApplicationRepresentation_0 (rba_Nds_ApplicationRepresentation)
            rba_Nds_TransmitGroupSignalApplicationPort_Rsrv02_PT4_Det05_IMU_D_Ctrl_Pr5_ST3: rba_Nds_DataType=UINT8, rba_Nds_Name=Rsrv02_PT4_Det05_IMU_D_Ctrl_Pr5_ST3
              rba_Nds_ApplicationRepresentation_0 (rba_Nds_ApplicationRepresentation)
            rba_Nds_TransmitGroupSignalApplicationPort_IMU_D_VehDynData_TmStmp_Sec_ST3: rba_Nds_DataType=UINT32, rba_Nds_Name=IMU_D_VehDynData_TmStmp_Sec_ST3
              rba_Nds_ApplicationRepresentation_0 (rba_Nds_ApplicationRepresentation)
                rba_Nds_DirectRepresentation
            rba_Nds_TransmitGroupSignalApplicationPort_IMU_D_VehDynData_TmStmp_NanoSec_ST3: rba_Nds_DataType=UINT32, rba_Nds_Name=IMU_D_VehDynData_TmStmp_NanoSec_ST3
              rba_Nds_ApplicationRepresentation_0 (rba_Nds_ApplicationRepresentation)
                rba_Nds_DirectRepresentation
        rba_Nds_TransmitSignalGroupApplicationPort_IMU_D_Stat_ST3 (rba_Nds_TransmitSignalGroupApplicationPort): rba_Nds_Name=rbl_CustIf_IMU_D_Stat_Pr5Msg_ST3, rba_Nds_PortType=rbl_CustIf_IMU_D_Stat_Pr5_ST3_st
          rba_Nds_TransmitGroupSignalApplicationPort_IMU_D_Id_ST3 (rba_Nds_TransmitGroupSignalApplicationPort): rba_Nds_DataType=UINT32, rba_Nds_Name=IMU_D_Id_ST3
            rba_Nds_ApplicationRepresentation_0 (rba_Nds_ApplicationRepresentation)
          rba_Nds_TransmitGroupSignalApplicationPort_IMU_D_VehYawRateSens_Temp_ST3 (rba_Nds_TransmitGroupSignalApplicationPort): rba_Nds_DataType=UINT8, rba_Nds_Name=IMU_D_VehYawRateSens_Temp_ST3
            rba_Nds_ApplicationRepresentation_0 (rba_Nds_ApplicationRepresentation)
      rba_Nds_Connectors
        3 x rba_Nds_CanConnector:
          rba_Nds_CanConnector_INTERNAL_CAN: rba_Nds_CanControllerRef=rba_Nds_CanController_CanIfControllerConfig_0, rba_Nds_CanNetworkRef=rba_Nds_CanNetwork_INTERNAL_CAN
          rba_Nds_CanConnector_IMU_B_HAD_BACKUP: rba_Nds_CanControllerRef=rba_Nds_CanController_CanIfControllerConfig_1, rba_Nds_CanNetworkRef=rba_Nds_CanNetwork_IMU_B_HAD_BACKUP
          rba_Nds_CanConnector_DRIVING: rba_Nds_CanControllerRef=rba_Nds_CanController_CanIfControllerConfig_2, rba_Nds_CanNetworkRef=rba_Nds_CanNetwork_DRIVING
            rba_Nds_CanTransmitFrame_IMU_D_Driving_Container1_ST3_cezoqmepfi10b8h1n4t3o34x6 (rba_Nds_CanTransmitFrame):
              rba_Nds_CanFrameTxBehavior = CAN_FD
              rba_Nds_FramePollingPeriod = 5
              rba_Nds_CanFrameTriggeringRef = rba_Nds_CanFrameTriggering_IMU_D_Driving_Container1_ST3_cezoqmepfi10b8h1n4t3o34x6
              rba_Nds_CanTransmitPduLinkageRef = rba_Nds_CanTransmitPduLinkage_IMU_D_Driving_Container1_ST3_8jj3uqqyg57q3fi1o8xl6in62
            rba_Nds_CanTransmitFrame_IMU_D_DRIVING_Container_Det05_ST3_ed1rm8scgsl20exhxfn2srlnq (rba_Nds_CanTransmitFrame):
              rba_Nds_CanFrameTxBehavior = CAN_FD
              rba_Nds_FramePollingPeriod = 5
              rba_Nds_CanFrameTriggeringRef = rba_Nds_CanFrameTriggering_IMU_D_DRIVING_Container_Det05_ST3_ed1rm8scgsl20exhxfn2srlnq
              rba_Nds_CanTransmitPduLinkageRef = rba_Nds_CanTransmitPduLinkage_IMU_D_DRIVING_Container_Det05_ST3_dy2d9b7s08zan5fawxjxn67da
            5 x rba_Nds_CanTransmitPduLinkage:
              rba_Nds_CanTransmitPduLinkage_IMU_D_Driving_Container1_ST3_IMU_D_Driving_Container1_ST3_IMU_D_Stat_ST3_7r5emjrjqifhmoluyjdx39vet: rba_Nds_CanPduTriggeringRef=rba_Nds_CanPduTriggering_IMU_D_Driving_Container1_ST3_IMU_D_Driving_Container1_ST3_IMU_D_Stat_ST3_7r5emjrjqifhmoluyjdx39vet, rba_Nds_TransmitPduRef=rba_Nds_TransmitPdu_IMU_D_Driving_Container1_ST3_IMU_D_Stat_ST3
              rba_Nds_CanTransmitPduLinkage_IMU_D_DRIVING_Container_Det05_ST3_IMU_D_DRIVING_Container_Det05_ST3_PT4_Det05_IMU_D_Ctrl_ST3_23jvaq3ummpy3hlk0oahpkf34: rba_Nds_CanPduTriggeringRef=rba_Nds_CanPduTriggering_IMU_D_DRIVING_Container_Det05_ST3_IMU_D_DRIVING_Container_Det05_ST3_PT4_Det05_IMU_D_Ctrl_ST3_23jvaq3ummpy3hlk0oahpkf34, rba_Nds_TransmitPduRef=rba_Nds_TransmitPdu_IMU_D_DRIVING_Container_Det05_ST3_PT4_Det05_IMU_D_Ctrl_ST3
              rba_Nds_CanTransmitPduLinkage_IMU_D_DRIVING_Container_Det05_ST3_dy2d9b7s08zan5fawxjxn67da: rba_Nds_CanPduTriggeringRef=rba_Nds_CanPduTriggering_IMU_D_DRIVING_Container_Det05_ST3_dy2d9b7s08zan5fawxjxn67da, rba_Nds_TransmitPduRef=rba_Nds_TransmitPdu_IMU_D_DRIVING_Container_Det05_ST3_dy2d9b7s08zan5fawxjxn67da
              rba_Nds_CanTransmitPduLinkage_IMU_D_DRIVING_Container_Det05_ST3_IMU_D_DRIVING_Container_Det05_ST3_PT4_Det05_IMU_D_Ctrl_ST3_1joxqmpavt6pujhrm2rp8u71k: rba_Nds_CanPduTriggeringRef=rba_Nds_CanPduTriggering_IMU_D_DRIVING_Container_Det05_ST3_IMU_D_DRIVING_Container_Det05_ST3_PT4_Det05_IMU_D_Ctrl_ST3_1joxqmpavt6pujhrm2rp8u71k, rba_Nds_TransmitPduRef=rba_Nds_TransmitPdu_IMU_D_DRIVING_Container_Det05_ST3_IMU_D_DRIVING_Container_Det05_ST3_PT4_Det05_IMU_D_Ctrl_ST3_secured
              rba_Nds_CanTransmitPduLinkage_IMU_D_Driving_Container1_ST3_8jj3uqqyg57q3fi1o8xl6in62: rba_Nds_CanPduTriggeringRef=rba_Nds_CanPduTriggering_IMU_D_Driving_Container1_ST3_8jj3uqqyg57q3fi1o8xl6in62, rba_Nds_TransmitPduRef=rba_Nds_TransmitPdu_IMU_D_Driving_Container1_ST3_8jj3uqqyg57q3fi1o8xl6in62
      rba_Nds_Controllers
        3 x rba_Nds_CanController:
          rba_Nds_CanController_CanIfControllerConfig_{0..2}: rba_Nds_ControllerId={0..2}, rba_Nds_Name=CanIfControllerConfig_{0..2}
      rba_Nds_EcuPdus
        5 x rba_Nds_TransmitPdu:
          rba_Nds_TransmitPdu_IMU_D_Driving_Container1_ST3_IMU_D_Stat_ST3
            rba_Nds_TransmitSignalPdu:
              rba_Nds_SignalConfirmationProcessing = DEFERRED
              rba_Nds_EcuTransmitProcessRef = rba_Nds_EcuTransmitProcess_5ms
              rba_Nds_SignalPduRef = rba_Nds_Pdu_IMU_D_Driving_Container1_ST3_IMU_D_Stat_ST3/rba_Nds_SignalPdu
              rba_Nds_PduGroupRef = rba_Nds_PduGroup_IMU_B_DRIVING_Tx_PNC_All_Active
              rba_Nds_PduGroupRef = rba_Nds_PduGroup_IMU_B_DRIVING_Tx_PNC_20
              rba_Nds_PduGroupRef = rba_Nds_PduGroup_IMU_B_DRIVING_Tx_PNC_23
              rba_Nds_TransmitSignalGroupNetworkPort_IMU_D_Stat_ST3_axy9lqt6gl1tcwttoyfd136l6 (rba_Nds_TransmitSignalGroupNetworkPort): rba_Nds_SignalGroupInstanceRef=rba_Nds_SignalGroupInstance_IMU_D_Stat_ST3_axy9lqt6gl1tcwttoyfd136l6
              rba_Nds_TransmitSignalNetworkPort_IMU_D_Id_ST3 (rba_Nds_TransmitSignalNetworkPort): rba_Nds_InitValue=4.294967295E9, rba_Nds_SignalInstanceRef=rba_Nds_SignalInstance_IMU_D_Id_ST3
              rba_Nds_TransmitSignalNetworkPort_IMU_D_VehYawRateSens_Temp_ST3 (rba_Nds_TransmitSignalNetworkPort): rba_Nds_InitValue=255, rba_Nds_SignalInstanceRef=rba_Nds_SignalInstance_IMU_D_VehYawRateSens_Temp_ST3
              rba_Nds_ContainedTxPduProperties: rba_Nds_CollectionSemantics=LAST_IS_BEST, rba_Nds_Trigger=ALWAYS
          rba_Nds_TransmitPdu_IMU_D_DRIVING_Container_Det05_ST3_PT4_Det05_IMU_D_Ctrl_ST3
            rba_Nds_TransmitSignalPdu:
              rba_Nds_SignalConfirmationProcessing = DEFERRED
              rba_Nds_EcuTransmitProcessRef = rba_Nds_EcuTransmitProcess_5ms
              rba_Nds_SignalPduRef = rba_Nds_Pdu_IMU_D_DRIVING_Container_Det05_ST3_PT4_Det05_IMU_D_Ctrl_ST3/rba_Nds_SignalPdu
              rba_Nds_PduGroupRef = rba_Nds_PduGroup_IMU_B_DRIVING_Tx_PNC_All_Active
              rba_Nds_PduGroupRef = rba_Nds_PduGroup_IMU_B_DRIVING_Tx_PNC_20
              rba_Nds_PduGroupRef = rba_Nds_PduGroup_IMU_B_DRIVING_Tx_PNC_23
              rba_Nds_TransmitSignalGroupNetworkPort_PT4_Det05_IMU_D_Ctrl_Pr5_ST3_9ibx3pdl90d59keo4mo66if6x (rba_Nds_TransmitSignalGroupNetworkPort):
                rba_Nds_SignalGroupInstanceRef = rba_Nds_SignalGroupInstance_PT4_Det05_IMU_D_Ctrl_Pr5_ST3_9ibx3pdl90d59keo4mo66if6x
                rba_Nds_ISignalToIPduMappingRef = PT4_Det05_IMU_D_Ctrl_Pr5_ST3_9ibx3pdl90d59keo4mo66if6x
              25 x rba_Nds_TransmitSignalNetworkPort:
                rba_Nds_TransmitSignalNetworkPort_CRC_PT4_Det05_IMU_D_Ctrl_Pr5_ST3: rba_Nds_InitValue=8398, rba_Nds_SignalInstanceRef=rba_Nds_SignalInstance_CRC_PT4_Det05_IMU_D_Ctrl_Pr5_ST3
                rba_Nds_TransmitSignalNetworkPort_IMU_D_VehAccel_X_ST3: rba_Nds_InitValue=0, rba_Nds_SignalInstanceRef=rba_Nds_SignalInstance_IMU_D_VehAccel_X_ST3
                rba_Nds_TransmitSignalNetworkPort_IMU_D_VehAccel_X_Stat_ST3: rba_Nds_InitValue=0, rba_Nds_SignalInstanceRef=rba_Nds_SignalInstance_IMU_D_VehAccel_X_Stat_ST3
                rba_Nds_TransmitSignalNetworkPort_IMU_D_VehAccel_Y_ST3: rba_Nds_InitValue=0, rba_Nds_SignalInstanceRef=rba_Nds_SignalInstance_IMU_D_VehAccel_Y_ST3
                rba_Nds_TransmitSignalNetworkPort_IMU_D_VehAccel_Y_Stat_ST3: rba_Nds_InitValue=0, rba_Nds_SignalInstanceRef=rba_Nds_SignalInstance_IMU_D_VehAccel_Y_Stat_ST3
                rba_Nds_TransmitSignalNetworkPort_IMU_D_VehAccel_Z_ST3: rba_Nds_InitValue=0, rba_Nds_SignalInstanceRef=rba_Nds_SignalInstance_IMU_D_VehAccel_Z_ST3
                rba_Nds_TransmitSignalNetworkPort_IMU_D_VehAccel_Z_Stat_ST3: rba_Nds_InitValue=0, rba_Nds_SignalInstanceRef=rba_Nds_SignalInstance_IMU_D_VehAccel_Z_Stat_ST3
                rba_Nds_TransmitSignalNetworkPort_IMU_D_VehDynData_TmSyncStat_ST3: rba_Nds_InitValue=3, rba_Nds_SignalInstanceRef=rba_Nds_SignalInstance_IMU_D_VehDynData_TmSyncStat_ST3
                rba_Nds_TransmitSignalNetworkPort_IMU_D_VehPitch_Accel_ST3: rba_Nds_InitValue=0, rba_Nds_SignalInstanceRef=rba_Nds_SignalInstance_IMU_D_VehPitch_Accel_ST3
                rba_Nds_TransmitSignalNetworkPort_IMU_D_VehPitchAccel_Stat_ST3: rba_Nds_InitValue=0, rba_Nds_SignalInstanceRef=rba_Nds_SignalInstance_IMU_D_VehPitchAccel_Stat_ST3
                rba_Nds_TransmitSignalNetworkPort_IMU_D_VehPitchRate_ST3: rba_Nds_InitValue=0, rba_Nds_SignalInstanceRef=rba_Nds_SignalInstance_IMU_D_VehPitchRate_ST3
                rba_Nds_TransmitSignalNetworkPort_IMU_D_VehPitchRate_Stat_ST3: rba_Nds_InitValue=0, rba_Nds_SignalInstanceRef=rba_Nds_SignalInstance_IMU_D_VehPitchRate_Stat_ST3
                rba_Nds_TransmitSignalNetworkPort_IMU_D_VehRollAccel_ST3: rba_Nds_InitValue=0, rba_Nds_SignalInstanceRef=rba_Nds_SignalInstance_IMU_D_VehRollAccel_ST3
                rba_Nds_TransmitSignalNetworkPort_IMU_D_VehRollAccel_Stat_ST3: rba_Nds_InitValue=0, rba_Nds_SignalInstanceRef=rba_Nds_SignalInstance_IMU_D_VehRollAccel_Stat_ST3
                rba_Nds_TransmitSignalNetworkPort_IMU_D_VehRollRate_ST3: rba_Nds_InitValue=0, rba_Nds_SignalInstanceRef=rba_Nds_SignalInstance_IMU_D_VehRollRate_ST3
                rba_Nds_TransmitSignalNetworkPort_IMU_D_VehRollRate_Stat_ST3: rba_Nds_InitValue=0, rba_Nds_SignalInstanceRef=rba_Nds_SignalInstance_IMU_D_VehRollRate_Stat_ST3
                rba_Nds_TransmitSignalNetworkPort_IMU_D_VehYawAccel_ST3: rba_Nds_InitValue=0, rba_Nds_SignalInstanceRef=rba_Nds_SignalInstance_IMU_D_VehYawAccel_ST3
                rba_Nds_TransmitSignalNetworkPort_IMU_D_VehYawAccel_Stat_ST3: rba_Nds_InitValue=0, rba_Nds_SignalInstanceRef=rba_Nds_SignalInstance_IMU_D_VehYawAccel_Stat_ST3
                rba_Nds_TransmitSignalNetworkPort_IMU_D_VehYawRate_ST3: rba_Nds_InitValue=0, rba_Nds_SignalInstanceRef=rba_Nds_SignalInstance_IMU_D_VehYawRate_ST3
                rba_Nds_TransmitSignalNetworkPort_IMU_D_VehYawRate_Stat_ST3: rba_Nds_InitValue=0, rba_Nds_SignalInstanceRef=rba_Nds_SignalInstance_IMU_D_VehYawRate_Stat_ST3
                rba_Nds_TransmitSignalNetworkPort_SQC_PT4_Det05_IMU_D_Ctrl_Pr5_ST3: rba_Nds_InitValue=0, rba_Nds_SignalInstanceRef=rba_Nds_SignalInstance_SQC_PT4_Det05_IMU_D_Ctrl_Pr5_ST3
                rba_Nds_TransmitSignalNetworkPort_Rsrv01_PT4_Det05_IMU_D_Ctrl_Pr5_ST3: rba_Nds_InitValue=7, rba_Nds_SignalInstanceRef=rba_Nds_SignalInstance_Rsrv01_PT4_Det05_IMU_D_Ctrl_Pr5_ST3
                rba_Nds_TransmitSignalNetworkPort_Rsrv02_PT4_Det05_IMU_D_Ctrl_Pr5_ST3: rba_Nds_InitValue=255, rba_Nds_SignalInstanceRef=rba_Nds_SignalInstance_Rsrv02_PT4_Det05_IMU_D_Ctrl_Pr5_ST3
                rba_Nds_TransmitSignalNetworkPort_IMU_D_VehDynData_TmStmp_Sec_ST3: rba_Nds_InitValue=0, rba_Nds_SignalInstanceRef=rba_Nds_SignalInstance_IMU_D_VehDynData_TmStmp_Sec_ST3
                rba_Nds_TransmitSignalNetworkPort_IMU_D_VehDynData_TmStmp_NanoSec_ST3: rba_Nds_InitValue=0, rba_Nds_SignalInstanceRef=rba_Nds_SignalInstance_IMU_D_VehDynData_TmStmp_NanoSec_ST3
          rba_Nds_TransmitPdu_IMU_D_DRIVING_Container_Det05_ST3_dy2d9b7s08zan5fawxjxn67da
            rba_Nds_TransmitContainerPdu:
              rba_Nds_FirstContainedPduTrigger = false
              rba_Nds_SendTimeout = 5.0
              rba_Nds_TriggerMode = DIRECT
              rba_Nds_ContainerPduRef = rba_Nds_Pdu_IMU_D_DRIVING_Container_Det05_ST3_ContainerIPdu/rba_Nds_ContainerPdu
              rba_Nds_ContainedTransmitPduLinkageRef = rba_Nds_CanTransmitPduLinkage_IMU_D_DRIVING_Container_Det05_ST3_IMU_D_DRIVING_Container_Det05_ST3_PT4_Det05_IMU_D_Ctrl_ST3_1joxqmpavt6pujhrm2rp8u71k
          rba_Nds_TransmitPdu_IMU_D_DRIVING_Container_Det05_ST3_IMU_D_DRIVING_Container_Det05_ST3_PT4_Det05_IMU_D_Ctrl_ST3_secured
            rba_Nds_TransmitSecuredPdu:
              rba_Nds_AuthenticTransmitPduLinkageRef = rba_Nds_CanTransmitPduLinkage_IMU_D_DRIVING_Container_Det05_ST3_IMU_D_DRIVING_Container_Det05_ST3_PT4_Det05_IMU_D_Ctrl_ST3_23jvaq3ummpy3hlk0oahpkf34
              rba_Nds_SecuredPduRef = rba_Nds_SecuredPdu
              rba_Nds_ContainedTxPduProperties: rba_Nds_CollectionSemantics=LAST_IS_BEST, rba_Nds_Trigger=ALWAYS
          rba_Nds_TransmitPdu_IMU_D_Driving_Container1_ST3_8jj3uqqyg57q3fi1o8xl6in62
            rba_Nds_TransmitContainerPdu:
              rba_Nds_FirstContainedPduTrigger = false
              rba_Nds_SendTimeout = 10.0
              rba_Nds_TriggerMode = DIRECT
              rba_Nds_SizeThreshold = 59
              rba_Nds_ContainedTransmitPduLinkageRef = rba_Nds_CanTransmitPduLinkage_IMU_D_Driving_Container1_ST3_IMU_D_Driving_Container1_ST3_IMU_D_Stat_ST3_7r5emjrjqifhmoluyjdx39vet
              rba_Nds_ContainerPduRef = rba_Nds_Pdu_IMU_D_Driving_Container1_ST3_ContainerIPdu/rba_Nds_ContainerPdu
      rba_Nds_EcuProcesses
        rba_Nds_EcuTransmitProcess_5ms (rba_Nds_EcuTransmitProcess): rba_Nds_IsDefaultProcess=true, rba_Nds_Name=ComScl_Tx_Proc_5ms, rba_Nds_Period=5
      12 x rba_Nds_PduGroup:
        rba_Nds_PduGroup_IMU_B_HAD_IMU_Tx_PNC_All_Active: rba_Nds_Name=IPG_IMU_B_HAD_IMU_Tx_PNC_All_Active_CAN
        rba_Nds_PduGroup_IMU_B_IMU_INTERNAL_Tx_PNC_All_Active: rba_Nds_Name=IPG_IMU_B_IMU_INTERNAL_Tx_PNC_All_Active_CAN
        rba_Nds_PduGroup_IMU_B_IMU_INTERNAL_Rx_PNC_All_Active: rba_Nds_Name=IPG_IMU_B_IMU_INTERNAL_Rx_PNC_All_Active_CAN
        rba_Nds_PduGroup_IMU_B_IMU_INTERNAL_Rx_PNC_15_ComCtrl: rba_Nds_Name=IPG_IMU_B_IMU_INTERNAL_Rx_PNC_15_ComCtrl_CAN
        rba_Nds_PduGroup_IMU_B_IMU_INTERNAL_Rx_PNC_20: rba_Nds_Name=IPG_IMU_B_IMU_INTERNAL_Rx_PNC_20_CAN
        rba_Nds_PduGroup_IMU_B_DRIVING_Tx_PNC_All_Active: rba_Nds_Name=IPG_IMU_B_IMU_B_DRIVING_CAN_Tx_PNC_All_Active_CAN
        rba_Nds_PduGroup_IMU_B_DRIVING_Tx_PNC_20: rba_Nds_Name=IPG_IMU_B_IMU_B_DRIVING_CAN_Tx_PNC_20_CAN
        rba_Nds_PduGroup_IMU_B_DRIVING_Tx_PNC_23: rba_Nds_Name=IPG_IMU_B_DRIVING_Tx_PNC_23_CAN
        rba_Nds_PduGroup_IMU_B_HAD_IMU_Tx_PNC_23: rba_Nds_Name=IPG_IMU_B_HAD_IMU_Tx_PNC_23_CAN
        rba_Nds_PduGroup_IMU_B_IMU_INTERNAL_Tx_PNC_23: rba_Nds_Name=IPG_IMU_B_IMU_INTERNAL_Tx_PNC_23_CAN
        rba_Nds_PduGroup_IMU_B_IMU_INTERNAL_Rx_PNC_23: rba_Nds_Name=IPG_IMU_B_IMU_INTERNAL_Rx_PNC_23_CAN
        rba_Nds_PduGroup_TxMess_IMU_B_DRIVING: rba_Nds_Name=IPG_TxMess_IMU_B_DRIVING_CAN
      rba_Nds_SignalProcessing
        27 x rba_Nds_TransmitSignalProcessing:
          rba_Nds_TransmitSignalProcessing_CRC_PT4_Det05_IMU_D_Ctrl_Pr5_ST3: rba_Nds_TransmitApplicationPortRef=rba_Nds_TransmitGroupSignalApplicationPort_CRC_PT4_Det05_IMU_D_Ctrl_Pr5_ST3, rba_Nds_TransmitNetworkPortRef=rba_Nds_TransmitSignalNetworkPort_CRC_PT4_Det05_IMU_D_Ctrl_Pr5_ST3
          rba_Nds_TransmitSignalProcessing_SQC_PT4_Det05_IMU_D_Ctrl_Pr5_ST3: rba_Nds_TransmitApplicationPortRef=rba_Nds_TransmitGroupSignalApplicationPort_SQC_PT4_Det05_IMU_D_Ctrl_Pr5_ST3, rba_Nds_TransmitNetworkPortRef=rba_Nds_TransmitSignalNetworkPort_SQC_PT4_Det05_IMU_D_Ctrl_Pr5_ST3
          rba_Nds_TransmitSignalProcessing_IMU_D_VehAccel_X_Stat_ST3: rba_Nds_TransmitApplicationPortRef=rba_Nds_TransmitGroupSignalApplicationPort_IMU_D_VehAccel_X_Stat_ST3, rba_Nds_TransmitNetworkPortRef=rba_Nds_TransmitSignalNetworkPort_IMU_D_VehAccel_X_Stat_ST3
          rba_Nds_TransmitSignalProcessing_IMU_D_VehRollRate_Stat_ST3: rba_Nds_TransmitApplicationPortRef=rba_Nds_TransmitGroupSignalApplicationPort_IMU_D_VehRollRate_Stat_ST3, rba_Nds_TransmitNetworkPortRef=rba_Nds_TransmitSignalNetworkPort_IMU_D_VehRollRate_Stat_ST3
          rba_Nds_TransmitSignalProcessing_IMU_D_VehRollAccel_Stat_ST3: rba_Nds_TransmitApplicationPortRef=rba_Nds_TransmitGroupSignalApplicationPort_IMU_D_VehRollAccel_Stat_ST3, rba_Nds_TransmitNetworkPortRef=rba_Nds_TransmitSignalNetworkPort_IMU_D_VehRollAccel_Stat_ST3
          rba_Nds_TransmitSignalProcessing_IMU_D_VehAccel_Y_Stat_ST3: rba_Nds_TransmitApplicationPortRef=rba_Nds_TransmitGroupSignalApplicationPort_IMU_D_VehAccel_Y_Stat_ST3, rba_Nds_TransmitNetworkPortRef=rba_Nds_TransmitSignalNetworkPort_IMU_D_VehAccel_Y_Stat_ST3
          rba_Nds_TransmitSignalProcessing_IMU_D_VehYawRate_Stat_ST3: rba_Nds_TransmitApplicationPortRef=rba_Nds_TransmitGroupSignalApplicationPort_IMU_D_VehYawRate_Stat_ST3, rba_Nds_TransmitNetworkPortRef=rba_Nds_TransmitSignalNetworkPort_IMU_D_VehYawRate_Stat_ST3
          rba_Nds_TransmitSignalProcessing_IMU_D_VehYawAccel_Stat_ST3: rba_Nds_TransmitApplicationPortRef=rba_Nds_TransmitGroupSignalApplicationPort_IMU_D_VehYawAccel_Stat_ST3, rba_Nds_TransmitNetworkPortRef=rba_Nds_TransmitSignalNetworkPort_IMU_D_VehYawAccel_Stat_ST3
          rba_Nds_TransmitSignalProcessing_IMU_D_VehAccel_Z_Stat_ST3: rba_Nds_TransmitApplicationPortRef=rba_Nds_TransmitGroupSignalApplicationPort_IMU_D_VehAccel_Z_Stat_ST3, rba_Nds_TransmitNetworkPortRef=rba_Nds_TransmitSignalNetworkPort_IMU_D_VehAccel_Z_Stat_ST3
          rba_Nds_TransmitSignalProcessing_IMU_D_VehPitchRate_Stat_ST3: rba_Nds_TransmitApplicationPortRef=rba_Nds_TransmitGroupSignalApplicationPort_IMU_D_VehPitchRate_Stat_ST3, rba_Nds_TransmitNetworkPortRef=rba_Nds_TransmitSignalNetworkPort_IMU_D_VehPitchRate_Stat_ST3
          rba_Nds_TransmitSignalProcessing_IMU_D_VehPitchAccel_Stat_ST3: rba_Nds_TransmitApplicationPortRef=rba_Nds_TransmitGroupSignalApplicationPort_IMU_D_VehPitchAccel_Stat_ST3, rba_Nds_TransmitNetworkPortRef=rba_Nds_TransmitSignalNetworkPort_IMU_D_VehPitchAccel_Stat_ST3
          rba_Nds_TransmitSignalProcessing_IMU_D_VehAccel_X_ST3: rba_Nds_TransmitApplicationPortRef=rba_Nds_TransmitGroupSignalApplicationPort_IMU_D_VehAccel_X_ST3, rba_Nds_TransmitNetworkPortRef=rba_Nds_TransmitSignalNetworkPort_IMU_D_VehAccel_X_ST3
          rba_Nds_TransmitSignalProcessing_IMU_D_VehRollRate_ST3: rba_Nds_TransmitApplicationPortRef=rba_Nds_TransmitGroupSignalApplicationPort_IMU_D_VehRollRate_ST3, rba_Nds_TransmitNetworkPortRef=rba_Nds_TransmitSignalNetworkPort_IMU_D_VehRollRate_ST3
          rba_Nds_TransmitSignalProcessing_IMU_D_VehRollAccel_ST3: rba_Nds_TransmitApplicationPortRef=rba_Nds_TransmitGroupSignalApplicationPort_IMU_D_VehRollAccel_ST3, rba_Nds_TransmitNetworkPortRef=rba_Nds_TransmitSignalNetworkPort_IMU_D_VehRollAccel_ST3
          rba_Nds_TransmitSignalProcessing_IMU_D_VehAccel_Y_ST3: rba_Nds_TransmitApplicationPortRef=rba_Nds_TransmitGroupSignalApplicationPort_IMU_D_VehAccel_Y_ST3, rba_Nds_TransmitNetworkPortRef=rba_Nds_TransmitSignalNetworkPort_IMU_D_VehAccel_Y_ST3
          rba_Nds_TransmitSignalProcessing_IMU_D_VehYawRate_ST3: rba_Nds_TransmitApplicationPortRef=rba_Nds_TransmitGroupSignalApplicationPort_IMU_D_VehYawRate_ST3, rba_Nds_TransmitNetworkPortRef=rba_Nds_TransmitSignalNetworkPort_IMU_D_VehYawRate_ST3
          rba_Nds_TransmitSignalProcessing_IMU_D_VehYawAccel_ST3: rba_Nds_TransmitApplicationPortRef=rba_Nds_TransmitGroupSignalApplicationPort_IMU_D_VehYawAccel_ST3, rba_Nds_TransmitNetworkPortRef=rba_Nds_TransmitSignalNetworkPort_IMU_D_VehYawAccel_ST3
          rba_Nds_TransmitSignalProcessing_IMU_D_VehAccel_Z_ST3: rba_Nds_TransmitApplicationPortRef=rba_Nds_TransmitGroupSignalApplicationPort_IMU_D_VehAccel_Z_ST3, rba_Nds_TransmitNetworkPortRef=rba_Nds_TransmitSignalNetworkPort_IMU_D_VehAccel_Z_ST3
          rba_Nds_TransmitSignalProcessing_IMU_D_VehPitchRate_ST3: rba_Nds_TransmitApplicationPortRef=rba_Nds_TransmitGroupSignalApplicationPort_IMU_D_VehPitchRate_ST3, rba_Nds_TransmitNetworkPortRef=rba_Nds_TransmitSignalNetworkPort_IMU_D_VehPitchRate_ST3
          rba_Nds_TransmitSignalProcessing_IMU_D_VehPitch_Accel_ST3: rba_Nds_TransmitApplicationPortRef=rba_Nds_TransmitGroupSignalApplicationPort_IMU_D_VehPitch_Accel_ST3, rba_Nds_TransmitNetworkPortRef=rba_Nds_TransmitSignalNetworkPort_IMU_D_VehPitch_Accel_ST3
          rba_Nds_TransmitSignalProcessing_IMU_D_VehDynData_TmSyncStat_ST3: rba_Nds_TransmitApplicationPortRef=rba_Nds_TransmitGroupSignalApplicationPort_IMU_D_VehDynData_TmSyncStat_ST3, rba_Nds_TransmitNetworkPortRef=rba_Nds_TransmitSignalNetworkPort_IMU_D_VehDynData_TmSyncStat_ST3
          rba_Nds_TransmitSignalProcessing_Rsrv01_PT4_Det05_IMU_D_Ctrl_Pr5_ST3: rba_Nds_TransmitApplicationPortRef=rba_Nds_TransmitGroupSignalApplicationPort_Rsrv01_PT4_Det05_IMU_D_Ctrl_Pr5_ST3, rba_Nds_TransmitNetworkPortRef=rba_Nds_TransmitSignalNetworkPort_Rsrv01_PT4_Det05_IMU_D_Ctrl_Pr5_ST3
          rba_Nds_TransmitSignalProcessing_Rsrv02_PT4_Det05_IMU_D_Ctrl_Pr5_ST3: rba_Nds_TransmitApplicationPortRef=rba_Nds_TransmitGroupSignalApplicationPort_Rsrv02_PT4_Det05_IMU_D_Ctrl_Pr5_ST3, rba_Nds_TransmitNetworkPortRef=rba_Nds_TransmitSignalNetworkPort_Rsrv02_PT4_Det05_IMU_D_Ctrl_Pr5_ST3
          rba_Nds_TransmitSignalProcessing_IMU_D_Id_ST3: rba_Nds_TransmitApplicationPortRef=rba_Nds_TransmitGroupSignalApplicationPort_IMU_D_Id_ST3, rba_Nds_TransmitNetworkPortRef=rba_Nds_TransmitSignalNetworkPort_IMU_D_Id_ST3
          rba_Nds_TransmitSignalProcessing_IMU_D_VehYawRateSens_Temp_ST3: rba_Nds_TransmitApplicationPortRef=rba_Nds_TransmitGroupSignalApplicationPort_IMU_D_VehYawRateSens_Temp_ST3, rba_Nds_TransmitNetworkPortRef=rba_Nds_TransmitSignalNetworkPort_IMU_D_VehYawRateSens_Temp_ST3
          rba_Nds_TransmitSignalProcessing_IMU_D_VehDynData_TmStmp_Sec_ST3: rba_Nds_TransmitApplicationPortRef=rba_Nds_TransmitGroupSignalApplicationPort_IMU_D_VehDynData_TmStmp_Sec_ST3, rba_Nds_TransmitNetworkPortRef=rba_Nds_TransmitSignalNetworkPort_IMU_D_VehDynData_TmStmp_Sec_ST3
          rba_Nds_TransmitSignalProcessing_IMU_D_VehDynData_TmStmp_NanoSec_ST3: rba_Nds_TransmitApplicationPortRef=rba_Nds_TransmitGroupSignalApplicationPort_IMU_D_VehDynData_TmStmp_NanoSec_ST3, rba_Nds_TransmitNetworkPortRef=rba_Nds_TransmitSignalNetworkPort_IMU_D_VehDynData_TmStmp_NanoSec_ST3
    rba_Nds_Project: rba_Nds_Baseline=01.2020, rba_Nds_Department=CAP-SST/ESA2, rba_Nds_Editor=rba_Nds, rba_Nds_ProjectName=MyProject
  module config rba_Nds_Cc: implementation-config-variant=VARIANT-PRE-COMPILE
    rba_Nds_Cc_NdsApplicationPortMappings
      rba_Nds_Cc_NdsTransmitSignalGroupApplicationPortMapping_IMU_D_Stat_ST3 (rba_Nds_Cc_NdsTransmitSignalGroupApplicationPortMapping):
        rba_Nds_Cc_MessageInterfaceType = RBMESG
        rba_Nds_Cc_NdsTransmitSignalGroupApplicationPortRef = rba_Nds_TransmitSignalGroupApplicationPort_PT4_Det05_IMU_D_Ctrl_ST3
      rba_Nds_Cc_NdsTransmitSignalGroupApplicationPortMapping_PT4_Det05_IMU_D_Ctrl_ST3 (rba_Nds_Cc_NdsTransmitSignalGroupApplicationPortMapping):
        rba_Nds_Cc_MessageInterfaceType = RBMESG
        rba_Nds_Cc_NdsTransmitSignalGroupApplicationPortRef = rba_Nds_TransmitSignalGroupApplicationPort_IMU_D_Stat_ST3
    rba_Nds_Cc_PduProtections
    rba_Nds_Cc_SignalGroupProtections
      rba_Nds_Cc_TransmitSignalGroupProtection_IMU_D_DRIVING_Container_Det05_ST3_PT4_Det05_IMU_D_Ctrl_ST3 (rba_Nds_Cc_TransmitSignalGroupProtection):
        rba_Nds_Cc_ProcessingAssignment = TRANSMIT
        rba_Nds_Cc_TransmitSignalGroupNetworkPortRef = rba_Nds_TransmitSignalGroupNetworkPort_PT4_Det05_IMU_D_Ctrl_Pr5_ST3_9ibx3pdl90d59keo4mo66if6x
        rba_Nds_Cc_Checksum
          rba_Nds_Cc_Function: rba_Nds_Cc_Name=e2e_p05
        rba_Nds_Cc_Counter
          rba_Nds_Cc_Function: rba_Nds_Cc_Name=e2e_p05
