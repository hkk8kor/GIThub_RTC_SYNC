AUTOSAR XML (schema 4-2-2)
package /RB/UBK/Project/EcucModuleConfigurationValuess
  module config BswM
    BswMConfig_0 (BswMConfig)
      BswMArbitration
        8 x BswMLogicalExpression:
          LE_PNC_8_PNC_REQUESTED: BswMArgumentRef=MC_PNC_8_PNC_REQUESTED
          LE_PNC_28_PNC_REQUESTED: BswMArgumentRef=MC_PNC_28_PNC_REQUESTED
          LE_PNC_23_PNC_REQUESTED: BswMArgumentRef=MC_PNC_23_PNC_REQUESTED
          LE_PNC_31_PNC_REQUESTED: BswMArgumentRef=MC_PNC_31_PNC_REQUESTED
          LE_PNC_8_PNC_NO_COM: BswMArgumentRef=MC_PNC_8_PNC_NO_COM
          LE_PNC_28_PNC_NO_COM: BswMArgumentRef=MC_PNC_28_PNC_NO_COM
          LE_PNC_23_PNC_NO_COM: BswMArgumentRef=MC_PNC_23_PNC_NO_COM
          LE_PNC_31_PNC_NO_COM: BswMArgumentRef=MC_PNC_31_PNC_NO_COM
        8 x BswMModeCondition, all with BswMConditionType=BSWM_EQUALS:
          MC_PNC_8_PNC_REQUESTED: BswMConditionMode=MRP_ComMPnc_PNC_8
            BswMConditionValue
              BswMBswMode: BswMBswRequestedMode=COMM_PNC_REQUESTED
          MC_PNC_8_PNC_NO_COM: BswMConditionMode=MRP_ComMPnc_PNC_8
            BswMConditionValue
              BswMBswMode: BswMBswRequestedMode=COMM_PNC_NO_COMMUNICATION
          MC_PNC_28_PNC_REQUESTED: BswMConditionMode=MRP_ComMPnc_PNC_28
            BswMConditionValue
              BswMBswMode: BswMBswRequestedMode=COMM_PNC_REQUESTED
          MC_PNC_28_PNC_NO_COM: BswMConditionMode=MRP_ComMPnc_PNC_28
            BswMConditionValue
              BswMBswMode: BswMBswRequestedMode=COMM_PNC_NO_COMMUNICATION
          MC_PNC_23_PNC_REQUESTED: BswMConditionMode=MRP_ComMPnc_PNC_23
            BswMConditionValue
              BswMBswMode: BswMBswRequestedMode=COMM_PNC_REQUESTED
          MC_PNC_23_PNC_NO_COM: BswMConditionMode=MRP_ComMPnc_PNC_23
            BswMConditionValue
              BswMBswMode: BswMBswRequestedMode=COMM_PNC_NO_COMMUNICATION
          MC_PNC_31_PNC_REQUESTED: BswMConditionMode=MRP_ComMPnc_PNC_31
            BswMConditionValue
              BswMBswMode: BswMBswRequestedMode=COMM_PNC_REQUESTED
          MC_PNC_31_PNC_NO_COM: BswMConditionMode=MRP_ComMPnc_PNC_31
            BswMConditionValue
              BswMBswMode: BswMBswRequestedMode=COMM_PNC_NO_COMMUNICATION
        4 x BswMModeRequestPort, all with BswMRequestProcessing=BSWM_DEFERRED:
          MRP_ComMPnc_PNC_8
            BswMModeRequestSource
              BswMComMPncRequest: BswMComMPncRef=Id_8
          MRP_ComMPnc_PNC_28
            BswMModeRequestSource
              BswMComMPncRequest: BswMComMPncRef=Id_28
          MRP_ComMPnc_PNC_23
            BswMModeRequestSource
              BswMComMPncRequest: BswMComMPncRef=Id_23
          MRP_ComMPnc_PNC_31
            BswMModeRequestSource
              BswMComMPncRequest: BswMComMPncRef=Id_31
        8 x BswMRule, all with BswMRuleInitState=BSWM_UNDEFINED:
          RL_PNC_8_Enable_Ipdu: BswMRuleExpressionRef=LE_PNC_8_PNC_REQUESTED, BswMRuleTrueActionList=AL_PNC_8_Enabling_Ipdu
          RL_PNC_28_Enable_Ipdu: BswMRuleExpressionRef=LE_PNC_28_PNC_REQUESTED, BswMRuleTrueActionList=AL_PNC_28_Enabling_Ipdu
          RL_PNC_23_Enable_Ipdu: BswMRuleExpressionRef=LE_PNC_23_PNC_REQUESTED, BswMRuleTrueActionList=AL_PNC_23_Enabling_Ipdu
          RL_PNC_31_Enable_Ipdu: BswMRuleExpressionRef=LE_PNC_31_PNC_REQUESTED, BswMRuleTrueActionList=AL_PNC_31_Enabling_Ipdu
          RL_PNC_8_Disable_Ipdu: BswMRuleExpressionRef=LE_PNC_8_PNC_NO_COM, BswMRuleTrueActionList=AL_PNC_8_Disbling_Ipdu
          RL_PNC_28_Disable_Ipdu: BswMRuleExpressionRef=LE_PNC_28_PNC_NO_COM, BswMRuleTrueActionList=AL_PNC_28_Disabling_Ipdu
          RL_PNC_23_Disable_Ipdu: BswMRuleExpressionRef=LE_PNC_23_PNC_NO_COM, BswMRuleTrueActionList=AL_PNC_23_Disabling_Ipdu
          RL_PNC_31_Disable_Ipdu: BswMRuleExpressionRef=LE_PNC_31_PNC_NO_COM, BswMRuleTrueActionList=AL_PNC_31_Disbling_Ipdu
      BswMModeControl
        8 x BswMAction:
          AI_PNC_8_Enabling_Ipdu
            BswMAvailableActions
              BswMPduGroupSwitch:
                BswMPduGroupSwitchReinit = false
                BswMEnabledPduGroupRef = IPG_IMU_B_IMU_INTERNAL_Tx_PNC_All_Active_CAN
                BswMEnabledPduGroupRef = IPG_IMU_B_IMU_B_DRIVING_CAN_Tx_PNC_All_Active_CAN
                BswMEnabledPduGroupRef = IPG_IMU_B_HAD_IMU_Tx_PNC_All_Active_CAN
                BswMEnabledPduGroupRef = IPG_IMU_B_IMU_INTERNAL_Rx_PNC_All_Active_CAN
                BswMEnabledPduGroupRef = IPG_IMU_B_HAD_IMU_Rx_PNC_All_Active_CAN
          AI_PNC_8_Disabling_Ipdu
            BswMAvailableActions
              BswMPduGroupSwitch:
                BswMPduGroupSwitchReinit = false
                BswMDisabledPduGroupRef = IPG_IMU_B_IMU_INTERNAL_Tx_PNC_All_Active_CAN
                BswMDisabledPduGroupRef = IPG_IMU_B_IMU_B_DRIVING_CAN_Tx_PNC_All_Active_CAN
                BswMDisabledPduGroupRef = IPG_IMU_B_HAD_IMU_Tx_PNC_All_Active_CAN
                BswMDisabledPduGroupRef = IPG_IMU_B_IMU_INTERNAL_Rx_PNC_All_Active_CAN
                BswMDisabledPduGroupRef = IPG_IMU_B_HAD_IMU_Rx_PNC_All_Active_CAN
          AI_PNC_28_Disabling_Ipdu
            BswMAvailableActions
              BswMPduGroupSwitch:
                BswMPduGroupSwitchReinit = false
                BswMDisabledPduGroupRef = IPG_IMU_B_IMU_B_DRIVING_CAN_Tx_PNC_20_CAN
                BswMDisabledPduGroupRef = IPG_IMU_B_IMU_INTERNAL_Tx_PNC_20_CAN
                BswMDisabledPduGroupRef = IPG_IMU_B_IMU_INTERNAL_Rx_PNC_20_CAN
                BswMDisabledPduGroupRef = IPG_IMU_B_HAD_IMU_Tx_PNC_20_CAN
                BswMDisabledPduGroupRef = IPG_IMU_B_HAD_IMU_Rx_PNC_20_CAN
          AI_PNC_23_Disabling_Ipdu
            BswMAvailableActions
              BswMPduGroupSwitch: BswMPduGroupSwitchReinit=false, BswMDisabledPduGroupRef=IPG_IMU_B_IMU_INTERNAL_Rx_PNC_15_ComCtrl_CAN
          AI_PNC_28_Enabling_Ipdu
            BswMAvailableActions
              BswMPduGroupSwitch:
                BswMPduGroupSwitchReinit = false
                BswMEnabledPduGroupRef = IPG_IMU_B_IMU_B_DRIVING_CAN_Tx_PNC_20_CAN
                BswMEnabledPduGroupRef = IPG_IMU_B_IMU_INTERNAL_Tx_PNC_20_CAN
                BswMEnabledPduGroupRef = IPG_IMU_B_IMU_INTERNAL_Rx_PNC_20_CAN
                BswMEnabledPduGroupRef = IPG_IMU_B_HAD_IMU_Tx_PNC_20_CAN
                BswMEnabledPduGroupRef = IPG_IMU_B_HAD_IMU_Rx_PNC_20_CAN
          AI_PNC_23_Enabling_Ipdu
            BswMAvailableActions
              BswMPduGroupSwitch: BswMPduGroupSwitchReinit=false, BswMEnabledPduGroupRef=IPG_IMU_B_IMU_INTERNAL_Rx_PNC_15_ComCtrl_CAN
          AI_PNC_31_Enabling_Ipdu
            BswMAvailableActions
              BswMPduGroupSwitch:
                BswMPduGroupSwitchReinit = false
                BswMEnabledPduGroupRef = IPG_IMU_B_IMU_INTERNAL_Tx_PNC_23_CAN
                BswMEnabledPduGroupRef = IPG_IMU_B_HAD_IMU_Rx_PNC_23_CAN
                BswMEnabledPduGroupRef = IPG_IMU_B_DRIVING_Tx_PNC_23_CAN
                BswMEnabledPduGroupRef = IPG_IMU_B_IMU_INTERNAL_Rx_PNC_23_CAN
                BswMEnabledPduGroupRef = IPG_IMU_B_HAD_IMU_Tx_PNC_23_CAN
          AI_PNC_31_Disabling_Ipdu
            BswMAvailableActions
              BswMPduGroupSwitch:
                BswMPduGroupSwitchReinit = false
                BswMDisabledPduGroupRef = IPG_IMU_B_IMU_INTERNAL_Tx_PNC_23_CAN
                BswMDisabledPduGroupRef = IPG_IMU_B_HAD_IMU_Rx_PNC_23_CAN
                BswMDisabledPduGroupRef = IPG_IMU_B_DRIVING_Tx_PNC_23_CAN
                BswMDisabledPduGroupRef = IPG_IMU_B_IMU_INTERNAL_Rx_PNC_23_CAN
                BswMDisabledPduGroupRef = IPG_IMU_B_HAD_IMU_Tx_PNC_23_CAN
        8 x BswMActionList, all with BswMActionListExecution=BSWM_CONDITION:
          AL_PNC_8_Enabling_Ipdu
            BswMActionListItem_0 (BswMActionListItem): BswMAbortOnFail=false, BswMActionListItemIndex=0, BswMActionListItemRef=AI_PNC_8_Enabling_Ipdu
          AL_PNC_8_Disbling_Ipdu
            BswMActionListItem_0 (BswMActionListItem): BswMAbortOnFail=false, BswMActionListItemIndex=0, BswMActionListItemRef=AI_PNC_8_Disabling_Ipdu
          AL_PNC_23_Enabling_Ipdu
            BswMActionListItem_0 (BswMActionListItem): BswMAbortOnFail=false, BswMActionListItemIndex=0, BswMActionListItemRef=AI_PNC_23_Enabling_Ipdu
          AL_PNC_23_Disabling_Ipdu
            BswMActionListItem_0 (BswMActionListItem): BswMAbortOnFail=false, BswMActionListItemIndex=0, BswMActionListItemRef=AI_PNC_23_Disabling_Ipdu
          AL_PNC_28_Enabling_Ipdu
            BswMActionListItem_0 (BswMActionListItem): BswMAbortOnFail=false, BswMActionListItemIndex=0, BswMActionListItemRef=AI_PNC_28_Enabling_Ipdu
          AL_PNC_28_Disabling_Ipdu
            BswMActionListItem_0 (BswMActionListItem): BswMAbortOnFail=false, BswMActionListItemIndex=0, BswMActionListItemRef=AI_PNC_28_Disabling_Ipdu
          AL_PNC_31_Enabling_Ipdu
            BswMActionListItem_0 (BswMActionListItem): BswMAbortOnFail=false, BswMActionListItemIndex=0, BswMActionListItemRef=AI_PNC_31_Enabling_Ipdu
          AL_PNC_31_Disbling_Ipdu
            BswMActionListItem_0 (BswMActionListItem): BswMAbortOnFail=false, BswMActionListItemIndex=0, BswMActionListItemRef=AI_PNC_31_Disabling_Ipdu
