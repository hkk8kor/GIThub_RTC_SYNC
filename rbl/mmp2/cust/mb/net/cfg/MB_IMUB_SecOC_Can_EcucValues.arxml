AUTOSAR XML (schema 4-2-2)
package /RB/UBK/Project/EcucModuleConfigurationValuess
  module config PduR
    SecOC (PduRBswModules):
      PduRCancelReceive = false
      PduRCancelTransmit = false
      PduRCommunicationInterface = true
      PduRLowerModule = true
      PduRTransportProtocol = true
      PduRTriggertransmit = true
      PduRTxConfirmation = true
      PduRUpperModule = true
      PduRBswModuleRef = SecOC
  module config SecOC
    Tx_IMU_B_Output_Fast_ST3_secured_HAD_IMU_CAN (SecOCTxPduProcessing):
      SecOCFreshnessValueLength = 40
      SecOCDataId = 36544
      SecOCFreshnessValueTruncLength = 8
      SecOCProvideTxTruncatedFreshnessValue = true
      SecOCFreshnessValueId = 1
      SecOCAuthInfoTruncLength = 24
      SecOCRbTxPduCryptIF = Csm_rba_CryptoHSM
      SecOCRbTxCryptMode = synchronous
      SecOCRbTxCryptAlgoSecondFamily = AES
      SecOCRbTxCryptAlgoMode = CMAC
      SecOCRbTxCryptAlgoFamily = AES
      SecOCUseTxConfirmation = true
      SecOCRbClearBufferAfterTransmit = true
      SecOCAuthenticationBuildAttempts = 0
      SecOCTxPduUnusedAreasDefault = 0
      SecOCReAuthenticateAfterTriggerTransmit = false
      SecOCReAuthenticateAfterTriggerTransmit = false
      SecOCTxAuthenticPduLayer: SecOCTxAuthenticLayerPduRef=IMU_B_Output_Fast_ST3_PduR2SecOC
      SecOCTxSecuredPduLayer
        SecOCTxSecuredPdu: SecOCTxSecuredLayerPduRef=IMU_B_Output_Fast_ST3_secured_SecOC2PduR
    Rx_Ign_Stat_ST3_secured_IMU_INTERNAL_CAN (SecOCRxPduProcessing):
      SecOCFreshnessValueLength = 40
      SecOCDataId = 28212
      SecOCAuthenticationVerifyAttempts = 0
      SecOCFreshnessValueTruncLength = 8
      SecOCFreshnessValueId = 1
      SecOCAuthInfoTruncLength = 24
      SecOCRbRxCryptAlgoFamily = AES
      SecOCRbRxCryptAlgoMode = CMAC
      SecOCRbRxCryptAlgoSecondFamily = AES
      SecOCRbRxPduCryptIF = Csm_rba_CryptoHSM
      SecOCRbRxCryptMode = synchronous
      SecOCReceptionOverflowStrategy = QUEUE
      SecOCReceptionQueueSize = 1
      SecOCVerificationStatusPropagationMode = FAILURE_ONLY
      SecOCUseAuthDataFreshness = false
      SecOCRxAuthenticPduLayer: SecOCRxAuthenticLayerPduRef=Ign_Stat_ST3_SecOC2PduR
      SecOCRxSecuredPduLayer
        SecOCRxSecuredPdu: SecOCSecuredRxPduVerification=true, SecOCRxSecuredLayerPduRef=Ign_Stat_ST3_secured_PduR2SecOC
    Rx_BCS_Whl_Msg1_BTC_ST3_secured_IMU_INTERNAL_CAN (SecOCRxPduProcessing):
      SecOCFreshnessValueLength = 40
      SecOCDataId = 1270
      SecOCAuthenticationVerifyAttempts = 0
      SecOCFreshnessValueTruncLength = 8
      SecOCFreshnessValueId = 1
      SecOCAuthInfoTruncLength = 24
      SecOCRbRxCryptAlgoFamily = AES
      SecOCRbRxCryptAlgoMode = CMAC
      SecOCRbRxCryptAlgoSecondFamily = AES
      SecOCRbRxPduCryptIF = Csm_rba_CryptoHSM
      SecOCRbRxCryptMode = synchronous
      SecOCReceptionOverflowStrategy = QUEUE
      SecOCReceptionQueueSize = 1
      SecOCUseAuthDataFreshness = false
      SecOCVerificationStatusPropagationMode = FAILURE_ONLY
      SecOCRxAuthenticPduLayer: SecOCRxAuthenticLayerPduRef=BCS_Whl_Msg1_BTC_ST3_SecOC2PduR
      SecOCRxSecuredPduLayer
        SecOCRxSecuredPdu: SecOCSecuredRxPduVerification=true, SecOCRxSecuredLayerPduRef=BCS_Whl_Msg1_BTC_ST3_secured_PduR2SecOC
    Tx_IMU_B_Output_ST3_secured_IMU_INTERNAL_CAN (SecOCTxPduProcessing):
      SecOCFreshnessValueLength = 40
      SecOCDataId = 46116
      SecOCFreshnessValueTruncLength = 8
      SecOCProvideTxTruncatedFreshnessValue = true
      SecOCFreshnessValueId = 1
      SecOCAuthInfoTruncLength = 24
      SecOCRbTxCryptAlgoFamily = AES
      SecOCRbTxCryptAlgoMode = CMAC
      SecOCRbTxCryptAlgoSecondFamily = AES
      SecOCRbTxPduCryptIF = Csm_rba_CryptoHSM
      SecOCRbTxCryptMode = synchronous
      SecOCTxPduUnusedAreasDefault = 0
      SecOCAuthenticationBuildAttempts = 0
      SecOCUseTxConfirmation = true
      SecOCRbClearBufferAfterTransmit = true
      SecOCReAuthenticateAfterTriggerTransmit = false
      SecOCTxAuthenticPduLayer: SecOCTxAuthenticLayerPduRef=IMU_B_Output_ST3_PduR2SecOC
      SecOCTxSecuredPduLayer
        SecOCTxSecuredPdu: SecOCTxSecuredLayerPduRef=IMU_B_Output_ST3_secured_SecOC2PduR
    3 x SecOCRxPduProcessing, all with SecOCAuthInfoTruncLength=24, SecOCRbRxCryptAlgoFamily=AES, SecOCRbRxCryptAlgoMode=CMAC, SecOCRbRxCryptAlgoSecondFamily=AES, SecOCRbRxPduCryptIF=Csm_rba_CryptoHSM, SecOCRbRxCryptMode=synchronous, SecOCFreshnessValueId=1, SecOCFreshnessValueLength=40, SecOCFreshnessValueTruncLength=8, SecOCAuthenticationVerifyAttempts=0, SecOCReceptionOverflowStrategy=QUEUE, SecOCReceptionQueueSize=1, SecOCUseAuthDataFreshness=false, SecOCVerificationStatusPropagationMode=FAILURE_ONLY:
      Rx_ADAS_HAD_Stat_IDC_M_FSI_ST3_secured_HAD_IMU_CAN: SecOCDataId=28326
        SecOCRxAuthenticPduLayer: SecOCRxAuthenticLayerPduRef=IDC_M_FSI_HAD_IMU_Container_ST3_ADAS_HAD_Stat_IDC_M_FSI_ST3_SecOC2PduR
        SecOCRxSecuredPduLayer
          SecOCRxSecuredPdu:
            SecOCSecuredRxPduVerification = true
            SecOCRxSecuredLayerPduRef = IDC_M_FSI_HAD_IMU_Container_ST3_IDC_M_FSI_HAD_IMU_Container_ST3_ADAS_HAD_Stat_IDC_M_FSI_ST3_secured_PduR2SecOC
      Rx_PT4_PTCoor4_ST3_secured_IMU_INTERNAL_CAN: SecOCDataId=26743
        SecOCRxAuthenticPduLayer: SecOCRxAuthenticLayerPduRef=PT4_PTCoor4_ST3_SecOC2PduR
        SecOCRxSecuredPduLayer
          SecOCRxSecuredPdu: SecOCSecuredRxPduVerification=true, SecOCRxSecuredLayerPduRef=PT4_PTCoor4_ST3_secured_PduR2SecOC
      Rx_PN14_Master_Stat1_ST3_secured_IMU_INTERNAL_CAN: SecOCDataId=57668
        SecOCRxAuthenticPduLayer: SecOCRxAuthenticLayerPduRef=PN14_Master_Stat1_ST3_SecOC2PduR
        SecOCRxSecuredPduLayer
          SecOCRxSecuredPdu: SecOCSecuredRxPduVerification=true, SecOCRxSecuredLayerPduRef=PN14_Master_Stat1_ST3_secured_PduR2SecOC
