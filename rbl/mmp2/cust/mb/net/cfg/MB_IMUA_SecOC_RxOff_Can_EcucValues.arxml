AUTOSAR XML (schema 4-2-2)
package /RB/UBK/Project/EcucModuleConfigurationValuess
  module config Can
    CanConfigSet
      6 x CanHardwareObject, all with CanFdPaddingValue=0, CanHandleType=FULL, CanIdType=STANDARD, CanMainFunctionRWPeriodRef=CanMainFunctionRWPeriods_5ms:
        ESP_HAD_BACKUP_GW_Container3_ST3_ESP_HAD_BACKUP_GW_Container3_ST3_22qnrsrd5p7i7sxhq5h7qa6eh_HAD_BACKUP_HAD_BACKUP_IN: CanObjectType=RECEIVE, CanControllerRef=CanIfControllerConfig_1
          CanHwFilter_312 (CanHwFilter): CanHwFilterCode=312, CanHwFilterMask=2047
        VSS_TP_Auth_ST3_VSS_TP_Auth_ST3_b0vczbv4viw3unw4ui2xxf7i9_IMU_INTERNAL_IMU_INTERNAL_OUT: CanObjectType=TRANSMIT, CanControllerRef=CanIfControllerConfig_0
        VSS_TP_RealTmOffset_ST3_VSS_TP_RealTmOffset_ST3_6pqq39zzkyaxjkhkpx4w6k2cd_IMU_INTERNAL_IMU_INTERNAL_OUT: CanObjectType=TRANSMIT, CanControllerRef=CanIfControllerConfig_0
        VSS_TP_SecTickCount_Lvl1_ST3_VSS_TP_SecTickCount_Lvl1_ST3_e35z9ulel939vqa575s89n6fb_IMU_INTERNAL_IMU_INTERNAL_OUT: CanObjectType=TRANSMIT, CanControllerRef=CanIfControllerConfig_0
        VSS_TP_VIN_ST3_VSS_TP_VIN_ST3_zo0ajku7bsc0uzxi9vkshgiq_IMU_INTERNAL_IMU_INTERNAL_OUT: CanObjectType=TRANSMIT, CanControllerRef=CanIfControllerConfig_0
        VSS_TP_SharedSecret_ST3_VSS_TP_SharedSecret_ST3_2qm4y40dwmslooj3ccjmc5rvn_IMU_INTERNAL_IMU_INTERNAL_OUT: CanObjectType=TRANSMIT, CanControllerRef=CanIfControllerConfig_0
  module config CanIf
    CanIfInitCfg
      5 x CanIfBufferCfg, all with CanIfBufferSize=0:
        Bu_VSS_TP_Auth_ST3_VSS_TP_Auth_ST3_b0vczbv4viw3unw4ui2xxf7i9_IMU_INTERNAL_IMU_INTERNAL_OUT: CanIfBufferHthRef=CanIfInitHohCfg/VSS_TP_Auth_ST3_VSS_TP_Auth_ST3_b0vczbv4viw3unw4ui2xxf7i9_IMU_INTERNAL_IMU_INTERNAL_OUT
        Bu_VSS_TP_RealTmOffset_ST3_VSS_TP_RealTmOffset_ST3_6pqq39zzkyaxjkhkpx4w6k2cd_IMU_INTERNAL_IMU_INTERNAL_OUT: CanIfBufferHthRef=CanIfInitHohCfg/VSS_TP_RealTmOffset_ST3_VSS_TP_RealTmOffset_ST3_6pqq39zzkyaxjkhkpx4w6k2cd_IMU_INTERNAL_IMU_INTERNAL_OUT
        Bu_VSS_TP_SecTickCount_Lvl1_ST3_VSS_TP_SecTickCount_Lvl1_ST3_e35z9ulel939vqa575s89n6fb_IMU_INTERNAL_IMU_INTERNAL_OUT: CanIfBufferHthRef=CanIfInitHohCfg/VSS_TP_SecTickCount_Lvl1_ST3_VSS_TP_SecTickCount_Lvl1_ST3_e35z9ulel939vqa575s89n6fb_IMU_INTERNAL_IMU_INTERNAL_OUT
        Bu_VSS_TP_VIN_ST3_VSS_TP_VIN_ST3_zo0ajku7bsc0uzxi9vkshgiq_IMU_INTERNAL_IMU_INTERNAL_OUT: CanIfBufferHthRef=CanIfInitHohCfg/VSS_TP_VIN_ST3_VSS_TP_VIN_ST3_zo0ajku7bsc0uzxi9vkshgiq_IMU_INTERNAL_IMU_INTERNAL_OUT
        Bu_VSS_TP_SharedSecret_ST3_VSS_TP_SharedSecret_ST3_2qm4y40dwmslooj3ccjmc5rvn_IMU_INTERNAL_IMU_INTERNAL_OUT: CanIfBufferHthRef=CanIfInitHohCfg/VSS_TP_SharedSecret_ST3_VSS_TP_SharedSecret_ST3_2qm4y40dwmslooj3ccjmc5rvn_IMU_INTERNAL_IMU_INTERNAL_OUT
      CanIfInitHohCfg
        ESP_HAD_BACKUP_GW_Container3_ST3_ESP_HAD_BACKUP_GW_Container3_ST3_22qnrsrd5p7i7sxhq5h7qa6eh_HAD_BACKUP_HAD_BACKUP_IN (CanIfHrhCfg):
          CanIfHrhCanCtrlIdRef = CanIfControllerConfig_1
          CanIfHrhIdSymRef = CanConfigSet/ESP_HAD_BACKUP_GW_Container3_ST3_ESP_HAD_BACKUP_GW_Container3_ST3_22qnrsrd5p7i7sxhq5h7qa6eh_HAD_BACKUP_HAD_BACKUP_IN
        5 x CanIfHthCfg, all with CanIfHthCanCtrlIdRef=CanIfControllerConfig_0:
          VSS_TP_Auth_ST3_VSS_TP_Auth_ST3_b0vczbv4viw3unw4ui2xxf7i9_IMU_INTERNAL_IMU_INTERNAL_OUT: CanIfHthIdSymRef=CanConfigSet/VSS_TP_Auth_ST3_VSS_TP_Auth_ST3_b0vczbv4viw3unw4ui2xxf7i9_IMU_INTERNAL_IMU_INTERNAL_OUT
          VSS_TP_RealTmOffset_ST3_VSS_TP_RealTmOffset_ST3_6pqq39zzkyaxjkhkpx4w6k2cd_IMU_INTERNAL_IMU_INTERNAL_OUT: CanIfHthIdSymRef=CanConfigSet/VSS_TP_RealTmOffset_ST3_VSS_TP_RealTmOffset_ST3_6pqq39zzkyaxjkhkpx4w6k2cd_IMU_INTERNAL_IMU_INTERNAL_OUT
          VSS_TP_SecTickCount_Lvl1_ST3_VSS_TP_SecTickCount_Lvl1_ST3_e35z9ulel939vqa575s89n6fb_IMU_INTERNAL_IMU_INTERNAL_OUT: CanIfHthIdSymRef=CanConfigSet/VSS_TP_SecTickCount_Lvl1_ST3_VSS_TP_SecTickCount_Lvl1_ST3_e35z9ulel939vqa575s89n6fb_IMU_INTERNAL_IMU_INTERNAL_OUT
          VSS_TP_VIN_ST3_VSS_TP_VIN_ST3_zo0ajku7bsc0uzxi9vkshgiq_IMU_INTERNAL_IMU_INTERNAL_OUT: CanIfHthIdSymRef=CanConfigSet/VSS_TP_VIN_ST3_VSS_TP_VIN_ST3_zo0ajku7bsc0uzxi9vkshgiq_IMU_INTERNAL_IMU_INTERNAL_OUT
          VSS_TP_SharedSecret_ST3_VSS_TP_SharedSecret_ST3_2qm4y40dwmslooj3ccjmc5rvn_IMU_INTERNAL_IMU_INTERNAL_OUT: CanIfHthIdSymRef=CanConfigSet/VSS_TP_SharedSecret_ST3_VSS_TP_SharedSecret_ST3_2qm4y40dwmslooj3ccjmc5rvn_IMU_INTERNAL_IMU_INTERNAL_OUT
      ESP_HAD_BACKUP_GW_Container3_ST3_ESP_HAD_BACKUP_GW_Container3_ST3_22qnrsrd5p7i7sxhq5h7qa6eh_HAD_BACKUP_HAD_BACKUP_IN (CanIfRxPduCfg):
        CanIfRxPduCanId = 312
        CanIfRxPduCanIdType = STANDARD_FD_CAN
        CanIfRxPduDataLength = 64
        CanIfRxPduReadData = false
        CanIfRxPduReadNotifyStatus = false
        CanIfRxPduUserRxIndicationName = PduR_CanIfRxIndication
        CanIfRxPduUserRxIndicationUL = PDUR
        CanIfRxPduHrhIdRef = CanIfInitHohCfg/ESP_HAD_BACKUP_GW_Container3_ST3_ESP_HAD_BACKUP_GW_Container3_ST3_22qnrsrd5p7i7sxhq5h7qa6eh_HAD_BACKUP_HAD_BACKUP_IN
        CanIfRxPduRef = EcucPduCollection/ESP_HAD_BACKUP_GW_Container3_ST3_ContainerIPdu_CanIf2PduR_HAD_BACKUP_CAN
      5 x CanIfTxPduCfg, all with CanIfTxPduCanIdType=STANDARD_FD_CAN, CanIfTxPduUserTxConfirmationName=PduR_CanIfTxConfirmation, CanIfTxPduUserTxConfirmationUL=PDUR, CanIfTxPduType=STATIC, CanIfTxPduCanIdMask=536870911:
        VSS_TP_Auth_ST3_VSS_TP_Auth_ST3_b0vczbv4viw3unw4ui2xxf7i9_IMU_INTERNAL_IMU_INTERNAL_OUT: CanIfTxPduCanId=749, CanIfTxPduBufferRef=Bu_VSS_TP_Auth_ST3_VSS_TP_Auth_ST3_b0vczbv4viw3unw4ui2xxf7i9_IMU_INTERNAL_IMU_INTERNAL_OUT, CanIfTxPduRef=VSS_TP_Auth_ST3_PduR2CanIf_IMU_INTERNAL_CAN
        VSS_TP_RealTmOffset_ST3_VSS_TP_RealTmOffset_ST3_6pqq39zzkyaxjkhkpx4w6k2cd_IMU_INTERNAL_IMU_INTERNAL_OUT: CanIfTxPduCanId=741, CanIfTxPduBufferRef=Bu_VSS_TP_RealTmOffset_ST3_VSS_TP_RealTmOffset_ST3_6pqq39zzkyaxjkhkpx4w6k2cd_IMU_INTERNAL_IMU_INTERNAL_OUT, CanIfTxPduRef=VSS_TP_RealTmOffset_ST3_PduR2CanIf_IMU_INTERNAL_CAN
        VSS_TP_SecTickCount_Lvl1_ST3_VSS_TP_SecTickCount_Lvl1_ST3_e35z9ulel939vqa575s89n6fb_IMU_INTERNAL_IMU_INTERNAL_OUT: CanIfTxPduCanId=745, CanIfTxPduBufferRef=Bu_VSS_TP_SecTickCount_Lvl1_ST3_VSS_TP_SecTickCount_Lvl1_ST3_e35z9ulel939vqa575s89n6fb_IMU_INTERNAL_IMU_INTERNAL_OUT, CanIfTxPduRef=VSS_TP_SecTickCount_Lvl1_ST3_PduR2CanIf_IMU_INTERNAL_CAN
        VSS_TP_VIN_ST3_VSS_TP_VIN_ST3_zo0ajku7bsc0uzxi9vkshgiq_IMU_INTERNAL_IMU_INTERNAL_OUT: CanIfTxPduCanId=747, CanIfTxPduBufferRef=Bu_VSS_TP_VIN_ST3_VSS_TP_VIN_ST3_zo0ajku7bsc0uzxi9vkshgiq_IMU_INTERNAL_IMU_INTERNAL_OUT, CanIfTxPduRef=VSS_TP_VIN_ST3_PduR2CanIf_IMU_INTERNAL_CAN
        VSS_TP_SharedSecret_ST3_VSS_TP_SharedSecret_ST3_2qm4y40dwmslooj3ccjmc5rvn_IMU_INTERNAL_IMU_INTERNAL_OUT: CanIfTxPduCanId=751, CanIfTxPduBufferRef=Bu_VSS_TP_SharedSecret_ST3_VSS_TP_SharedSecret_ST3_2qm4y40dwmslooj3ccjmc5rvn_IMU_INTERNAL_IMU_INTERNAL_OUT, CanIfTxPduRef=VSS_TP_SharedSecret_ST3_PduR2CanIf_IMU_INTERNAL_CAN
  module config Com
    ComConfig
      5 x ComIPdu, all with ComIPduDirection=RECEIVE, ComIPduSignalProcessing=DEFERRED, ComIPduType=NORMAL, ComIPduGroupRef=IPG_IMU_A_HAD_BACKUP_Rx_PNC_All_Active_CAN, ComIPduGroupRef=IPG_IMU_A_HAD_BACKUP_Rx_PNC_20_CAN:
        IP_ESP_HAD_BACKUP_GW_Container3_ST3_VSS_TP_Auth_ST3_CAN_Rx: ComIPduSignalGroupRef=SG_VSS_TP_Auth_ST3_6j4id7sghlvlbroli4wjozjik_HAD_BACKUP_CAN_Rx, ComPduIdRef=EcucPduCollection/ESP_HAD_BACKUP_GW_Container3_ST3_VSS_TP_Auth_ST3_PduR2Com_HAD_BACKUP_CAN
        IP_ESP_HAD_BACKUP_GW_Container3_ST3_VSS_TP_RealTmOffset_ST3_CAN_Rx: ComIPduSignalGroupRef=SG_VSS_TP_RealTmOffset_ST3_1t7vc44gftc0wv35k5kgc2in9_HAD_BACKUP_CAN_Rx, ComPduIdRef=EcucPduCollection/ESP_HAD_BACKUP_GW_Container3_ST3_VSS_TP_RealTmOffset_ST3_PduR2Com_HAD_BACKUP_CAN
        IP_ESP_HAD_BACKUP_GW_Container3_ST3_VSS_TP_SecTickCount_Lvl1_ST3_CAN_Rx: ComIPduSignalGroupRef=SG_VSS_TP_SecTickCount_Lvl1_ST3_mzmfdqtqz5kvv1kfpvg0kql3_HAD_BACKUP_CAN_Rx, ComPduIdRef=EcucPduCollection/ESP_HAD_BACKUP_GW_Container3_ST3_VSS_TP_SecTickCount_Lvl1_ST3_PduR2Com_HAD_BACKUP_CAN
        IP_ESP_HAD_BACKUP_GW_Container3_ST3_VSS_TP_SharedSecret_ST3_CAN_Rx: ComIPduSignalGroupRef=SG_VSS_TP_SharedSecret_ST3_8pj4t8t4rm3tw3pk5hj7vonti_HAD_BACKUP_CAN_Rx, ComPduIdRef=EcucPduCollection/ESP_HAD_BACKUP_GW_Container3_ST3_VSS_TP_SharedSecret_ST3_PduR2Com_HAD_BACKUP_CAN
        IP_ESP_HAD_BACKUP_GW_Container3_ST3_VSS_TP_VIN_ST3_CAN_Rx: ComIPduSignalGroupRef=SG_VSS_TP_VIN_ST3_bz1xsv84cxzl09j028gn39p69_HAD_BACKUP_CAN_Rx, ComPduIdRef=EcucPduCollection/ESP_HAD_BACKUP_GW_Container3_ST3_VSS_TP_VIN_ST3_PduR2Com_HAD_BACKUP_CAN
      10 x ComIPduGroup:
        IPG_IMU_A_HAD_BACKUP_Rx_PNC_All_Active_CAN
        IPG_IMU_A_HAD_BACKUP_Tx_PNC_All_Active_CAN
        IPG_IMU_A_HAD_BACKUP_Tx_PNC_20_CAN
        IPG_IMU_A_HAD_BACKUP_Rx_PNC_20_CAN
        IPG_TxMess_IMU_A_HAD_BACKUP_CAN
        IPG_IMU_A_IMU_INTERNAL_Tx_PNC_All_Active_CAN
        IPG_IMU_A_IMU_INTERNAL_Tx_PNC_15_ComCtrl_CAN
        IPG_IMU_A_IMU_INTERNAL_Tx_PNC_20_CAN
        IPG_IMU_A_IMU_INTERNAL_Rx_PNC_All_Active_CAN
        IPG_IMU_A_IMU_INTERNAL_Rx_PNC_20_CAN
      5 x ComSignalGroup, all with ComRxDataTimeoutAction=NONE, ComSignalGroupArrayAccess=false, ComTransferProperty=PENDING:
        SG_VSS_TP_Auth_ST3_6j4id7sghlvlbroli4wjozjik_HAD_BACKUP_CAN_Rx: ComSystemTemplateSignalGroupRef=VSS_TP_Auth_ST3_6j4id7sghlvlbroli4wjozjik
          8 x ComGroupSignal, all with ComBitSize=8, ComSignalEndianness=LITTLE_ENDIAN, ComSignalInitValue=255, ComSignalType=UINT8:
            GS_VSS_TP_Auth_0_ST3_HAD_BACKUP_CAN_Rx: ComBitPosition=0, ComSystemTemplateSystemSignalRef=VSS_TP_Auth_0_ST3
            GS_VSS_TP_Auth_1_ST3_HAD_BACKUP_CAN_Rx: ComBitPosition=8, ComSystemTemplateSystemSignalRef=VSS_TP_Auth_1_ST3
            GS_VSS_TP_Auth_2_ST3_HAD_BACKUP_CAN_Rx: ComBitPosition=16, ComSystemTemplateSystemSignalRef=VSS_TP_Auth_2_ST3
            GS_VSS_TP_Auth_3_ST3_HAD_BACKUP_CAN_Rx: ComBitPosition=24, ComSystemTemplateSystemSignalRef=VSS_TP_Auth_3_ST3
            GS_VSS_TP_Auth_4_ST3_HAD_BACKUP_CAN_Rx: ComBitPosition=32, ComSystemTemplateSystemSignalRef=VSS_TP_Auth_4_ST3
            GS_VSS_TP_Auth_5_ST3_HAD_BACKUP_CAN_Rx: ComBitPosition=40, ComSystemTemplateSystemSignalRef=VSS_TP_Auth_5_ST3
            GS_VSS_TP_Auth_6_ST3_HAD_BACKUP_CAN_Rx: ComBitPosition=48, ComSystemTemplateSystemSignalRef=VSS_TP_Auth_6_ST3
            GS_VSS_TP_Auth_7_ST3_HAD_BACKUP_CAN_Rx: ComBitPosition=56, ComSystemTemplateSystemSignalRef=VSS_TP_Auth_7_ST3
        SG_VSS_TP_RealTmOffset_ST3_1t7vc44gftc0wv35k5kgc2in9_HAD_BACKUP_CAN_Rx: ComSystemTemplateSignalGroupRef=VSS_TP_RealTmOffset_ST3_1t7vc44gftc0wv35k5kgc2in9
          8 x ComGroupSignal, all with ComBitSize=8, ComSignalEndianness=LITTLE_ENDIAN, ComSignalInitValue=255, ComSignalType=UINT8:
            GS_VSS_TP_RealTmOffset_0_ST3_HAD_BACKUP_CAN_Rx: ComBitPosition=0, ComSystemTemplateSystemSignalRef=VSS_TP_RealTmOffset_0_ST3
            GS_VSS_TP_RealTmOffset_1_ST3_HAD_BACKUP_CAN_Rx: ComBitPosition=8, ComSystemTemplateSystemSignalRef=VSS_TP_RealTmOffset_1_ST3
            GS_VSS_TP_RealTmOffset_2_ST3_HAD_BACKUP_CAN_Rx: ComBitPosition=16, ComSystemTemplateSystemSignalRef=VSS_TP_RealTmOffset_2_ST3
            GS_VSS_TP_RealTmOffset_3_ST3_HAD_BACKUP_CAN_Rx: ComBitPosition=24, ComSystemTemplateSystemSignalRef=VSS_TP_RealTmOffset_3_ST3
            GS_VSS_TP_RealTmOffset_4_ST3_HAD_BACKUP_CAN_Rx: ComBitPosition=32, ComSystemTemplateSystemSignalRef=VSS_TP_RealTmOffset_4_ST3
            GS_VSS_TP_RealTmOffset_5_ST3_HAD_BACKUP_CAN_Rx: ComBitPosition=40, ComSystemTemplateSystemSignalRef=VSS_TP_RealTmOffset_5_ST3
            GS_VSS_TP_RealTmOffset_6_ST3_HAD_BACKUP_CAN_Rx: ComBitPosition=48, ComSystemTemplateSystemSignalRef=VSS_TP_RealTmOffset_6_ST3
            GS_VSS_TP_RealTmOffset_7_ST3_HAD_BACKUP_CAN_Rx: ComBitPosition=56, ComSystemTemplateSystemSignalRef=VSS_TP_RealTmOffset_7_ST3
        SG_VSS_TP_SecTickCount_Lvl1_ST3_mzmfdqtqz5kvv1kfpvg0kql3_HAD_BACKUP_CAN_Rx: ComSystemTemplateSignalGroupRef=VSS_TP_SecTickCount_Lvl1_ST3_mzmfdqtqz5kvv1kfpvg0kql3
          8 x ComGroupSignal, all with ComBitSize=8, ComSignalEndianness=LITTLE_ENDIAN, ComSignalInitValue=255, ComSignalType=UINT8:
            GS_VSS_TP_SecTickCount_Lvl1_0_ST3_HAD_BACKUP_CAN_Rx: ComBitPosition=0, ComSystemTemplateSystemSignalRef=VSS_TP_SecTickCount_Lvl1_0_ST3
            GS_VSS_TP_SecTickCount_Lvl1_1_ST3_HAD_BACKUP_CAN_Rx: ComBitPosition=8, ComSystemTemplateSystemSignalRef=VSS_TP_SecTickCount_Lvl1_1_ST3
            GS_VSS_TP_SecTickCount_Lvl1_2_ST3_HAD_BACKUP_CAN_Rx: ComBitPosition=16, ComSystemTemplateSystemSignalRef=VSS_TP_SecTickCount_Lvl1_2_ST3
            GS_VSS_TP_SecTickCount_Lvl1_3_ST3_HAD_BACKUP_CAN_Rx: ComBitPosition=24, ComSystemTemplateSystemSignalRef=VSS_TP_SecTickCount_Lvl1_3_ST3
            GS_VSS_TP_SecTickCount_Lvl1_4_ST3_HAD_BACKUP_CAN_Rx: ComBitPosition=32, ComSystemTemplateSystemSignalRef=VSS_TP_SecTickCount_Lvl1_4_ST3
            GS_VSS_TP_SecTickCount_Lvl1_5_ST3_HAD_BACKUP_CAN_Rx: ComBitPosition=40, ComSystemTemplateSystemSignalRef=VSS_TP_SecTickCount_Lvl1_5_ST3
            GS_VSS_TP_SecTickCount_Lvl1_6_ST3_HAD_BACKUP_CAN_Rx: ComBitPosition=48, ComSystemTemplateSystemSignalRef=VSS_TP_SecTickCount_Lvl1_6_ST3
            GS_VSS_TP_SecTickCount_Lvl1_7_ST3_HAD_BACKUP_CAN_Rx: ComBitPosition=56, ComSystemTemplateSystemSignalRef=VSS_TP_SecTickCount_Lvl1_7_ST3
        SG_VSS_TP_SharedSecret_ST3_8pj4t8t4rm3tw3pk5hj7vonti_HAD_BACKUP_CAN_Rx: ComSystemTemplateSignalGroupRef=VSS_TP_SharedSecret_ST3_8pj4t8t4rm3tw3pk5hj7vonti
          8 x ComGroupSignal, all with ComBitSize=8, ComSignalEndianness=LITTLE_ENDIAN, ComSignalInitValue=255, ComSignalType=UINT8:
            GS_VSS_TP_SharedSecret_0_ST3_HAD_BACKUP_CAN_Rx: ComBitPosition=0, ComSystemTemplateSystemSignalRef=VSS_TP_SharedSecret_0_ST3
            GS_VSS_TP_SharedSecret_1_ST3_HAD_BACKUP_CAN_Rx: ComBitPosition=8, ComSystemTemplateSystemSignalRef=VSS_TP_SharedSecret_1_ST3
            GS_VSS_TP_SharedSecret_2_ST3_HAD_BACKUP_CAN_Rx: ComBitPosition=16, ComSystemTemplateSystemSignalRef=VSS_TP_SharedSecret_2_ST3
            GS_VSS_TP_SharedSecret_3_ST3_HAD_BACKUP_CAN_Rx: ComBitPosition=24, ComSystemTemplateSystemSignalRef=VSS_TP_SharedSecret_3_ST3
            GS_VSS_TP_SharedSecret_4_ST3_HAD_BACKUP_CAN_Rx: ComBitPosition=32, ComSystemTemplateSystemSignalRef=VSS_TP_SharedSecret_4_ST3
            GS_VSS_TP_SharedSecret_5_ST3_HAD_BACKUP_CAN_Rx: ComBitPosition=40, ComSystemTemplateSystemSignalRef=VSS_TP_SharedSecret_5_ST3
            GS_VSS_TP_SharedSecret_6_ST3_HAD_BACKUP_CAN_Rx: ComBitPosition=48, ComSystemTemplateSystemSignalRef=VSS_TP_SharedSecret_6_ST3
            GS_VSS_TP_SharedSecret_7_ST3_HAD_BACKUP_CAN_Rx: ComBitPosition=56, ComSystemTemplateSystemSignalRef=VSS_TP_SharedSecret_7_ST3
        SG_VSS_TP_VIN_ST3_bz1xsv84cxzl09j028gn39p69_HAD_BACKUP_CAN_Rx: ComSystemTemplateSignalGroupRef=VSS_TP_VIN_ST3_bz1xsv84cxzl09j028gn39p69
          8 x ComGroupSignal, all with ComBitSize=8, ComSignalEndianness=LITTLE_ENDIAN, ComSignalInitValue=63, ComSignalType=UINT8:
            GS_VSS_TP_VIN_0_ST3_HAD_BACKUP_CAN_Rx: ComBitPosition=0, ComSystemTemplateSystemSignalRef=VSS_TP_VIN_0_ST3
            GS_VSS_TP_VIN_1_ST3_HAD_BACKUP_CAN_Rx: ComBitPosition=8, ComSystemTemplateSystemSignalRef=VSS_TP_VIN_1_ST3
            GS_VSS_TP_VIN_2_ST3_HAD_BACKUP_CAN_Rx: ComBitPosition=16, ComSystemTemplateSystemSignalRef=VSS_TP_VIN_2_ST3
            GS_VSS_TP_VIN_3_ST3_HAD_BACKUP_CAN_Rx: ComBitPosition=24, ComSystemTemplateSystemSignalRef=VSS_TP_VIN_3_ST3
            GS_VSS_TP_VIN_4_ST3_HAD_BACKUP_CAN_Rx: ComBitPosition=32, ComSystemTemplateSystemSignalRef=VSS_TP_VIN_4_ST3
            GS_VSS_TP_VIN_5_ST3_HAD_BACKUP_CAN_Rx: ComBitPosition=40, ComSystemTemplateSystemSignalRef=VSS_TP_VIN_5_ST3
            GS_VSS_TP_VIN_6_ST3_HAD_BACKUP_CAN_Rx: ComBitPosition=48, ComSystemTemplateSystemSignalRef=VSS_TP_VIN_6_ST3
            GS_VSS_TP_VIN_7_ST3_HAD_BACKUP_CAN_Rx: ComBitPosition=56, ComSystemTemplateSystemSignalRef=VSS_TP_VIN_7_ST3
  module config EcuC
    EcucConfigSet
      EcucPduCollection
        12 x Pdu:
          ESP_HAD_BACKUP_GW_Container3_ST3_ContainerIPdu_CanIf2PduR_HAD_BACKUP_CAN: PduLength=64, SysTPduToPduTriggeringRef=ESP_HAD_BACKUP_GW_Container3_ST3_es20z922k0hdxd542vyccnt5z
          ESP_HAD_BACKUP_GW_Container3_ST3_ContainerIPdu_PduR2IpduM_HAD_BACKUP_CAN: PduLength=64, SysTPduToPduTriggeringRef=ESP_HAD_BACKUP_GW_Container3_ST3_es20z922k0hdxd542vyccnt5z
          ESP_HAD_BACKUP_GW_Container3_ST3_VSS_TP_Auth_ST3_IpduM2PduR_HAD_BACKUP_CAN: PduLength=8, SysTPduToPduTriggeringRef=ESP_HAD_BACKUP_GW_Container3_ST3_ESP_HAD_BACKUP_GW_Container3_ST3_VSS_TP_Auth_ST3_a5m1oehgi1yzcicgsdebhigxy
          ESP_HAD_BACKUP_GW_Container3_ST3_VSS_TP_Auth_ST3_PduR2Com_HAD_BACKUP_CAN: PduLength=8, SysTPduToPduTriggeringRef=ESP_HAD_BACKUP_GW_Container3_ST3_ESP_HAD_BACKUP_GW_Container3_ST3_VSS_TP_Auth_ST3_a5m1oehgi1yzcicgsdebhigxy
          ESP_HAD_BACKUP_GW_Container3_ST3_VSS_TP_RealTmOffset_ST3_IpduM2PduR_HAD_BACKUP_CAN: PduLength=8, SysTPduToPduTriggeringRef=ESP_HAD_BACKUP_GW_Container3_ST3_ESP_HAD_BACKUP_GW_Container3_ST3_VSS_TP_RealTmOffset_ST3_2686huv0x9rg4cu1k20p07zrz
          ESP_HAD_BACKUP_GW_Container3_ST3_VSS_TP_RealTmOffset_ST3_PduR2Com_HAD_BACKUP_CAN: PduLength=8, SysTPduToPduTriggeringRef=ESP_HAD_BACKUP_GW_Container3_ST3_ESP_HAD_BACKUP_GW_Container3_ST3_VSS_TP_RealTmOffset_ST3_2686huv0x9rg4cu1k20p07zrz
          ESP_HAD_BACKUP_GW_Container3_ST3_VSS_TP_SecTickCount_Lvl1_ST3_IpduM2PduR_HAD_BACKUP_CAN: PduLength=8, SysTPduToPduTriggeringRef=ESP_HAD_BACKUP_GW_Container3_ST3_ESP_HAD_BACKUP_GW_Container3_ST3_VSS_TP_SecTickCount_Lvl1_ST3_azhv8t4onxhjhi2zn8in2my2n
          ESP_HAD_BACKUP_GW_Container3_ST3_VSS_TP_SecTickCount_Lvl1_ST3_PduR2Com_HAD_BACKUP_CAN: PduLength=8, SysTPduToPduTriggeringRef=ESP_HAD_BACKUP_GW_Container3_ST3_ESP_HAD_BACKUP_GW_Container3_ST3_VSS_TP_SecTickCount_Lvl1_ST3_azhv8t4onxhjhi2zn8in2my2n
          ESP_HAD_BACKUP_GW_Container3_ST3_VSS_TP_SharedSecret_ST3_IpduM2PduR_HAD_BACKUP_CAN: PduLength=8, SysTPduToPduTriggeringRef=ESP_HAD_BACKUP_GW_Container3_ST3_ESP_HAD_BACKUP_GW_Container3_ST3_VSS_TP_SharedSecret_ST3_82pb6fg4cswmgotegs6aplrj2
          ESP_HAD_BACKUP_GW_Container3_ST3_VSS_TP_SharedSecret_ST3_PduR2Com_HAD_BACKUP_CAN: PduLength=8, SysTPduToPduTriggeringRef=ESP_HAD_BACKUP_GW_Container3_ST3_ESP_HAD_BACKUP_GW_Container3_ST3_VSS_TP_SharedSecret_ST3_82pb6fg4cswmgotegs6aplrj2
          ESP_HAD_BACKUP_GW_Container3_ST3_VSS_TP_VIN_ST3_IpduM2PduR_HAD_BACKUP_CAN: PduLength=8, SysTPduToPduTriggeringRef=ESP_HAD_BACKUP_GW_Container3_ST3_ESP_HAD_BACKUP_GW_Container3_ST3_VSS_TP_VIN_ST3_3331jz4zbik8yl0ehm51yf8w4
          ESP_HAD_BACKUP_GW_Container3_ST3_VSS_TP_VIN_ST3_PduR2Com_HAD_BACKUP_CAN: PduLength=8, SysTPduToPduTriggeringRef=ESP_HAD_BACKUP_GW_Container3_ST3_ESP_HAD_BACKUP_GW_Container3_ST3_VSS_TP_VIN_ST3_3331jz4zbik8yl0ehm51yf8w4
  module config IpduM
    IpduMConfig
      5 x IpduMContainedRxPdu, all with IpduMContainedRxInContainerPduRef=CrRx_ESP_HAD_BACKUP_GW_Container3_ST3_ContainerIPdu_HAD_BACKUP_CAN:
        CdRx_ESP_HAD_BACKUP_GW_Container3_ST3_ESP_HAD_BACKUP_GW_Container3_ST3_VSS_TP_Auth_ST3_a5m1oehgi1yzcicgsdebhigxy_HAD_BACKUP_CAN: IpduMContainedRxPduShortHeaderId=4259841, IpduMContainedRxPduRef=EcucPduCollection/ESP_HAD_BACKUP_GW_Container3_ST3_VSS_TP_Auth_ST3_IpduM2PduR_HAD_BACKUP_CAN
        CdRx_ESP_HAD_BACKUP_GW_Container3_ST3_ESP_HAD_BACKUP_GW_Container3_ST3_VSS_TP_RealTmOff_E7B08D65E4D5A677F33BB700C2D32EABB38601A1: IpduMContainedRxPduShortHeaderId=4259842, IpduMContainedRxPduRef=EcucPduCollection/ESP_HAD_BACKUP_GW_Container3_ST3_VSS_TP_RealTmOffset_ST3_IpduM2PduR_HAD_BACKUP_CAN
        CdRx_ESP_HAD_BACKUP_GW_Container3_ST3_ESP_HAD_BACKUP_GW_Container3_ST3_VSS_TP_SecTickCo_F56F65CB22E8BF2658A0904E053FB28E7B0F75D2: IpduMContainedRxPduShortHeaderId=4259844, IpduMContainedRxPduRef=EcucPduCollection/ESP_HAD_BACKUP_GW_Container3_ST3_VSS_TP_SecTickCount_Lvl1_ST3_IpduM2PduR_HAD_BACKUP_CAN
        CdRx_ESP_HAD_BACKUP_GW_Container3_ST3_ESP_HAD_BACKUP_GW_Container3_ST3_VSS_TP_SharedSec_34119C75D971893190FB63EC9EFAA11C0DAB5F9D: IpduMContainedRxPduShortHeaderId=4259843, IpduMContainedRxPduRef=EcucPduCollection/ESP_HAD_BACKUP_GW_Container3_ST3_VSS_TP_SharedSecret_ST3_IpduM2PduR_HAD_BACKUP_CAN
        CdRx_ESP_HAD_BACKUP_GW_Container3_ST3_ESP_HAD_BACKUP_GW_Container3_ST3_VSS_TP_VIN_ST3_3331jz4zbik8yl0ehm51yf8w4_HAD_BACKUP_CAN: IpduMContainedRxPduShortHeaderId=4259840, IpduMContainedRxPduRef=EcucPduCollection/ESP_HAD_BACKUP_GW_Container3_ST3_VSS_TP_VIN_ST3_IpduM2PduR_HAD_BACKUP_CAN
      CrRx_ESP_HAD_BACKUP_GW_Container3_ST3_ContainerIPdu_HAD_BACKUP_CAN (IpduMContainerRxPdu):
        IpduMContainerHeaderSize = IPDUM_HEADERTYPE_SHORT
        IpduMContainerPduProcessing = IPDUM_PROCESSING_IMMEDIATE
        IpduMContainerRxAcceptContainedPdu = IPDUM_ACCEPT_CONFIGURED
        IpduMContainerRxPduRef = EcucPduCollection/ESP_HAD_BACKUP_GW_Container3_ST3_ContainerIPdu_PduR2IpduM_HAD_BACKUP_CAN
  module config PduR
    PduRRoutingTables
      PduRRoutingTable
        6 x PduRRoutingPath:
          ESP_HAD_BACKUP_GW_Container3_ST3_ContainerIPdu_CanIf2IpduM_HAD_BACKUP_CAN
            ESP_HAD_BACKUP_GW_Container3_ST3_ContainerIPdu_PduR2IpduM_HAD_BACKUP_CAN (PduRDestPdu): PduRDestPduRef=EcucPduCollection/ESP_HAD_BACKUP_GW_Container3_ST3_ContainerIPdu_PduR2IpduM_HAD_BACKUP_CAN
            ESP_HAD_BACKUP_GW_Container3_ST3_ContainerIPdu_CanIf2PduR_HAD_BACKUP_CAN (PduRSrcPdu): PduRSrcPduRef=EcucPduCollection/ESP_HAD_BACKUP_GW_Container3_ST3_ContainerIPdu_CanIf2PduR_HAD_BACKUP_CAN
          ESP_HAD_BACKUP_GW_Container3_ST3_VSS_TP_Auth_ST3_IpduM2Com_HAD_BACKUP_CAN
            ESP_HAD_BACKUP_GW_Container3_ST3_VSS_TP_Auth_ST3_PduR2Com_HAD_BACKUP_CAN (PduRDestPdu): PduRDestPduRef=EcucPduCollection/ESP_HAD_BACKUP_GW_Container3_ST3_VSS_TP_Auth_ST3_PduR2Com_HAD_BACKUP_CAN
            VSS_TP_Auth_ST3_PduR2CanIf_IMU_INTERNAL_CAN (PduRDestPdu): PduRDestPduDataProvision=PDUR_DIRECT, PduRTransmissionConfirmation=true, PduRDestPduRef=VSS_TP_Auth_ST3_PduR2CanIf_IMU_INTERNAL_CAN
            ESP_HAD_BACKUP_GW_Container3_ST3_VSS_TP_Auth_ST3_IpduM2PduR_HAD_BACKUP_CAN (PduRSrcPdu): PduRSrcPduRef=EcucPduCollection/ESP_HAD_BACKUP_GW_Container3_ST3_VSS_TP_Auth_ST3_IpduM2PduR_HAD_BACKUP_CAN
          ESP_HAD_BACKUP_GW_Container3_ST3_VSS_TP_RealTmOffset_ST3_IpduM2Com_HAD_BACKUP_CAN
            ESP_HAD_BACKUP_GW_Container3_ST3_VSS_TP_RealTmOffset_ST3_PduR2Com_HAD_BACKUP_CAN (PduRDestPdu): PduRDestPduRef=EcucPduCollection/ESP_HAD_BACKUP_GW_Container3_ST3_VSS_TP_RealTmOffset_ST3_PduR2Com_HAD_BACKUP_CAN
            VSS_TP_RealTmOffset_ST3_PduR2CanIf_IMU_INTERNAL_CAN (PduRDestPdu): PduRDestPduDataProvision=PDUR_DIRECT, PduRTransmissionConfirmation=true, PduRDestPduRef=VSS_TP_RealTmOffset_ST3_PduR2CanIf_IMU_INTERNAL_CAN
            ESP_HAD_BACKUP_GW_Container3_ST3_VSS_TP_RealTmOffset_ST3_IpduM2PduR_HAD_BACKUP_CAN (PduRSrcPdu): PduRSrcPduRef=EcucPduCollection/ESP_HAD_BACKUP_GW_Container3_ST3_VSS_TP_RealTmOffset_ST3_IpduM2PduR_HAD_BACKUP_CAN
          ESP_HAD_BACKUP_GW_Container3_ST3_VSS_TP_SecTickCount_Lvl1_ST3_IpduM2Com_HAD_BACKUP_CAN
            ESP_HAD_BACKUP_GW_Container3_ST3_VSS_TP_SecTickCount_Lvl1_ST3_PduR2Com_HAD_BACKUP_CAN (PduRDestPdu): PduRDestPduRef=EcucPduCollection/ESP_HAD_BACKUP_GW_Container3_ST3_VSS_TP_SecTickCount_Lvl1_ST3_PduR2Com_HAD_BACKUP_CAN
            VSS_TP_SecTickCount_Lvl1_ST3_PduR2CanIf_IMU_INTERNAL_CAN (PduRDestPdu): PduRDestPduDataProvision=PDUR_DIRECT, PduRTransmissionConfirmation=true, PduRDestPduRef=VSS_TP_SecTickCount_Lvl1_ST3_PduR2CanIf_IMU_INTERNAL_CAN
            ESP_HAD_BACKUP_GW_Container3_ST3_VSS_TP_SecTickCount_Lvl1_ST3_IpduM2PduR_HAD_BACKUP_CAN (PduRSrcPdu): PduRSrcPduRef=EcucPduCollection/ESP_HAD_BACKUP_GW_Container3_ST3_VSS_TP_SecTickCount_Lvl1_ST3_IpduM2PduR_HAD_BACKUP_CAN
          ESP_HAD_BACKUP_GW_Container3_ST3_VSS_TP_SharedSecret_ST3_IpduM2Com_HAD_BACKUP_CAN
            ESP_HAD_BACKUP_GW_Container3_ST3_VSS_TP_SharedSecret_ST3_PduR2Com_HAD_BACKUP_CAN (PduRDestPdu): PduRDestPduRef=EcucPduCollection/ESP_HAD_BACKUP_GW_Container3_ST3_VSS_TP_SharedSecret_ST3_PduR2Com_HAD_BACKUP_CAN
            VSS_TP_SharedSecret_ST3_PduR2CanIf_IMU_INTERNAL_CAN (PduRDestPdu): PduRDestPduDataProvision=PDUR_DIRECT, PduRTransmissionConfirmation=true, PduRDestPduRef=VSS_TP_SharedSecret_ST3_PduR2CanIf_IMU_INTERNAL_CAN
            ESP_HAD_BACKUP_GW_Container3_ST3_VSS_TP_SharedSecret_ST3_IpduM2PduR_HAD_BACKUP_CAN (PduRSrcPdu): PduRSrcPduRef=EcucPduCollection/ESP_HAD_BACKUP_GW_Container3_ST3_VSS_TP_SharedSecret_ST3_IpduM2PduR_HAD_BACKUP_CAN
          ESP_HAD_BACKUP_GW_Container3_ST3_VSS_TP_VIN_ST3_IpduM2Com_HAD_BACKUP_CAN
            ESP_HAD_BACKUP_GW_Container3_ST3_VSS_TP_VIN_ST3_PduR2Com_HAD_BACKUP_CAN (PduRDestPdu): PduRDestPduRef=EcucPduCollection/ESP_HAD_BACKUP_GW_Container3_ST3_VSS_TP_VIN_ST3_PduR2Com_HAD_BACKUP_CAN
            VSS_TP_VIN_ST3_PduR2CanIf_IMU_INTERNAL_CAN (PduRDestPdu): PduRDestPduDataProvision=PDUR_DIRECT, PduRTransmissionConfirmation=true, PduRDestPduRef=VSS_TP_VIN_ST3_PduR2CanIf_IMU_INTERNAL_CAN
            ESP_HAD_BACKUP_GW_Container3_ST3_VSS_TP_VIN_ST3_IpduM2PduR_HAD_BACKUP_CAN (PduRSrcPdu): PduRSrcPduRef=EcucPduCollection/ESP_HAD_BACKUP_GW_Container3_ST3_VSS_TP_VIN_ST3_IpduM2PduR_HAD_BACKUP_CAN
    SecOC (PduRBswModules):
      PduRCancelReceive = false
      PduRCancelTransmit = false
      PduRChangeParameterApi = false
      PduRCommunicationInterface = true
      PduRLowerModule = true
      PduRRetransmission = false
      PduRTransportProtocol = true
      PduRTriggertransmit = true
      PduRTxConfirmation = true
      PduRUpperModule = true
      PduRUseTag = false
      PduRBswModuleRef = SecOC
      PduRInvalidHandlers: PduRIHCancelReceive=false, PduRIHCancelTransmit=false
  module config SecOC
    Tx_IMU_A_Output_ST3_secured_HAD_BACKUP_CAN (SecOCTxPduProcessing):
      SecOCAuthenticationBuildAttempts = 0
      SecOCAuthInfoTruncLength = 24
      SecOCDataId = 38014
      SecOCFreshnessValueId = 1
      SecOCFreshnessValueLength = 40
      SecOCFreshnessValueTruncLength = 8
      SecOCProvideTxTruncatedFreshnessValue = true
      SecOCRbClearBufferAfterTransmit = true
      SecOCRbTxCryptAlgoFamily = AES
      SecOCRbTxCryptAlgoMode = CMAC
      SecOCRbTxCryptAlgoSecondFamily = AES
      SecOCRbTxCryptMode = synchronous
      SecOCRbTxPduCryptIF = Csm_rba_CryptoHSM
      SecOCTxPduUnusedAreasDefault = 0
      SecOCUseTxConfirmation = true
      IMU_A_Output_ST3_PduR2SecOC_HAD_BACKUP_CAN (SecOCTxAuthenticPduLayer): SecOCTxAuthenticLayerPduRef=IMU_A_Output_ST3_PduR2SecOC
      SecOCTxSecuredPduLayer
        SecOCTxSecuredPdu: SecOCTxSecuredLayerPduRef=IMU_A_Output_ST3_secured_SecOC2PduR
    Tx_IMU_A_Output_Fast_ST3_secured_IMU_INTERNAL_CAN (SecOCTxPduProcessing):
      SecOCAuthenticationBuildAttempts = 0
      SecOCAuthInfoTruncLength = 24
      SecOCDataId = 38379
      SecOCFreshnessValueId = 1
      SecOCFreshnessValueLength = 40
      SecOCFreshnessValueTruncLength = 8
      SecOCProvideTxTruncatedFreshnessValue = true
      SecOCRbClearBufferAfterTransmit = true
      SecOCRbTxCryptAlgoFamily = AES
      SecOCRbTxCryptAlgoMode = CMAC
      SecOCRbTxCryptAlgoSecondFamily = AES
      SecOCRbTxCryptMode = synchronous
      SecOCRbTxPduCryptIF = Csm_rba_CryptoHSM
      SecOCTxPduUnusedAreasDefault = 0
      SecOCUseTxConfirmation = true
      IMU_A_Output_Fast_ST3_PduR2SecOC_IMU_INTERNAL_CAN (SecOCTxAuthenticPduLayer): SecOCTxAuthenticLayerPduRef=IMU_A_Output_Fast_ST3_PduR2SecOC
      SecOCTxSecuredPduLayer
        SecOCTxSecuredPdu: SecOCTxSecuredLayerPduRef=IMU_A_Output_Fast_ST3_secured_SecOC2PduR
    5 x SecOCRxPduProcessing, all with SecOCAuthenticationVerifyAttempts=0, SecOCAuthInfoTruncLength=24, SecOCFreshnessValueId=1, SecOCFreshnessValueLength=40, SecOCFreshnessValueTruncLength=8, SecOCRbRxCryptAlgoFamily=AES, SecOCRbRxCryptAlgoMode=CMAC, SecOCRbRxCryptAlgoSecondFamily=AES, SecOCRbRxCryptMode=asynchronous, SecOCReceptionOverflowStrategy=QUEUE, SecOCReceptionQueueSize=1, SecOCUseAuthDataFreshness=false, SecOCVerificationStatusPropagationMode=FAILURE_ONLY:
      Rx_ESP_HAD_BACKUP_COM_Container1_ST3_ESP_HAD_BACKUP_COM_Container1_ST3_BCS_Whl_Msg1_BTC_ST3_secured_HAD_BACKUP_CAN: SecOCDataId=1270
        ESP_HAD_BACKUP_COM_Container1_ST3_BCS_Whl_Msg1_BTC_ST3_SecOC2PduR_HAD_BACKUP_CAN (SecOCRxAuthenticPduLayer): SecOCPduType=SECOC_IFPDU, SecOCRxAuthenticLayerPduRef=ESP_HAD_BACKUP_COM_Container1_ST3_BCS_Whl_Msg1_BTC_ST3_SecOC2PduR
        SecOCRxSecuredPduLayer
          SecOCRxSecuredPdu:
            SecOCSecuredRxPduVerification = false
            SecOCRxSecuredLayerPduRef = ESP_HAD_BACKUP_COM_Container1_ST3_ESP_HAD_BACKUP_COM_Container1_ST3_BCS_Whl_Msg1_BTC_ST3_secured_PduR2SecOC
      Rx_ESP_HAD_BACKUP_GW_Container2_ST3_ESP_HAD_BACKUP_GW_Container2_ST3_Ign_Stat_ST3_secured_HAD_BACKUP_CAN: SecOCDataId=28212
        ESP_HAD_BACKUP_GW_Container2_ST3_Ign_Stat_ST3_SecOC2PduR_HAD_BACKUP_CAN (SecOCRxAuthenticPduLayer): SecOCPduType=SECOC_IFPDU, SecOCRxAuthenticLayerPduRef=ESP_HAD_BACKUP_GW_Container2_ST3_Ign_Stat_ST3_SecOC2PduR
        SecOCRxSecuredPduLayer
          SecOCRxSecuredPdu:
            SecOCSecuredRxPduVerification = false
            SecOCRxSecuredLayerPduRef = ESP_HAD_BACKUP_GW_Container2_ST3_ESP_HAD_BACKUP_GW_Container2_ST3_Ign_Stat_ST3_secured_PduR2SecOC
      Rx_ESP_HAD_BACKUP_GW_Container2_ST3_ESP_HAD_BACKUP_GW_Container2_ST3_PT4_PTCoor4_ST3_secured_HAD_BACKUP_CAN: SecOCDataId=26743
        ESP_HAD_BACKUP_GW_Container2_ST3_PT4_PTCoor4_ST3_SecOC2PduR_HAD_BACKUP_CAN (SecOCRxAuthenticPduLayer): SecOCPduType=SECOC_IFPDU, SecOCRxAuthenticLayerPduRef=ESP_HAD_BACKUP_GW_Container2_ST3_PT4_PTCoor4_ST3_SecOC2PduR
        SecOCRxSecuredPduLayer
          SecOCRxSecuredPdu:
            SecOCSecuredRxPduVerification = false
            SecOCRxSecuredLayerPduRef = ESP_HAD_BACKUP_GW_Container2_ST3_ESP_HAD_BACKUP_GW_Container2_ST3_PT4_PTCoor4_ST3_secured_PduR2SecOC
      Rx_ESP_HAD_BACKUP_GW_Container4_ST3_ESP_HAD_BACKUP_GW_Container4_ST3_DI_OdoSpeedometer_ST3_secured_HAD_BACKUP_CAN: SecOCDataId=64886
        ESP_HAD_BACKUP_GW_Container4_ST3_DI_OdoSpeedometer_ST3_SecOC2PduR_HAD_BACKUP_CAN (SecOCRxAuthenticPduLayer): SecOCPduType=SECOC_IFPDU, SecOCRxAuthenticLayerPduRef=ESP_HAD_BACKUP_GW_Container4_ST3_DI_OdoSpeedometer_ST3_SecOC2PduR
        SecOCRxSecuredPduLayer
          SecOCRxSecuredPdu:
            SecOCSecuredRxPduVerification = true
            SecOCRxSecuredLayerPduRef = ESP_HAD_BACKUP_GW_Container4_ST3_ESP_HAD_BACKUP_GW_Container4_ST3_DI_OdoSpeedometer_ST3_secured_PduR2SecOC
      Rx_ESP_HAD_BACKUP_GW_Container4_ST3_ESP_HAD_BACKUP_GW_Container4_ST3_PN14_Master_Stat1_ST3_secured_HAD_BACKUP_CAN: SecOCDataId=57668
        ESP_HAD_BACKUP_GW_Container4_ST3_PN14_Master_Stat1_ST3_SecOC2PduR_HAD_BACKUP_CAN (SecOCRxAuthenticPduLayer): SecOCPduType=SECOC_IFPDU, SecOCRxAuthenticLayerPduRef=ESP_HAD_BACKUP_GW_Container4_ST3_PN14_Master_Stat1_ST3_SecOC2PduR
        SecOCRxSecuredPduLayer
          SecOCRxSecuredPdu:
            SecOCSecuredRxPduVerification = false
            SecOCRxSecuredLayerPduRef = ESP_HAD_BACKUP_GW_Container4_ST3_ESP_HAD_BACKUP_GW_Container4_ST3_PN14_Master_Stat1_ST3_secured_PduR2SecOC
