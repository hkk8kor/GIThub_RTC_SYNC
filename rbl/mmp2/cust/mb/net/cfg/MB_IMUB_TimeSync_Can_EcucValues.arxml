AUTOSAR XML (schema 4-2-2)
package /RB/UBK/Project/EcucModuleConfigurationValuess
  module config CanTSyn: implementation-config-variant=VARIANT-PRE-COMPILE
    CanTSynGeneral: CanTSynDevErrorDetect=false, CanTSynMainFunctionPeriod=0.005, CanTSynHardwareTimestampSupport=false, CanTSynVersionInfoApi=false
    CanTSynGlobalTimeDomain_1 (CanTSynGlobalTimeDomain): CanTSynGlobalTimeDomainId=0, CanTSynUseExtendedMsgFormat=false, CanTSynSynchronizedTimeBaseRef=SynchTimeBase
      CanTSynGlobalTimeFupDataIDList
        16 x CanTSynGlobalTimeFupDataIDListElement:
          CanTSynGlobalTimeFupDataIDListElement_0: CanTSynGlobalTimeFupDataIDListIndex=0, CanTSynGlobalTimeFupDataIDListValue=143
          CanTSynGlobalTimeFupDataIDListElement_1: CanTSynGlobalTimeFupDataIDListIndex=1, CanTSynGlobalTimeFupDataIDListValue=78
          CanTSynGlobalTimeFupDataIDListElement_2: CanTSynGlobalTimeFupDataIDListIndex=2, CanTSynGlobalTimeFupDataIDListValue=13
          CanTSynGlobalTimeFupDataIDListElement_3: CanTSynGlobalTimeFupDataIDListIndex=3, CanTSynGlobalTimeFupDataIDListValue=199
          CanTSynGlobalTimeFupDataIDListElement_4: CanTSynGlobalTimeFupDataIDListIndex=4, CanTSynGlobalTimeFupDataIDListValue=134
          CanTSynGlobalTimeFupDataIDListElement_5: CanTSynGlobalTimeFupDataIDListIndex=5, CanTSynGlobalTimeFupDataIDListValue=69
          CanTSynGlobalTimeFupDataIDListElement_6: CanTSynGlobalTimeFupDataIDListIndex=6, CanTSynGlobalTimeFupDataIDListValue=4
          CanTSynGlobalTimeFupDataIDListElement_7: CanTSynGlobalTimeFupDataIDListIndex=7, CanTSynGlobalTimeFupDataIDListValue=190
          CanTSynGlobalTimeFupDataIDListElement_8: CanTSynGlobalTimeFupDataIDListIndex=8, CanTSynGlobalTimeFupDataIDListValue=125
          CanTSynGlobalTimeFupDataIDListElement_9: CanTSynGlobalTimeFupDataIDListIndex=9, CanTSynGlobalTimeFupDataIDListValue=60
          CanTSynGlobalTimeFupDataIDListElement_10: CanTSynGlobalTimeFupDataIDListIndex=10, CanTSynGlobalTimeFupDataIDListValue=246
          CanTSynGlobalTimeFupDataIDListElement_11: CanTSynGlobalTimeFupDataIDListIndex=11, CanTSynGlobalTimeFupDataIDListValue=181
          CanTSynGlobalTimeFupDataIDListElement_12: CanTSynGlobalTimeFupDataIDListIndex=12, CanTSynGlobalTimeFupDataIDListValue=116
          CanTSynGlobalTimeFupDataIDListElement_13: CanTSynGlobalTimeFupDataIDListIndex=13, CanTSynGlobalTimeFupDataIDListValue=51
          CanTSynGlobalTimeFupDataIDListElement_14: CanTSynGlobalTimeFupDataIDListIndex=14, CanTSynGlobalTimeFupDataIDListValue=237
          CanTSynGlobalTimeFupDataIDListElement_15: CanTSynGlobalTimeFupDataIDListIndex=15, CanTSynGlobalTimeFupDataIDListValue=172
      CanTSynGlobalTimeSlave:
        CanTSynGlobalTimeFollowUpTimeout = 0.25
        CanTSynGlobalTimeSequenceCounterJumpWidth = 3
        CanTSynGlobalTimeSequenceCounterHysteresis = 0
        CanTSynRxCrcValidated = CRC_VALIDATED
        CanTSynGlobalTimeSlavePdu: CanTSynGlobalTimePduRef=GTS_Main_CAN_ST3_CanIf2CanTSyn_IMU_INTERNAL_CAN
      CanTSynGlobalTimeSyncDataIDList
        16 x CanTSynGlobalTimeSyncDataIDListElement:
          CanTSynGlobalTimeSyncDataIDListElement_0: CanTSynGlobalTimeSyncDataIDListIndex=0, CanTSynGlobalTimeSyncDataIDListValue=225
          CanTSynGlobalTimeSyncDataIDListElement_1: CanTSynGlobalTimeSyncDataIDListIndex=1, CanTSynGlobalTimeSyncDataIDListValue=102
          CanTSynGlobalTimeSyncDataIDListElement_2: CanTSynGlobalTimeSyncDataIDListIndex=2, CanTSynGlobalTimeSyncDataIDListValue=230
          CanTSynGlobalTimeSyncDataIDListElement_3: CanTSynGlobalTimeSyncDataIDListIndex=3, CanTSynGlobalTimeSyncDataIDListValue=107
          CanTSynGlobalTimeSyncDataIDListElement_4: CanTSynGlobalTimeSyncDataIDListIndex=4, CanTSynGlobalTimeSyncDataIDListValue=235
          CanTSynGlobalTimeSyncDataIDListElement_5: CanTSynGlobalTimeSyncDataIDListIndex=5, CanTSynGlobalTimeSyncDataIDListValue=112
          CanTSynGlobalTimeSyncDataIDListElement_6: CanTSynGlobalTimeSyncDataIDListIndex=6, CanTSynGlobalTimeSyncDataIDListValue=240
          CanTSynGlobalTimeSyncDataIDListElement_7: CanTSynGlobalTimeSyncDataIDListIndex=7, CanTSynGlobalTimeSyncDataIDListValue=117
          CanTSynGlobalTimeSyncDataIDListElement_8: CanTSynGlobalTimeSyncDataIDListIndex=8, CanTSynGlobalTimeSyncDataIDListValue=245
          CanTSynGlobalTimeSyncDataIDListElement_9: CanTSynGlobalTimeSyncDataIDListIndex=9, CanTSynGlobalTimeSyncDataIDListValue=122
          CanTSynGlobalTimeSyncDataIDListElement_10: CanTSynGlobalTimeSyncDataIDListIndex=10, CanTSynGlobalTimeSyncDataIDListValue=250
          CanTSynGlobalTimeSyncDataIDListElement_11: CanTSynGlobalTimeSyncDataIDListIndex=11, CanTSynGlobalTimeSyncDataIDListValue=127
          CanTSynGlobalTimeSyncDataIDListElement_12: CanTSynGlobalTimeSyncDataIDListIndex=12, CanTSynGlobalTimeSyncDataIDListValue=4
          CanTSynGlobalTimeSyncDataIDListElement_13: CanTSynGlobalTimeSyncDataIDListIndex=13, CanTSynGlobalTimeSyncDataIDListValue=132
          CanTSynGlobalTimeSyncDataIDListElement_14: CanTSynGlobalTimeSyncDataIDListIndex=14, CanTSynGlobalTimeSyncDataIDListValue=9
          CanTSynGlobalTimeSyncDataIDListElement_15: CanTSynGlobalTimeSyncDataIDListIndex=15, CanTSynGlobalTimeSyncDataIDListValue=137
  module config StbM: implementation-config-variant=VARIANT-PRE-COMPILE
    StbMGeneral:
      StbMDevErrorDetect = true
      StbMGetCurrentTimeExtendedAvailable = false
      StbMMainFunctionPeriod = 0.005
      StbMTimeRecordingSupport = true
      StbMVersionInfoApi = false
    StbMRbExternalCounter_0 (StbMRbExternalCounter):
      StbMRbExternalCounterGetCounterValueCallback = Stbm_Get_CounterValue_Cbk
      StbMRbExternalCounterGetElapsedValueCallback = Stbm_Get_ElapsedValue_Cbk
      StbMRbExternalCounterTicksTonsCallback = Stbm_Tick_To_Ns_Cbk
    SynchTimeBase (StbMSynchronizedTimeBase):
      StbMClearTimeleapCount = 3
      StbMIsSystemWideGlobalTimeMaster = false
      StbMStoreTimebaseNonVolatile = NO_STORAGE
      StbMSynchronizedTimeBaseIdentifier = 0
      StbMSyncLossTimeout = 1.75
      StbMTimeLeapFutureThreshold = 0.0017
      StbMTimeLeapPastThreshold = 0.0017
      StbMNotificationInterface = CALLBACK
      StbMStatusNotificationCallback = rbl_CustIf_TiSync_eventStatusCallback
      StbMStatusNotificationMask = 1536
      StbMLocalTimeClock: StbMClockFrequency=80000000, StbMClockPrescaler=1, StbMLocalTimeHardware=StbMRbExternalCounter_0
      StbMTimeCorrection:
        StbMOffsetCorrectionAdaptionInterval = 0.5
        StbMOffsetCorrectionJumpThreshold = 0
        StbMRateCorrectionMeasurementDuration = 15
        StbMRateCorrectionsPerMeasurementDuration = 1
      StbMTimeRecording:
        StbMOffsetTimeRecordTableBlockCount = 0
        StbMSyncTimeRecordBlockCallback = dcom_MB_SyncTimeRecordBlockCallBack_SyncTimeBase
        StbMSyncTimeRecordTableBlockCount = 1
    PureLocalTimeBase (StbMSynchronizedTimeBase):
      StbMAllowSystemWideGlobalTimeMaster = true
      StbMIsSystemWideGlobalTimeMaster = true
      StbMStoreTimebaseNonVolatile = NO_STORAGE
      StbMSynchronizedTimeBaseIdentifier = 32
      StbMNotificationInterface = NO_NOTIFICATION
      StbMLocalTimeClock: StbMClockFrequency=80000000, StbMClockPrescaler=1, StbMLocalTimeHardware=StbMRbExternalCounter_0
      StbMTimeCorrection:
        StbMAllowMasterRateCorrection = true
        StbMOffsetCorrectionAdaptionInterval = 0.5
        StbMOffsetCorrectionJumpThreshold = 0
        StbMRateCorrectionMeasurementDuration = 15
        StbMRateCorrectionsPerMeasurementDuration = 1
