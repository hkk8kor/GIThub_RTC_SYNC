AUTOSAR XML (schema 4-2-2)
package /RB/UBK/Project/EcucModuleConfigurationValuess
  module config Rba_E2EWP: definition=rba_E2EWP, implementation-config-variant=VARIANT-PRE-COMPILE
    rba_E2EWPRbProfile5
      8 x rba_E2EWP_RbConfig, all with rba_E2EWPRbDataOffset=0, rba_E2EWPRbMaxDeltaCounter=3, rba_E2EWPRbOffset=0:
        rba_E2EWP_RbConfig_IMU_B_Output_ST3: rba_E2EWPRbCheck=false, rba_E2EWPRbDataID=845, rba_E2EWPRbDataLen=320, rba_E2EWPRbPDU=IMU_B_Output_ST3, rba_E2EWPRbProtect=true, rba_E2EWPRbSigGrp=IMU_B_Output_Pr5_ST3_8enshzy4a8xe2badcgusoewm2
        rba_E2EWP_RbConfig_IMU_B_Output_Fast_ST3: rba_E2EWPRbCheck=false, rba_E2EWPRbDataID=923, rba_E2EWPRbDataLen=320, rba_E2EWPRbPDU=IMU_B_Output_Fast_ST3, rba_E2EWPRbProtect=true, rba_E2EWPRbSigGrp=IMU_B_Output_Fast_Pr5_ST3_dk96owji618h3fdh75ws5eyj3
        rba_E2EWP_RbConfig_BCS_Whl_Msg1_BTC_ST3: rba_E2EWPRbCheck=true, rba_E2EWPRbDataID=413, rba_E2EWPRbDataLen=160, rba_E2EWPRbPDU=BCS_Whl_Msg1_BTC_ST3, rba_E2EWPRbProtect=false, rba_E2EWPRbSigGrp=BCS_Whl_Msg1_BTC_Pr5_ST3_3z5vvcdtzaheg7vz23u7gb0g6
        rba_E2EWP_RbConfig_DI_OdoSpeedometer_ST3: rba_E2EWPRbCheck=true, rba_E2EWPRbDataID=186, rba_E2EWPRbDataLen=48, rba_E2EWPRbPDU=DI_OdoSpeedometer_ST3, rba_E2EWPRbProtect=false, rba_E2EWPRbSigGrp=DI_Odo_Pr5_ST3_e68xmtlkywxgxsdwekdjjhw3t
        rba_E2EWP_RbConfig_Ign_Stat_ST3: rba_E2EWPRbCheck=true, rba_E2EWPRbDataID=51, rba_E2EWPRbDataLen=32, rba_E2EWPRbPDU=Ign_Stat_ST3, rba_E2EWPRbProtect=false, rba_E2EWPRbSigGrp=Ign_Stat_Pr5_ST3_csgs1dv6drms80o1i9p49677w
        rba_E2EWP_RbConfig_PT4_PTCoor4_ST3: rba_E2EWPRbCheck=true, rba_E2EWPRbDataID=196, rba_E2EWPRbDataLen=32, rba_E2EWPRbPDU=PT4_PTCoor4_ST3, rba_E2EWPRbProtect=false, rba_E2EWPRbSigGrp=PT4_PTCoor4_Pr5_ST3_af4fxb1ykieox3itqdfzs0kpb
        IMU_D_DRIVING_Container_Det05_ST3_PT4_Det05_IMU_D_Ctrl_ST3: rba_E2EWPRbCheck=false, rba_E2EWPRbDataID=824, rba_E2EWPRbDataLen=272, rba_E2EWPRbPDU=IMU_D_DRIVING_Container_Det05_ST3_PT4_Det05_IMU_D_Ctrl_ST3, rba_E2EWPRbProtect=true, rba_E2EWPRbSigGrp=PT4_Det05_IMU_D_Ctrl_Pr5_ST3_9ibx3pdl90d59keo4mo66if6x
        rba_E2EWP_RbConfig_ADAS_HAD_Stat_IDC_M_FSI_ST3: rba_E2EWPRbDataID=1083, rba_E2EWPRbDataLen=64, rba_E2EWPRbCheck=true, rba_E2EWPRbProtect=false, rba_E2EWPRbPDU=IDC_M_FSI_HAD_IMU_Container_ST3_ADAS_HAD_Stat_IDC_M_FSI_ST3, rba_E2EWPRbSigGrp=ADAS_HAD_Stat_IDC_M_FSI_Pr5_ST3_azb6uvmzdxiqsmnean8m9u52u
