AUTOSAR XML (schema 4-2-2)
package /RB/UBK/Project/EcucModuleConfigurationValuess
  module config Can
    CanConfigSet
      CanIfControllerConfig_0 (CanController):
        CanBusoffProcessing = POLLING
        CanControllerId = 0
        CanRbFDIsoOperation = true
        CanRbHardwareNodeId = TTCAN_0
        CanRbSwPollingFifoSize = 500
        CanControllerDefaultBaudrate = CanControllerBaudrateConfig_0
        CanControllerBaudrateConfig_0 (CanControllerBaudrateConfig):
          CanControllerBaudRate = 500
          CanControllerBaudRateConfigID = 0
          CanControllerPropSeg = 47
          CanControllerSeg1 = 16
          CanControllerSeg2 = 16
          CanControllerSyncJumpWidth = 16
          CanRbBrp = 2
          CanControllerFdBaudrateConfig_0 (CanControllerFdBaudrateConfig):
            CanControllerFdBaudRate = 1000
            CanControllerPropSeg = 19
            CanControllerSeg1 = 10
            CanControllerSeg2 = 10
            CanControllerSyncJumpWidth = 10
            CanControllerTxBitRateSwitch = true
            CanRbBrp = 2
      CanIfControllerConfig_1 (CanController):
        CanBusoffProcessing = POLLING
        CanControllerId = 1
        CanRbHardwareNodeId = MCAN_0
        CanRbFDIsoOperation = true
        CanRbSwPollingFifoSize = 500
        CanControllerDefaultBaudrate = CanControllerBaudrateConfig_1
        CanControllerBaudrateConfig_1 (CanControllerBaudrateConfig):
          CanControllerBaudRate = 500
          CanControllerBaudRateConfigID = 1
          CanControllerPropSeg = 47
          CanControllerSeg1 = 16
          CanControllerSeg2 = 16
          CanControllerSyncJumpWidth = 16
          CanRbBrp = 2
          CanControllerFdBaudrateConfig_1 (CanControllerFdBaudrateConfig):
            CanControllerFdBaudRate = 1000
            CanControllerPropSeg = 19
            CanControllerSeg1 = 10
            CanControllerSeg2 = 10
            CanControllerSyncJumpWidth = 10
            CanControllerTxBitRateSwitch = true
            CanRbBrp = 2
    CanGeneral:
      CanIndex = 0
      CanMainFunctionBusoffPeriod = 0.005
      CanMainFunctionModePeriod = 0.005
      CanVersionInfoApi = false
      CanRbLiteConfiguration = false
      CanRbDynamicMCANIpDetection = true
      CanDevErrorDetect = false
      CanGlobalTimeSupport = false
      CanDemEventParameterRefs: CanRbDynCreate_CAN_E_TIMEOUT=Disabled
      CanMainFunctionRWPeriods_5ms (CanMainFunctionRWPeriods): CanMainFunctionPeriod=0.005
  module config CanIf
    CanIfCtrlDrvCfg_0 (CanIfCtrlDrvCfg): CanIfCtrlDrvInitHohConfigRef=CanIfInitHohCfg, CanIfCtrlDrvNameRef=CanGeneral
      CanIfControllerConfig_0 (CanIfCtrlCfg): CanIfCtrlId=0, CanIfCtrlWakeupSupport=false, CanIfCtrlCanCtrlRef=CanConfigSet/CanIfControllerConfig_0
      CanIfControllerConfig_1 (CanIfCtrlCfg): CanIfCtrlId=1, CanIfCtrlWakeupSupport=false, CanIfCtrlCanCtrlRef=CanConfigSet/CanIfControllerConfig_1, CanIfCtrlTrcvRef=CanIfTrcvCfg_1
    CanIfPublicCfg:
      CanIfPublicBusoffRecoveryfromRxIndication = true
      CanIfPublicCancelTransmitSupport = false
      CanIfPublicCanIfLiteConfiguration = false
      CanIfPublicCddHeaderFile = cdd_header
      CanIfPublicErrorPassiveSupport = false
      CanIfPublicHandleTypeEnum = UINT8
      CanIfPublicMultipleDrvSupport = false
      CanIfPublicPnSupport = false
      CanIfPublicReadRxPduDataApi = false
      CanIfPublicReadRxPduNotifyStatusApi = true
      CanIfPublicReadTxPduNotifyStatusApi = true
      CanIfPublicSetDynamicTxIdApi = true
      CanIfPublicTxBuffering = false
      CanIfPublicTxConfirmPollingSupport = false
      CanIfPublicUserTpTxInOfflineMode = true
      CanIfPublicWakeupCheckValidSupport = false
      CanIfTriggerTransmitSupport = true
      CanIfGlobalTimeSupport = false
      CanIfTxOfflineActiveSupport = false
      CanIfWakeupSupport = true
      CanIfDevErrorDetect = true
      CanIfVersionInfoApi = true
    CanIfTrcvDrvCfg_0 (CanIfTrcvDrvCfg)
      CanIfTrcvCfg_1 (CanIfTrcvCfg): CanIfTrcvId=0, CanIfTrcvWakeupSupport=false, CanIfTrcvCanTrcvRef=CanTrcvChannel_0
    CanIfDispatchCfg:
      CanIfDispatchUserCheckTrcvWakeFlagIndicationName = CanSM_CheckTransceiverWakeFlagIndication
      CanIfDispatchUserCheckTrcvWakeFlagIndicationUL = CAN_SM
      CanIfDispatchUserClearTrcvWufFlagIndicationName = CanSM_ClearTrcvWufFlagIndication
      CanIfDispatchUserClearTrcvWufFlagIndicationUL = CAN_SM
      CanIfDispatchUserConfirmPnAvailabilityName = CanSM_ConfirmPnAvailability
      CanIfDispatchUserConfirmPnAvailabilityUL = CAN_SM
      CanIfDispatchUserCtrlBusOffName = CanSM_ControllerBusOff
      CanIfDispatchUserCtrlBusOffUL = CAN_SM
      CanIfDispatchUserCtrlModeIndicationUL = CAN_SM
      CanIfDispatchUserTrcvModeIndicationUL = CAN_SM
    CanIfPrivateCfg: CanIfPrivateDataLengthCheck=false
  module config CanNm: implementation-config-variant=VARIANT-PRE-COMPILE
    CanNmGlobalConfig:
      CanNmBusLoadReductionEnabled = false
      CanNmBusSynchronizationEnabled = false
      CanNmComControlEnabled = true
      CanNmComUserDataSupport = true
      CanNmCoordinatorSyncSupport = false
      CanNmDevErrorDetect = true
      CanNmImmediateRestartEnabled = false
      CanNmImmediateTxconfEnabled = false
      CanNmMainFunctionPeriod = 0.005
      CanNmPassiveModeEnabled = false
      CanNmPduRxIndicationEnabled = true
      CanNmRemoteSleepIndEnabled = true
      CanNmStateChangeIndEnabled = true
      CanNmUserDataEnabled = true
      CanNmVersionInfoApi = false
      CanNmGlobalPnSupport = true
      CanNmPnSyncShutdownErrorReactionEnabled = false
      CanNmPnEiraCalcEnabled = true
      CanNmPnResetTime = 1.1
      CanNmPnEiraRxNSduRef = NmPnEiraRxNSduRef_CAN_CanNm2PduR_IMU_INTERNAL_CAN
      CanNmPnInfo: CanNmPnInfoLength=7, CanNmPnInfoOffset=1
        7 x CanNmPnFilterMaskByte:
          CanNmPnFilterMaskByte_0: CanNmPnFilterMaskByteIndex=0, CanNmPnFilterMaskByteValue=1
          CanNmPnFilterMaskByte_1: CanNmPnFilterMaskByteIndex=1, CanNmPnFilterMaskByteValue=128
          CanNmPnFilterMaskByte_2: CanNmPnFilterMaskByteIndex=2, CanNmPnFilterMaskByteValue=144
          CanNmPnFilterMaskByte_{3..6}: CanNmPnFilterMaskByteIndex={3..6}, CanNmPnFilterMaskByteValue=0
  module config CanSM
    CanSMConfiguration: CanSMModeRequestRepetitionMax=10, CanSMModeRequestRepetitionTime=0.01
      IMU_Can (CanSMManagerNetwork):
        CanSMBorTimeL1 = 0.06
        CanSMBorTxConfirmationPolling = false
        CanSMBorCounterL1ToL2 = 20
        CanSMBorTimeL2 = 1
        CanSMBorTimeTxEnsured = 1
        CanSMComMNetworkHandleRef = ComMChannel_Can
        IMU_INTERNAL_CAN (CanSMController): CanSMControllerId=CanIfCtrlDrvCfg_0/CanIfControllerConfig_0
        CanSMDemEventParameterRefs: CanSMRbDynCreate_CANSM_E_BUS_OFF=Disabled, CANSM_E_BUS_OFF=CANSM_E_BUSOFF_NETWORK_0
      IMU_Can1 (CanSMManagerNetwork):
        CanSMBorTimeL1 = 0.06
        CanSMBorTimeL2 = 1
        CanSMBorTxConfirmationPolling = false
        CanSMBorCounterL1ToL2 = 20
        CanSMBorTimeTxEnsured = 1
        CanSMComMNetworkHandleRef = ComMChannel_Can1
        CanSMTransceiverId = CanIfTrcvCfg_1
        IMU_A_HAD_BACKUP (CanSMController): CanSMControllerId=CanIfCtrlDrvCfg_0/CanIfControllerConfig_1
        CanSMDemEventParameterRefs: CanSMRbDynCreate_CANSM_E_BUS_OFF=Disabled, CANSM_E_BUS_OFF=CANSM_E_BUSOFF_NETWORK_1
    CanSMGeneral: CanSMDevErrorDetect=false, CanSMMainFunctionTimePeriod=0.005, CanSMPncSupport=false, CanSMSetBaudrateApi=false, CanSMVersionInfoApi=false
  module config CanTrcv_0: definition=CanTrcv
    CanTrcvConfigSet
      CanTrcvChannel_0 (CanTrcvChannel):
        CanTrcvChannelId = 0
        CanTrcvChannelUsed = true
        CanTrcvControlsPowerSupply = true
        CanTrcvHwPnSupport = false
        CanTrcvInitState = CANTRCV_OP_MODE_STANDBY
        CanTrcvMaxBaudrate = 500
        CanTrcvWakeupByBusUsed = true
        CanTrcvRbHardwareType = TJA1145
        CanTrcvWakeupSourceRef = ECUM_WKSOURCE_CAN1
        CanTrcvAccess
          CanTrcvSpiAccess
            CanTrcvSpiSequence_0 (CanTrcvSpiSequence): CanTrcvSpiSequenceName=SpiSequence_CanTrcv_Seq0
        CanTrcvDemEventParameterRefs: CanTrcvRbDynCreate_CANTRCV_X_Y_E_NO_TRCV_CONTROL_Z=Disabled, CANTRCV_RB_E_UNEXPECTED_MODE_PROP=CANTRCV_TJA_E_NO_TRCV_CONTROL_CH0
    CanTrcvGeneral:
      CanTrcvDevErrorDetect = true
      CanTrcvIndex = 0
      CanTrcvWakeUpSupport = CANTRCV_WAKEUP_BY_POLLING
      CanTrcvVersionInfoApi = false
      CanTrcvMainFunctionPeriod = 0.01
      CanTrcvRbCheckWakeupReturnVal = true
  module config Com: implementation-config-variant=VARIANT-PRE-COMPILE
    ComGeneral:
      ComCancellationSupport = false
      ComCommonIPduTxPeriodFeature = false
      ComConfigurationUseDet = false
      ComEnableJitterFilter = false
      ComEnableSignalGroupArrayApi = true
      ComIPduControlViaCalibration = false
      ComMultiCoreSwitch = false
      ComProvideIpduStatusAPI = false
      ComReadRxIPduLength = false
      ComRetryFailedTransmitRequests = true
      ComRTESpecificSymbolicNames = false
      ComTxScheduledInDiffTimebase = false
      ComVersionInfoApi = false
    ComConfig
  module config ComM: implementation-config-variant=VARIANT-PRE-COMPILE
    ComMConfigSet
      ComMChannel_Can (ComMChannel):
        ComMBusType = COMM_BUS_TYPE_CAN
        ComMChannelId = 0
        ComMFullCommRequestNotificationEnabled = false
        ComMMainFunctionPeriod = 0.01
        ComMNoCom = false
        ComMNoWakeup = false
        ComMNoWakeUpInhibitionNvmStorage = false
        ComMPncGatewayType = COMM_GATEWAY_TYPE_ACTIVE
        ComMNetworkManagement: ComMNmLightTimeout=0.01, ComMNmVariant=FULL, ComMPncNmRequest=true
        ComMUserPerChannel_0 (ComMUserPerChannel): ComMUserChannel=ComMUser_Can
      ComMChannel_Can1 (ComMChannel):
        ComMBusType = COMM_BUS_TYPE_CAN
        ComMChannelId = 1
        ComMFullCommRequestNotificationEnabled = false
        ComMMainFunctionPeriod = 0.01
        ComMNoCom = false
        ComMNoWakeup = false
        ComMNoWakeUpInhibitionNvmStorage = false
        ComMPncGatewayType = COMM_GATEWAY_TYPE_PASSIVE
        ComMNetworkManagement: ComMNmLightTimeout=0.01, ComMNmVariant=FULL, ComMPncNmRequest=true
        ComMUserPerChannel_0 (ComMUserPerChannel): ComMUserChannel=ComMUser_Can1
      4 x ComMPnc, all with ComMPncMainFunctionPeriod=0.01, ComMChannelPerPnc=ComMChannel_Can:
        Id_8: ComMPncId=8, ComMChannelPerPnc=ComMChannel_Can1
          4 x ComMPncComSignal:
            ComMPncComSignal_ERA_INTERNAL_CAN_Rx: ComMPncComSignalDirection=RX, ComMPncComSignalKind=ERA, ComMPncComSignalChannelRef=ComMChannel_Can, ComMPncComSignalRef=S_NM_IMU_A_CanNmUserDataSig_Era_INTERNAL_CAN_Rx
            ComMPncComSignal_ERA_HAD_BACKUP_CAN_Rx: ComMPncComSignalDirection=RX, ComMPncComSignalKind=ERA, ComMPncComSignalChannelRef=ComMChannel_Can1, ComMPncComSignalRef=S_NM_IMU_A_CanNmUserDataSig_Era_HAD_BACKUP_CAN_Rx
            ComMPncComSignal_ERA_INTERNAL_CAN_Tx: ComMPncComSignalDirection=TX, ComMPncComSignalChannelRef=ComMChannel_Can, ComMPncComSignalRef=S_NM_IMU_A_ST3_PNC_IMU_INTERNAL_CAN_Tx
            ComMPncComSignal_ERA_HAD_BACKUP_CAN_Tx: ComMPncComSignalDirection=TX, ComMPncComSignalChannelRef=ComMChannel_Can1, ComMPncComSignalRef=S_NM_IMU_A_ST3_PNC_HAD_BACKUP_CAN_Tx
        Id_23: ComMPncId=23
          ComMPncComSignal_ERA_INTERNAL_CAN_Rx (ComMPncComSignal):
            ComMPncComSignalDirection = RX
            ComMPncComSignalKind = ERA
            ComMPncComSignalChannelRef = ComMChannel_Can
            ComMPncComSignalRef = S_NM_IMU_A_CanNmUserDataSig_Era_INTERNAL_CAN_Rx
          ComMPncComSignal_ERA_INTERNAL_CAN_Tx (ComMPncComSignal): ComMPncComSignalDirection=TX, ComMPncComSignalChannelRef=ComMChannel_Can, ComMPncComSignalRef=S_NM_IMU_A_ST3_PNC_IMU_INTERNAL_CAN_Tx
        Id_28: ComMPncId=28, ComMChannelPerPnc=ComMChannel_Can1
          4 x ComMPncComSignal:
            ComMPncComSignal_ERA_INTERNAL_CAN_Rx: ComMPncComSignalDirection=RX, ComMPncComSignalKind=ERA, ComMPncComSignalChannelRef=ComMChannel_Can, ComMPncComSignalRef=S_NM_IMU_A_CanNmUserDataSig_Era_INTERNAL_CAN_Rx
            ComMPncComSignal_ERA_HAD_BACKUP_CAN_Rx: ComMPncComSignalDirection=RX, ComMPncComSignalKind=ERA, ComMPncComSignalChannelRef=ComMChannel_Can1, ComMPncComSignalRef=S_NM_IMU_A_CanNmUserDataSig_Era_HAD_BACKUP_CAN_Rx
            ComMPncComSignal_ERA_INTERNAL_CAN_Tx: ComMPncComSignalDirection=TX, ComMPncComSignalChannelRef=ComMChannel_Can, ComMPncComSignalRef=S_NM_IMU_A_ST3_PNC_IMU_INTERNAL_CAN_Tx
            ComMPncComSignal_ERA_HAD_BACKUP_CAN_Tx: ComMPncComSignalDirection=TX, ComMPncComSignalChannelRef=ComMChannel_Can1, ComMPncComSignalRef=S_NM_IMU_A_ST3_PNC_HAD_BACKUP_CAN_Tx
        Id_31: ComMPncId=31, ComMChannelPerPnc=ComMChannel_Can1
          4 x ComMPncComSignal:
            ComMPncComSignal_ERA_INTERNAL_CAN_Rx: ComMPncComSignalDirection=RX, ComMPncComSignalKind=ERA, ComMPncComSignalChannelRef=ComMChannel_Can, ComMPncComSignalRef=S_NM_IMU_A_CanNmUserDataSig_Era_INTERNAL_CAN_Rx
            ComMPncComSignal_ERA_HAD_BACKUP_CAN_Rx: ComMPncComSignalDirection=RX, ComMPncComSignalKind=ERA, ComMPncComSignalChannelRef=ComMChannel_Can1, ComMPncComSignalRef=S_NM_IMU_A_CanNmUserDataSig_Era_HAD_BACKUP_CAN_Rx
            ComMPncComSignal_ERA_INTERNAL_CAN_Tx: ComMPncComSignalDirection=TX, ComMPncComSignalChannelRef=ComMChannel_Can, ComMPncComSignalRef=S_NM_IMU_A_ST3_PNC_IMU_INTERNAL_CAN_Tx
            ComMPncComSignal_ERA_HAD_BACKUP_CAN_Tx: ComMPncComSignalDirection=TX, ComMPncComSignalChannelRef=ComMChannel_Can1, ComMPncComSignalRef=S_NM_IMU_A_ST3_PNC_HAD_BACKUP_CAN_Tx
      ComMUser_Can (ComMUser)
      ComMUser_Can1 (ComMUser)
    ComMGeneral:
      ComMDevErrorDetect = false
      ComMEcuGroupClassification = 0
      ComMModeLimitationEnabled = false
      ComMPncGatewayEnabled = true
      ComMPncPrepareSleepTimer = 1.3
      ComMPncSupport = true
      ComMResetAfterForcingNoComm = false
      ComMRteEnabled = false
      ComMSynchronousWakeUp = true
      ComMTMinFullComModeDuration = 3
      ComMVersionInfoApi = true
      ComMWakeupInhibitionEnabled = false
  module config Nm: implementation-config-variant=VARIANT-PRE-COMPILE
    NmGlobalConfig
      NmGlobalConstants:
        NmNumberOfChannels = 2
        NmStateChangeIndCallback = RBEMM_NmCtrl_NMStateChangeIndication_Cbk
        NmRxIndicationCallback = NM_RxIndication
        NmRxCallbackHeader = RBEMM_Extended_Callouts.h
      NmGlobalFeatures:
        NmBusSynchronizationEnabled = false
        NmCarWakeUpRxEnabled = false
        NmComControlEnabled = true
        NmCoordinatorSupportEnabled = false
        NmCoordinatorSyncSupport = false
        NmPduRxIndicationEnabled = true
        NmRemoteSleepIndEnabled = true
        NmStateChangeIndEnabled = true
        NmUserDataEnabled = true
      NmGlobalProperties: NmCycletimeMainFunction=0.01, NmDevErrorDetect=false, NmVersionInfoApi=false
    NmChannelConfig_Can (NmChannelConfig):
      NmChannelSleepMaster = false
      NmComUserDataSupport = true
      NmPassiveModeEnabled = false
      NmShutdownDelayTimer = 0
      NmStateReportEnabled = false
      NmSynchronizingNetwork = false
      NmComMChannelRef = ComMChannel_Can
      NmBusType
        NmStandardBusNmConfig: NmStandardBusType=NM_BUSNM_CANNM
    NmChannelConfig_Can1 (NmChannelConfig):
      NmChannelSleepMaster = false
      NmShutdownDelayTimer = 0
      NmStateReportEnabled = false
      NmSynchronizingNetwork = false
      NmPassiveModeEnabled = false
      NmComUserDataSupport = true
      NmComMChannelRef = ComMChannel_Can1
      NmBusType
        NmStandardBusNmConfig: NmStandardBusType=NM_BUSNM_CANNM
  module config PduR: implementation-config-variant=VARIANT-PRE-COMPILE
    PduRGeneral:
      PduRDevErrorDetect = false
      PduRVersionInfoApi = true
      PduRZeroCostOperation = false
      PduRRbDsmReInitEnabled = false
      PduRRbGwTpWithLimitedBuffer = false
      PduRRbIFGatewayOperation = true
      PduRRbQueueingSupport = false
    PduRRoutingPaths
      PduRRbDemEventParameterRefs: PduRRbDynCreate_E_INIT_FAILED=Disabled, PduRRbDynCreate_E_PDU_INSTANCE_LOST=Disabled
    Com (PduRBswModules):
      PduRCancelReceive = false
      PduRCancelTransmit = false
      PduRCommunicationInterface = true
      PduRLowerModule = false
      PduRTransportProtocol = false
      PduRTriggertransmit = true
      PduRTxConfirmation = true
      PduRUpperModule = true
      PduRBswModuleRef = Com
    CanNm (PduRBswModules):
      PduRCancelReceive = false
      PduRCancelTransmit = false
      PduRCommunicationInterface = true
      PduRLowerModule = true
      PduRTransportProtocol = false
      PduRTriggertransmit = true
      PduRTxConfirmation = true
      PduRUpperModule = false
      PduRBswModuleRef = CanNm
  module config rba_ComDrv
    rba_ComDrvGeneral: ComDrvCpuCanType=MCU_RB_REN_RH850_P1MC_D3V2, ComDrvCpuType=MCU_RB_REN_RH850_P1MC_D3V2
