AUTOSAR XML (schema 4-2-2)
package /RB/UBK/Project/EcucModuleConfigurationValuess
  module config Rba_E2EWP: definition=rba_E2EWP, implementation-config-variant=VARIANT-PRE-COMPILE
    rba_E2EWPRbProfile5
      7 x rba_E2EWP_RbConfig, all with rba_E2EWPRbDataOffset=0, rba_E2EWPRbMaxDeltaCounter=3, rba_E2EWPRbOffset=0:
        rba_E2EWP_RbConfig_IMU_A_Output_ST3: rba_E2EWPRbCheck=false, rba_E2EWPRbDataID=844, rba_E2EWPRbDataLen=320, rba_E2EWPRbPDU=IMU_A_Output_ST3, rba_E2EWPRbProtect=true, rba_E2EWPRbSigGrp=IMU_A_Output_Pr5_ST3_bezr5ct33mhwxias0s8rjhbne
        rba_E2EWP_RbConfig_IMU_A_Output_Fast_ST3: rba_E2EWPRbCheck=false, rba_E2EWPRbDataID=931, rba_E2EWPRbDataLen=320, rba_E2EWPRbPDU=IMU_A_Output_Fast_ST3, rba_E2EWPRbProtect=true, rba_E2EWPRbSigGrp=IMU_A_Output_Fast_Pr5_ST3_5ym0lyqjosyobfhfksta75zc4
        rba_E2EWP_RbConfig_ESP_HAD_BACKUP_GW_Container2_ST3_Ign_Stat_ST3: rba_E2EWPRbCheck=true, rba_E2EWPRbDataID=51, rba_E2EWPRbDataLen=32, rba_E2EWPRbPDU=ESP_HAD_BACKUP_GW_Container2_ST3_Ign_Stat_ST3, rba_E2EWPRbProtect=false, rba_E2EWPRbSigGrp=Ign_Stat_Pr5_ST3_csgs1dv6drms80o1i9p49677w
        rba_E2EWP_RbConfig_ESP_HAD_BACKUP_GW_Container2_ST3_PT4_PTCoor4_ST3: rba_E2EWPRbCheck=true, rba_E2EWPRbDataID=196, rba_E2EWPRbDataLen=32, rba_E2EWPRbPDU=ESP_HAD_BACKUP_GW_Container2_ST3_PT4_PTCoor4_ST3, rba_E2EWPRbProtect=false, rba_E2EWPRbSigGrp=PT4_PTCoor4_Pr5_ST3_af4fxb1ykieox3itqdfzs0kpb
        rba_E2EWP_RbConfig_ESP_HAD_BACKUP_COM_Container1_ST3_BCS_Whl_Msg1_BTC_ST3: rba_E2EWPRbCheck=true, rba_E2EWPRbDataID=413, rba_E2EWPRbDataLen=160, rba_E2EWPRbPDU=ESP_HAD_BACKUP_COM_Container1_ST3_BCS_Whl_Msg1_BTC_ST3, rba_E2EWPRbProtect=false, rba_E2EWPRbSigGrp=BCS_Whl_Msg1_BTC_Pr5_ST3_3z5vvcdtzaheg7vz23u7gb0g6
        rba_E2EWP_RbConfig_ESP_HAD_BACKUP_GW_Container4_ST3_DI_OdoSpeedometer_ST3: rba_E2EWPRbCheck=true, rba_E2EWPRbDataID=186, rba_E2EWPRbDataLen=48, rba_E2EWPRbPDU=ESP_HAD_BACKUP_GW_Container4_ST3_DI_OdoSpeedometer_ST3, rba_E2EWPRbProtect=false, rba_E2EWPRbSigGrp=DI_Odo_Pr5_ST3_e68xmtlkywxgxsdwekdjjhw3t
        rba_E2EWP_RbConfig_IDC_S_FSI_HAD_BACKUP_Container_ST3_ADAS_HAD_Stat_IDC_S_FSI_Bckp_ST3: rba_E2EWPRbDataID=1079, rba_E2EWPRbDataLen=64, rba_E2EWPRbCheck=true, rba_E2EWPRbProtect=false, rba_E2EWPRbPDU=IDC_S_FSI_HAD_BACKUP_Container_ST3_ADAS_HAD_Stat_IDC_S_FSI_Bckp_ST3, rba_E2EWPRbSigGrp=ADAS_HAD_Stat_IDC_S_FSI_Bckp_Pr5_ST3_1hazv0zum1rfjs1udwdzrjfp4
