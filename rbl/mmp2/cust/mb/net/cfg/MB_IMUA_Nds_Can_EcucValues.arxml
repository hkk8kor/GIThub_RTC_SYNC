[part 1 of 2: package /RB/UBK/Project/EcucModuleConfigurationValuess]
AUTOSAR XML (schema 00050)
package /RB/UBK/Project/EcucModuleConfigurationValuess
  module config rba_Nds
    rba_Nds_Communication
      rba_Nds_Frame_ESP_HAD_BACKUP_GW_Container3_ST3 (rba_Nds_Frame): rba_Nds_Description=ESP HAD BACKUP GW Container, rba_Nds_Length=64, rba_Nds_Name=ESP_HAD_BACKUP_GW_Container3_ST3
        rba_Nds_PduInst_ESP_HAD_BACKUP_GW_Container3_ST3_ContainerIPdu (rba_Nds_PduInstance): rba_Nds_BitPosition=0, rba_Nds_ByteOrder=INTEL, rba_Nds_PduRef=rba_Nds_Pdu_ESP_HAD_BACKUP_GW_Container3_ST3_ContainerIPdu
      5 x rba_Nds_Signal, all with rba_Nds_Encoding=UNSIGNED:
        rba_Nds_Signal_Rsrv1_BCS_Whl_Msg1_BTC_Pr5_ST3: rba_Nds_BitSize=4, rba_Nds_Description=Reserviert für zukünftige Verwendung, rba_Nds_Name=Rsrv1_BCS_Whl_Msg1_BTC_Pr5_ST3
          rba_Nds_NetworkRepresentation_0 (rba_Nds_NetworkRepresentation)
            rba_Nds_DirectRepresentation: rba_Nds_MinValue=0, rba_Nds_MaxValue=15
        rba_Nds_Signal_BCS_Whl_Msg1_TmStmp_BTC_ST3: rba_Nds_BitSize=16, rba_Nds_Description=Radbotschaft 1 Zeitstempel, rba_Nds_Name=BCS_Whl_Msg1_TmStmp_BTC_ST3
          rba_Nds_NetworkRepresentation_BCS_Whl_Msg1_TmStmp_BTC_ST3_ms_0d1_0 (rba_Nds_NetworkRepresentation)
            rba_Nds_DirectRepresentation: rba_Nds_MinValue=0, rba_Nds_MaxValue=65535
        rba_Nds_Signal_BCS_Whl_Msg1_TmSyncStat_BTC_ST3: rba_Nds_BitSize=2, rba_Nds_Description=Synchronisationsstatus des globalen Zeitstempels der Komponente ESP, rba_Nds_Name=BCS_Whl_Msg1_TmSyncStat_BTC_ST3
          rba_Nds_NetworkRepresentation_0 (rba_Nds_NetworkRepresentation)
            rba_Nds_DirectRepresentation: rba_Nds_MinValue=0, rba_Nds_MaxValue=2
        rba_Nds_Signal_CRC_BCS_Whl_Msg1_BTC_Pr5_ST3: rba_Nds_BitSize=16, rba_Nds_Description=CRC-Checksumme der Signal Gruppe gemäß AUTOSAR Profil 5, rba_Nds_Name=CRC_BCS_Whl_Msg1_BTC_Pr5_ST3, rba_Nds_SignalType=CHECKSUM
          rba_Nds_NetworkRepresentation_0 (rba_Nds_NetworkRepresentation)
            rba_Nds_DirectRepresentation: rba_Nds_MinValue=0, rba_Nds_MaxValue=65535
        rba_Nds_Signal_GTS_ESP_Clk_Stat_Bckp_ST3: rba_Nds_BitSize=2, rba_Nds_Description=Internal ESP GTS Clock Stat, rba_Nds_Name=GTS_ESP_Clk_Stat_Bckp_ST3
          rba_Nds_NetworkRepresentation_0_GTS_ESP_Clk_Stat_Bckp_ST3 (rba_Nds_NetworkRepresentation)
            rba_Nds_DirectRepresentation: rba_Nds_MinValue=0, rba_Nds_MaxValue=3
      13 x rba_Nds_Frame:
        rba_Nds_Frame_FBL_CFG_Star3_ST3: rba_Nds_Description=FBL_CFG_Star3, rba_Nds_Length=1, rba_Nds_Name=FBL_CFG_Star3_ST3
          rba_Nds_PduInst_FBL_Cfg_Star3_ST3 (rba_Nds_PduInstance): rba_Nds_BitPosition=0, rba_Nds_ByteOrder=INTEL, rba_Nds_PduRef=rba_Nds_Communication/rba_Nds_Pdu_FBL_Cfg_Star3_ST3
        rba_Nds_Frame_FBL_CFG_Star3_ST3: rba_Nds_Description=FBL_CFG_Star3, rba_Nds_Length=1, rba_Nds_Name=FBL_CFG_Star3_ST3
          rba_Nds_PduInst_FBL_Cfg_Star3_ST3 (rba_Nds_PduInstance): rba_Nds_BitPosition=0, rba_Nds_ByteOrder=INTEL, rba_Nds_PduRef=rba_Nds_Communication/rba_Nds_Pdu_FBL_Cfg_Star3_ST3
        rba_Nds_Frame_DI_OdoSpeedometer_ST3: rba_Nds_Description=Fahrerinformation Odometer und Tacho, rba_Nds_Length=8, rba_Nds_Name=DI_OdoSpeedometer_ST3
          rba_Nds_PduInst_DI_OdoSpeedometer_ST3 (rba_Nds_PduInstance): rba_Nds_BitPosition=0, rba_Nds_ByteOrder=INTEL, rba_Nds_PduRef=rba_Nds_Pdu_DI_OdoSpeedometer_ST3
        rba_Nds_Frame_DIAG_Stat_ST3: rba_Nds_Description=Actv Line Status Tester pres, rba_Nds_Length=4, rba_Nds_Name=DIAG_Stat_ST3
          rba_Nds_PduInst_DIAG_Stat_ST3 (rba_Nds_PduInstance): rba_Nds_BitPosition=0, rba_Nds_ByteOrder=INTEL, rba_Nds_PduRef=rba_Nds_Pdu_DIAG_Stat_ST3
        rba_Nds_Frame_Ign_Stat_ST3: rba_Nds_Description=Zuendungsstatus, rba_Nds_Length=8, rba_Nds_Name=Ign_Stat_ST3
          rba_Nds_PduInst_Ign_Stat_ST3_secured (rba_Nds_PduInstance): rba_Nds_BitPosition=0, rba_Nds_ByteOrder=INTEL, rba_Nds_PduRef=rba_Nds_Pdu_Ign_Stat_ST3_secured
        rba_Nds_Frame_PT4_PTCoor4_SecOC_ST3: rba_Nds_Description=PT4_PTCoor4_SecOC_ST3, rba_Nds_Length=8, rba_Nds_Name=PT4_PTCoor4_SecOC_ST3
          rba_Nds_PduInst_PT4_PTCoor4_ST3_secured (rba_Nds_PduInstance): rba_Nds_BitPosition=0, rba_Nds_ByteOrder=INTEL, rba_Nds_PduRef=rba_Nds_Pdu_PT4_PTCoor4_ST3_secured
        rba_Nds_Frame_PN14_Master_Stat1_SecOC_ST3: rba_Nds_Description=Status 12V Bordnetz Master, rba_Nds_Length=12, rba_Nds_Name=PN14_Master_Stat1_SecOC_ST3
          rba_Nds_PduInst_PN14_Master_Stat1_ST3_secured (rba_Nds_PduInstance): rba_Nds_BitPosition=0, rba_Nds_ByteOrder=INTEL, rba_Nds_PduRef=rba_Nds_Pdu_PN14_Master_Stat1_ST3_secured
        rba_Nds_Frame_BCS_Whl_Msg1_BTC_ST3: rba_Nds_Description=BCS Whl Msg 1 ST3, rba_Nds_Length=24, rba_Nds_Name=BCS_Whl_Msg1_BTC_ST3
          rba_Nds_PduInst_BCS_Whl_Msg1_BTC_ST3_secured (rba_Nds_PduInstance): rba_Nds_BitPosition=0, rba_Nds_ByteOrder=INTEL, rba_Nds_PduRef=rba_Nds_Pdu_BCS_Whl_Msg1_BTC_ST3_secured
        rba_Nds_Frame_VSS_TP_VIN_ST3: rba_Nds_Description=VSS TP VIN ST3, rba_Nds_Length=8, rba_Nds_Name=VSS_TP_VIN_ST3
          rba_Nds_PduInst_VSS_TP_VIN_ST3 (rba_Nds_PduInstance): rba_Nds_BitPosition=0, rba_Nds_ByteOrder=INTEL, rba_Nds_PduRef=rba_Nds_Pdu_VSS_TP_VIN_ST3
        rba_Nds_Frame_VSS_TP_SharedSecret_ST3: rba_Nds_Description=VSS TP SharedSecret ST3, rba_Nds_Length=8, rba_Nds_Name=VSS_TP_SharedSecret_ST3
          rba_Nds_PduInst_VSS_TP_SharedSecret_ST3 (rba_Nds_PduInstance): rba_Nds_BitPosition=0, rba_Nds_ByteOrder=INTEL, rba_Nds_PduRef=rba_Nds_Pdu_VSS_TP_SharedSecret_ST3
        rba_Nds_Frame_VSS_TP_SecTickCount_Lvl1_ST3: rba_Nds_Description=VSS TP SecTickCount Lvl1 ST3, rba_Nds_Length=8, rba_Nds_Name=VSS_TP_SecTickCount_Lvl1_ST3
          rba_Nds_PduInst_VSS_TP_SecTickCount_Lvl1_ST3 (rba_Nds_PduInstance): rba_Nds_BitPosition=0, rba_Nds_ByteOrder=INTEL, rba_Nds_PduRef=rba_Nds_Pdu_VSS_TP_SecTickCount_Lvl1_ST3
        rba_Nds_Frame_VSS_TP_RealTmOffset_ST3: rba_Nds_Description=VSS TP RealTmOffset ST3, rba_Nds_Length=8, rba_Nds_Name=VSS_TP_RealTmOffset_ST3
          rba_Nds_PduInst_VSS_TP_RealTmOffset_ST3 (rba_Nds_PduInstance): rba_Nds_BitPosition=0, rba_Nds_ByteOrder=INTEL, rba_Nds_PduRef=rba_Nds_Pdu_VSS_TP_RealTmOffset_ST3
        rba_Nds_Frame_VSS_TP_Auth_ST3: rba_Nds_Description=VSS TP Auth ST3, rba_Nds_Length=8, rba_Nds_Name=VSS_TP_Auth_ST3
          rba_Nds_PduInst_VSS_TP_Auth_ST3 (rba_Nds_PduInstance): rba_Nds_BitPosition=0, rba_Nds_ByteOrder=INTEL, rba_Nds_PduRef=rba_Nds_Pdu_VSS_TP_Auth_ST3
      20 x rba_Nds_Signal, all with rba_Nds_Encoding=UNSIGNED:
        rba_Nds_Signal_SQC_BCS_Whl_Msg1_BTC_Pr5_ST3: rba_Nds_BitSize=8, rba_Nds_Description=Sequenzzähler, rba_Nds_Name=SQC_BCS_Whl_Msg1_BTC_Pr5_ST3, rba_Nds_SignalType=ALIVECOUNTER
          rba_Nds_NetworkRepresentation_SQC_BCS_Whl_Msg1_BTC_Pr5_ST3_none_1_0 (rba_Nds_NetworkRepresentation)
            rba_Nds_DirectRepresentation: rba_Nds_MaxValue=255, rba_Nds_MinValue=0
        rba_Nds_Signal_WhlDir_FL_Stat_BTC_ST3: rba_Nds_BitSize=2, rba_Nds_Description=Drehrichtung Rad vorne links (SNA falls Sensor nicht vorhanden), rba_Nds_Name=WhlDir_FL_Stat_BTC_ST3
          rba_Nds_NetworkRepresentation_0_WhlDir_FL_Stat_BTC_ST3 (rba_Nds_NetworkRepresentation)
            rba_Nds_DirectRepresentation: rba_Nds_MinValue=0, rba_Nds_MaxValue=3
        rba_Nds_Signal_WhlDir_FR_Stat_BTC_ST3: rba_Nds_BitSize=2, rba_Nds_Description=Drehrichtung Rad vorne rechts (SNA falls Sensor nicht vorhanden), rba_Nds_Name=WhlDir_FR_Stat_BTC_ST3
          rba_Nds_NetworkRepresentation_0_WhlDir_FR_Stat_BTC_ST3 (rba_Nds_NetworkRepresentation)
            rba_Nds_DirectRepresentation: rba_Nds_MinValue=0, rba_Nds_MaxValue=3
        rba_Nds_Signal_WhlDir_RL_Stat_BTC_ST3: rba_Nds_BitSize=2, rba_Nds_Description=Drehrichtung Rad hinten links (SNA falls Sensor nicht vorhanden), rba_Nds_Name=WhlDir_RL_Stat_BTC_ST3
          rba_Nds_NetworkRepresentation_0_WhlDir_RL_Stat_BTC_ST3 (rba_Nds_NetworkRepresentation)
            rba_Nds_DirectRepresentation: rba_Nds_MinValue=0, rba_Nds_MaxValue=3
        rba_Nds_Signal_WhlDir_RR_Stat_BTC_ST3: rba_Nds_BitSize=2, rba_Nds_Description=Drehrichtung Rad hinten rechts (SNA falls Sensor nicht vorhanden), rba_Nds_Name=WhlDir_RR_Stat_BTC_ST3
          rba_Nds_NetworkRepresentation_0_WhlDir_RR_Stat_BTC_ST3 (rba_Nds_NetworkRepresentation)
            rba_Nds_DirectRepresentation: rba_Nds_MinValue=0, rba_Nds_MaxValue=3
        rba_Nds_Signal_WhlPlsCnt_FL_BTC_ST3: rba_Nds_BitSize=10, rba_Nds_Description=Impuls-Ringzähler Rad vorne links (160 pro Umdrehung), rba_Nds_Name=WhlPlsCnt_FL_BTC_ST3
          rba_Nds_NetworkRepresentation_0_WhlPlsCnt_FL_BTC_ST3 (rba_Nds_NetworkRepresentation)
            rba_Nds_DirectRepresentation: rba_Nds_MinValue=0, rba_Nds_MaxValue=1023
        rba_Nds_Signal_WhlPlsCnt_FR_BTC_ST3: rba_Nds_BitSize=10, rba_Nds_Description=Impuls-Ringzähler Rad vorne rechts (160 pro Umdrehung), rba_Nds_Name=WhlPlsCnt_FR_BTC_ST3
          rba_Nds_NetworkRepresentation_0_WhlPlsCnt_FR_BTC_ST3 (rba_Nds_NetworkRepresentation)
            rba_Nds_DirectRepresentation: rba_Nds_MinValue=0, rba_Nds_MaxValue=1023
        rba_Nds_Signal_WhlPlsCnt_RL_BTC_ST3: rba_Nds_BitSize=10, rba_Nds_Description=Impuls-Ringzähler Rad hinten links (160 pro Umdrehung), rba_Nds_Name=WhlPlsCnt_RL_BTC_ST3
          rba_Nds_NetworkRepresentation_0_WhlPlsCnt_RL_BTC_ST3 (rba_Nds_NetworkRepresentation)
            rba_Nds_DirectRepresentation: rba_Nds_MinValue=0, rba_Nds_MaxValue=1023
        rba_Nds_Signal_WhlPlsCnt_RR_BTC_ST3: rba_Nds_BitSize=10, rba_Nds_Description=Impuls-Ringzähler Rad hinten rechts (160 pro Umdrehung), rba_Nds_Name=WhlPlsCnt_RR_BTC_ST3
          rba_Nds_NetworkRepresentation_0_WhlPlsCnt_RR_BTC_ST3 (rba_Nds_NetworkRepresentation)
            rba_Nds_DirectRepresentation: rba_Nds_MinValue=0, rba_Nds_MaxValue=1023
        rba_Nds_Signal_WhlRPM_FL_BTC_ST3: rba_Nds_BitSize=14, rba_Nds_Description=Raddrehzahl vorne links, rba_Nds_Name=WhlRPM_FL_BTC_ST3
          rba_Nds_NetworkRepresentation_1_WhlRPM_FL_BTC_ST3 (rba_Nds_NetworkRepresentation)
            rba_Nds_DirectRepresentation: rba_Nds_MaxValue=16383, rba_Nds_MinValue=0
        rba_Nds_Signal_WhlRPM_FL_Qual_BTC_ST3: rba_Nds_BitSize=2, rba_Nds_Description=Qualität der Raddrehzahl vorne links, rba_Nds_Name=WhlRPM_FL_Qual_BTC_ST3
          rba_Nds_NetworkRepresentation_0_WhlRPM_FL_Qual_BTC_ST3 (rba_Nds_NetworkRepresentation)
            rba_Nds_DirectRepresentation: rba_Nds_MinValue=0, rba_Nds_MaxValue=3
        rba_Nds_Signal_WhlRPM_FR_BTC_ST3: rba_Nds_BitSize=14, rba_Nds_Description=Raddrehzahl vorne rechts, rba_Nds_Name=WhlRPM_FR_BTC_ST3
          rba_Nds_NetworkRepresentation_0 (rba_Nds_NetworkRepresentation)
            rba_Nds_DirectRepresentation: rba_Nds_MinValue=0, rba_Nds_MaxValue=16383
        rba_Nds_Signal_WhlRPM_FR_Qual_BTC_ST3: rba_Nds_BitSize=2, rba_Nds_Description=Qualität der Raddrehzahl vorne rechts, rba_Nds_Name=WhlRPM_FR_Qual_BTC_ST3
          rba_Nds_NetworkRepresentation_0_WhlRPM_FR_Qual_BTC_ST3 (rba_Nds_NetworkRepresentation)
            rba_Nds_DirectRepresentation: rba_Nds_MinValue=0, rba_Nds_MaxValue=2
        rba_Nds_Signal_WhlRPM_RL_BTC_ST3: rba_Nds_BitSize=14, rba_Nds_Description=Raddrehzahl hinten links, rba_Nds_Name=WhlRPM_RL_BTC_ST3
          rba_Nds_NetworkRepresentation_0_WhlRPM_RL_BTC_ST3 (rba_Nds_NetworkRepresentation)
            rba_Nds_DirectRepresentation: rba_Nds_MinValue=0, rba_Nds_MaxValue=16383
        rba_Nds_Signal_WhlRPM_RL_Qual_BTC_ST3: rba_Nds_BitSize=2, rba_Nds_Description=Qualität der Raddrehzahl hinten links, rba_Nds_Name=WhlRPM_RL_Qual_BTC_ST3
          rba_Nds_NetworkRepresentation_0_WhlRPM_RL_Qual_BTC_ST3 (rba_Nds_NetworkRepresentation)
            rba_Nds_DirectRepresentation: rba_Nds_MinValue=0, rba_Nds_MaxValue=2
        rba_Nds_Signal_WhlRPM_RR_BTC_ST3: rba_Nds_BitSize=14, rba_Nds_Description=Raddrehzahl hinten rechts, rba_Nds_Name=WhlRPM_RR_BTC_ST3
          rba_Nds_NetworkRepresentation_0_WhlRPM_RR_BTC_ST3 (rba_Nds_NetworkRepresentation)
            rba_Nds_DirectRepresentation: rba_Nds_MinValue=0, rba_Nds_MaxValue=16383
        rba_Nds_Signal_WhlRPM_RR_Qual_BTC_ST3: rba_Nds_BitSize=2, rba_Nds_Description=Qualität der Raddrehzahl hinten rechts, rba_Nds_Name=WhlRPM_RR_Qual_BTC_ST3
          rba_Nds_NetworkRepresentation_0_WhlRPM_RR_Qual_BTC_ST3 (rba_Nds_NetworkRepresentation)
            rba_Nds_DirectRepresentation: rba_Nds_MinValue=0, rba_Nds_MaxValue=2
        rba_Nds_Signal_CRC_Ign_Stat_Pr5_ST3: rba_Nds_BitSize=16, rba_Nds_Description=CRC-Checksumme der Signal Gruppe gemäß AUTOSAR Profil 5, rba_Nds_Name=CRC_Ign_Stat_Pr5_ST3, rba_Nds_SignalType=CHECKSUM
          rba_Nds_NetworkRepresentation_0 (rba_Nds_NetworkRepresentation)
            rba_Nds_DirectRepresentation: rba_Nds_MaxValue=65535
        rba_Nds_Signal_ISw_Stat_ST3: rba_Nds_BitSize=3, rba_Nds_Description=Klemmenstatus, rba_Nds_Name=ISw_Stat_ST3
          rba_Nds_NetworkRepresentation_0_ISw_Stat_ST3 (rba_Nds_NetworkRepresentation)
            rba_Nds_DirectRepresentation: rba_Nds_MinValue=0, rba_Nds_MaxValue=7
        rba_Nds_Signal_KG_StartSw_Psd_ST3: rba_Nds_BitSize=1, rba_Nds_Description=Keyless Go Starttaster betätigt, rba_Nds_Name=KG_StartSw_Psd_ST3
          rba_Nds_NetworkRepresentation_0 (rba_Nds_NetworkRepresentation)
            rba_Nds_DirectRepresentation: rba_Nds_MinValue=0, rba_Nds_MaxValue=1
      23 x rba_Nds_Pdu:
        rba_Nds_Pdu_FBL_Cfg_Star3_ST3
          rba_Nds_SignalPdu: rba_Nds_Description=FBL Konfigurationsinfo für Star3, rba_Nds_Length=1, rba_Nds_Name=FBL_Cfg_Star3_ST3, rba_Nds_UnusedAreasDefault=255
            rba_Nds_PduTiming
              rba_Nds_TransmissionModeDeclaration
                rba_Nds_TransmissionModeTrueTiming: rba_Nds_CycleTime=200.0
            rba_Nds_SignalInstance_Platform_Stat_Star3 (rba_Nds_SignalInstance): rba_Nds_BitPosition=0, rba_Nds_ByteOrder=INTEL, rba_Nds_SignalRef=rba_Nds_Signal_Platform_Stat_Star3
        rba_Nds_Pdu_DI_OdoSpeedometer_ST3
          rba_Nds_SignalPdu: rba_Nds_Description=Fahrerinformation Odometer und Tacho, rba_Nds_Length=8, rba_Nds_Name=DI_OdoSpeedometer_ST3, rba_Nds_UnusedAreasDefault=255
            rba_Nds_PduTiming
              rba_Nds_TransmissionModeDeclaration
                rba_Nds_TransmissionModeTrueTiming: rba_Nds_CycleTime=1000.0, rba_Nds_NumberOfEventTransmissions=0
            rba_Nds_SignalGroupInstance_DI_Odo_Pr5_ST3_e68xmtlkywxgxsdwekdjjhw3t (rba_Nds_SignalGroupInstance): rba_Nds_UpdateBitPosition=63, rba_Nds_SignalGroupRef=rba_Nds_SignalGroup_DI_Odo_Pr5_ST3_e68xmtlkywxgxsdwekdjjhw3t
            4 x rba_Nds_SignalInstance, all with rba_Nds_ByteOrder=INTEL:
              rba_Nds_SignalInstance_CRC_DI_Odo_Pr5_ST3: rba_Nds_BitPosition=0, rba_Nds_SignalRef=rba_Nds_Signal_CRC_DI_Odo_Pr5_ST3
              rba_Nds_SignalInstance_Odo_ST3: rba_Nds_BitPosition=24, rba_Nds_SignalRef=rba_Nds_Signal_Odo_ST3
              rba_Nds_SignalInstance_SQC_DI_Odo_Pr5_ST3: rba_Nds_BitPosition=16, rba_Nds_SignalRef=rba_Nds_Signal_SQC_DI_Odo_Pr5_ST3
              rba_Nds_SignalInstance_VehSpd_Disp_ST3: rba_Nds_BitPosition=48, rba_Nds_SignalRef=rba_Nds_Signal_VehSpd_Disp_ST3
        rba_Nds_Pdu_DIAG_Stat_ST3
          rba_Nds_SignalPdu: rba_Nds_Description=Actv Line Status Tester pres, rba_Nds_Length=4, rba_Nds_Name=DIAG_Stat_ST3, rba_Nds_UnusedAreasDefault=255
            rba_Nds_PduTiming
              rba_Nds_TransmissionModeDeclaration
                rba_Nds_TransmissionModeTrueTiming: rba_Nds_CycleTime=1000.0, rba_Nds_NumberOfEventTransmissions=0
            rba_Nds_SignalInstance_Actv_Line_Stat_ST3 (rba_Nds_SignalInstance): rba_Nds_BitPosition=0, rba_Nds_ByteOrder=INTEL, rba_Nds_SignalRef=rba_Nds_Signal_Actv_Line_Stat_ST3
            rba_Nds_SignalInstance_DidA_ExtTest_Pres_ST3 (rba_Nds_SignalInstance): rba_Nds_BitPosition=2, rba_Nds_ByteOrder=INTEL, rba_Nds_SignalRef=rba_Nds_Signal_DidA_ExtTest_Pres_ST3
        rba_Nds_Pdu_Ign_Stat_ST3_secured
          rba_Nds_SecuredPdu:
            rba_Nds_Description = Ign_Stat_ST3_secured
            rba_Nds_Length = 8
            rba_Nds_Name = Ign_Stat_ST3_secured
            rba_Nds_AuthenticPduTriggeringRef = rba_Nds_CanPduTriggering_Ign_Stat_ST3_74u0yv4bzub4d7kkohk0jy10a
        rba_Nds_Pdu_Ign_Stat_ST3
          rba_Nds_SignalPdu: rba_Nds_Description=Zuendungsstatus, rba_Nds_Length=4, rba_Nds_Name=Ign_Stat_ST3, rba_Nds_UnusedAreasDefault=255
            rba_Nds_PduTiming
              rba_Nds_TransmissionModeDeclaration
                rba_Nds_TransmissionModeTrueTiming: rba_Nds_CycleTime=100.0, rba_Nds_NumberOfEventTransmissions=0
            rba_Nds_SignalGroupInstance_Ign_Stat_Pr5_ST3_csgs1dv6drms80o1i9p49677w (rba_Nds_SignalGroupInstance): rba_Nds_SignalGroupRef=rba_Nds_SignalGroup_Ign_Stat_Pr5_ST3_csgs1dv6drms80o1i9p49677w
            5 x rba_Nds_SignalInstance, all with rba_Nds_ByteOrder=INTEL:
              rba_Nds_SignalInstance_CRC_Ign_Stat_Pr5_ST3: rba_Nds_BitPosition=0, rba_Nds_SignalRef=rba_Nds_Signal_CRC_Ign_Stat_Pr5_ST3
              rba_Nds_SignalInstance_ISw_Stat_ST3: rba_Nds_BitPosition=24, rba_Nds_SignalRef=rba_Nds_Signal_ISw_Stat_ST3
              rba_Nds_SignalInstance_KG_StartSw_Psd_ST3: rba_Nds_BitPosition=31, rba_Nds_SignalRef=rba_Nds_Signal_KG_StartSw_Psd_ST3
              rba_Nds_SignalInstance_SQC_Ign_Stat_Pr5_ST3: rba_Nds_BitPosition=16, rba_Nds_SignalRef=rba_Nds_Signal_SQC_Ign_Stat_Pr5_ST3
              rba_Nds_SignalInstance_Veh_Op_Mode_ST3: rba_Nds_BitPosition=27, rba_Nds_SignalRef=rba_Nds_Signal_Veh_Op_Mode_ST3
        rba_Nds_Pdu_BCS_Whl_Msg1_BTC_ST3
          rba_Nds_SignalPdu: rba_Nds_Description=BCS Whl Msg 1 ST3, rba_Nds_Length=20, rba_Nds_Name=BCS_Whl_Msg1_BTC_ST3, rba_Nds_UnusedAreasDefault=255
            rba_Nds_PduTiming
              rba_Nds_TransmissionModeDeclaration
                rba_Nds_TransmissionModeTrueTiming: rba_Nds_CycleTime=20.0
            rba_Nds_SignalGroupInstance_BCS_Whl_Msg1_BTC_Pr5_ST3_3z5vvcdtzaheg7vz23u7gb0g6 (rba_Nds_SignalGroupInstance): rba_Nds_SignalGroupRef=rba_Nds_SignalGroup_BCS_Whl_Msg1_BTC_Pr5_ST3_3z5vvcdtzaheg7vz23u7gb0g6
            22 x rba_Nds_SignalInstance, all with rba_Nds_ByteOrder=INTEL:
              rba_Nds_SignalInstance_BCS_Whl_Msg1_TmStmp_BTC_ST3: rba_Nds_BitPosition=136, rba_Nds_SignalRef=rba_Nds_Signal_BCS_Whl_Msg1_TmStmp_BTC_ST3
              rba_Nds_SignalInstance_BCS_Whl_Msg1_TmSyncStat_BTC_ST3: rba_Nds_BitPosition=152, rba_Nds_SignalRef=rba_Nds_Signal_BCS_Whl_Msg1_TmSyncStat_BTC_ST3
              rba_Nds_SignalInstance_CRC_BCS_Whl_Msg1_BTC_Pr5_ST3: rba_Nds_BitPosition=0, rba_Nds_SignalRef=rba_Nds_Signal_CRC_BCS_Whl_Msg1_BTC_Pr5_ST3
              rba_Nds_SignalInstance_GTS_ESP_Clk_Stat_Bckp_ST3: rba_Nds_BitPosition=154, rba_Nds_SignalRef=rba_Nds_Signal_GTS_ESP_Clk_Stat_Bckp_ST3
              rba_Nds_SignalInstance_SQC_BCS_Whl_Msg1_BTC_Pr5_ST3: rba_Nds_BitPosition=16, rba_Nds_SignalRef=rba_Nds_Signal_SQC_BCS_Whl_Msg1_BTC_Pr5_ST3
              rba_Nds_SignalInstance_WhlDir_FL_Stat_BTC_ST3: rba_Nds_BitPosition=34, rba_Nds_SignalRef=rba_Nds_Signal_WhlDir_FL_Stat_BTC_ST3
              rba_Nds_SignalInstance_WhlDir_FR_Stat_BTC_ST3: rba_Nds_BitPosition=36, rba_Nds_SignalRef=rba_Nds_Signal_WhlDir_FR_Stat_BTC_ST3
              rba_Nds_SignalInstance_WhlDir_RL_Stat_BTC_ST3: rba_Nds_BitPosition=38, rba_Nds_SignalRef=rba_Nds_Signal_WhlDir_RL_Stat_BTC_ST3
              rba_Nds_SignalInstance_WhlDir_RR_Stat_BTC_ST3: rba_Nds_BitPosition=134, rba_Nds_SignalRef=rba_Nds_Signal_WhlDir_RR_Stat_BTC_ST3
              rba_Nds_SignalInstance_WhlPlsCnt_FL_BTC_ST3: rba_Nds_BitPosition=104, rba_Nds_SignalRef=rba_Nds_Signal_WhlPlsCnt_FL_BTC_ST3
              rba_Nds_SignalInstance_WhlPlsCnt_FR_BTC_ST3: rba_Nds_BitPosition=114, rba_Nds_SignalRef=rba_Nds_Signal_WhlPlsCnt_FR_BTC_ST3
              rba_Nds_SignalInstance_WhlPlsCnt_RL_BTC_ST3: rba_Nds_BitPosition=24, rba_Nds_SignalRef=rba_Nds_Signal_WhlPlsCnt_RL_BTC_ST3
              rba_Nds_SignalInstance_WhlPlsCnt_RR_BTC_ST3: rba_Nds_BitPosition=124, rba_Nds_SignalRef=rba_Nds_Signal_WhlPlsCnt_RR_BTC_ST3
              rba_Nds_SignalInstance_WhlRPM_FL_BTC_ST3: rba_Nds_BitPosition=40, rba_Nds_SignalRef=rba_Nds_Signal_WhlRPM_FL_BTC_ST3
              rba_Nds_SignalInstance_WhlRPM_FL_Qual_BTC_ST3: rba_Nds_BitPosition=54, rba_Nds_SignalRef=rba_Nds_Signal_WhlRPM_FL_Qual_BTC_ST3
              rba_Nds_SignalInstance_WhlRPM_FR_BTC_ST3: rba_Nds_BitPosition=56, rba_Nds_SignalRef=rba_Nds_Signal_WhlRPM_FR_BTC_ST3
              rba_Nds_SignalInstance_WhlRPM_FR_Qual_BTC_ST3: rba_Nds_BitPosition=70, rba_Nds_SignalRef=rba_Nds_Signal_WhlRPM_FR_Qual_BTC_ST3
              rba_Nds_SignalInstance_WhlRPM_RL_BTC_ST3: rba_Nds_BitPosition=72, rba_Nds_SignalRef=rba_Nds_Signal_WhlRPM_RL_BTC_ST3
              rba_Nds_SignalInstance_WhlRPM_RL_Qual_BTC_ST3: rba_Nds_BitPosition=86, rba_Nds_SignalRef=rba_Nds_Signal_WhlRPM_RL_Qual_BTC_ST3
              rba_Nds_SignalInstance_WhlRPM_RR_BTC_ST3: rba_Nds_BitPosition=88, rba_Nds_SignalRef=rba_Nds_Signal_WhlRPM_RR_BTC_ST3
              rba_Nds_SignalInstance_WhlRPM_RR_Qual_BTC_ST3: rba_Nds_BitPosition=102, rba_Nds_SignalRef=rba_Nds_Signal_WhlRPM_RR_Qual_BTC_ST3
              rba_Nds_SignalInstance_Rsrv1_BCS_Whl_Msg1_BTC_Pr5_ST3: rba_Nds_BitPosition=156, rba_Nds_SignalRef=rba_Nds_Signal_Rsrv1_BCS_Whl_Msg1_BTC_Pr5_ST3
        rba_Nds_Pdu_PT4_PTCoor4_ST3
          rba_Nds_SignalPdu: rba_Nds_Description=PT4_PTCoor4_ST3, rba_Nds_Length=4, rba_Nds_Name=PT4_PTCoor4_ST3, rba_Nds_UnusedAreasDefault=255
            rba_Nds_PduTiming
              rba_Nds_TransmissionModeDeclaration
                rba_Nds_TransmissionModeTrueTiming: rba_Nds_CycleTime=100.0, rba_Nds_NumberOfEventTransmissions=0
            rba_Nds_SignalGroupInstance_PT4_PTCoor4_Pr5_ST3_af4fxb1ykieox3itqdfzs0kpb (rba_Nds_SignalGroupInstance): rba_Nds_SignalGroupRef=rba_Nds_SignalGroup_PT4_PTCoor4_Pr5_ST3_af4fxb1ykieox3itqdfzs0kpb
            6 x rba_Nds_SignalInstance, all with rba_Nds_ByteOrder=INTEL:
              rba_Nds_SignalInstance_CRC_PT4_PTCoor4_Pr5_ST3: rba_Nds_BitPosition=0, rba_Nds_SignalRef=rba_Nds_Signal_CRC_PT4_PTCoor4_Pr5_ST3
              rba_Nds_SignalInstance_PT4_PTCoor_EngStartPN14_Stat_ST3: rba_Nds_BitPosition=28, rba_Nds_SignalRef=rba_Nds_Signal_PT4_PTCoor_EngStartPN14_Stat_ST3
              rba_Nds_SignalInstance_PT4_PTCoor_PT_Rdy_ST3: rba_Nds_BitPosition=24, rba_Nds_SignalRef=rba_Nds_Signal_PT4_PTCoor_PT_Rdy_ST3
              rba_Nds_SignalInstance_PT4_PTCoor_SSA_EngSp_ST3: rba_Nds_BitPosition=26, rba_Nds_SignalRef=rba_Nds_Signal_PT4_PTCoor_SSA_EngSp_ST3
              rba_Nds_SignalInstance_SQC_PT4_PTCoor4_Pr5_ST3: rba_Nds_BitPosition=16, rba_Nds_SignalRef=rba_Nds_Signal_SQC_PT4_PTCoor4_Pr5_ST3
              rba_Nds_SignalInstance_Rsrv1_PT4_PTCoor_PT_Rdy_Pr5_ST3: rba_Nds_BitPosition=31, rba_Nds_SignalRef=rba_Nds_Signal_Rsrv1_PT4_PTCoor_PT_Rdy_Pr5_ST3
        rba_Nds_Pdu_PN14_Master_Stat1_ST3
          rba_Nds_SignalPdu: rba_Nds_Description=Status 12V Bordnetz Master, rba_Nds_Length=8, rba_Nds_Name=PN14_Master_Stat1_ST3, rba_Nds_UnusedAreasDefault=255
            rba_Nds_PduTiming
              rba_Nds_TransmissionModeDeclaration
                rba_Nds_TransmissionModeTrueTiming: rba_Nds_CycleTime=200.0
            11 x rba_Nds_SignalInstance, all with rba_Nds_ByteOrder=INTEL:
              rba_Nds_SignalInstance_PN14_DDP_Sw2_Stat_ST3: rba_Nds_BitPosition=57, rba_Nds_SignalRef=rba_Nds_Signal_PN14_DDP_Sw2_Stat_ST3
              rba_Nds_SignalInstance_PN14_DDP_Sw_Stat_ST3: rba_Nds_BitPosition=2, rba_Nds_SignalRef=rba_Nds_Signal_PN14_DDP_Sw_Stat_ST3
              rba_Nds_SignalInstance_PN14_ExtBat_Charge_Actv_ST3: rba_Nds_BitPosition=55, rba_Nds_SignalRef=rba_Nds_Signal_PN14_ExtBat_Charge_Actv_ST3
              rba_Nds_SignalInstance_PN14_PNSec_RechargeEnable_ST3: rba_Nds_BitPosition=53, rba_Nds_SignalRef=rba_Nds_Signal_PN14_PNSec_RechargeEnable_ST3
              rba_Nds_SignalInstance_PN14_ProdMd_BatStat_ST3: rba_Nds_BitPosition=8, rba_Nds_SignalRef=rba_Nds_Signal_PN14_ProdMd_BatStat_ST3
              rba_Nds_SignalInstance_PN14_ProdMd_Stat_ST3: rba_Nds_BitPosition=5, rba_Nds_SignalRef=rba_Nds_Signal_PN14_ProdMd_Stat_ST3
              rba_Nds_SignalInstance_PN14_SupBat_Curr_ST3: rba_Nds_BitPosition=32, rba_Nds_SignalRef=rba_Nds_Signal_PN14_SupBat_Curr_ST3
              rba_Nds_SignalInstance_PN14_SupBat_Stat_ST3: rba_Nds_BitPosition=15, rba_Nds_SignalRef=rba_Nds_Signal_PN14_SupBat_Stat_ST3
              rba_Nds_SignalInstance_PN14_SupBat_Temp_ST3: rba_Nds_BitPosition=45, rba_Nds_SignalRef=rba_Nds_Signal_PN14_SupBat_Temp_ST3
              rba_Nds_SignalInstance_PN14_SupBat_Volt_ST3: rba_Nds_BitPosition=22, rba_Nds_SignalRef=rba_Nds_Signal_PN14_SupBat_Volt_ST3
              rba_Nds_SignalInstance_PN14_TransMd_Stat_ST3: rba_Nds_BitPosition=0, rba_Nds_SignalRef=rba_Nds_Signal_PN14_TransMd_Stat_ST3
        rba_Nds_Pdu_BCS_Whl_Msg1_BTC_ST3_secured
          rba_Nds_SecuredPdu:
            rba_Nds_Description = BCS_Whl_Msg1_BTC_ST3_secured
            rba_Nds_Length = 24
            rba_Nds_Name = BCS_Whl_Msg1_BTC_ST3_secured
            rba_Nds_AuthenticPduTriggeringRef = rba_Nds_CanPduTriggering_BCS_Whl_Msg1_BTC_ST3_c16k4ur8udt67j57b0rf78j53
        rba_Nds_Pdu_PT4_PTCoor4_ST3_secured
          rba_Nds_SecuredPdu:
            rba_Nds_Description = PT4_PTCoor4_ST3_secured
            rba_Nds_Length = 8
            rba_Nds_Name = PT4_PTCoor4_ST3_secured
            rba_Nds_AuthenticPduTriggeringRef = rba_Nds_CanPduTriggering_PT4_PTCoor4_ST3_831x3bc2a5f0b8lcc0rs7f0hl
        rba_Nds_Pdu_PN14_Master_Stat1_ST3_secured
          rba_Nds_SecuredPdu:
            rba_Nds_Description = PN14_Master_Stat1_ST3_secured
            rba_Nds_Length = 12
            rba_Nds_Name = PN14_Master_Stat1_ST3_secured
            rba_Nds_AuthenticPduTriggeringRef = rba_Nds_CanPduTriggering_PN14_Master_Stat1_ST3_2eb8i7df9hluel7u1vtmv4jbu
        rba_Nds_Pdu_ESP_HAD_BACKUP_GW_Container3_ST3_ContainerIPdu
          rba_Nds_ContainerPdu:
            rba_Nds_Description = ESP_HAD_BACKUP_GW_Container3_ST3_ContainerIPdu
            rba_Nds_HeaderType = SHORT_HEADER
            rba_Nds_Length = 64
            rba_Nds_Name = ESP_HAD_BACKUP_GW_Container3_ST3_ContainerIPdu
            rba_Nds_UnusedAreasDefault = 0
            rba_Nds_ContainedPduTriggering = rba_Nds_CanPduTriggering_ESP_HAD_BACKUP_GW_Container3_ST3_ESP_HAD_BACKUP_GW_Container3_ST3_VSS_TP_SharedSecret_ST3_82pb6fg4cswmgotegs6aplrj2
            rba_Nds_ContainedPduTriggering = rba_Nds_CanPduTriggering_ESP_HAD_BACKUP_GW_Container3_ST3_ESP_HAD_BACKUP_GW_Container3_ST3_VSS_TP_RealTmOffset_ST3_2686huv0x9rg4cu1k20p07zrz
            rba_Nds_ContainedPduTriggering = rba_Nds_CanPduTriggering_ESP_HAD_BACKUP_GW_Container3_ST3_ESP_HAD_BACKUP_GW_Container3_ST3_VSS_TP_Auth_ST3_a5m1oehgi1yzcicgsdebhigxy
            rba_Nds_ContainedPduTriggering = rba_Nds_CanPduTriggering_ESP_HAD_BACKUP_GW_Container3_ST3_ESP_HAD_BACKUP_GW_Container3_ST3_VSS_TP_VIN_ST3_3331jz4zbik8yl0ehm51yf8w4
            rba_Nds_ContainedPduTriggering = rba_Nds_CanPduTriggering_ESP_HAD_BACKUP_GW_Container3_ST3_ESP_HAD_BACKUP_GW_Container3_ST3_VSS_TP_SecTickCount_Lvl1_ST3_azhv8t4onxhjhi2zn8in2my2n
        rba_Nds_Pdu_ESP_HAD_BACKUP_GW_Container3_ST3_VSS_TP_VIN_ST3
          rba_Nds_SignalPdu: rba_Nds_Description=VSS TP VIN ST3, rba_Nds_Length=8, rba_Nds_Name=ESP_HAD_BACKUP_GW_Container3_ST3_VSS_TP_VIN_ST3, rba_Nds_UnusedAreasDefault=255
            rba_Nds_PduTiming
              rba_Nds_TransmissionModeDeclaration
                rba_Nds_TransmissionModeTrueTiming: rba_Nds_NumberOfEventTransmissions=0, rba_Nds_CycleTime=5000, rba_Nds_EventTransmissionCycleTime=0.0
            rba_Nds_SignalGroupInstance_VSS_TP_VIN_ST3_bz1xsv84cxzl09j028gn39p69 (rba_Nds_SignalGroupInstance): rba_Nds_SignalGroupRef=rba_Nds_SignalGroup_VSS_TP_VIN_ST3_bz1xsv84cxzl09j028gn39p69
            8 x rba_Nds_SignalInstance, all with rba_Nds_ByteOrder=INTEL:
              rba_Nds_SignalInstance_VSS_TP_VIN_0_ST3: rba_Nds_BitPosition=0, rba_Nds_SignalRef=rba_Nds_Signal_VSS_TP_VIN_0_ST3
              rba_Nds_SignalInstance_VSS_TP_VIN_1_ST3: rba_Nds_BitPosition=8, rba_Nds_SignalRef=rba_Nds_Signal_VSS_TP_VIN_1_ST3
              rba_Nds_SignalInstance_VSS_TP_VIN_2_ST3: rba_Nds_BitPosition=16, rba_Nds_SignalRef=rba_Nds_Signal_VSS_TP_VIN_2_ST3
              rba_Nds_SignalInstance_VSS_TP_VIN_3_ST3: rba_Nds_BitPosition=24, rba_Nds_SignalRef=rba_Nds_Signal_VSS_TP_VIN_3_ST3
              rba_Nds_SignalInstance_VSS_TP_VIN_4_ST3: rba_Nds_BitPosition=32, rba_Nds_SignalRef=rba_Nds_Signal_VSS_TP_VIN_4_ST3
              rba_Nds_SignalInstance_VSS_TP_VIN_5_ST3: rba_Nds_BitPosition=40, rba_Nds_SignalRef=rba_Nds_Signal_VSS_TP_VIN_5_ST3
              rba_Nds_SignalInstance_VSS_TP_VIN_6_ST3: rba_Nds_BitPosition=48, rba_Nds_SignalRef=rba_Nds_Signal_VSS_TP_VIN_6_ST3
              rba_Nds_SignalInstance_VSS_TP_VIN_7_ST3: rba_Nds_BitPosition=56, rba_Nds_SignalRef=rba_Nds_Signal_VSS_TP_VIN_7_ST3
            rba_Nds_ContainedPduProperties: rba_Nds_HeaderIdShortHeader=4259840
        rba_Nds_Pdu_ESP_HAD_BACKUP_GW_Container3_ST3_VSS_TP_SharedSecret_ST3
          rba_Nds_SignalPdu:
            rba_Nds_Description = VSS TP SharedSecret ST3
            rba_Nds_Length = 8
            rba_Nds_Name = ESP_HAD_BACKUP_GW_Container3_ST3_VSS_TP_SharedSecret_ST3
            rba_Nds_UnusedAreasDefault = 255
            rba_Nds_ContainedPduProperties: rba_Nds_HeaderIdShortHeader=4259843
            rba_Nds_PduTiming
              rba_Nds_TransmissionModeDeclaration
                rba_Nds_TransmissionModeTrueTiming: rba_Nds_NumberOfEventTransmissions=0
            rba_Nds_SignalGroupInstance_VSS_TP_SharedSecret_ST3_8pj4t8t4rm3tw3pk5hj7vonti (rba_Nds_SignalGroupInstance): rba_Nds_SignalGroupRef=rba_Nds_SignalGroup_VSS_TP_SharedSecret_ST3_8pj4t8t4rm3tw3pk5hj7vonti
            8 x rba_Nds_SignalInstance, all with rba_Nds_ByteOrder=INTEL:
              rba_Nds_SignalInstance_VSS_TP_SharedSecret_0_ST3: rba_Nds_BitPosition=0, rba_Nds_SignalRef=rba_Nds_Signal_VSS_TP_SharedSecret_0_ST3
              rba_Nds_SignalInstance_VSS_TP_SharedSecret_1_ST3: rba_Nds_BitPosition=8, rba_Nds_SignalRef=rba_Nds_Signal_VSS_TP_SharedSecret_1_ST3
              rba_Nds_SignalInstance_VSS_TP_SharedSecret_2_ST3: rba_Nds_BitPosition=16, rba_Nds_SignalRef=rba_Nds_Signal_VSS_TP_SharedSecret_2_ST3
              rba_Nds_SignalInstance_VSS_TP_SharedSecret_3_ST3: rba_Nds_BitPosition=24, rba_Nds_SignalRef=rba_Nds_Signal_VSS_TP_SharedSecret_3_ST3
              rba_Nds_SignalInstance_VSS_TP_SharedSecret_4_ST3: rba_Nds_BitPosition=32, rba_Nds_SignalRef=rba_Nds_Signal_VSS_TP_SharedSecret_4_ST3
              rba_Nds_SignalInstance_VSS_TP_SharedSecret_5_ST3: rba_Nds_BitPosition=40, rba_Nds_SignalRef=rba_Nds_Signal_VSS_TP_SharedSecret_5_ST3
              rba_Nds_SignalInstance_VSS_TP_SharedSecret_6_ST3: rba_Nds_BitPosition=48, rba_Nds_SignalRef=rba_Nds_Signal_VSS_TP_SharedSecret_6_ST3
              rba_Nds_SignalInstance_VSS_TP_SharedSecret_7_ST3: rba_Nds_BitPosition=56, rba_Nds_SignalRef=rba_Nds_Signal_VSS_TP_SharedSecret_7_ST3
        rba_Nds_Pdu_ESP_HAD_BACKUP_GW_Container3_ST3_VSS_TP_SecTickCount_Lvl1_ST3
          rba_Nds_SignalPdu:
            rba_Nds_Description = VSS TP SecTickCount Lvl1 ST3
            rba_Nds_Length = 8
            rba_Nds_Name = ESP_HAD_BACKUP_GW_Container3_ST3_VSS_TP_SecTickCount_Lvl1_ST3
            rba_Nds_UnusedAreasDefault = 255
            rba_Nds_ContainedPduProperties: rba_Nds_HeaderIdShortHeader=4259844
            rba_Nds_PduTiming
              rba_Nds_TransmissionModeDeclaration
                rba_Nds_TransmissionModeTrueTiming: rba_Nds_NumberOfEventTransmissions=0, rba_Nds_CycleTime=3000
            rba_Nds_SignalGroupInstance_VSS_TP_SecTickCount_Lvl1_ST3_mzmfdqtqz5kvv1kfpvg0kql3 (rba_Nds_SignalGroupInstance): rba_Nds_SignalGroupRef=rba_Nds_SignalGroup_VSS_TP_SecTickCount_Lvl1_ST3_mzmfdqtqz5kvv1kfpvg0kql3
            8 x rba_Nds_SignalInstance, all with rba_Nds_ByteOrder=INTEL:
              rba_Nds_SignalInstance_VSS_TP_SecTickCount_Lvl1_0_ST3: rba_Nds_BitPosition=0, rba_Nds_SignalRef=rba_Nds_Signal_VSS_TP_SecTickCount_Lvl1_0_ST3
              rba_Nds_SignalInstance_VSS_TP_SecTickCount_Lvl1_1_ST3: rba_Nds_BitPosition=8, rba_Nds_SignalRef=rba_Nds_Signal_VSS_TP_SecTickCount_Lvl1_1_ST3
              rba_Nds_SignalInstance_VSS_TP_SecTickCount_Lvl1_2_ST3: rba_Nds_BitPosition=16, rba_Nds_SignalRef=rba_Nds_Signal_VSS_TP_SecTickCount_Lvl1_2_ST3
              rba_Nds_SignalInstance_VSS_TP_SecTickCount_Lvl1_3_ST3: rba_Nds_BitPosition=24, rba_Nds_SignalRef=rba_Nds_Signal_VSS_TP_SecTickCount_Lvl1_3_ST3
              rba_Nds_SignalInstance_VSS_TP_SecTickCount_Lvl1_4_ST3: rba_Nds_BitPosition=32, rba_Nds_SignalRef=rba_Nds_Signal_VSS_TP_SecTickCount_Lvl1_4_ST3
              rba_Nds_SignalInstance_VSS_TP_SecTickCount_Lvl1_5_ST3: rba_Nds_BitPosition=40, rba_Nds_SignalRef=rba_Nds_Signal_VSS_TP_SecTickCount_Lvl1_5_ST3
              rba_Nds_SignalInstance_VSS_TP_SecTickCount_Lvl1_6_ST3: rba_Nds_BitPosition=48, rba_Nds_SignalRef=rba_Nds_Signal_VSS_TP_SecTickCount_Lvl1_6_ST3
              rba_Nds_SignalInstance_VSS_TP_SecTickCount_Lvl1_7_ST3: rba_Nds_BitPosition=56, rba_Nds_SignalRef=rba_Nds_Signal_VSS_TP_SecTickCount_Lvl1_7_ST3
        rba_Nds_Pdu_ESP_HAD_BACKUP_GW_Container3_ST3_VSS_TP_RealTmOffset_ST3
          rba_Nds_SignalPdu:
            rba_Nds_Description = VSS TP RealTmOffset ST3
            rba_Nds_Length = 8
            rba_Nds_Name = ESP_HAD_BACKUP_GW_Container3_ST3_VSS_TP_RealTmOffset_ST3
            rba_Nds_UnusedAreasDefault = 255
            rba_Nds_ContainedPduProperties: rba_Nds_HeaderIdShortHeader=4259842
            rba_Nds_PduTiming
              rba_Nds_TransmissionModeDeclaration
                rba_Nds_TransmissionModeTrueTiming: rba_Nds_NumberOfEventTransmissions=0
            rba_Nds_SignalGroupInstance_VSS_TP_RealTmOffset_ST3_1t7vc44gftc0wv35k5kgc2in9 (rba_Nds_SignalGroupInstance): rba_Nds_SignalGroupRef=rba_Nds_SignalGroup_VSS_TP_RealTmOffset_ST3_1t7vc44gftc0wv35k5kgc2in9
            8 x rba_Nds_SignalInstance, all with rba_Nds_ByteOrder=INTEL:
              rba_Nds_SignalInstance_VSS_TP_RealTmOffset_0_ST3: rba_Nds_BitPosition=0, rba_Nds_SignalRef=rba_Nds_Signal_VSS_TP_RealTmOffset_0_ST3
              rba_Nds_SignalInstance_VSS_TP_RealTmOffset_1_ST3: rba_Nds_BitPosition=8, rba_Nds_SignalRef=rba_Nds_Signal_VSS_TP_RealTmOffset_1_ST3
              rba_Nds_SignalInstance_VSS_TP_RealTmOffset_2_ST3: rba_Nds_BitPosition=16, rba_Nds_SignalRef=rba_Nds_Signal_VSS_TP_RealTmOffset_2_ST3
              rba_Nds_SignalInstance_VSS_TP_RealTmOffset_3_ST3: rba_Nds_BitPosition=24, rba_Nds_SignalRef=rba_Nds_Signal_VSS_TP_RealTmOffset_3_ST3
              rba_Nds_SignalInstance_VSS_TP_RealTmOffset_4_ST3: rba_Nds_BitPosition=32, rba_Nds_SignalRef=rba_Nds_Signal_VSS_TP_RealTmOffset_4_ST3
              rba_Nds_SignalInstance_VSS_TP_RealTmOffset_5_ST3: rba_Nds_BitPosition=40, rba_Nds_SignalRef=rba_Nds_Signal_VSS_TP_RealTmOffset_5_ST3
              rba_Nds_SignalInstance_VSS_TP_RealTmOffset_6_ST3: rba_Nds_BitPosition=48, rba_Nds_SignalRef=rba_Nds_Signal_VSS_TP_RealTmOffset_6_ST3
              rba_Nds_SignalInstance_VSS_TP_RealTmOffset_7_ST3: rba_Nds_BitPosition=56, rba_Nds_SignalRef=rba_Nds_Signal_VSS_TP_RealTmOffset_7_ST3
        rba_Nds_Pdu_ESP_HAD_BACKUP_GW_Container3_ST3_VSS_TP_Auth_ST3
          rba_Nds_SignalPdu:
            rba_Nds_Description = VSS TP Auth ST3
            rba_Nds_Length = 8
            rba_Nds_Name = ESP_HAD_BACKUP_GW_Container3_ST3_VSS_TP_Auth_ST3
            rba_Nds_UnusedAreasDefault = 255
            rba_Nds_ContainedPduProperties: rba_Nds_HeaderIdShortHeader=4259841
            rba_Nds_PduTiming
              rba_Nds_TransmissionModeDeclaration
                rba_Nds_TransmissionModeTrueTiming: rba_Nds_NumberOfEventTransmissions=0
            rba_Nds_SignalGroupInstance_VSS_TP_Auth_ST3_6j4id7sghlvlbroli4wjozjik (rba_Nds_SignalGroupInstance): rba_Nds_SignalGroupRef=rba_Nds_SignalGroup_VSS_TP_Auth_ST3_6j4id7sghlvlbroli4wjozjik
            8 x rba_Nds_SignalInstance, all with rba_Nds_ByteOrder=INTEL:
              rba_Nds_SignalInstance_VSS_TP_Auth_0_ST3: rba_Nds_BitPosition=0, rba_Nds_SignalRef=rba_Nds_Signal_VSS_TP_Auth_0_ST3
              rba_Nds_SignalInstance_VSS_TP_Auth_1_ST3: rba_Nds_BitPosition=8, rba_Nds_SignalRef=rba_Nds_Signal_VSS_TP_Auth_1_ST3
              rba_Nds_SignalInstance_VSS_TP_Auth_2_ST3: rba_Nds_BitPosition=16, rba_Nds_SignalRef=rba_Nds_Signal_VSS_TP_Auth_2_ST3
              rba_Nds_SignalInstance_VSS_TP_Auth_3_ST3: rba_Nds_BitPosition=24, rba_Nds_SignalRef=rba_Nds_Signal_VSS_TP_Auth_3_ST3
              rba_Nds_SignalInstance_VSS_TP_Auth_4_ST3: rba_Nds_BitPosition=32, rba_Nds_SignalRef=rba_Nds_Signal_VSS_TP_Auth_4_ST3
              rba_Nds_SignalInstance_VSS_TP_Auth_5_ST3: rba_Nds_BitPosition=40, rba_Nds_SignalRef=rba_Nds_Signal_VSS_TP_Auth_5_ST3
              rba_Nds_SignalInstance_VSS_TP_Auth_6_ST3: rba_Nds_BitPosition=48, rba_Nds_SignalRef=rba_Nds_Signal_VSS_TP_Auth_6_ST3
              rba_Nds_SignalInstance_VSS_TP_Auth_7_ST3: rba_Nds_BitPosition=56, rba_Nds_SignalRef=rba_Nds_Signal_VSS_TP_Auth_7_ST3
        rba_Nds_Pdu_VSS_TP_VIN_ST3
          rba_Nds_SignalPdu: rba_Nds_Description=VSS TP VIN ST3, rba_Nds_Length=8, rba_Nds_Name=VSS_TP_VIN_ST3, rba_Nds_UnusedAreasDefault=255
            rba_Nds_PduTiming
              rba_Nds_TransmissionModeDeclaration
                rba_Nds_TransmissionModeTrueTiming: rba_Nds_NumberOfEventTransmissions=0
            rba_Nds_SignalGroupInstance_VSS_TP_VIN_ST3_bz1xsv84cxzl09j028gn39p69 (rba_Nds_SignalGroupInstance): rba_Nds_SignalGroupRef=rba_Nds_SignalGroup_VSS_TP_VIN_ST3_bz1xsv84cxzl09j028gn39p69
            8 x rba_Nds_SignalInstance, all with rba_Nds_ByteOrder=INTEL:
              rba_Nds_SignalInstance_VSS_TP_VIN_0_ST3: rba_Nds_BitPosition=0, rba_Nds_SignalRef=rba_Nds_Signal_VSS_TP_VIN_0_ST3
              rba_Nds_SignalInstance_VSS_TP_VIN_1_ST3: rba_Nds_BitPosition=8, rba_Nds_SignalRef=rba_Nds_Signal_VSS_TP_VIN_1_ST3
              rba_Nds_SignalInstance_VSS_TP_VIN_2_ST3: rba_Nds_BitPosition=16, rba_Nds_SignalRef=rba_Nds_Signal_VSS_TP_VIN_2_ST3
              rba_Nds_SignalInstance_VSS_TP_VIN_3_ST3: rba_Nds_BitPosition=24, rba_Nds_SignalRef=rba_Nds_Signal_VSS_TP_VIN_3_ST3
              rba_Nds_SignalInstance_VSS_TP_VIN_4_ST3: rba_Nds_BitPosition=32, rba_Nds_SignalRef=rba_Nds_Signal_VSS_TP_VIN_4_ST3
              rba_Nds_SignalInstance_VSS_TP_VIN_5_ST3: rba_Nds_BitPosition=40, rba_Nds_SignalRef=rba_Nds_Signal_VSS_TP_VIN_5_ST3
              rba_Nds_SignalInstance_VSS_TP_VIN_6_ST3: rba_Nds_BitPosition=48, rba_Nds_SignalRef=rba_Nds_Signal_VSS_TP_VIN_6_ST3
              rba_Nds_SignalInstance_VSS_TP_VIN_7_ST3: rba_Nds_BitPosition=56, rba_Nds_SignalRef=rba_Nds_Signal_VSS_TP_VIN_7_ST3
        rba_Nds_Pdu_VSS_TP_SharedSecret_ST3
          rba_Nds_SignalPdu: rba_Nds_Description=VSS TP SharedSecret ST3, rba_Nds_Length=8, rba_Nds_Name=VSS_TP_SharedSecret_ST3, rba_Nds_UnusedAreasDefault=255
            rba_Nds_PduTiming
              rba_Nds_TransmissionModeDeclaration
                rba_Nds_TransmissionModeTrueTiming: rba_Nds_NumberOfEventTransmissions=0
            rba_Nds_SignalGroupInstance_VSS_TP_SharedSecret_ST3_8pj4t8t4rm3tw3pk5hj7vonti (rba_Nds_SignalGroupInstance): rba_Nds_SignalGroupRef=rba_Nds_SignalGroup_VSS_TP_SharedSecret_ST3_8pj4t8t4rm3tw3pk5hj7vonti
            8 x rba_Nds_SignalInstance, all with rba_Nds_ByteOrder=INTEL:
              rba_Nds_SignalInstance_VSS_TP_SharedSecret_0_ST3: rba_Nds_BitPosition=0, rba_Nds_SignalRef=rba_Nds_Signal_VSS_TP_SharedSecret_0_ST3
              rba_Nds_SignalInstance_VSS_TP_SharedSecret_1_ST3: rba_Nds_BitPosition=8, rba_Nds_SignalRef=rba_Nds_Signal_VSS_TP_SharedSecret_1_ST3
              rba_Nds_SignalInstance_VSS_TP_SharedSecret_2_ST3: rba_Nds_BitPosition=16, rba_Nds_SignalRef=rba_Nds_Signal_VSS_TP_SharedSecret_2_ST3
              rba_Nds_SignalInstance_VSS_TP_SharedSecret_3_ST3: rba_Nds_BitPosition=24, rba_Nds_SignalRef=rba_Nds_Signal_VSS_TP_SharedSecret_3_ST3
              rba_Nds_SignalInstance_VSS_TP_SharedSecret_4_ST3: rba_Nds_BitPosition=32, rba_Nds_SignalRef=rba_Nds_Signal_VSS_TP_SharedSecret_4_ST3
              rba_Nds_SignalInstance_VSS_TP_SharedSecret_5_ST3: rba_Nds_BitPosition=40, rba_Nds_SignalRef=rba_Nds_Signal_VSS_TP_SharedSecret_5_ST3
              rba_Nds_SignalInstance_VSS_TP_SharedSecret_6_ST3: rba_Nds_BitPosition=48, rba_Nds_SignalRef=rba_Nds_Signal_VSS_TP_SharedSecret_6_ST3
              rba_Nds_SignalInstance_VSS_TP_SharedSecret_7_ST3: rba_Nds_BitPosition=56, rba_Nds_SignalRef=rba_Nds_Signal_VSS_TP_SharedSecret_7_ST3
        rba_Nds_Pdu_VSS_TP_SecTickCount_Lvl1_ST3
          rba_Nds_SignalPdu: rba_Nds_Description=VSS TP SecTickCount Lvl1 ST3, rba_Nds_Length=8, rba_Nds_Name=VSS_TP_SecTickCount_Lvl1_ST3, rba_Nds_UnusedAreasDefault=255
            rba_Nds_PduTiming
              rba_Nds_TransmissionModeDeclaration
                rba_Nds_TransmissionModeTrueTiming: rba_Nds_NumberOfEventTransmissions=0
            rba_Nds_SignalGroupInstance_VSS_TP_SecTickCount_Lvl1_ST3_mzmfdqtqz5kvv1kfpvg0kql3 (rba_Nds_SignalGroupInstance): rba_Nds_SignalGroupRef=rba_Nds_SignalGroup_VSS_TP_SecTickCount_Lvl1_ST3_mzmfdqtqz5kvv1kfpvg0kql3
            8 x rba_Nds_SignalInstance, all with rba_Nds_ByteOrder=INTEL:
              rba_Nds_SignalInstance_VSS_TP_SecTickCount_Lvl1_0_ST3: rba_Nds_BitPosition=0, rba_Nds_SignalRef=rba_Nds_Signal_VSS_TP_SecTickCount_Lvl1_0_ST3
              rba_Nds_SignalInstance_VSS_TP_SecTickCount_Lvl1_1_ST3: rba_Nds_BitPosition=8, rba_Nds_SignalRef=rba_Nds_Signal_VSS_TP_SecTickCount_Lvl1_1_ST3
              rba_Nds_SignalInstance_VSS_TP_SecTickCount_Lvl1_2_ST3: rba_Nds_BitPosition=16, rba_Nds_SignalRef=rba_Nds_Signal_VSS_TP_SecTickCount_Lvl1_2_ST3
              rba_Nds_SignalInstance_VSS_TP_SecTickCount_Lvl1_3_ST3: rba_Nds_BitPosition=24, rba_Nds_SignalRef=rba_Nds_Signal_VSS_TP_SecTickCount_Lvl1_3_ST3
              rba_Nds_SignalInstance_VSS_TP_SecTickCount_Lvl1_4_ST3: rba_Nds_BitPosition=32, rba_Nds_SignalRef=rba_Nds_Signal_VSS_TP_SecTickCount_Lvl1_4_ST3
              rba_Nds_SignalInstance_VSS_TP_SecTickCount_Lvl1_5_ST3: rba_Nds_BitPosition=40, rba_Nds_SignalRef=rba_Nds_Signal_VSS_TP_SecTickCount_Lvl1_5_ST3
              rba_Nds_SignalInstance_VSS_TP_SecTickCount_Lvl1_6_ST3: rba_Nds_BitPosition=48, rba_Nds_SignalRef=rba_Nds_Signal_VSS_TP_SecTickCount_Lvl1_6_ST3
              rba_Nds_SignalInstance_VSS_TP_SecTickCount_Lvl1_7_ST3: rba_Nds_BitPosition=56, rba_Nds_SignalRef=rba_Nds_Signal_VSS_TP_SecTickCount_Lvl1_7_ST3
        rba_Nds_Pdu_VSS_TP_RealTmOffset_ST3
          rba_Nds_SignalPdu: rba_Nds_Description=VSS TP RealTmOffset ST3, rba_Nds_Length=8, rba_Nds_Name=VSS_TP_RealTmOffset_ST3, rba_Nds_UnusedAreasDefault=255
            rba_Nds_PduTiming
              rba_Nds_TransmissionModeDeclaration
                rba_Nds_TransmissionModeTrueTiming: rba_Nds_NumberOfEventTransmissions=0
            rba_Nds_SignalGroupInstance_VSS_TP_RealTmOffset_ST3_1t7vc44gftc0wv35k5kgc2in9 (rba_Nds_SignalGroupInstance): rba_Nds_SignalGroupRef=rba_Nds_SignalGroup_VSS_TP_RealTmOffset_ST3_1t7vc44gftc0wv35k5kgc2in9
            8 x rba_Nds_SignalInstance, all with rba_Nds_ByteOrder=INTEL:
              rba_Nds_SignalInstance_VSS_TP_RealTmOffset_0_ST3: rba_Nds_BitPosition=0, rba_Nds_SignalRef=rba_Nds_Signal_VSS_TP_RealTmOffset_0_ST3
              rba_Nds_SignalInstance_VSS_TP_RealTmOffset_1_ST3: rba_Nds_BitPosition=8, rba_Nds_SignalRef=rba_Nds_Signal_VSS_TP_RealTmOffset_1_ST3
              rba_Nds_SignalInstance_VSS_TP_RealTmOffset_2_ST3: rba_Nds_BitPosition=16, rba_Nds_SignalRef=rba_Nds_Signal_VSS_TP_RealTmOffset_2_ST3
              rba_Nds_SignalInstance_VSS_TP_RealTmOffset_3_ST3: rba_Nds_BitPosition=24, rba_Nds_SignalRef=rba_Nds_Signal_VSS_TP_RealTmOffset_3_ST3
              rba_Nds_SignalInstance_VSS_TP_RealTmOffset_4_ST3: rba_Nds_BitPosition=32, rba_Nds_SignalRef=rba_Nds_Signal_VSS_TP_RealTmOffset_4_ST3
              rba_Nds_SignalInstance_VSS_TP_RealTmOffset_5_ST3: rba_Nds_BitPosition=40, rba_Nds_SignalRef=rba_Nds_Signal_VSS_TP_RealTmOffset_5_ST3
              rba_Nds_SignalInstance_VSS_TP_RealTmOffset_6_ST3: rba_Nds_BitPosition=48, rba_Nds_SignalRef=rba_Nds_Signal_VSS_TP_RealTmOffset_6_ST3
              rba_Nds_SignalInstance_VSS_TP_RealTmOffset_7_ST3: rba_Nds_BitPosition=56, rba_Nds_SignalRef=rba_Nds_Signal_VSS_TP_RealTmOffset_7_ST3
        rba_Nds_Pdu_VSS_TP_Auth_ST3
          rba_Nds_SignalPdu: rba_Nds_Description=VSS TP Auth ST3, rba_Nds_Length=8, rba_Nds_Name=VSS_TP_Auth_ST3, rba_Nds_UnusedAreasDefault=255
            rba_Nds_PduTiming
              rba_Nds_TransmissionModeDeclaration
                rba_Nds_TransmissionModeTrueTiming: rba_Nds_NumberOfEventTransmissions=0
            rba_Nds_SignalGroupInstance_VSS_TP_Auth_ST3_6j4id7sghlvlbroli4wjozjik (rba_Nds_SignalGroupInstance): rba_Nds_SignalGroupRef=rba_Nds_SignalGroup_VSS_TP_Auth_ST3_6j4id7sghlvlbroli4wjozjik
            8 x rba_Nds_SignalInstance, all with rba_Nds_ByteOrder=INTEL:
              rba_Nds_SignalInstance_VSS_TP_Auth_0_ST3: rba_Nds_BitPosition=0, rba_Nds_SignalRef=rba_Nds_Signal_VSS_TP_Auth_0_ST3
              rba_Nds_SignalInstance_VSS_TP_Auth_1_ST3: rba_Nds_BitPosition=8, rba_Nds_SignalRef=rba_Nds_Signal_VSS_TP_Auth_1_ST3
              rba_Nds_SignalInstance_VSS_TP_Auth_2_ST3: rba_Nds_BitPosition=16, rba_Nds_SignalRef=rba_Nds_Signal_VSS_TP_Auth_2_ST3
              rba_Nds_SignalInstance_VSS_TP_Auth_3_ST3: rba_Nds_BitPosition=24, rba_Nds_SignalRef=rba_Nds_Signal_VSS_TP_Auth_3_ST3
              rba_Nds_SignalInstance_VSS_TP_Auth_4_ST3: rba_Nds_BitPosition=32, rba_Nds_SignalRef=rba_Nds_Signal_VSS_TP_Auth_4_ST3
              rba_Nds_SignalInstance_VSS_TP_Auth_5_ST3: rba_Nds_BitPosition=40, rba_Nds_SignalRef=rba_Nds_Signal_VSS_TP_Auth_5_ST3
              rba_Nds_SignalInstance_VSS_TP_Auth_6_ST3: rba_Nds_BitPosition=48, rba_Nds_SignalRef=rba_Nds_Signal_VSS_TP_Auth_6_ST3
              rba_Nds_SignalInstance_VSS_TP_Auth_7_ST3: rba_Nds_BitPosition=56, rba_Nds_SignalRef=rba_Nds_Signal_VSS_TP_Auth_7_ST3
        rba_Nds_Pdu_FBL_Cfg_Star3_ST3
          rba_Nds_SignalPdu: rba_Nds_Description=FBL Konfigurationsinfo für Star3, rba_Nds_Length=1, rba_Nds_Name=FBL_Cfg_Star3_ST3, rba_Nds_UnusedAreasDefault=255
            rba_Nds_PduTiming
              rba_Nds_TransmissionModeDeclaration
                rba_Nds_TransmissionModeTrueTiming: rba_Nds_CycleTime=200.0
            rba_Nds_SignalInstance_Platform_Stat_Star3 (rba_Nds_SignalInstance): rba_Nds_BitPosition=0, rba_Nds_ByteOrder=INTEL, rba_Nds_SignalRef=rba_Nds_Signal_Platform_Stat_Star3
      77 x rba_Nds_Signal, all with rba_Nds_Encoding=UNSIGNED:
        rba_Nds_Signal_SQC_Ign_Stat_Pr5_ST3: rba_Nds_BitSize=8, rba_Nds_Description=Sequenzzähler, rba_Nds_Name=SQC_Ign_Stat_Pr5_ST3, rba_Nds_SignalType=ALIVECOUNTER
          rba_Nds_NetworkRepresentation_SQC_Ign_Stat_Pr5_ST3_none_1_0 (rba_Nds_NetworkRepresentation)
            rba_Nds_DirectRepresentation: rba_Nds_MaxValue=255, rba_Nds_MinValue=0
        rba_Nds_Signal_Veh_Op_Mode_ST3: rba_Nds_BitSize=4, rba_Nds_Description=Fahrzeug Betriebsmodus, rba_Nds_Name=Veh_Op_Mode_ST3
          rba_Nds_NetworkRepresentation_0_Veh_Op_Mode_ST3 (rba_Nds_NetworkRepresentation)
            rba_Nds_DirectRepresentation: rba_Nds_MaxValue=15, rba_Nds_MinValue=0
        rba_Nds_Signal_Rsrv1_PT4_PTCoor_PT_Rdy_Pr5_ST3: rba_Nds_BitSize=1, rba_Nds_Description=Reserviert für zukünftige Verwendung, rba_Nds_Name=Rsrv1_PT4_PTCoor_PT_Rdy_Pr5_ST3
          rba_Nds_NetworkRepresentation_0 (rba_Nds_NetworkRepresentation)
            rba_Nds_DirectRepresentation: rba_Nds_MinValue=0, rba_Nds_MaxValue=1
        rba_Nds_Signal_CRC_PT4_PTCoor4_Pr5_ST3: rba_Nds_BitSize=16, rba_Nds_Description=CRC-Checksumme der Signal Gruppe gemäß AUTOSAR Profil 5, rba_Nds_Name=CRC_PT4_PTCoor4_Pr5_ST3, rba_Nds_SignalType=CHECKSUM
          rba_Nds_NetworkRepresentation_CRC_PT4_PTCoor4_Pr5_ST3 (rba_Nds_NetworkRepresentation)
            rba_Nds_DirectRepresentation: rba_Nds_MaxValue=65535
        rba_Nds_Signal_PT4_PTCoor_EngStartPN14_Stat_ST3: rba_Nds_BitSize=3, rba_Nds_Description=Status PN14 bei Motorstart, rba_Nds_Name=PT4_PTCoor_EngStartPN14_Stat_ST3
          rba_Nds_NetworkRepresentation_0_PT4_PTCoor_EngStartPN14_Stat_ST3 (rba_Nds_NetworkRepresentation)
            rba_Nds_DirectRepresentation: rba_Nds_MinValue=0, rba_Nds_MaxValue=7
        rba_Nds_Signal_PT4_PTCoor_PT_Rdy_ST3: rba_Nds_BitSize=2, rba_Nds_Description=Antrieb bereit, rba_Nds_Name=PT4_PTCoor_PT_Rdy_ST3
          rba_Nds_NetworkRepresentation_0_PT4_PTCoor_PT_Rdy_ST3 (rba_Nds_NetworkRepresentation)
            rba_Nds_DirectRepresentation: rba_Nds_MinValue=0, rba_Nds_MaxValue=3
        rba_Nds_Signal_PT4_PTCoor_SSA_EngSp_ST3: rba_Nds_BitSize=2, rba_Nds_Description=ASS Motorstopp, rba_Nds_Name=PT4_PTCoor_SSA_EngSp_ST3
          rba_Nds_NetworkRepresentation_0_PT4_PTCoor_SSA_EngSp_ST3 (rba_Nds_NetworkRepresentation)
            rba_Nds_DirectRepresentation: rba_Nds_MaxValue=3, rba_Nds_MinValue=0
        rba_Nds_Signal_SQC_PT4_PTCoor4_Pr5_ST3: rba_Nds_BitSize=8, rba_Nds_Description=Sequenzzähler, rba_Nds_Name=SQC_PT4_PTCoor4_Pr5_ST3, rba_Nds_SignalType=ALIVECOUNTER
          rba_Nds_NetworkRepresentation_SQC_PT4_PTCoor4_Pr5_ST3_none_1_0 (rba_Nds_NetworkRepresentation)
            rba_Nds_DirectRepresentation: rba_Nds_MaxValue=255, rba_Nds_MinValue=0
        rba_Nds_Signal_VehSpd_Disp_ST3: rba_Nds_BitSize=12, rba_Nds_Description=Angezeigte Geschwindigkeit (ohne Zeigerdämpfung), rba_Nds_Name=VehSpd_Disp_ST3
          rba_Nds_NetworkRepresentation_1_VehSpd_Disp_ST3 (rba_Nds_NetworkRepresentation)
            rba_Nds_DirectRepresentation: rba_Nds_MinValue=0, rba_Nds_MaxValue=4095
        rba_Nds_Signal_CRC_DI_Odo_Pr5_ST3: rba_Nds_BitSize=16, rba_Nds_Description=CRC-Checksumme der Signal Gruppe gemäß AUTOSAR Profil 5, rba_Nds_Name=CRC_DI_Odo_Pr5_ST3, rba_Nds_SignalType=CHECKSUM
          rba_Nds_NetworkRepresentation_0 (rba_Nds_NetworkRepresentation)
            rba_Nds_DirectRepresentation: rba_Nds_MinValue=0, rba_Nds_MaxValue=65535
        rba_Nds_Signal_Odo_ST3: rba_Nds_BitSize=24, rba_Nds_Description=Kilometerstand (für alle), rba_Nds_Name=Odo_ST3
          rba_Nds_NetworkRepresentation_0_Odo_ST3 (rba_Nds_NetworkRepresentation)
            rba_Nds_DirectRepresentation: rba_Nds_MinValue=0, rba_Nds_MaxValue=16777215
        rba_Nds_Signal_SQC_DI_Odo_Pr5_ST3: rba_Nds_BitSize=8, rba_Nds_Description=Sequenzzähler, rba_Nds_Name=SQC_DI_Odo_Pr5_ST3, rba_Nds_SignalType=ALIVECOUNTER
          rba_Nds_NetworkRepresentation_SQC_DI_Odo_Pr5_ST3_none_1_0 (rba_Nds_NetworkRepresentation)
            rba_Nds_DirectRepresentation: rba_Nds_MaxValue=255, rba_Nds_MinValue=0
        rba_Nds_Signal_Actv_Line_Stat_ST3: rba_Nds_BitSize=2, rba_Nds_Description=Aktivierungs Leitungsstatus, rba_Nds_Name=Actv_Line_Stat_ST3
          rba_Nds_NetworkRepresentation_0_Actv_Line_Stat_ST3 (rba_Nds_NetworkRepresentation)
            rba_Nds_DirectRepresentation: rba_Nds_MinValue=0, rba_Nds_MaxValue=3
        rba_Nds_Signal_DidA_ExtTest_Pres_ST3: rba_Nds_BitSize=2, rba_Nds_Description=DidA Externer Tester erkannt, rba_Nds_Name=DidA_ExtTest_Pres_ST3
          rba_Nds_NetworkRepresentation_0_DidA_ExtTest_Pres_ST3 (rba_Nds_NetworkRepresentation)
            rba_Nds_DirectRepresentation: rba_Nds_MinValue=1, rba_Nds_MaxValue=3
        rba_Nds_Signal_PN14_DDP_Sw2_Stat_ST3: rba_Nds_BitSize=3, rba_Nds_Description=Schalterstatus DDP Switch 2 (Always On Switch), rba_Nds_Name=PN14_DDP_Sw2_Stat_ST3
          rba_Nds_NetworkRepresentation_0_PN14_DDP_Sw2_Stat_ST3 (rba_Nds_NetworkRepresentation)
            rba_Nds_DirectRepresentation: rba_Nds_MinValue=0, rba_Nds_MaxValue=7
        rba_Nds_Signal_PN14_DDP_Sw_Stat_ST3: rba_Nds_BitSize=3, rba_Nds_Description=Schalterstatus Tiefentladeschutz, rba_Nds_Name=PN14_DDP_Sw_Stat_ST3
          rba_Nds_NetworkRepresentation_0_PN14_DDP_Sw_Stat_ST3 (rba_Nds_NetworkRepresentation)
            rba_Nds_DirectRepresentation: rba_Nds_MinValue=0, rba_Nds_MaxValue=7
        rba_Nds_Signal_PN14_ExtBat_Charge_Actv_ST3: rba_Nds_BitSize=2, rba_Nds_Description=Externe Batterieladung erkannt, rba_Nds_Name=PN14_ExtBat_Charge_Actv_ST3
          rba_Nds_NetworkRepresentation_0_PN14_ExtBat_Charge_Actv_ST3 (rba_Nds_NetworkRepresentation)
            rba_Nds_DirectRepresentation: rba_Nds_MaxValue=3, rba_Nds_MinValue=1
        rba_Nds_Signal_PN14_PNSec_RechargeEnable_ST3: rba_Nds_BitSize=2, rba_Nds_Description=Freigabe zum Nachladen der Sekundärbatterie, rba_Nds_Name=PN14_PNSec_RechargeEnable_ST3
          rba_Nds_NetworkRepresentation_0_PN14_PNSec_RechargeEnable_ST3 (rba_Nds_NetworkRepresentation)
            rba_Nds_DirectRepresentation: rba_Nds_MinValue=1, rba_Nds_MaxValue=3
        rba_Nds_Signal_PN14_ProdMd_BatStat_ST3: rba_Nds_BitSize=7, rba_Nds_Description=Der aktuelle Status der 12V Versorgungsbatterie während Produktions-Mode., rba_Nds_Name=PN14_ProdMd_BatStat_ST3
          rba_Nds_NetworkRepresentation_0_PN14_ProdMd_BatStat_ST3 (rba_Nds_NetworkRepresentation)
            rba_Nds_DirectRepresentation: rba_Nds_MinValue=0, rba_Nds_MaxValue=127
        rba_Nds_Signal_PN14_ProdMd_Stat_ST3: rba_Nds_BitSize=3, rba_Nds_Description=Status des Bordnetz Produktionsmodus, rba_Nds_Name=PN14_ProdMd_Stat_ST3
          rba_Nds_NetworkRepresentation_0_PN14_ProdMd_Stat_ST3 (rba_Nds_NetworkRepresentation)
            rba_Nds_DirectRepresentation: rba_Nds_MinValue=0, rba_Nds_MaxValue=7
        rba_Nds_Signal_PN14_SupBat_Curr_ST3: rba_Nds_BitSize=13, rba_Nds_Description=Versorgungsbatterie Iststrom, rba_Nds_Name=PN14_SupBat_Curr_ST3
          rba_Nds_NetworkRepresentation_0 (rba_Nds_NetworkRepresentation)
            rba_Nds_DirectRepresentation: rba_Nds_MinValue=0, rba_Nds_MaxValue=8191
        rba_Nds_Signal_PN14_SupBat_Stat_ST3: rba_Nds_BitSize=7, rba_Nds_Description=Status Versorgungsbatterie, rba_Nds_Name=PN14_SupBat_Stat_ST3
          rba_Nds_NetworkRepresentation_0_PN14_SupBat_Stat_ST3 (rba_Nds_NetworkRepresentation)
            rba_Nds_DirectRepresentation: rba_Nds_MinValue=0, rba_Nds_MaxValue=127
        rba_Nds_Signal_PN14_SupBat_Temp_ST3: rba_Nds_BitSize=8, rba_Nds_Description=Temperatur Versorgungsbatterie, rba_Nds_Name=PN14_SupBat_Temp_ST3
          rba_Nds_NetworkRepresentation_0_PN14_SupBat_Temp_ST3 (rba_Nds_NetworkRepresentation)
            rba_Nds_DirectRepresentation: rba_Nds_MinValue=0, rba_Nds_MaxValue=255
        rba_Nds_Signal_PN14_SupBat_Volt_ST3: rba_Nds_BitSize=10, rba_Nds_Description=Versorgungsbatterie Istspannung, rba_Nds_Name=PN14_SupBat_Volt_ST3
          rba_Nds_NetworkRepresentation_0_PN14_SupBat_Volt_ST3 (rba_Nds_NetworkRepresentation)
            rba_Nds_DirectRepresentation: rba_Nds_MaxValue=1023, rba_Nds_MinValue=0
        rba_Nds_Signal_PN14_TransMd_Stat_ST3: rba_Nds_BitSize=2, rba_Nds_Description=Bordnetz Status Transportmodus, rba_Nds_Name=PN14_TransMd_Stat_ST3
          rba_Nds_NetworkRepresentation_0_PN14_TransMd_Stat_ST3 (rba_Nds_NetworkRepresentation)
            rba_Nds_DirectRepresentation: rba_Nds_MinValue=0, rba_Nds_MaxValue=3
        rba_Nds_Signal_Rsrv01_IMU_A_Output_Pr5_ST3: rba_Nds_BitSize=9, rba_Nds_Description=Rsrv 01 IMU A Output Pr 5 ST3, rba_Nds_Name=Rsrv01_IMU_A_Output_Pr5_ST3
          rba_Nds_NetworkRepresentation_Rsrv01_IMU_A_Output_Pr5_ST3 (rba_Nds_NetworkRepresentation)
            rba_Nds_DirectRepresentation: rba_Nds_MinValue=0, rba_Nds_MaxValue=511
        rba_Nds_Signal_Rsrv02_IMU_A_Output_Pr5_ST3: rba_Nds_BitSize=8, rba_Nds_Description=Rsrv 02 IMU A Output Pr 5 ST3, rba_Nds_Name=Rsrv02_IMU_A_Output_Pr5_ST3
          rba_Nds_NetworkRepresentation_Rsrv02_IMU_A_Output_Pr5_ST3 (rba_Nds_NetworkRepresentation)
            rba_Nds_DirectRepresentation: rba_Nds_MinValue=0, rba_Nds_MaxValue=255
        rba_Nds_Signal_Rsrv03_IMU_A_Output_Pr5_ST3: rba_Nds_BitSize=8, rba_Nds_Description=Rsrv 03 IMU A Output Pr 5 ST3, rba_Nds_Name=Rsrv03_IMU_A_Output_Pr5_ST3
          rba_Nds_NetworkRepresentation_Rsrv03_IMU_A_Output_Pr5_ST3 (rba_Nds_NetworkRepresentation)
            rba_Nds_DirectRepresentation: rba_Nds_MinValue=0, rba_Nds_MaxValue=255
        rba_Nds_Signal_Rsrv04_IMU_A_Output_Pr5_ST3: rba_Nds_BitSize=8, rba_Nds_Description=Rsrv 04 IMU A Output Pr 5 ST3, rba_Nds_Name=Rsrv04_IMU_A_Output_Pr5_ST3
          rba_Nds_NetworkRepresentation_Rsrv04_IMU_A_Output_Pr5_ST3 (rba_Nds_NetworkRepresentation)
            rba_Nds_DirectRepresentation: rba_Nds_MinValue=0, rba_Nds_MaxValue=255
        rba_Nds_Signal_Rsrv05_IMU_A_Output_Pr5_ST3: rba_Nds_BitSize=8, rba_Nds_Description=Rsrv 05 IMU A Output Pr 5 ST3, rba_Nds_Name=Rsrv05_IMU_A_Output_Pr5_ST3
          rba_Nds_NetworkRepresentation_Rsrv05_IMU_A_Output_Pr5_ST3 (rba_Nds_NetworkRepresentation)
            rba_Nds_DirectRepresentation: rba_Nds_MinValue=0, rba_Nds_MaxValue=255
        rba_Nds_Signal_Rsrv06_IMU_A_Output_Pr5_ST3: rba_Nds_BitSize=16, rba_Nds_Description=Rsrv 06 IMU A Output Pr 5 ST3, rba_Nds_Name=Rsrv06_IMU_A_Output_Pr5_ST3
          rba_Nds_NetworkRepresentation_Rsrv06_IMU_A_Output_Pr5_ST3 (rba_Nds_NetworkRepresentation)
            rba_Nds_DirectRepresentation: rba_Nds_MaxValue=65535, rba_Nds_MinValue=0
        rba_Nds_Signal_Rsrv07_IMU_A_Output_Pr5_ST3: rba_Nds_BitSize=3, rba_Nds_Description=Rsrv 07 IMU A Output Pr 5 ST3, rba_Nds_Name=Rsrv07_IMU_A_Output_Pr5_ST3
          rba_Nds_NetworkRepresentation_Rsrv07_IMU_A_Output_Pr5_ST3 (rba_Nds_NetworkRepresentation)
            rba_Nds_DirectRepresentation: rba_Nds_MinValue=0, rba_Nds_MaxValue=7
        rba_Nds_Signal_CRC_IMU_A_Output_Pr5_ST3: rba_Nds_BitSize=16, rba_Nds_Description=CRC-Checksumme der Signal Gruppe gemäß AUTOSAR Profil 5, rba_Nds_Name=CRC_IMU_A_Output_Pr5_ST3, rba_Nds_SignalType=CHECKSUM
          rba_Nds_NetworkRepresentation_CRC_IMU_A_Output_Pr5_ST3 (rba_Nds_NetworkRepresentation)
            rba_Nds_DirectRepresentation: rba_Nds_MinValue=0, rba_Nds_MaxValue=65535
        rba_Nds_Signal_IMU_A_AngAcc_Stat_ST3: rba_Nds_BitSize=3, rba_Nds_Description=Status der Winkelbeschleunigungssignale, rba_Nds_Name=IMU_A_AngAcc_Stat_ST3
          rba_Nds_NetworkRepresentation_0_IMU_A_AngAcc_Stat_ST3 (rba_Nds_NetworkRepresentation)
            rba_Nds_DirectRepresentation: rba_Nds_MinValue=0, rba_Nds_MaxValue=7
        rba_Nds_Signal_IMU_A_AngAcc_X_ST3: rba_Nds_BitSize=16, rba_Nds_Description=Winkelbeschleunigung um die X-Achse, rba_Nds_Name=IMU_A_AngAcc_X_ST3
          rba_Nds_NetworkRepresentation_0_IMU_A_AngAcc_X_ST3 (rba_Nds_NetworkRepresentation)
            rba_Nds_DirectRepresentation: rba_Nds_MaxValue=65535, rba_Nds_MinValue=0
        rba_Nds_Signal_IMU_A_AngAcc_Y_ST3: rba_Nds_BitSize=16, rba_Nds_Description=Winkelbeschleunigung um die Y-Achse, rba_Nds_Name=IMU_A_AngAcc_Y_ST3
          rba_Nds_NetworkRepresentation_0_IMU_A_AngAcc_Y_ST3 (rba_Nds_NetworkRepresentation)
            rba_Nds_DirectRepresentation: rba_Nds_MaxValue=65535, rba_Nds_MinValue=0
        rba_Nds_Signal_IMU_A_AngAcc_Z_ST3: rba_Nds_BitSize=16, rba_Nds_Description=Winkelbeschleunigung um die Z-Achse, rba_Nds_Name=IMU_A_AngAcc_Z_ST3
          rba_Nds_NetworkRepresentation_0_IMU_A_AngAcc_Z_ST3 (rba_Nds_NetworkRepresentation)
            rba_Nds_DirectRepresentation: rba_Nds_MinValue=0, rba_Nds_MaxValue=65535
        rba_Nds_Signal_IMU_A_AngRate_X_ST3: rba_Nds_BitSize=16, rba_Nds_Description=Drehrate über die X-Achse, rba_Nds_Name=IMU_A_AngRate_X_ST3
          rba_Nds_NetworkRepresentation_0_IMU_A_AngRate_X_ST3 (rba_Nds_NetworkRepresentation)
            rba_Nds_DirectRepresentation: rba_Nds_MaxValue=65535, rba_Nds_MinValue=0
        rba_Nds_Signal_IMU_A_AngRate_Y_ST3: rba_Nds_BitSize=16, rba_Nds_Description=Drehrate über die Y-Achse, rba_Nds_Name=IMU_A_AngRate_Y_ST3
          rba_Nds_NetworkRepresentation_0_IMU_A_AngRate_Y_ST3 (rba_Nds_NetworkRepresentation)
            rba_Nds_DirectRepresentation: rba_Nds_MaxValue=65535, rba_Nds_MinValue=0
        rba_Nds_Signal_IMU_A_AngRate_Z_ST3: rba_Nds_BitSize=16, rba_Nds_Description=Drehrate über die Z-Achse, rba_Nds_Name=IMU_A_AngRate_Z_ST3
          rba_Nds_NetworkRepresentation_0_IMU_A_AngRate_Z_ST3 (rba_Nds_NetworkRepresentation)
            rba_Nds_DirectRepresentation: rba_Nds_MaxValue=65535, rba_Nds_MinValue=0
        rba_Nds_Signal_IMU_A_AngRates_Stat_ST3: rba_Nds_BitSize=3, rba_Nds_Description=Status der Drehratensignale, rba_Nds_Name=IMU_A_AngRates_Stat_ST3
          rba_Nds_NetworkRepresentation_0_IMU_A_AngRates_Stat_ST3 (rba_Nds_NetworkRepresentation)
            rba_Nds_DirectRepresentation: rba_Nds_MaxValue=7, rba_Nds_MinValue=0
        rba_Nds_Signal_IMU_A_SpecForce_Stat_ST3: rba_Nds_BitSize=3, rba_Nds_Description=Status spezifischer Kraftsignale, rba_Nds_Name=IMU_A_SpecForce_Stat_ST3
          rba_Nds_NetworkRepresentation_0_IMU_A_SpecForce_Stat_ST3 (rba_Nds_NetworkRepresentation)
            rba_Nds_DirectRepresentation: rba_Nds_MaxValue=7, rba_Nds_MinValue=0
        rba_Nds_Signal_IMU_A_SpecForce_X_ST3: rba_Nds_BitSize=16, rba_Nds_Description=Spezifische Kraft entlang der X-Achse, rba_Nds_Name=IMU_A_SpecForce_X_ST3
          rba_Nds_NetworkRepresentation_0_IMU_A_SpecForce_X_ST3 (rba_Nds_NetworkRepresentation)
            rba_Nds_DirectRepresentation: rba_Nds_MaxValue=65535, rba_Nds_MinValue=0
        rba_Nds_Signal_IMU_A_SpecForce_Y_ST3: rba_Nds_BitSize=16, rba_Nds_Description=Spezifische Kraft entlang der Y-Achse, rba_Nds_Name=IMU_A_SpecForce_Y_ST3
          rba_Nds_NetworkRepresentation_0_IMU_A_SpecForce_Y_ST3 (rba_Nds_NetworkRepresentation)
            rba_Nds_DirectRepresentation: rba_Nds_MaxValue=65535, rba_Nds_MinValue=0
        rba_Nds_Signal_IMU_A_SpecForce_Z_ST3: rba_Nds_BitSize=16, rba_Nds_Description=Spezifische Kraft entlang der Z-Achse, rba_Nds_Name=IMU_A_SpecForce_Z_ST3
          rba_Nds_NetworkRepresentation_0_IMU_A_SpecForce_Z_ST3 (rba_Nds_NetworkRepresentation)
            rba_Nds_DirectRepresentation: rba_Nds_MaxValue=65535, rba_Nds_MinValue=0
        rba_Nds_Signal_IMU_A_Stat_ST3: rba_Nds_BitSize=3, rba_Nds_Description=Gesamtstatus der IMU, rba_Nds_Name=IMU_A_Stat_ST3
          rba_Nds_NetworkRepresentation_0 (rba_Nds_NetworkRepresentation)
            rba_Nds_DirectRepresentation: rba_Nds_MaxValue=7, rba_Nds_MinValue=0
        rba_Nds_Signal_IMU_A_Temp_ST3: rba_Nds_BitSize=8, rba_Nds_Description=IMU-Temperatur, rba_Nds_Name=IMU_A_Temp_ST3
          rba_Nds_NetworkRepresentation_0_IMU_A_Temp_ST3 (rba_Nds_NetworkRepresentation)
            rba_Nds_DirectRepresentation: rba_Nds_MinValue=0, rba_Nds_MaxValue=255
        rba_Nds_Signal_IMU_A_TmStmp_NanoSec_ST3: rba_Nds_BitSize=32, rba_Nds_Description=IMU Zeitstempel, Ziffernbruchteil in Nanosekunden, rba_Nds_Name=IMU_A_TmStmp_NanoSec_ST3
          rba_Nds_NetworkRepresentation_IMU_A_TmStmp_NanoSec_ST3_ns_1_0 (rba_Nds_NetworkRepresentation)
            rba_Nds_DirectRepresentation: rba_Nds_MaxValue=4294967295, rba_Nds_MinValue=0
        rba_Nds_Signal_IMU_A_TmStmp_Sec_ST3: rba_Nds_BitSize=32, rba_Nds_Description=IMU Zeitstempel, ganze Sekunde Teil, rba_Nds_Name=IMU_A_TmStmp_Sec_ST3
          rba_Nds_NetworkRepresentation_IMU_A_TmStmp_Sec_ST3_s_1_0 (rba_Nds_NetworkRepresentation)
            rba_Nds_DirectRepresentation: rba_Nds_MaxValue=4294967295, rba_Nds_MinValue=0
        rba_Nds_Signal_IMU_A_TmSync_Stat_ST3: rba_Nds_BitSize=8, rba_Nds_Description=Status der globalen Zeitsynchronisierung, rba_Nds_Name=IMU_A_TmSync_Stat_ST3
          rba_Nds_NetworkRepresentation_0_IMU_A_TmSync_Stat_ST3 (rba_Nds_NetworkRepresentation)
            rba_Nds_DirectRepresentation: rba_Nds_MinValue=0, rba_Nds_MaxValue=128
        rba_Nds_Signal_SQC_IMU_A_Output_Pr5_ST3: rba_Nds_BitSize=8, rba_Nds_Description=Sequenzzähler, rba_Nds_Name=SQC_IMU_A_Output_Pr5_ST3, rba_Nds_SignalType=ALIVECOUNTER
          rba_Nds_NetworkRepresentation_SQC_IMU_A_Output_Pr5_ST3_none_1_0 (rba_Nds_NetworkRepresentation)
            rba_Nds_DirectRepresentation: rba_Nds_MaxValue=255, rba_Nds_MinValue=0
        rba_Nds_Signal_Rsrv01_IMU_A_Output_Fast_Pr5_ST3: rba_Nds_BitSize=9, rba_Nds_Description=Rsrv 01 IMU A Output Pr 5 ST3 fast, rba_Nds_Name=Rsrv01_IMU_A_Output_Fast_Pr5_ST3
          rba_Nds_NetworkRepresentation_0 (rba_Nds_NetworkRepresentation)
            rba_Nds_DirectRepresentation: rba_Nds_MinValue=0, rba_Nds_MaxValue=511
        rba_Nds_Signal_Rsrv02_IMU_A_Output_Fast_Pr5_ST3: rba_Nds_BitSize=8, rba_Nds_Description=Rsrv 02 IMU A Output Pr 5 ST3 fast, rba_Nds_Name=Rsrv02_IMU_A_Output_Fast_Pr5_ST3
          rba_Nds_NetworkRepresentation_0 (rba_Nds_NetworkRepresentation)
            rba_Nds_DirectRepresentation: rba_Nds_MinValue=0, rba_Nds_MaxValue=255
        rba_Nds_Signal_Rsrv03_IMU_A_Output_Fast_Pr5_ST3: rba_Nds_BitSize=8, rba_Nds_Description=Rsrv 03 IMU A Output Pr 5 ST3 fast, rba_Nds_Name=Rsrv03_IMU_A_Output_Fast_Pr5_ST3
          rba_Nds_NetworkRepresentation_0 (rba_Nds_NetworkRepresentation)
            rba_Nds_DirectRepresentation: rba_Nds_MinValue=0, rba_Nds_MaxValue=255
        rba_Nds_Signal_Rsrv04_IMU_A_Output_Fast_Pr5_ST3: rba_Nds_BitSize=8, rba_Nds_Description=Rsrv 04 IMU A Output Pr 5 ST3 fast, rba_Nds_Name=Rsrv04_IMU_A_Output_Fast_Pr5_ST3
          rba_Nds_NetworkRepresentation_0 (rba_Nds_NetworkRepresentation)
            rba_Nds_DirectRepresentation: rba_Nds_MinValue=0, rba_Nds_MaxValue=255
        rba_Nds_Signal_Rsrv05_IMU_A_Output_Fast_Pr5_ST3: rba_Nds_BitSize=8, rba_Nds_Description=Rsrv 05 IMU A Output Pr 5 ST3 fast, rba_Nds_Name=Rsrv05_IMU_A_Output_Fast_Pr5_ST3
          rba_Nds_NetworkRepresentation_0 (rba_Nds_NetworkRepresentation)
            rba_Nds_DirectRepresentation: rba_Nds_MinValue=0, rba_Nds_MaxValue=255
        rba_Nds_Signal_Rsrv06_IMU_A_Output_Fast_Pr5_ST3: rba_Nds_BitSize=16, rba_Nds_Description=Rsrv 06 IMU A Output Pr 5 ST3 fast, rba_Nds_Name=Rsrv06_IMU_A_Output_Fast_Pr5_ST3
          rba_Nds_NetworkRepresentation_0 (rba_Nds_NetworkRepresentation)
            rba_Nds_DirectRepresentation: rba_Nds_MinValue=0, rba_Nds_MaxValue=65535
        rba_Nds_Signal_Rsrv07_IMU_A_Output_Fast_Pr5_ST3: rba_Nds_BitSize=3, rba_Nds_Description=Rsrv 07 IMU A Output Pr 5 ST3 fast, rba_Nds_Name=Rsrv07_IMU_A_Output_Fast_Pr5_ST3
          rba_Nds_NetworkRepresentation_0 (rba_Nds_NetworkRepresentation)
            rba_Nds_DirectRepresentation: rba_Nds_MinValue=0, rba_Nds_MaxValue=7
        rba_Nds_Signal_CRC_IMU_A_Output_Fast_Pr5_ST3: rba_Nds_BitSize=16, rba_Nds_Description=CRC-Checksumme der Signal Gruppe gemäß AUTOSAR Profil 5, rba_Nds_Name=CRC_IMU_A_Output_Fast_Pr5_ST3, rba_Nds_SignalType=CHECKSUM
          rba_Nds_NetworkRepresentation_0 (rba_Nds_NetworkRepresentation)
            rba_Nds_DirectRepresentation: rba_Nds_MinValue=0, rba_Nds_MaxValue=65535
        rba_Nds_Signal_IMU_A_AngAcc_Stat_Fast_ST3: rba_Nds_BitSize=3, rba_Nds_Description=Status der Winkelbeschleunigungssignale fast, rba_Nds_Name=IMU_A_AngAcc_Stat_Fast_ST3
          rba_Nds_NetworkRepresentation_0_IMU_A_AngAcc_Stat_Fast_ST3 (rba_Nds_NetworkRepresentation)
            rba_Nds_DirectRepresentation: rba_Nds_MinValue=0, rba_Nds_MaxValue=7
        rba_Nds_Signal_IMU_A_AngAcc_X_Fast_ST3: rba_Nds_BitSize=16, rba_Nds_Description=Winkelbeschleunigung um die X-Achse fast, rba_Nds_Name=IMU_A_AngAcc_X_Fast_ST3
          rba_Nds_NetworkRepresentation_0_IMU_A_AngAcc_X_Fast_ST3 (rba_Nds_NetworkRepresentation)
            rba_Nds_DirectRepresentation: rba_Nds_MinValue=0, rba_Nds_MaxValue=65535
        rba_Nds_Signal_IMU_A_AngAcc_Y_Fast_ST3: rba_Nds_BitSize=16, rba_Nds_Description=Winkelbeschleunigung um die Y-Achse fast, rba_Nds_Name=IMU_A_AngAcc_Y_Fast_ST3
          rba_Nds_NetworkRepresentation_0_IMU_A_AngAcc_Y_Fast_ST3 (rba_Nds_NetworkRepresentation)
            rba_Nds_DirectRepresentation: rba_Nds_MinValue=0, rba_Nds_MaxValue=65535
        rba_Nds_Signal_IMU_A_AngAcc_Z_Fast_ST3: rba_Nds_BitSize=16, rba_Nds_Description=Winkelbeschleunigung um die Z-Achse fast, rba_Nds_Name=IMU_A_AngAcc_Z_Fast_ST3
          rba_Nds_NetworkRepresentation_0_IMU_A_AngAcc_Z_Fast_ST3 (rba_Nds_NetworkRepresentation)
            rba_Nds_DirectRepresentation: rba_Nds_MinValue=0, rba_Nds_MaxValue=65535
        rba_Nds_Signal_IMU_A_AngRate_X_Fast_ST3: rba_Nds_BitSize=16, rba_Nds_Description=Drehrate über die X-Achse fast, rba_Nds_Name=IMU_A_AngRate_X_Fast_ST3
          rba_Nds_NetworkRepresentation_0_IMU_A_AngRate_X_Fast_ST3 (rba_Nds_NetworkRepresentation)
            rba_Nds_DirectRepresentation: rba_Nds_MinValue=0, rba_Nds_MaxValue=65535
        rba_Nds_Signal_IMU_A_AngRate_Y_Fast_ST3: rba_Nds_BitSize=16, rba_Nds_Description=Drehrate über die Y-Achse fast, rba_Nds_Name=IMU_A_AngRate_Y_Fast_ST3
          rba_Nds_NetworkRepresentation_0_IMU_A_AngRate_Y_Fast_ST3 (rba_Nds_NetworkRepresentation)
            rba_Nds_DirectRepresentation: rba_Nds_MinValue=0, rba_Nds_MaxValue=65535
        rba_Nds_Signal_IMU_A_AngRate_Z_Fast_ST3: rba_Nds_BitSize=16, rba_Nds_Description=Drehrate über die Z-Achse fast, rba_Nds_Name=IMU_A_AngRate_Z_Fast_ST3
          rba_Nds_NetworkRepresentation_0_IMU_A_AngRate_Z_Fast_ST3 (rba_Nds_NetworkRepresentation)
            rba_Nds_DirectRepresentation: rba_Nds_MinValue=0, rba_Nds_MaxValue=65535
        rba_Nds_Signal_IMU_A_AngRates_Stat_Fast_ST3: rba_Nds_BitSize=3, rba_Nds_Description=Status der Drehratensignale fast, rba_Nds_Name=IMU_A_AngRates_Stat_Fast_ST3
          rba_Nds_NetworkRepresentation_0_IMU_A_AngRates_Stat_Fast_ST3 (rba_Nds_NetworkRepresentation)
            rba_Nds_DirectRepresentation: rba_Nds_MinValue=0, rba_Nds_MaxValue=7
        rba_Nds_Signal_IMU_A_SpecForce_Stat_Fast_ST3: rba_Nds_BitSize=3, rba_Nds_Description=Status spezifischer Kraftsignale fast, rba_Nds_Name=IMU_A_SpecForce_Stat_Fast_ST3
          rba_Nds_NetworkRepresentation_0_IMU_A_SpecForce_Stat_Fast_ST3 (rba_Nds_NetworkRepresentation)
            rba_Nds_DirectRepresentation: rba_Nds_MinValue=0, rba_Nds_MaxValue=7
        rba_Nds_Signal_IMU_A_SpecForce_X_Fast_ST3: rba_Nds_BitSize=16, rba_Nds_Description=Spezifische Kraft entlang der X-Achse fast, rba_Nds_Name=IMU_A_SpecForce_X_Fast_ST3
          rba_Nds_NetworkRepresentation_0_IMU_A_SpecForce_X_Fast_ST3 (rba_Nds_NetworkRepresentation)
            rba_Nds_DirectRepresentation: rba_Nds_MinValue=0, rba_Nds_MaxValue=65535
        rba_Nds_Signal_IMU_A_SpecForce_Y_Fast_ST3: rba_Nds_BitSize=16, rba_Nds_Description=Spezifische Kraft entlang der Y-Achse fast, rba_Nds_Name=IMU_A_SpecForce_Y_Fast_ST3
          rba_Nds_NetworkRepresentation_0_IMU_A_SpecForce_Y_Fast_ST3 (rba_Nds_NetworkRepresentation)
            rba_Nds_DirectRepresentation: rba_Nds_MinValue=0, rba_Nds_MaxValue=65535
        rba_Nds_Signal_IMU_A_SpecForce_Z_Fast_ST3: rba_Nds_BitSize=16, rba_Nds_Description=Spezifische Kraft entlang der Z-Achse fast, rba_Nds_Name=IMU_A_SpecForce_Z_Fast_ST3
          rba_Nds_NetworkRepresentation_0_IMU_A_SpecForce_Z_Fast_ST3 (rba_Nds_NetworkRepresentation)
            rba_Nds_DirectRepresentation: rba_Nds_MinValue=0, rba_Nds_MaxValue=65535
        rba_Nds_Signal_IMU_A_Stat_Fast_ST3: rba_Nds_BitSize=3, rba_Nds_Description=Gesamtstatus der IMU fast, rba_Nds_Name=IMU_A_Stat_Fast_ST3
          rba_Nds_NetworkRepresentation_0_IMU_A_Stat_Fast_ST3 (rba_Nds_NetworkRepresentation)
            rba_Nds_DirectRepresentation: rba_Nds_MinValue=0, rba_Nds_MaxValue=7
        rba_Nds_Signal_IMU_A_Temp_Fast_ST3: rba_Nds_BitSize=8, rba_Nds_Description=IMU-Temperatur fast, rba_Nds_Name=IMU_A_Temp_Fast_ST3
          rba_Nds_NetworkRepresentation_0_IMU_A_Temp_Fast_ST3 (rba_Nds_NetworkRepresentation)
            rba_Nds_DirectRepresentation: rba_Nds_MinValue=0, rba_Nds_MaxValue=255
        rba_Nds_Signal_IMU_A_TmStmp_NanoSec_Fast_ST3: rba_Nds_BitSize=32, rba_Nds_Description=IMU Zeitstempel, Ziffernbruchteil in Nanosekunden fast, rba_Nds_Name=IMU_A_TmStmp_NanoSec_Fast_ST3
          rba_Nds_NetworkRepresentation_IMU_A_TmStmp_NanoSec_Fast_ST3_ns_1_0 (rba_Nds_NetworkRepresentation)
            rba_Nds_DirectRepresentation: rba_Nds_MaxValue=4294967295, rba_Nds_MinValue=0
        rba_Nds_Signal_IMU_A_TmStmp_Sec_Fast_ST3: rba_Nds_BitSize=32, rba_Nds_Description=IMU Zeitstempel, ganze Sekunde Teil fast, rba_Nds_Name=IMU_A_TmStmp_Sec_Fast_ST3
          rba_Nds_NetworkRepresentation_IMU_A_TmStmp_Sec_Fast_ST3_s_1_0 (rba_Nds_NetworkRepresentation)
            rba_Nds_DirectRepresentation: rba_Nds_MaxValue=4294967295, rba_Nds_MinValue=0
        rba_Nds_Signal_IMU_A_TmSync_Stat_Fast_ST3: rba_Nds_BitSize=8, rba_Nds_Description=Status der globalen Zeitsynchronisierung fast, rba_Nds_Name=IMU_A_TmSync_Stat_Fast_ST3
          rba_Nds_NetworkRepresentation_0_IMU_A_TmSync_Stat_Fast_ST3 (rba_Nds_NetworkRepresentation)
            rba_Nds_DirectRepresentation: rba_Nds_MinValue=0, rba_Nds_MaxValue=128
        rba_Nds_Signal_SQC_IMU_A_Output_Fast_Pr5_ST3: rba_Nds_BitSize=8, rba_Nds_Description=Sequenzzähler, rba_Nds_Name=SQC_IMU_A_Output_Fast_Pr5_ST3, rba_Nds_SignalType=ALIVECOUNTER
          rba_Nds_NetworkRepresentation_SQC_IMU_A_Output_Fast_Pr5_ST3_none_1_0 (rba_Nds_NetworkRepresentation)
            rba_Nds_DirectRepresentation: rba_Nds_MaxValue=255, rba_Nds_MinValue=0
      6 x rba_Nds_SignalGroup:
        rba_Nds_SignalGroup_BCS_Whl_Msg1_BTC_Pr5_ST3_3z5vvcdtzaheg7vz23u7gb0g6: rba_Nds_Name=BCS_Whl_Msg1_BTC_Pr5_ST3_3z5vvcdtzaheg7vz23u7gb0g6, rba_Nds_SignalRef=rba_Nds_Signal_BCS_Whl_Msg1_TmStmp_BTC_ST3, rba_Nds_SignalRef=rba_Nds_Signal_BCS_Whl_Msg1_TmSyncStat_BTC_ST3, rba_Nds_SignalRef=rba_Nds_Signal_CRC_BCS_Whl_Msg1_BTC_Pr5_ST3, rba_Nds_SignalRef=rba_Nds_Signal_GTS_ESP_Clk_Stat_Bckp_ST3, rba_Nds_SignalRef=rba_Nds_Signal_Rsrv1_BCS_Whl_Msg1_BTC_Pr5_ST3, rba_Nds_SignalRef=rba_Nds_Signal_SQC_BCS_Whl_Msg1_BTC_Pr5_ST3, rba_Nds_SignalRef=rba_Nds_Signal_WhlDir_FL_Stat_BTC_ST3, rba_Nds_SignalRef=rba_Nds_Signal_WhlDir_FR_Stat_BTC_ST3, rba_Nds_SignalRef=rba_Nds_Signal_WhlDir_RL_Stat_BTC_ST3, rba_Nds_SignalRef=rba_Nds_Signal_WhlDir_RR_Stat_BTC_ST3, rba_Nds_SignalRef=rba_Nds_Signal_WhlPlsCnt_FL_BTC_ST3, rba_Nds_SignalRef=rba_Nds_Signal_WhlPlsCnt_FR_BTC_ST3, rba_Nds_SignalRef=rba_Nds_Signal_WhlPlsCnt_RL_BTC_ST3, rba_Nds_SignalRef=rba_Nds_Signal_WhlPlsCnt_RR_BTC_ST3, rba_Nds_SignalRef=rba_Nds_Signal_WhlRPM_FL_BTC_ST3, rba_Nds_SignalRef=rba_Nds_Signal_WhlRPM_FL_Qual_BTC_ST3, rba_Nds_SignalRef=rba_Nds_Signal_WhlRPM_FR_BTC_ST3, rba_Nds_SignalRef=rba_Nds_Signal_WhlRPM_FR_Qual_BTC_ST3, rba_Nds_SignalRef=rba_Nds_Signal_WhlRPM_RL_BTC_ST3, rba_Nds_SignalRef=rba_Nds_Signal_WhlRPM_RL_Qual_BTC_ST3, rba_Nds_SignalRef=rba_Nds_Signal_WhlRPM_RR_BTC_ST3, rba_Nds_SignalRef=rba_Nds_Signal_WhlRPM_RR_Qual_BTC_ST3
        rba_Nds_SignalGroup_Ign_Stat_Pr5_ST3_csgs1dv6drms80o1i9p49677w: rba_Nds_Name=Ign_Stat_Pr5_ST3_csgs1dv6drms80o1i9p49677w, rba_Nds_SignalRef=rba_Nds_Signal_CRC_Ign_Stat_Pr5_ST3, rba_Nds_SignalRef=rba_Nds_Signal_ISw_Stat_ST3, rba_Nds_SignalRef=rba_Nds_Signal_KG_StartSw_Psd_ST3, rba_Nds_SignalRef=rba_Nds_Signal_SQC_Ign_Stat_Pr5_ST3, rba_Nds_SignalRef=rba_Nds_Signal_Veh_Op_Mode_ST3
        rba_Nds_SignalGroup_PT4_PTCoor4_Pr5_ST3_af4fxb1ykieox3itqdfzs0kpb: rba_Nds_Name=PT4_PTCoor4_Pr5_ST3_af4fxb1ykieox3itqdfzs0kpb, rba_Nds_SignalRef=rba_Nds_Signal_CRC_PT4_PTCoor4_Pr5_ST3, rba_Nds_SignalRef=rba_Nds_Signal_PT4_PTCoor_EngStartPN14_Stat_ST3, rba_Nds_SignalRef=rba_Nds_Signal_PT4_PTCoor_PT_Rdy_ST3, rba_Nds_SignalRef=rba_Nds_Signal_PT4_PTCoor_SSA_EngSp_ST3, rba_Nds_SignalRef=rba_Nds_Signal_Rsrv1_PT4_PTCoor_PT_Rdy_Pr5_ST3, rba_Nds_SignalRef=rba_Nds_Signal_SQC_PT4_PTCoor4_Pr5_ST3
        rba_Nds_SignalGroup_DI_Odo_Pr5_ST3_e68xmtlkywxgxsdwekdjjhw3t: rba_Nds_Name=DI_Odo_Pr5_ST3_e68xmtlkywxgxsdwekdjjhw3t, rba_Nds_SignalRef=rba_Nds_Signal_CRC_DI_Odo_Pr5_ST3, rba_Nds_SignalRef=rba_Nds_Signal_Odo_ST3, rba_Nds_SignalRef=rba_Nds_Signal_SQC_DI_Odo_Pr5_ST3
        rba_Nds_SignalGroup_IMU_A_Output_Pr5_ST3_bezr5ct33mhwxias0s8rjhbne: rba_Nds_Name=IMU_A_Output_Pr5_ST3_bezr5ct33mhwxias0s8rjhbne, rba_Nds_SignalRef=rba_Nds_Signal_CRC_IMU_A_Output_Pr5_ST3, rba_Nds_SignalRef=rba_Nds_Signal_IMU_A_AngAcc_Stat_ST3, rba_Nds_SignalRef=rba_Nds_Signal_IMU_A_AngAcc_X_ST3, rba_Nds_SignalRef=rba_Nds_Signal_IMU_A_AngAcc_Y_ST3, rba_Nds_SignalRef=rba_Nds_Signal_IMU_A_AngAcc_Z_ST3, rba_Nds_SignalRef=rba_Nds_Signal_IMU_A_AngRate_X_ST3, rba_Nds_SignalRef=rba_Nds_Signal_IMU_A_AngRate_Y_ST3, rba_Nds_SignalRef=rba_Nds_Signal_IMU_A_AngRate_Z_ST3, rba_Nds_SignalRef=rba_Nds_Signal_IMU_A_AngRates_Stat_ST3, rba_Nds_SignalRef=rba_Nds_Signal_IMU_A_SpecForce_Stat_ST3, rba_Nds_SignalRef=rba_Nds_Signal_IMU_A_SpecForce_X_ST3, rba_Nds_SignalRef=rba_Nds_Signal_IMU_A_SpecForce_Y_ST3, rba_Nds_SignalRef=rba_Nds_Signal_IMU_A_SpecForce_Z_ST3, rba_Nds_SignalRef=rba_Nds_Signal_IMU_A_Stat_ST3, rba_Nds_SignalRef=rba_Nds_Signal_IMU_A_Temp_ST3, rba_Nds_SignalRef=rba_Nds_Signal_IMU_A_TmStmp_NanoSec_ST3, rba_Nds_SignalRef=rba_Nds_Signal_IMU_A_TmStmp_Sec_ST3, rba_Nds_SignalRef=rba_Nds_Signal_IMU_A_TmSync_Stat_ST3, rba_Nds_SignalRef=rba_Nds_Signal_Rsrv01_IMU_A_Output_Pr5_ST3, rba_Nds_SignalRef=rba_Nds_Signal_Rsrv02_IMU_A_Output_Pr5_ST3, rba_Nds_SignalRef=rba_Nds_Signal_Rsrv03_IMU_A_Output_Pr5_ST3, rba_Nds_SignalRef=rba_Nds_Signal_Rsrv04_IMU_A_Output_Pr5_ST3, rba_Nds_SignalRef=rba_Nds_Signal_Rsrv05_IMU_A_Output_Pr5_ST3, rba_Nds_SignalRef=rba_Nds_Signal_Rsrv06_IMU_A_Output_Pr5_ST3, rba_Nds_SignalRef=rba_Nds_Signal_Rsrv07_IMU_A_Output_Pr5_ST3, rba_Nds_SignalRef=rba_Nds_Signal_SQC_IMU_A_Output_Pr5_ST3
        rba_Nds_SignalGroup_IMU_A_Output_Fast_Pr5_ST3_5ym0lyqjosyobfhfksta75zc4: rba_Nds_Name=IMU_A_Output_Fast_Pr5_ST3_5ym0lyqjosyobfhfksta75zc4, rba_Nds_SignalRef=rba_Nds_Signal_CRC_IMU_A_Output_Fast_Pr5_ST3, rba_Nds_SignalRef=rba_Nds_Signal_IMU_A_AngAcc_Stat_Fast_ST3, rba_Nds_SignalRef=rba_Nds_Signal_IMU_A_AngAcc_X_Fast_ST3, rba_Nds_SignalRef=rba_Nds_Signal_IMU_A_AngAcc_Y_Fast_ST3, rba_Nds_SignalRef=rba_Nds_Signal_IMU_A_AngAcc_Z_Fast_ST3, rba_Nds_SignalRef=rba_Nds_Signal_IMU_A_AngRate_X_Fast_ST3, rba_Nds_SignalRef=rba_Nds_Signal_IMU_A_AngRate_Y_Fast_ST3, rba_Nds_SignalRef=rba_Nds_Signal_IMU_A_AngRate_Z_Fast_ST3, rba_Nds_SignalRef=rba_Nds_Signal_IMU_A_AngRates_Stat_Fast_ST3, rba_Nds_SignalRef=rba_Nds_Signal_IMU_A_SpecForce_Stat_Fast_ST3, rba_Nds_SignalRef=rba_Nds_Signal_IMU_A_SpecForce_X_Fast_ST3, rba_Nds_SignalRef=rba_Nds_Signal_IMU_A_SpecForce_Y_Fast_ST3, rba_Nds_SignalRef=rba_Nds_Signal_IMU_A_SpecForce_Z_Fast_ST3, rba_Nds_SignalRef=rba_Nds_Signal_IMU_A_Stat_Fast_ST3, rba_Nds_SignalRef=rba_Nds_Signal_IMU_A_Temp_Fast_ST3, rba_Nds_SignalRef=rba_Nds_Signal_IMU_A_TmStmp_NanoSec_Fast_ST3, rba_Nds_SignalRef=rba_Nds_Signal_IMU_A_TmStmp_Sec_Fast_ST3, rba_Nds_SignalRef=rba_Nds_Signal_IMU_A_TmSync_Stat_Fast_ST3, rba_Nds_SignalRef=rba_Nds_Signal_Rsrv01_IMU_A_Output_Fast_Pr5_ST3, rba_Nds_SignalRef=rba_Nds_Signal_Rsrv02_IMU_A_Output_Fast_Pr5_ST3, rba_Nds_SignalRef=rba_Nds_Signal_Rsrv03_IMU_A_Output_Fast_Pr5_ST3, rba_Nds_SignalRef=rba_Nds_Signal_Rsrv04_IMU_A_Output_Fast_Pr5_ST3, rba_Nds_SignalRef=rba_Nds_Signal_Rsrv05_IMU_A_Output_Fast_Pr5_ST3, rba_Nds_SignalRef=rba_Nds_Signal_Rsrv06_IMU_A_Output_Fast_Pr5_ST3, rba_Nds_SignalRef=rba_Nds_Signal_Rsrv07_IMU_A_Output_Fast_Pr5_ST3, rba_Nds_SignalRef=rba_Nds_Signal_SQC_IMU_A_Output_Fast_Pr5_ST3
      18 x rba_Nds_Pdu:
        rba_Nds_Pdu_ESP_HAD_BACKUP_COM_Container1_ST3_BCS_Whl_Msg1_BTC_ST3
          rba_Nds_SignalPdu:
            rba_Nds_Description = BCS Whl Msg 1 ST3
            rba_Nds_Length = 20
            rba_Nds_Name = ESP_HAD_BACKUP_COM_Container1_ST3_BCS_Whl_Msg1_BTC_ST3
            rba_Nds_UnusedAreasDefault = 255
            22 x rba_Nds_SignalInstance, all with rba_Nds_ByteOrder=INTEL:
              rba_Nds_SignalInstance_BCS_Whl_Msg1_TmStmp_BTC_ST3: rba_Nds_BitPosition=136, rba_Nds_SignalRef=rba_Nds_Signal_BCS_Whl_Msg1_TmStmp_BTC_ST3
              rba_Nds_SignalInstance_BCS_Whl_Msg1_TmSyncStat_BTC_ST3: rba_Nds_BitPosition=152, rba_Nds_SignalRef=rba_Nds_Signal_BCS_Whl_Msg1_TmSyncStat_BTC_ST3
              rba_Nds_SignalInstance_CRC_BCS_Whl_Msg1_BTC_Pr5_ST3: rba_Nds_BitPosition=0, rba_Nds_SignalRef=rba_Nds_Signal_CRC_BCS_Whl_Msg1_BTC_Pr5_ST3
              rba_Nds_SignalInstance_GTS_ESP_Clk_Stat_Bckp_ST3: rba_Nds_BitPosition=154, rba_Nds_SignalRef=rba_Nds_Signal_GTS_ESP_Clk_Stat_Bckp_ST3
              rba_Nds_SignalInstance_SQC_BCS_Whl_Msg1_BTC_Pr5_ST3: rba_Nds_BitPosition=16, rba_Nds_SignalRef=rba_Nds_Signal_SQC_BCS_Whl_Msg1_BTC_Pr5_ST3
              rba_Nds_SignalInstance_WhlDir_FL_Stat_BTC_ST3: rba_Nds_BitPosition=34, rba_Nds_SignalRef=rba_Nds_Signal_WhlDir_FL_Stat_BTC_ST3
              rba_Nds_SignalInstance_WhlDir_FR_Stat_BTC_ST3: rba_Nds_BitPosition=36, rba_Nds_SignalRef=rba_Nds_Signal_WhlDir_FR_Stat_BTC_ST3
              rba_Nds_SignalInstance_WhlDir_RL_Stat_BTC_ST3: rba_Nds_BitPosition=38, rba_Nds_SignalRef=rba_Nds_Signal_WhlDir_RL_Stat_BTC_ST3
              rba_Nds_SignalInstance_WhlDir_RR_Stat_BTC_ST3: rba_Nds_BitPosition=134, rba_Nds_SignalRef=rba_Nds_Signal_WhlDir_RR_Stat_BTC_ST3
              rba_Nds_SignalInstance_WhlPlsCnt_FL_BTC_ST3: rba_Nds_BitPosition=104, rba_Nds_SignalRef=rba_Nds_Signal_WhlPlsCnt_FL_BTC_ST3
              rba_Nds_SignalInstance_WhlPlsCnt_FR_BTC_ST3: rba_Nds_BitPosition=114, rba_Nds_SignalRef=rba_Nds_Signal_WhlPlsCnt_FR_BTC_ST3
              rba_Nds_SignalInstance_WhlPlsCnt_RL_BTC_ST3: rba_Nds_BitPosition=24, rba_Nds_SignalRef=rba_Nds_Signal_WhlPlsCnt_RL_BTC_ST3
              rba_Nds_SignalInstance_WhlPlsCnt_RR_BTC_ST3: rba_Nds_BitPosition=124, rba_Nds_SignalRef=rba_Nds_Signal_WhlPlsCnt_RR_BTC_ST3
              rba_Nds_SignalInstance_WhlRPM_FL_BTC_ST3: rba_Nds_BitPosition=40, rba_Nds_SignalRef=rba_Nds_Signal_WhlRPM_FL_BTC_ST3
              rba_Nds_SignalInstance_WhlRPM_FL_Qual_BTC_ST3: rba_Nds_BitPosition=54, rba_Nds_SignalRef=rba_Nds_Signal_WhlRPM_FL_Qual_BTC_ST3
              rba_Nds_SignalInstance_WhlRPM_FR_BTC_ST3: rba_Nds_BitPosition=56, rba_Nds_SignalRef=rba_Nds_Signal_WhlRPM_FR_BTC_ST3
              rba_Nds_SignalInstance_WhlRPM_FR_Qual_BTC_ST3: rba_Nds_BitPosition=70, rba_Nds_SignalRef=rba_Nds_Signal_WhlRPM_FR_Qual_BTC_ST3
              rba_Nds_SignalInstance_WhlRPM_RL_BTC_ST3: rba_Nds_BitPosition=72, rba_Nds_SignalRef=rba_Nds_Signal_WhlRPM_RL_BTC_ST3
              rba_Nds_SignalInstance_WhlRPM_RL_Qual_BTC_ST3: rba_Nds_BitPosition=86, rba_Nds_SignalRef=rba_Nds_Signal_WhlRPM_RL_Qual_BTC_ST3
              rba_Nds_SignalInstance_WhlRPM_RR_BTC_ST3: rba_Nds_BitPosition=88, rba_Nds_SignalRef=rba_Nds_Signal_WhlRPM_RR_BTC_ST3
              rba_Nds_SignalInstance_WhlRPM_RR_Qual_BTC_ST3: rba_Nds_BitPosition=102, rba_Nds_SignalRef=rba_Nds_Signal_WhlRPM_RR_Qual_BTC_ST3
              rba_Nds_SignalInstance_Rsrv1_BCS_Whl_Msg1_BTC_Pr5_ST3: rba_Nds_BitPosition=156, rba_Nds_SignalRef=rba_Nds_Signal_Rsrv1_BCS_Whl_Msg1_BTC_Pr5_ST3
            rba_Nds_SignalGroupInstance_BCS_Whl_Msg1_BTC_Pr5_ST3_3z5vvcdtzaheg7vz23u7gb0g6 (rba_Nds_SignalGroupInstance): rba_Nds_SignalGroupRef=rba_Nds_SignalGroup_BCS_Whl_Msg1_BTC_Pr5_ST3_3z5vvcdtzaheg7vz23u7gb0g6
            rba_Nds_PduTiming
              rba_Nds_TransmissionModeDeclaration
                rba_Nds_TransmissionModeTrueTiming: rba_Nds_CycleTime=20.0, rba_Nds_StartDelay=0.0
        rba_Nds_Pdu_ESP_HAD_BACKUP_GW_Container2_ST3_Ign_Stat_ST3
          rba_Nds_SignalPdu: rba_Nds_Description=Zuendungsstatus, rba_Nds_Length=4, rba_Nds_Name=ESP_HAD_BACKUP_GW_Container2_ST3_Ign_Stat_ST3, rba_Nds_UnusedAreasDefault=255
            5 x rba_Nds_SignalInstance, all with rba_Nds_ByteOrder=INTEL:
              rba_Nds_SignalInstance_CRC_Ign_Stat_Pr5_ST3: rba_Nds_BitPosition=0, rba_Nds_SignalRef=rba_Nds_Signal_CRC_Ign_Stat_Pr5_ST3
              rba_Nds_SignalInstance_ISw_Stat_ST3: rba_Nds_BitPosition=24, rba_Nds_SignalRef=rba_Nds_Signal_ISw_Stat_ST3
              rba_Nds_SignalInstance_KG_StartSw_Psd_ST3: rba_Nds_BitPosition=31, rba_Nds_SignalRef=rba_Nds_Signal_KG_StartSw_Psd_ST3
              rba_Nds_SignalInstance_SQC_Ign_Stat_Pr5_ST3: rba_Nds_BitPosition=16, rba_Nds_SignalRef=rba_Nds_Signal_SQC_Ign_Stat_Pr5_ST3
              rba_Nds_SignalInstance_Veh_Op_Mode_ST3: rba_Nds_BitPosition=27, rba_Nds_SignalRef=rba_Nds_Signal_Veh_Op_Mode_ST3
            rba_Nds_SignalGroupInstance_Ign_Stat_Pr5_ST3_csgs1dv6drms80o1i9p49677w (rba_Nds_SignalGroupInstance): rba_Nds_SignalGroupRef=rba_Nds_SignalGroup_Ign_Stat_Pr5_ST3_csgs1dv6drms80o1i9p49677w
            rba_Nds_PduTiming
              rba_Nds_TransmissionModeDeclaration
                rba_Nds_TransmissionModeTrueTiming: rba_Nds_CycleTime=100.0, rba_Nds_NumberOfEventTransmissions=0
        rba_Nds_Pdu_ESP_HAD_BACKUP_GW_Container2_ST3_PT4_PTCoor4_ST3
          rba_Nds_SignalPdu:
            rba_Nds_Description = PT4_PTCoor4_ST3
            rba_Nds_Length = 4
            rba_Nds_Name = ESP_HAD_BACKUP_GW_Container2_ST3_PT4_PTCoor4_ST3
            rba_Nds_UnusedAreasDefault = 255
            6 x rba_Nds_SignalInstance, all with rba_Nds_ByteOrder=INTEL:
              rba_Nds_SignalInstance_CRC_PT4_PTCoor4_Pr5_ST3: rba_Nds_BitPosition=0, rba_Nds_SignalRef=rba_Nds_Signal_CRC_PT4_PTCoor4_Pr5_ST3
              rba_Nds_SignalInstance_PT4_PTCoor_EngStartPN14_Stat_ST3: rba_Nds_BitPosition=28, rba_Nds_SignalRef=rba_Nds_Signal_PT4_PTCoor_EngStartPN14_Stat_ST3
              rba_Nds_SignalInstance_PT4_PTCoor_PT_Rdy_ST3: rba_Nds_BitPosition=24, rba_Nds_SignalRef=rba_Nds_Signal_PT4_PTCoor_PT_Rdy_ST3
              rba_Nds_SignalInstance_PT4_PTCoor_SSA_EngSp_ST3: rba_Nds_BitPosition=26, rba_Nds_SignalRef=rba_Nds_Signal_PT4_PTCoor_SSA_EngSp_ST3
              rba_Nds_SignalInstance_SQC_PT4_PTCoor4_Pr5_ST3: rba_Nds_BitPosition=16, rba_Nds_SignalRef=rba_Nds_Signal_SQC_PT4_PTCoor4_Pr5_ST3
              rba_Nds_SignalInstance_Rsrv1_PT4_PTCoor_PT_Rdy_Pr5_ST3: rba_Nds_BitPosition=31, rba_Nds_SignalRef=rba_Nds_Signal_Rsrv1_PT4_PTCoor_PT_Rdy_Pr5_ST3
            rba_Nds_SignalGroupInstance_PT4_PTCoor4_Pr5_ST3_af4fxb1ykieox3itqdfzs0kpb (rba_Nds_SignalGroupInstance): rba_Nds_SignalGroupRef=rba_Nds_SignalGroup_PT4_PTCoor4_Pr5_ST3_af4fxb1ykieox3itqdfzs0kpb
            rba_Nds_PduTiming
              rba_Nds_TransmissionModeDeclaration
                rba_Nds_TransmissionModeTrueTiming: rba_Nds_CycleTime=100.0, rba_Nds_NumberOfEventTransmissions=0
        rba_Nds_Pdu_ESP_HAD_BACKUP_GW_Container4_ST3_DI_OdoSpeedometer_ST3
          rba_Nds_SignalPdu:
            rba_Nds_Description = Fahrerinformation Odometer und Tacho
            rba_Nds_Length = 8
            rba_Nds_Name = ESP_HAD_BACKUP_GW_Container4_ST3_DI_OdoSpeedometer_ST3
            rba_Nds_UnusedAreasDefault = 255
            4 x rba_Nds_SignalInstance, all with rba_Nds_ByteOrder=INTEL:
              rba_Nds_SignalInstance_CRC_DI_Odo_Pr5_ST3: rba_Nds_BitPosition=0, rba_Nds_SignalRef=rba_Nds_Signal_CRC_DI_Odo_Pr5_ST3
              rba_Nds_SignalInstance_Odo_ST3: rba_Nds_BitPosition=24, rba_Nds_SignalRef=rba_Nds_Signal_Odo_ST3
              rba_Nds_SignalInstance_SQC_DI_Odo_Pr5_ST3: rba_Nds_BitPosition=16, rba_Nds_SignalRef=rba_Nds_Signal_SQC_DI_Odo_Pr5_ST3
              rba_Nds_SignalInstance_VehSpd_Disp_ST3: rba_Nds_BitPosition=48, rba_Nds_SignalRef=rba_Nds_Signal_VehSpd_Disp_ST3
            rba_Nds_SignalGroupInstance_DI_Odo_Pr5_ST3_e68xmtlkywxgxsdwekdjjhw3t (rba_Nds_SignalGroupInstance): rba_Nds_UpdateBitPosition=63, rba_Nds_SignalGroupRef=rba_Nds_SignalGroup_DI_Odo_Pr5_ST3_e68xmtlkywxgxsdwekdjjhw3t
            rba_Nds_PduTiming
              rba_Nds_TransmissionModeDeclaration
                rba_Nds_TransmissionModeTrueTiming: rba_Nds_CycleTime=1000.0, rba_Nds_NumberOfEventTransmissions=0
        rba_Nds_Pdu_ESP_HAD_BACKUP_GW_Container4_ST3_DIAG_Stat_ST3
          rba_Nds_SignalPdu:
            rba_Nds_Description = Actv Line Status Tester pres
            rba_Nds_Length = 4
            rba_Nds_Name = ESP_HAD_BACKUP_GW_Container4_ST3_DIAG_Stat_ST3
            rba_Nds_UnusedAreasDefault = 255
            rba_Nds_SignalInstance_Actv_Line_Stat_ST3 (rba_Nds_SignalInstance): rba_Nds_BitPosition=0, rba_Nds_ByteOrder=INTEL, rba_Nds_SignalRef=rba_Nds_Signal_Actv_Line_Stat_ST3
            rba_Nds_ContainedPduProperties: rba_Nds_HeaderIdShortHeader=3801600
            rba_Nds_PduTiming
              rba_Nds_TransmissionModeDeclaration
                rba_Nds_TransmissionModeTrueTiming: rba_Nds_CycleTime=1000.0, rba_Nds_NumberOfEventTransmissions=0
            rba_Nds_SignalInstance_DidA_ExtTest_Pres_ST3 (rba_Nds_SignalInstance): rba_Nds_BitPosition=2, rba_Nds_ByteOrder=INTEL, rba_Nds_SignalRef=rba_Nds_Signal_DidA_ExtTest_Pres_ST3
        rba_Nds_Pdu_ESP_HAD_BACKUP_GW_Container4_ST3_PN14_Master_Stat1_ST3
          rba_Nds_SignalPdu:
            rba_Nds_Description = Status 12V Bordnetz Master
            rba_Nds_Length = 8
            rba_Nds_Name = ESP_HAD_BACKUP_GW_Container4_ST3_PN14_Master_Stat1_ST3
            rba_Nds_UnusedAreasDefault = 255
            rba_Nds_SignalInstance_PN14_TransMd_Stat_ST3 (rba_Nds_SignalInstance): rba_Nds_BitPosition=0, rba_Nds_ByteOrder=INTEL, rba_Nds_SignalRef=rba_Nds_Signal_PN14_TransMd_Stat_ST3
            rba_Nds_PduTiming
              rba_Nds_TransmissionModeDeclaration
                rba_Nds_TransmissionModeTrueTiming: rba_Nds_CycleTime=200.0
            10 x rba_Nds_SignalInstance, all with rba_Nds_ByteOrder=INTEL:
              rba_Nds_SignalInstance_PN14_DDP_Sw_Stat_ST3: rba_Nds_BitPosition=2, rba_Nds_SignalRef=rba_Nds_Signal_PN14_DDP_Sw_Stat_ST3
              rba_Nds_SignalInstance_PN14_ExtBat_Charge_Actv_ST3: rba_Nds_BitPosition=55, rba_Nds_SignalRef=rba_Nds_Signal_PN14_ExtBat_Charge_Actv_ST3
              rba_Nds_SignalInstance_PN14_PNSec_RechargeEnable_ST3: rba_Nds_BitPosition=53, rba_Nds_SignalRef=rba_Nds_Signal_PN14_PNSec_RechargeEnable_ST3
              rba_Nds_SignalInstance_PN14_ProdMd_Stat_ST3: rba_Nds_BitPosition=5, rba_Nds_SignalRef=rba_Nds_Signal_PN14_ProdMd_Stat_ST3
              rba_Nds_SignalInstance_PN14_SupBat_Curr_ST3: rba_Nds_BitPosition=32, rba_Nds_SignalRef=rba_Nds_Signal_PN14_SupBat_Curr_ST3
              rba_Nds_SignalInstance_PN14_SupBat_Stat_ST3: rba_Nds_BitPosition=15, rba_Nds_SignalRef=rba_Nds_Signal_PN14_SupBat_Stat_ST3
              rba_Nds_SignalInstance_PN14_SupBat_Temp_ST3: rba_Nds_BitPosition=45, rba_Nds_SignalRef=rba_Nds_Signal_PN14_SupBat_Temp_ST3
              rba_Nds_SignalInstance_PN14_SupBat_Volt_ST3: rba_Nds_BitPosition=22, rba_Nds_SignalRef=rba_Nds_Signal_PN14_SupBat_Volt_ST3
              rba_Nds_SignalInstance_PN14_DDP_Sw2_Stat_ST3: rba_Nds_BitPosition=57, rba_Nds_SignalRef=rba_Nds_Signal_PN14_DDP_Sw2_Stat_ST3
              rba_Nds_SignalInstance_PN14_ProdMd_BatStat_ST3: rba_Nds_BitPosition=8, rba_Nds_SignalRef=rba_Nds_Signal_PN14_ProdMd_BatStat_ST3
        rba_Nds_Pdu_IMU_A_Output_ST3
          rba_Nds_SignalPdu: rba_Nds_Description=IMU A Output ST3, rba_Nds_Length=40, rba_Nds_Name=IMU_A_Output_ST3, rba_Nds_UnusedAreasDefault=255
            26 x rba_Nds_SignalInstance, all with rba_Nds_ByteOrder=INTEL:
              rba_Nds_SignalInstance_CRC_IMU_A_Output_Pr5_ST3: rba_Nds_BitPosition=0, rba_Nds_SignalRef=rba_Nds_Signal_CRC_IMU_A_Output_Pr5_ST3
              rba_Nds_SignalInstance_IMU_A_AngAcc_Stat_ST3: rba_Nds_BitPosition=27, rba_Nds_SignalRef=rba_Nds_Signal_IMU_A_AngAcc_Stat_ST3
              rba_Nds_SignalInstance_IMU_A_AngAcc_X_ST3: rba_Nds_BitPosition=55, rba_Nds_SignalRef=rba_Nds_Signal_IMU_A_AngAcc_X_ST3
              rba_Nds_SignalInstance_IMU_A_AngAcc_Y_ST3: rba_Nds_BitPosition=71, rba_Nds_SignalRef=rba_Nds_Signal_IMU_A_AngAcc_Y_ST3
              rba_Nds_SignalInstance_IMU_A_AngAcc_Z_ST3: rba_Nds_BitPosition=87, rba_Nds_SignalRef=rba_Nds_Signal_IMU_A_AngAcc_Z_ST3
              rba_Nds_SignalInstance_IMU_A_AngRate_X_ST3: rba_Nds_BitPosition=103, rba_Nds_SignalRef=rba_Nds_Signal_IMU_A_AngRate_X_ST3
              rba_Nds_SignalInstance_IMU_A_AngRate_Y_ST3: rba_Nds_BitPosition=119, rba_Nds_SignalRef=rba_Nds_Signal_IMU_A_AngRate_Y_ST3
              rba_Nds_SignalInstance_IMU_A_AngRate_Z_ST3: rba_Nds_BitPosition=135, rba_Nds_SignalRef=rba_Nds_Signal_IMU_A_AngRate_Z_ST3
              rba_Nds_SignalInstance_IMU_A_AngRates_Stat_ST3: rba_Nds_BitPosition=30, rba_Nds_SignalRef=rba_Nds_Signal_IMU_A_AngRates_Stat_ST3
              rba_Nds_SignalInstance_IMU_A_SpecForce_Stat_ST3: rba_Nds_BitPosition=36, rba_Nds_SignalRef=rba_Nds_Signal_IMU_A_SpecForce_Stat_ST3
              rba_Nds_SignalInstance_IMU_A_SpecForce_X_ST3: rba_Nds_BitPosition=151, rba_Nds_SignalRef=rba_Nds_Signal_IMU_A_SpecForce_X_ST3
              rba_Nds_SignalInstance_IMU_A_SpecForce_Y_ST3: rba_Nds_BitPosition=167, rba_Nds_SignalRef=rba_Nds_Signal_IMU_A_SpecForce_Y_ST3
              rba_Nds_SignalInstance_IMU_A_SpecForce_Z_ST3: rba_Nds_BitPosition=183, rba_Nds_SignalRef=rba_Nds_Signal_IMU_A_SpecForce_Z_ST3
              rba_Nds_SignalInstance_IMU_A_Stat_ST3: rba_Nds_BitPosition=24, rba_Nds_SignalRef=rba_Nds_Signal_IMU_A_Stat_ST3
              rba_Nds_SignalInstance_IMU_A_Temp_ST3: rba_Nds_BitPosition=39, rba_Nds_SignalRef=rba_Nds_Signal_IMU_A_Temp_ST3
              rba_Nds_SignalInstance_IMU_A_TmStmp_NanoSec_ST3: rba_Nds_BitPosition=199, rba_Nds_SignalRef=rba_Nds_Signal_IMU_A_TmStmp_NanoSec_ST3
              rba_Nds_SignalInstance_IMU_A_TmStmp_Sec_ST3: rba_Nds_BitPosition=231, rba_Nds_SignalRef=rba_Nds_Signal_IMU_A_TmStmp_Sec_ST3
              rba_Nds_SignalInstance_IMU_A_TmSync_Stat_ST3: rba_Nds_BitPosition=47, rba_Nds_SignalRef=rba_Nds_Signal_IMU_A_TmSync_Stat_ST3
              rba_Nds_SignalInstance_SQC_IMU_A_Output_Pr5_ST3: rba_Nds_BitPosition=16, rba_Nds_SignalRef=rba_Nds_Signal_SQC_IMU_A_Output_Pr5_ST3
              rba_Nds_SignalInstance_Rsrv01_IMU_A_Output_Pr5_ST3: rba_Nds_BitPosition=263, rba_Nds_SignalRef=rba_Nds_Signal_Rsrv01_IMU_A_Output_Pr5_ST3
              rba_Nds_SignalInstance_Rsrv02_IMU_A_Output_Pr5_ST3: rba_Nds_BitPosition=272, rba_Nds_SignalRef=rba_Nds_Signal_Rsrv02_IMU_A_Output_Pr5_ST3
              rba_Nds_SignalInstance_Rsrv03_IMU_A_Output_Pr5_ST3: rba_Nds_BitPosition=280, rba_Nds_SignalRef=rba_Nds_Signal_Rsrv03_IMU_A_Output_Pr5_ST3
              rba_Nds_SignalInstance_Rsrv04_IMU_A_Output_Pr5_ST3: rba_Nds_BitPosition=288, rba_Nds_SignalRef=rba_Nds_Signal_Rsrv04_IMU_A_Output_Pr5_ST3
              rba_Nds_SignalInstance_Rsrv05_IMU_A_Output_Pr5_ST3: rba_Nds_BitPosition=296, rba_Nds_SignalRef=rba_Nds_Signal_Rsrv05_IMU_A_Output_Pr5_ST3
              rba_Nds_SignalInstance_Rsrv06_IMU_A_Output_Pr5_ST3: rba_Nds_BitPosition=304, rba_Nds_SignalRef=rba_Nds_Signal_Rsrv06_IMU_A_Output_Pr5_ST3
              rba_Nds_SignalInstance_Rsrv07_IMU_A_Output_Pr5_ST3: rba_Nds_BitPosition=33, rba_Nds_SignalRef=rba_Nds_Signal_Rsrv07_IMU_A_Output_Pr5_ST3
            rba_Nds_SignalGroupInstance_IMU_A_Output_Pr5_ST3_bezr5ct33mhwxias0s8rjhbne (rba_Nds_SignalGroupInstance): rba_Nds_SignalGroupRef=rba_Nds_SignalGroup_IMU_A_Output_Pr5_ST3_bezr5ct33mhwxias0s8rjhbne
            rba_Nds_PduTiming: rba_Nds_MinimumDelayTime=10
              rba_Nds_TransmissionModeDeclaration
                rba_Nds_TransmissionModeTrueTiming: rba_Nds_NumberOfEventTransmissions=0
        rba_Nds_Pdu_IMU_A_Output_Fast_ST3
          rba_Nds_SignalPdu: rba_Nds_Description=IMU A Output ST3, rba_Nds_Length=40, rba_Nds_Name=IMU_A_Output_Fast_ST3, rba_Nds_UnusedAreasDefault=255
            26 x rba_Nds_SignalInstance, all with rba_Nds_ByteOrder=INTEL:
              rba_Nds_SignalInstance_CRC_IMU_A_Output_Fast_Pr5_ST3: rba_Nds_BitPosition=0, rba_Nds_SignalRef=rba_Nds_Signal_CRC_IMU_A_Output_Fast_Pr5_ST3
              rba_Nds_SignalInstance_IMU_A_AngAcc_Stat_Fast_ST3: rba_Nds_BitPosition=27, rba_Nds_SignalRef=rba_Nds_Signal_IMU_A_AngAcc_Stat_Fast_ST3
              rba_Nds_SignalInstance_IMU_A_AngAcc_X_Fast_ST3: rba_Nds_BitPosition=55, rba_Nds_SignalRef=rba_Nds_Signal_IMU_A_AngAcc_X_Fast_ST3
              rba_Nds_SignalInstance_IMU_A_AngAcc_Y_Fast_ST3: rba_Nds_BitPosition=71, rba_Nds_SignalRef=rba_Nds_Signal_IMU_A_AngAcc_Y_Fast_ST3
              rba_Nds_SignalInstance_IMU_A_AngAcc_Z_Fast_ST3: rba_Nds_BitPosition=87, rba_Nds_SignalRef=rba_Nds_Signal_IMU_A_AngAcc_Z_Fast_ST3
              rba_Nds_SignalInstance_IMU_A_AngRate_X_Fast_ST3: rba_Nds_BitPosition=103, rba_Nds_SignalRef=rba_Nds_Signal_IMU_A_AngRate_X_Fast_ST3
              rba_Nds_SignalInstance_IMU_A_AngRate_Y_Fast_ST3: rba_Nds_BitPosition=119, rba_Nds_SignalRef=rba_Nds_Signal_IMU_A_AngRate_Y_Fast_ST3
              rba_Nds_SignalInstance_IMU_A_AngRate_Z_Fast_ST3: rba_Nds_BitPosition=135, rba_Nds_SignalRef=rba_Nds_Signal_IMU_A_AngRate_Z_Fast_ST3
              rba_Nds_SignalInstance_IMU_A_AngRates_Stat_Fast_ST3: rba_Nds_BitPosition=30, rba_Nds_SignalRef=rba_Nds_Signal_IMU_A_AngRates_Stat_Fast_ST3
              rba_Nds_SignalInstance_IMU_A_SpecForce_Stat_Fast_ST3: rba_Nds_BitPosition=36, rba_Nds_SignalRef=rba_Nds_Signal_IMU_A_SpecForce_Stat_Fast_ST3
              rba_Nds_SignalInstance_IMU_A_SpecForce_X_Fast_ST3: rba_Nds_BitPosition=151, rba_Nds_SignalRef=rba_Nds_Signal_IMU_A_SpecForce_X_Fast_ST3
              rba_Nds_SignalInstance_IMU_A_SpecForce_Y_Fast_ST3: rba_Nds_BitPosition=167, rba_Nds_SignalRef=rba_Nds_Signal_IMU_A_SpecForce_Y_Fast_ST3
              rba_Nds_SignalInstance_IMU_A_SpecForce_Z_Fast_ST3: rba_Nds_BitPosition=183, rba_Nds_SignalRef=rba_Nds_Signal_IMU_A_SpecForce_Z_Fast_ST3
              rba_Nds_SignalInstance_IMU_A_Stat_Fast_ST3: rba_Nds_BitPosition=24, rba_Nds_SignalRef=rba_Nds_Signal_IMU_A_Stat_Fast_ST3
              rba_Nds_SignalInstance_IMU_A_Temp_Fast_ST3: rba_Nds_BitPosition=39, rba_Nds_SignalRef=rba_Nds_Signal_IMU_A_Temp_Fast_ST3
              rba_Nds_SignalInstance_IMU_A_TmStmp_NanoSec_Fast_ST3: rba_Nds_BitPosition=199, rba_Nds_SignalRef=rba_Nds_Signal_IMU_A_TmStmp_NanoSec_Fast_ST3
              rba_Nds_SignalInstance_IMU_A_TmStmp_Sec_Fast_ST3: rba_Nds_BitPosition=231, rba_Nds_SignalRef=rba_Nds_Signal_IMU_A_TmStmp_Sec_Fast_ST3
              rba_Nds_SignalInstance_IMU_A_TmSync_Stat_Fast_ST3: rba_Nds_BitPosition=47, rba_Nds_SignalRef=rba_Nds_Signal_IMU_A_TmSync_Stat_Fast_ST3
              rba_Nds_SignalInstance_SQC_IMU_A_Output_Fast_Pr5_ST3: rba_Nds_BitPosition=16, rba_Nds_SignalRef=rba_Nds_Signal_SQC_IMU_A_Output_Fast_Pr5_ST3
              rba_Nds_SignalInstance_Rsrv01_IMU_A_Output_Fast_Pr5_ST3: rba_Nds_BitPosition=263, rba_Nds_SignalRef=rba_Nds_Signal_Rsrv01_IMU_A_Output_Fast_Pr5_ST3
              rba_Nds_SignalInstance_Rsrv02_IMU_A_Output_Fast_Pr5_ST3: rba_Nds_BitPosition=272, rba_Nds_SignalRef=rba_Nds_Signal_Rsrv02_IMU_A_Output_Fast_Pr5_ST3
              rba_Nds_SignalInstance_Rsrv03_IMU_A_Output_Fast_Pr5_ST3: rba_Nds_BitPosition=280, rba_Nds_SignalRef=rba_Nds_Signal_Rsrv03_IMU_A_Output_Fast_Pr5_ST3
              rba_Nds_SignalInstance_Rsrv04_IMU_A_Output_Fast_Pr5_ST3: rba_Nds_BitPosition=288, rba_Nds_SignalRef=rba_Nds_Signal_Rsrv04_IMU_A_Output_Fast_Pr5_ST3
              rba_Nds_SignalInstance_Rsrv05_IMU_A_Output_Fast_Pr5_ST3: rba_Nds_BitPosition=296, rba_Nds_SignalRef=rba_Nds_Signal_Rsrv05_IMU_A_Output_Fast_Pr5_ST3
              rba_Nds_SignalInstance_Rsrv06_IMU_A_Output_Fast_Pr5_ST3: rba_Nds_BitPosition=304, rba_Nds_SignalRef=rba_Nds_Signal_Rsrv06_IMU_A_Output_Fast_Pr5_ST3
              rba_Nds_SignalInstance_Rsrv07_IMU_A_Output_Fast_Pr5_ST3: rba_Nds_BitPosition=33, rba_Nds_SignalRef=rba_Nds_Signal_Rsrv07_IMU_A_Output_Fast_Pr5_ST3
            rba_Nds_SignalGroupInstance_IMU_A_Output_Fast_Pr5_ST3_5ym0lyqjosyobfhfksta75zc4 (rba_Nds_SignalGroupInstance): rba_Nds_SignalGroupRef=rba_Nds_SignalGroup_IMU_A_Output_Fast_Pr5_ST3_5ym0lyqjosyobfhfksta75zc4
            rba_Nds_PduTiming: rba_Nds_MinimumDelayTime=5
              rba_Nds_TransmissionModeDeclaration
                rba_Nds_TransmissionModeTrueTiming: rba_Nds_NumberOfEventTransmissions=0
        rba_Nds_Pdu_ESP_HAD_BACKUP_COM_Container1_ST3_ContainerIPdu
          rba_Nds_ContainerPdu:
            rba_Nds_Description = ESP_HAD_BACKUP_COM_Container1_ST3_ContainerIPdu
            rba_Nds_Name = ESP_HAD_BACKUP_COM_Container1_ST3_ContainerIPdu
            rba_Nds_Length = 64
            rba_Nds_UnusedAreasDefault = 0
            rba_Nds_HeaderType = SHORT_HEADER
            rba_Nds_ContainedPduTriggering = rba_Nds_CanPduTriggering_ESP_HAD_BACKUP_COM_Container1_ST3_ESP_HAD_BACKUP_COM_Container1_ST3_BCS_Whl_Msg1_BTC_ST3_16ebm65e7roje1m2kqzv87azq
        rba_Nds_Pdu_ESP_HAD_BACKUP_COM_Container1_ST3_ESP_HAD_BACKUP_COM_Container1_ST3_BCS_Whl_Msg1_BTC_ST3_secured
          rba_Nds_SecuredPdu:
            rba_Nds_Description = ESP_HAD_BACKUP_COM_Container1_ST3_ESP_HAD_BACKUP_COM_Container1_ST3_BCS_Whl_Msg1_BTC_ST3_secured
            rba_Nds_Name = ESP_HAD_BACKUP_COM_Container1_ST3_ESP_HAD_BACKUP_COM_Container1_ST3_BCS_Whl_Msg1_BTC_ST3_secured
            rba_Nds_Length = 24
            rba_Nds_AuthenticPduTriggeringRef = rba_Nds_CanPduTriggering_ESP_HAD_BACKUP_COM_Container1_ST3_ESP_HAD_BACKUP_COM_Container1_ST3_BCS_Whl_Msg1_BTC_ST3_5veu2p0tm6432xnhqor79qs7k
            rba_Nds_ContainedPduProperties: rba_Nds_HeaderIdShortHeader=2457857
        rba_Nds_Pdu_ESP_HAD_BACKUP_GW_Container2_ST3_ContainerIPdu
          rba_Nds_ContainerPdu:
            rba_Nds_Description = ESP_HAD_BACKUP_GW_Container2_ST3_ContainerIPdu
            rba_Nds_Name = ESP_HAD_BACKUP_GW_Container2_ST3_ContainerIPdu
            rba_Nds_Length = 64
            rba_Nds_UnusedAreasDefault = 0
            rba_Nds_HeaderType = SHORT_HEADER
            rba_Nds_ContainedPduTriggering = rba_Nds_CanPduTriggering_ESP_HAD_BACKUP_GW_Container2_ST3_ESP_HAD_BACKUP_GW_Container2_ST3_Ign_Stat_ST3_2evpht35ev1p8y12nz0ebo5h3
            rba_Nds_ContainedPduTriggering = rba_Nds_CanPduTriggering_ESP_HAD_BACKUP_GW_Container2_ST3_ESP_HAD_BACKUP_GW_Container2_ST3_PT4_PTCoor4_ST3_4jwqfrzf6ypk91w3rckoip7tp
        rba_Nds_Pdu_ESP_HAD_BACKUP_GW_Container2_ST3_ESP_HAD_BACKUP_GW_Container2_ST3_Ign_Stat_ST3_secured
          rba_Nds_SecuredPdu:
            rba_Nds_Description = ESP_HAD_BACKUP_GW_Container2_ST3_ESP_HAD_BACKUP_GW_Container2_ST3_Ign_Stat_ST3_secured
            rba_Nds_Name = ESP_HAD_BACKUP_GW_Container2_ST3_ESP_HAD_BACKUP_GW_Container2_ST3_Ign_Stat_ST3_secured
            rba_Nds_Length = 8
            rba_Nds_AuthenticPduTriggeringRef = rba_Nds_CanPduTriggering_ESP_HAD_BACKUP_GW_Container2_ST3_ESP_HAD_BACKUP_GW_Container2_ST3_Ign_Stat_ST3_bcjlclrj2mauvscq34e4kbcj3
            rba_Nds_ContainedPduProperties: rba_Nds_HeaderIdShortHeader=32768
        rba_Nds_Pdu_ESP_HAD_BACKUP_GW_Container2_ST3_ESP_HAD_BACKUP_GW_Container2_ST3_PT4_PTCoor4_ST3_secured
          rba_Nds_SecuredPdu:
            rba_Nds_Description = ESP_HAD_BACKUP_GW_Container2_ST3_ESP_HAD_BACKUP_GW_Container2_ST3_PT4_PTCoor4_ST3_secured
            rba_Nds_Name = ESP_HAD_BACKUP_GW_Container2_ST3_ESP_HAD_BACKUP_GW_Container2_ST3_PT4_PTCoor4_ST3_secured
            rba_Nds_Length = 8
            rba_Nds_AuthenticPduTriggeringRef = rba_Nds_CanPduTriggering_ESP_HAD_BACKUP_GW_Container2_ST3_ESP_HAD_BACKUP_GW_Container2_ST3_PT4_PTCoor4_ST3_9c9xmhimk3956a8bl74rmvxi7
            rba_Nds_ContainedPduProperties: rba_Nds_HeaderIdShortHeader=3736582
        rba_Nds_Pdu_ESP_HAD_BACKUP_GW_Container4_ST3_ContainerIPdu
          rba_Nds_ContainerPdu:
            rba_Nds_Description = ESP_HAD_BACKUP_GW_Container4_ST3_ContainerIPdu
            rba_Nds_Name = ESP_HAD_BACKUP_GW_Container4_ST3_ContainerIPdu
            rba_Nds_Length = 64
            rba_Nds_UnusedAreasDefault = 0
            rba_Nds_HeaderType = SHORT_HEADER
            rba_Nds_ContainedPduTriggering = rba_Nds_CanPduTriggering_ESP_HAD_BACKUP_GW_Container4_ST3_ESP_HAD_BACKUP_GW_Container4_ST3_DI_OdoSpeedometer_ST3_8fnay511jh4db945s2stpdw7p
            rba_Nds_ContainedPduTriggering = rba_Nds_CanPduTriggering_ESP_HAD_BACKUP_GW_Container4_ST3_ESP_HAD_BACKUP_GW_Container4_ST3_DIAG_Stat_ST3_a9kzo9c723k3h5cgrsehf20w0
            rba_Nds_ContainedPduTriggering = rba_Nds_CanPduTriggering_ESP_HAD_BACKUP_GW_Container4_ST3_ESP_HAD_BACKUP_GW_Container4_ST3_PN14_Master_Stat1_ST3_11xqv03a1oeng5zctxoxlpsa
        rba_Nds_Pdu_ESP_HAD_BACKUP_GW_Container4_ST3_ESP_HAD_BACKUP_GW_Container4_ST3_DI_OdoSpeedometer_ST3_secured
          rba_Nds_SecuredPdu:
            rba_Nds_Description = ESP_HAD_BACKUP_GW_Container4_ST3_ESP_HAD_BACKUP_GW_Container4_ST3_DI_OdoSpeedometer_ST3_secured
            rba_Nds_Name = ESP_HAD_BACKUP_GW_Container4_ST3_ESP_HAD_BACKUP_GW_Container4_ST3_DI_OdoSpeedometer_ST3_secured
            rba_Nds_Length = 12
            rba_Nds_AuthenticPduTriggeringRef = rba_Nds_CanPduTriggering_ESP_HAD_BACKUP_GW_Container4_ST3_ESP_HAD_BACKUP_GW_Container4_ST3_DI_OdoSpeedometer_ST3_2wrcqkh4ub39zvlu7w28s2r1f
            rba_Nds_ContainedPduProperties: rba_Nds_HeaderIdShortHeader=3277824
        rba_Nds_Pdu_ESP_HAD_BACKUP_GW_Container4_ST3_ESP_HAD_BACKUP_GW_Container4_ST3_PN14_Master_Stat1_ST3_secured
          rba_Nds_SecuredPdu:
            rba_Nds_Description = ESP_HAD_BACKUP_GW_Container4_ST3_ESP_HAD_BACKUP_GW_Container4_ST3_PN14_Master_Stat1_ST3_secured
            rba_Nds_Name = ESP_HAD_BACKUP_GW_Container4_ST3_ESP_HAD_BACKUP_GW_Container4_ST3_PN14_Master_Stat1_ST3_secured
            rba_Nds_Length = 12
            rba_Nds_AuthenticPduTriggeringRef = rba_Nds_CanPduTriggering_ESP_HAD_BACKUP_GW_Container4_ST3_ESP_HAD_BACKUP_GW_Container4_ST3_PN14_Master_Stat1_ST3_6wlpxzn4ez9a5ru3exv8xu1x7
            rba_Nds_ContainedPduProperties: rba_Nds_HeaderIdShortHeader=3768320
        rba_Nds_Pdu_IMU_A_Output_ST3_secured
          rba_Nds_SecuredPdu:
            rba_Nds_Description = IMU_A_Output_ST3_secured
            rba_Nds_Name = IMU_A_Output_ST3_secured
            rba_Nds_Length = 44
            rba_Nds_AuthenticPduTriggeringRef = rba_Nds_CanPduTriggering_IMU_A_Output_ST3_brfz9q0nahr147hbo9yhq1vvv
        rba_Nds_Pdu_IMU_A_Output_Fast_ST3_secured
          rba_Nds_SecuredPdu:
            rba_Nds_Description = IMU_A_Output_Fast_ST3_secured
            rba_Nds_Name = IMU_A_Output_Fast_ST3_secured
            rba_Nds_Length = 44
            rba_Nds_AuthenticPduTriggeringRef = rba_Nds_CanPduTriggering_IMU_A_Output_Fast_ST3_9j5x7ag429n202ymo68kf1vn0
      41 x rba_Nds_Signal, all with rba_Nds_BitSize=8, rba_Nds_Encoding=UNSIGNED:
        rba_Nds_Signal_Platform_Stat_Star3: rba_Nds_Description=Plattformstatus, rba_Nds_Name=Platform_Stat_Star3
          rba_Nds_NetworkRepresentation_0_Platform_Stat_Star3 (rba_Nds_NetworkRepresentation)
            rba_Nds_DirectRepresentation: rba_Nds_MinValue=0, rba_Nds_MaxValue=255
        rba_Nds_Signal_VSS_TP_VIN_7_ST3: rba_Nds_Description=VSS-Transportprotokoll für Fahrzeugidentifikationsnummer, Byte 7, rba_Nds_Name=VSS_TP_VIN_7_ST3
          rba_Nds_NetworkRepresentation_0 (rba_Nds_NetworkRepresentation)
            rba_Nds_DirectRepresentation: rba_Nds_MinValue=0, rba_Nds_MaxValue=255
        rba_Nds_Signal_VSS_TP_VIN_6_ST3: rba_Nds_Description=VSS-Transportprotokoll für Fahrzeugidentifikationsnummer, Byte 6, rba_Nds_Name=VSS_TP_VIN_6_ST3
          rba_Nds_NetworkRepresentation_0 (rba_Nds_NetworkRepresentation)
            rba_Nds_DirectRepresentation: rba_Nds_MinValue=0, rba_Nds_MaxValue=255
        rba_Nds_Signal_VSS_TP_VIN_5_ST3: rba_Nds_Description=VSS-Transportprotokoll für Fahrzeugidentifikationsnummer, Byte 5, rba_Nds_Name=VSS_TP_VIN_5_ST3
          rba_Nds_NetworkRepresentation_0 (rba_Nds_NetworkRepresentation)
            rba_Nds_DirectRepresentation: rba_Nds_MaxValue=255, rba_Nds_MinValue=0
        rba_Nds_Signal_VSS_TP_VIN_4_ST3: rba_Nds_Description=VSS-Transportprotokoll für Fahrzeugidentifikationsnummer, Byte 4, rba_Nds_Name=VSS_TP_VIN_4_ST3
          rba_Nds_NetworkRepresentation_0 (rba_Nds_NetworkRepresentation)
            rba_Nds_DirectRepresentation: rba_Nds_MaxValue=255, rba_Nds_MinValue=0
        rba_Nds_Signal_VSS_TP_VIN_3_ST3: rba_Nds_Description=VSS-Transportprotokoll für Fahrzeugidentifikationsnummer, Byte 3, rba_Nds_Name=VSS_TP_VIN_3_ST3
          rba_Nds_NetworkRepresentation_0 (rba_Nds_NetworkRepresentation)
            rba_Nds_DirectRepresentation: rba_Nds_MaxValue=255, rba_Nds_MinValue=0
        rba_Nds_Signal_VSS_TP_VIN_2_ST3: rba_Nds_Description=VSS-Transportprotokoll für Fahrzeugidentifikationsnummer, Byte 2, rba_Nds_Name=VSS_TP_VIN_2_ST3
          rba_Nds_NetworkRepresentation_0 (rba_Nds_NetworkRepresentation)
            rba_Nds_DirectRepresentation: rba_Nds_MaxValue=255, rba_Nds_MinValue=0
        rba_Nds_Signal_VSS_TP_VIN_1_ST3: rba_Nds_Description=VSS-Transportprotokoll für Fahrzeugidentifikationsnummer, Byte 1, rba_Nds_Name=VSS_TP_VIN_1_ST3
          rba_Nds_NetworkRepresentation_0 (rba_Nds_NetworkRepresentation)
            rba_Nds_DirectRepresentation: rba_Nds_MaxValue=255, rba_Nds_MinValue=0
        rba_Nds_Signal_VSS_TP_VIN_0_ST3: rba_Nds_Description=VSS-Transportprotokoll für Fahrzeugidentifikationsnummer, Byte 0, rba_Nds_Name=VSS_TP_VIN_0_ST3
          rba_Nds_NetworkRepresentation_0 (rba_Nds_NetworkRepresentation)
            rba_Nds_DirectRepresentation: rba_Nds_MaxValue=255, rba_Nds_MinValue=0
        rba_Nds_Signal_VSS_TP_SharedSecret_7_ST3: rba_Nds_Description=VSS-Transportprotokoll für gemeinsames Geheimnis, Byte 7, rba_Nds_Name=VSS_TP_SharedSecret_7_ST3
          rba_Nds_NetworkRepresentation_0 (rba_Nds_NetworkRepresentation)
            rba_Nds_DirectRepresentation: rba_Nds_MaxValue=255, rba_Nds_MinValue=0
        rba_Nds_Signal_VSS_TP_SharedSecret_6_ST3: rba_Nds_Description=VSS-Transportprotokoll für gemeinsames Geheimnis, Byte 6, rba_Nds_Name=VSS_TP_SharedSecret_6_ST3
          rba_Nds_NetworkRepresentation_0 (rba_Nds_NetworkRepresentation)
            rba_Nds_DirectRepresentation: rba_Nds_MaxValue=255, rba_Nds_MinValue=0
        rba_Nds_Signal_VSS_TP_SharedSecret_5_ST3: rba_Nds_Description=VSS-Transportprotokoll für gemeinsames Geheimnis, Byte 5, rba_Nds_Name=VSS_TP_SharedSecret_5_ST3
          rba_Nds_NetworkRepresentation_0 (rba_Nds_NetworkRepresentation)
            rba_Nds_DirectRepresentation: rba_Nds_MaxValue=255, rba_Nds_MinValue=0
        rba_Nds_Signal_VSS_TP_SharedSecret_4_ST3: rba_Nds_Description=VSS-Transportprotokoll für gemeinsames Geheimnis, Byte 4, rba_Nds_Name=VSS_TP_SharedSecret_4_ST3
          rba_Nds_NetworkRepresentation_0 (rba_Nds_NetworkRepresentation)
            rba_Nds_DirectRepresentation: rba_Nds_MaxValue=255, rba_Nds_MinValue=0
        rba_Nds_Signal_VSS_TP_SharedSecret_3_ST3: rba_Nds_Description=VSS-Transportprotokoll für gemeinsames Geheimnis, Byte 3, rba_Nds_Name=VSS_TP_SharedSecret_3_ST3
          rba_Nds_NetworkRepresentation_0 (rba_Nds_NetworkRepresentation)
            rba_Nds_DirectRepresentation: rba_Nds_MaxValue=255, rba_Nds_MinValue=0
        rba_Nds_Signal_VSS_TP_SharedSecret_2_ST3: rba_Nds_Description=VSS-Transportprotokoll für gemeinsames Geheimnis, Byte 2, rba_Nds_Name=VSS_TP_SharedSecret_2_ST3
          rba_Nds_NetworkRepresentation_0 (rba_Nds_NetworkRepresentation)
            rba_Nds_DirectRepresentation: rba_Nds_MaxValue=255, rba_Nds_MinValue=0
        rba_Nds_Signal_VSS_TP_SharedSecret_1_ST3: rba_Nds_Description=VSS-Transportprotokoll für gemeinsames Geheimnis, Byte 1, rba_Nds_Name=VSS_TP_SharedSecret_1_ST3
          rba_Nds_NetworkRepresentation_0 (rba_Nds_NetworkRepresentation)
            rba_Nds_DirectRepresentation: rba_Nds_MaxValue=255, rba_Nds_MinValue=0
        rba_Nds_Signal_VSS_TP_SharedSecret_0_ST3: rba_Nds_Description=VSS-Transportprotokoll für gemeinsames Geheimnis, Byte 0, rba_Nds_Name=VSS_TP_SharedSecret_0_ST3
          rba_Nds_NetworkRepresentation_0 (rba_Nds_NetworkRepresentation)
            rba_Nds_DirectRepresentation: rba_Nds_MaxValue=255, rba_Nds_MinValue=0
        rba_Nds_Signal_VSS_TP_SecTickCount_Lvl1_7_ST3: rba_Nds_Description=VSS-Transportprotokoll für sichere Zeit Stufe 1, Byte 7, rba_Nds_Name=VSS_TP_SecTickCount_Lvl1_7_ST3
          rba_Nds_NetworkRepresentation_0 (rba_Nds_NetworkRepresentation)
            rba_Nds_DirectRepresentation: rba_Nds_MaxValue=255, rba_Nds_MinValue=0
        rba_Nds_Signal_VSS_TP_SecTickCount_Lvl1_6_ST3: rba_Nds_Description=VSS-Transportprotokoll für sichere Zeit Stufe 1, Byte 6, rba_Nds_Name=VSS_TP_SecTickCount_Lvl1_6_ST3
          rba_Nds_NetworkRepresentation_0 (rba_Nds_NetworkRepresentation)
            rba_Nds_DirectRepresentation: rba_Nds_MaxValue=255, rba_Nds_MinValue=0
        rba_Nds_Signal_VSS_TP_SecTickCount_Lvl1_5_ST3: rba_Nds_Description=VSS-Transportprotokoll für sichere Zeit Stufe 1, Byte 5, rba_Nds_Name=VSS_TP_SecTickCount_Lvl1_5_ST3
          rba_Nds_NetworkRepresentation_0 (rba_Nds_NetworkRepresentation)
            rba_Nds_DirectRepresentation: rba_Nds_MaxValue=255, rba_Nds_MinValue=0
        rba_Nds_Signal_VSS_TP_SecTickCount_Lvl1_4_ST3: rba_Nds_Description=VSS-Transportprotokoll für sichere Zeit Stufe 1, Byte 4, rba_Nds_Name=VSS_TP_SecTickCount_Lvl1_4_ST3
          rba_Nds_NetworkRepresentation_0 (rba_Nds_NetworkRepresentation)
            rba_Nds_DirectRepresentation: rba_Nds_MaxValue=255, rba_Nds_MinValue=0
        rba_Nds_Signal_VSS_TP_SecTickCount_Lvl1_3_ST3: rba_Nds_Description=VSS-Transportprotokoll für sichere Zeit Stufe 1, Byte 3, rba_Nds_Name=VSS_TP_SecTickCount_Lvl1_3_ST3
          rba_Nds_NetworkRepresentation_0 (rba_Nds_NetworkRepresentation)
            rba_Nds_DirectRepresentation: rba_Nds_MaxValue=255, rba_Nds_MinValue=0
        rba_Nds_Signal_VSS_TP_SecTickCount_Lvl1_2_ST3: rba_Nds_Description=VSS-Transportprotokoll für sichere Zeit Stufe 1, Byte 2, rba_Nds_Name=VSS_TP_SecTickCount_Lvl1_2_ST3
          rba_Nds_NetworkRepresentation_0 (rba_Nds_NetworkRepresentation)
            rba_Nds_DirectRepresentation: rba_Nds_MaxValue=255, rba_Nds_MinValue=0
        rba_Nds_Signal_VSS_TP_SecTickCount_Lvl1_1_ST3: rba_Nds_Description=VSS-Transportprotokoll für sichere Zeit Stufe 1, Byte 1, rba_Nds_Name=VSS_TP_SecTickCount_Lvl1_1_ST3
          rba_Nds_NetworkRepresentation_0 (rba_Nds_NetworkRepresentation)
            rba_Nds_DirectRepresentation: rba_Nds_MaxValue=255, rba_Nds_MinValue=0
        rba_Nds_Signal_VSS_TP_SecTickCount_Lvl1_0_ST3: rba_Nds_Description=VSS-Transportprotokoll für sichere Zeit Stufe 1, Byte 0, rba_Nds_Name=VSS_TP_SecTickCount_Lvl1_0_ST3
          rba_Nds_NetworkRepresentation_0 (rba_Nds_NetworkRepresentation)
            rba_Nds_DirectRepresentation: rba_Nds_MaxValue=255, rba_Nds_MinValue=0
        rba_Nds_Signal_VSS_TP_RealTmOffset_7_ST3: rba_Nds_Description=VSS-Transportprotokoll für Echtzeit-Offset, Byte 7, rba_Nds_Name=VSS_TP_RealTmOffset_7_ST3
          rba_Nds_NetworkRepresentation_0 (rba_Nds_NetworkRepresentation)
            rba_Nds_DirectRepresentation: rba_Nds_MaxValue=255, rba_Nds_MinValue=0
        rba_Nds_Signal_VSS_TP_RealTmOffset_6_ST3: rba_Nds_Description=VSS-Transportprotokoll für Echtzeit-Offset, Byte 6, rba_Nds_Name=VSS_TP_RealTmOffset_6_ST3
          rba_Nds_NetworkRepresentation_0 (rba_Nds_NetworkRepresentation)
            rba_Nds_DirectRepresentation: rba_Nds_MaxValue=255, rba_Nds_MinValue=0
        rba_Nds_Signal_VSS_TP_RealTmOffset_5_ST3: rba_Nds_Description=VSS-Transportprotokoll für Echtzeit-Offset, Byte 5, rba_Nds_Name=VSS_TP_RealTmOffset_5_ST3
          rba_Nds_NetworkRepresentation_0 (rba_Nds_NetworkRepresentation)
            rba_Nds_DirectRepresentation: rba_Nds_MaxValue=255, rba_Nds_MinValue=0
        rba_Nds_Signal_VSS_TP_RealTmOffset_4_ST3: rba_Nds_Description=VSS-Transportprotokoll für Echtzeit-Offset, Byte 4, rba_Nds_Name=VSS_TP_RealTmOffset_4_ST3
          rba_Nds_NetworkRepresentation_0 (rba_Nds_NetworkRepresentation)
            rba_Nds_DirectRepresentation: rba_Nds_MaxValue=255, rba_Nds_MinValue=0
        rba_Nds_Signal_VSS_TP_RealTmOffset_3_ST3: rba_Nds_Description=VSS-Transportprotokoll für Echtzeit-Offset, Byte 3, rba_Nds_Name=VSS_TP_RealTmOffset_3_ST3
          rba_Nds_NetworkRepresentation_0 (rba_Nds_NetworkRepresentation)
            rba_Nds_DirectRepresentation: rba_Nds_MaxValue=255, rba_Nds_MinValue=0
        rba_Nds_Signal_VSS_TP_RealTmOffset_2_ST3: rba_Nds_Description=VSS-Transportprotokoll für Echtzeit-Offset, Byte 2, rba_Nds_Name=VSS_TP_RealTmOffset_2_ST3
          rba_Nds_NetworkRepresentation_0 (rba_Nds_NetworkRepresentation)
            rba_Nds_DirectRepresentation: rba_Nds_MaxValue=255, rba_Nds_MinValue=0
        rba_Nds_Signal_VSS_TP_RealTmOffset_1_ST3: rba_Nds_Description=VSS-Transportprotokoll für Echtzeit-Offset, Byte 1, rba_Nds_Name=VSS_TP_RealTmOffset_1_ST3
          rba_Nds_NetworkRepresentation_0 (rba_Nds_NetworkRepresentation)
            rba_Nds_DirectRepresentation: rba_Nds_MaxValue=255, rba_Nds_MinValue=0
        rba_Nds_Signal_VSS_TP_RealTmOffset_0_ST3: rba_Nds_Description=VSS-Transportprotokoll für Echtzeit-Offset, Byte 0, rba_Nds_Name=VSS_TP_RealTmOffset_0_ST3
          rba_Nds_NetworkRepresentation_0 (rba_Nds_NetworkRepresentation)
            rba_Nds_DirectRepresentation: rba_Nds_MaxValue=255, rba_Nds_MinValue=0
        rba_Nds_Signal_VSS_TP_Auth_7_ST3: rba_Nds_Description=VSS-Transportprotokoll für Authentifizierung, Byte 7, rba_Nds_Name=VSS_TP_Auth_7_ST3
          rba_Nds_NetworkRepresentation_0 (rba_Nds_NetworkRepresentation)
            rba_Nds_DirectRepresentation: rba_Nds_MaxValue=255, rba_Nds_MinValue=0
        rba_Nds_Signal_VSS_TP_Auth_6_ST3: rba_Nds_Description=VSS-Transportprotokoll für Authentifizierung, Byte 6, rba_Nds_Name=VSS_TP_Auth_6_ST3
          rba_Nds_NetworkRepresentation_0 (rba_Nds_NetworkRepresentation)
            rba_Nds_DirectRepresentation: rba_Nds_MaxValue=255, rba_Nds_MinValue=0
        rba_Nds_Signal_VSS_TP_Auth_5_ST3: rba_Nds_Description=VSS-Transportprotokoll für Authentifizierung, Byte 5, rba_Nds_Name=VSS_TP_Auth_5_ST3
          rba_Nds_NetworkRepresentation_0 (rba_Nds_NetworkRepresentation)
            rba_Nds_DirectRepresentation: rba_Nds_MaxValue=255, rba_Nds_MinValue=0
        rba_Nds_Signal_VSS_TP_Auth_4_ST3: rba_Nds_Description=VSS-Transportprotokoll für Authentifizierung, Byte 4, rba_Nds_Name=VSS_TP_Auth_4_ST3
          rba_Nds_NetworkRepresentation_0 (rba_Nds_NetworkRepresentation)
            rba_Nds_DirectRepresentation: rba_Nds_MaxValue=255, rba_Nds_MinValue=0
        rba_Nds_Signal_VSS_TP_Auth_3_ST3: rba_Nds_Description=VSS-Transportprotokoll für Authentifizierung, Byte 3, rba_Nds_Name=VSS_TP_Auth_3_ST3
          rba_Nds_NetworkRepresentation_0 (rba_Nds_NetworkRepresentation)
            rba_Nds_DirectRepresentation: rba_Nds_MaxValue=255, rba_Nds_MinValue=0
        rba_Nds_Signal_VSS_TP_Auth_2_ST3: rba_Nds_Description=VSS-Transportprotokoll für Authentifizierung, Byte 2, rba_Nds_Name=VSS_TP_Auth_2_ST3
          rba_Nds_NetworkRepresentation_0 (rba_Nds_NetworkRepresentation)
            rba_Nds_DirectRepresentation: rba_Nds_MaxValue=255, rba_Nds_MinValue=0
        rba_Nds_Signal_VSS_TP_Auth_1_ST3: rba_Nds_Description=VSS-Transportprotokoll für Authentifizierung, Byte 1, rba_Nds_Name=VSS_TP_Auth_1_ST3
          rba_Nds_NetworkRepresentation_0 (rba_Nds_NetworkRepresentation)
            rba_Nds_DirectRepresentation: rba_Nds_MaxValue=255, rba_Nds_MinValue=0
        rba_Nds_Signal_VSS_TP_Auth_0_ST3: rba_Nds_Description=VSS-Transportprotokoll für Authentifizierung, Byte 0, rba_Nds_Name=VSS_TP_Auth_0_ST3
          rba_Nds_NetworkRepresentation_0 (rba_Nds_NetworkRepresentation)
            rba_Nds_DirectRepresentation: rba_Nds_MaxValue=255, rba_Nds_MinValue=0
      5 x rba_Nds_Frame:
        rba_Nds_Frame_ESP_HAD_BACKUP_COM_Container1_ST3: rba_Nds_Description=ESP HAD BACKUP COM Container 1, rba_Nds_Length=64, rba_Nds_Name=ESP_HAD_BACKUP_COM_Container1_ST3
          rba_Nds_PduInst_ESP_HAD_BACKUP_COM_Container1_ST3_ContainerIPdu (rba_Nds_PduInstance): rba_Nds_BitPosition=0, rba_Nds_ByteOrder=INTEL, rba_Nds_PduRef=rba_Nds_Pdu_ESP_HAD_BACKUP_COM_Container1_ST3_ContainerIPdu
        rba_Nds_Frame_ESP_HAD_BACKUP_GW_Container2_ST3: rba_Nds_Description=ESP HAD BACKUP GW Container, rba_Nds_Length=64, rba_Nds_Name=ESP_HAD_BACKUP_GW_Container2_ST3
          rba_Nds_PduInst_ESP_HAD_BACKUP_GW_Container2_ST3_ContainerIPdu (rba_Nds_PduInstance): rba_Nds_BitPosition=0, rba_Nds_ByteOrder=INTEL, rba_Nds_PduRef=rba_Nds_Pdu_ESP_HAD_BACKUP_GW_Container2_ST3_ContainerIPdu
        rba_Nds_Frame_ESP_HAD_BACKUP_GW_Container4_ST3: rba_Nds_Description=ESP HAD BACKUP GW Container, rba_Nds_Length=64, rba_Nds_Name=ESP_HAD_BACKUP_GW_Container4_ST3
          rba_Nds_PduInst_ESP_HAD_BACKUP_GW_Container4_ST3_ContainerIPdu (rba_Nds_PduInstance): rba_Nds_BitPosition=0, rba_Nds_ByteOrder=INTEL, rba_Nds_PduRef=rba_Nds_Pdu_ESP_HAD_BACKUP_GW_Container4_ST3_ContainerIPdu
        rba_Nds_Frame_IMU_A_Output_ST3: rba_Nds_Description=IMU A Output ST3, rba_Nds_Length=44, rba_Nds_Name=IMU_A_Output_ST3
          rba_Nds_PduInst_IMU_A_Output_ST3_secured (rba_Nds_PduInstance): rba_Nds_BitPosition=0, rba_Nds_ByteOrder=INTEL, rba_Nds_PduRef=rba_Nds_Pdu_IMU_A_Output_ST3_secured
        rba_Nds_Frame_IMU_A_Output_Fast_ST3: rba_Nds_Description=IMU A Output ST3, rba_Nds_Length=44, rba_Nds_Name=IMU_A_Output_Fast_ST3
          rba_Nds_PduInst_IMU_A_Output_Fast_ST3_secured (rba_Nds_PduInstance): rba_Nds_BitPosition=0, rba_Nds_ByteOrder=INTEL, rba_Nds_PduRef=rba_Nds_Pdu_IMU_A_Output_Fast_ST3_secured
      rba_Nds_Networks
        rba_Nds_CanNetwork_IMU_INTERNAL (rba_Nds_CanNetwork): rba_Nds_Name=CanIfControllerConfig_0
          13 x rba_Nds_CanFrameTriggering, all with rba_Nds_CanIdentifierType=CAN_STANDARD:
            rba_Nds_CanFrameTriggering_IMU_A_Output_Fast_ST3_d33wkvtuwgnwwqqgrob3dgi12: rba_Nds_IdentifierValue=691, rba_Nds_FrameRef=rba_Nds_Frame_IMU_A_Output_Fast_ST3
            rba_Nds_CanFrameTriggering_FBL_CFG_Star3_ST3_cldjru6psp0a48ztyemlm017u: rba_Nds_IdentifierValue=104, rba_Nds_FrameRef=rba_Nds_Communication/rba_Nds_Frame_FBL_CFG_Star3_ST3
            rba_Nds_CanFrameTriggering_DI_OdoSpeedometer_ST3_8mlouci43d97tcfc95n5bqkid: rba_Nds_IdentifierValue=1381, rba_Nds_FrameRef=rba_Nds_Frame_DI_OdoSpeedometer_ST3
            rba_Nds_CanFrameTriggering_DIAG_Stat_ST3_dt8bq8tgaz165b4x6hqjhzofe: rba_Nds_IdentifierValue=1744, rba_Nds_FrameRef=rba_Nds_Frame_DIAG_Stat_ST3
            rba_Nds_CanFrameTriggering_Ign_Stat_ST3_azv2kpz5f3i2ckijly43qh64y: rba_Nds_IdentifierValue=127, rba_Nds_FrameRef=rba_Nds_Frame_Ign_Stat_ST3
            rba_Nds_CanFrameTriggering_BCS_Whl_Msg1_BTC_ST3_88gp48lncz4sl99hiznckz4ft: rba_Nds_IdentifierValue=702, rba_Nds_FrameRef=rba_Nds_Frame_BCS_Whl_Msg1_BTC_ST3
            rba_Nds_CanFrameTriggering_PT4_PTCoor4_SecOC_ST3_3p7mhse2f5pn836ryyf6obbjo: rba_Nds_IdentifierValue=1305, rba_Nds_FrameRef=rba_Nds_Frame_PT4_PTCoor4_SecOC_ST3
            rba_Nds_CanFrameTriggering_PN14_Master_Stat1_SecOC_ST3_eos1ildj6v44zy7pnb4ojc1r4: rba_Nds_IdentifierValue=1512, rba_Nds_FrameRef=rba_Nds_Frame_PN14_Master_Stat1_SecOC_ST3
            rba_Nds_CanFrameTriggering_VSS_TP_VIN_ST3_zo0ajku7bsc0uzxi9vkshgiq: rba_Nds_IdentifierValue=747, rba_Nds_FrameRef=rba_Nds_Frame_VSS_TP_VIN_ST3
            rba_Nds_CanFrameTriggering_VSS_TP_SharedSecret_ST3_2qm4y40dwmslooj3ccjmc5rvn: rba_Nds_IdentifierValue=751, rba_Nds_FrameRef=rba_Nds_Frame_VSS_TP_SharedSecret_ST3
            rba_Nds_CanFrameTriggering_VSS_TP_SecTickCount_Lvl1_ST3_e35z9ulel939vqa575s89n6fb: rba_Nds_IdentifierValue=745, rba_Nds_FrameRef=rba_Nds_Frame_VSS_TP_SecTickCount_Lvl1_ST3
            rba_Nds_CanFrameTriggering_VSS_TP_RealTmOffset_ST3_6pqq39zzkyaxjkhkpx4w6k2cd: rba_Nds_IdentifierValue=741, rba_Nds_FrameRef=rba_Nds_Frame_VSS_TP_RealTmOffset_ST3
            rba_Nds_CanFrameTriggering_VSS_TP_Auth_ST3_b0vczbv4viw3unw4ui2xxf7i9: rba_Nds_IdentifierValue=749, rba_Nds_FrameRef=rba_Nds_Frame_VSS_TP_Auth_ST3
          18 x rba_Nds_CanPduTriggering:
            rba_Nds_CanPduTriggering_IMU_A_Output_Fast_ST3_9j5x7ag429n202ymo68kf1vn0: rba_Nds_PduRef=rba_Nds_Pdu_IMU_A_Output_Fast_ST3
            rba_Nds_CanPduTriggering_IMU_A_Output_Fast_ST3_bqi5o7xakr4svvuyh363ta1md: rba_Nds_PduRef=rba_Nds_Pdu_IMU_A_Output_Fast_ST3_secured
            rba_Nds_CanPduTriggering_FBL_Cfg_Star3_ST3_99p3uqy39g6epfv2pbzswmxpx: rba_Nds_PduRef=rba_Nds_Communication/rba_Nds_Pdu_FBL_Cfg_Star3_ST3
            rba_Nds_CanPduTriggering_DI_OdoSpeedometer_ST3_d51h7apu0p6erk4x2uv7ypbjk: rba_Nds_PduRef=rba_Nds_Pdu_DI_OdoSpeedometer_ST3
            rba_Nds_CanPduTriggering_DIAG_Stat_ST3_7wcdjjvxsq7cvcqwamzuwla9r: rba_Nds_PduRef=rba_Nds_Pdu_DIAG_Stat_ST3
            rba_Nds_CanPduTriggering_Ign_Stat_ST3_6g0xknvbw6ctbm94m0moj11hz: rba_Nds_PduRef=rba_Nds_Pdu_Ign_Stat_ST3_secured
            rba_Nds_CanPduTriggering_Ign_Stat_ST3_74u0yv4bzub4d7kkohk0jy10a: rba_Nds_PduRef=rba_Nds_Pdu_Ign_Stat_ST3
            rba_Nds_CanPduTriggering_BCS_Whl_Msg1_BTC_ST3_c16k4ur8udt67j57b0rf78j53: rba_Nds_PduRef=rba_Nds_Pdu_BCS_Whl_Msg1_BTC_ST3
            rba_Nds_CanPduTriggering_BCS_Whl_Msg1_BTC_ST3_8a04iqb2oetawgg1tamq1ygln: rba_Nds_PduRef=rba_Nds_Pdu_BCS_Whl_Msg1_BTC_ST3_secured
            rba_Nds_CanPduTriggering_PT4_PTCoor4_ST3_831x3bc2a5f0b8lcc0rs7f0hl: rba_Nds_PduRef=rba_Nds_Pdu_PT4_PTCoor4_ST3
            rba_Nds_CanPduTriggering_PT4_PTCoor4_ST3_7k5tx1ze82mns06hxebn4axs5: rba_Nds_PduRef=rba_Nds_Pdu_PT4_PTCoor4_ST3_secured
            rba_Nds_CanPduTriggering_PN14_Master_Stat1_ST3_2eb8i7df9hluel7u1vtmv4jbu: rba_Nds_PduRef=rba_Nds_Pdu_PN14_Master_Stat1_ST3
            rba_Nds_CanPduTriggering_PN14_Master_Stat1_ST3_ck5rf1gmu93402vsfgdnyzarn: rba_Nds_PduRef=rba_Nds_Pdu_PN14_Master_Stat1_ST3_secured
            rba_Nds_CanPduTriggering_VSS_TP_VIN_ST3_4nk9rxvqgs3grjwivgjcdu51j: rba_Nds_PduRef=rba_Nds_Pdu_VSS_TP_VIN_ST3
            rba_Nds_CanPduTriggering_VSS_TP_SharedSecret_ST3_88tqqosaxmp4sl3xcmxab9vk5: rba_Nds_PduRef=rba_Nds_Pdu_VSS_TP_SharedSecret_ST3
            rba_Nds_CanPduTriggering_VSS_TP_SecTickCount_Lvl1_ST3_6z5nkrjami4ggt3euhfetk7ow: rba_Nds_PduRef=rba_Nds_Pdu_VSS_TP_SecTickCount_Lvl1_ST3
            rba_Nds_CanPduTriggering_VSS_TP_RealTmOffset_ST3_4fzwxp0omvccavnefvnhtwbc7: rba_Nds_PduRef=rba_Nds_Pdu_VSS_TP_RealTmOffset_ST3
            rba_Nds_CanPduTriggering_VSS_TP_Auth_ST3_7ysnahxb0suco3wwriicgs0im: rba_Nds_PduRef=rba_Nds_Pdu_VSS_TP_Auth_ST3
        rba_Nds_CanNetwork_HAD_BACKUP (rba_Nds_CanNetwork): rba_Nds_Name=CanIfControllerConfig_1
          6 x rba_Nds_CanFrameTriggering, all with rba_Nds_CanIdentifierType=CAN_STANDARD:
            rba_Nds_CanFrameTriggering_ESP_HAD_BACKUP_COM_Container1_ST3_m7h6933xsls2hbt3g5pz7rbf: rba_Nds_IdentifierValue=295, rba_Nds_FrameRef=rba_Nds_Frame_ESP_HAD_BACKUP_COM_Container1_ST3
            rba_Nds_CanFrameTriggering_ESP_HAD_BACKUP_GW_Container2_ST3_deec5dnwupxl75uf6xumsqsv3: rba_Nds_IdentifierValue=305, rba_Nds_FrameRef=rba_Nds_Frame_ESP_HAD_BACKUP_GW_Container2_ST3
            rba_Nds_CanFrameTriggering_ESP_HAD_BACKUP_GW_Container4_ST3_66g2nnp4u3e1cromt6kb2ifeb: rba_Nds_IdentifierValue=314, rba_Nds_FrameRef=rba_Nds_Frame_ESP_HAD_BACKUP_GW_Container4_ST3
            rba_Nds_CanFrameTriggering_IMU_A_Output_ST3_a6686b0hkqb3mtkryedfilug7: rba_Nds_IdentifierValue=933, rba_Nds_FrameRef=rba_Nds_Frame_IMU_A_Output_ST3
            rba_Nds_CanFrameTriggering_FBL_CFG_Star3_ST3_16bmiwrdd9xf3hibeboe5uaeu: rba_Nds_IdentifierValue=104, rba_Nds_FrameRef=rba_Nds_Communication/rba_Nds_Frame_FBL_CFG_Star3_ST3
            rba_Nds_CanFrameTriggering_ESP_HAD_BACKUP_GW_Container3_ST3_22qnrsrd5p7i7sxhq5h7qa6eh: rba_Nds_IdentifierValue=312, rba_Nds_FrameRef=rba_Nds_Frame_ESP_HAD_BACKUP_GW_Container3_ST3
          23 x rba_Nds_CanPduTriggering:
            rba_Nds_CanPduTriggering_ESP_HAD_BACKUP_COM_Container1_ST3_9wgr7acccdjxfn4xsmzzlmfj6: rba_Nds_PduRef=rba_Nds_Pdu_ESP_HAD_BACKUP_COM_Container1_ST3_ContainerIPdu
            rba_Nds_CanPduTriggering_ESP_HAD_BACKUP_COM_Container1_ST3_ESP_HAD_BACKUP_COM_Container1_ST3_BCS_Whl_Msg1_BTC_ST3_16ebm65e7roje1m2kqzv87azq: rba_Nds_PduRef=rba_Nds_Pdu_ESP_HAD_BACKUP_COM_Container1_ST3_ESP_HAD_BACKUP_COM_Container1_ST3_BCS_Whl_Msg1_BTC_ST3_secured
            rba_Nds_CanPduTriggering_ESP_HAD_BACKUP_COM_Container1_ST3_ESP_HAD_BACKUP_COM_Container1_ST3_BCS_Whl_Msg1_BTC_ST3_5veu2p0tm6432xnhqor79qs7k: rba_Nds_PduRef=rba_Nds_Pdu_ESP_HAD_BACKUP_COM_Container1_ST3_BCS_Whl_Msg1_BTC_ST3
            rba_Nds_CanPduTriggering_ESP_HAD_BACKUP_GW_Container2_ST3_aadd7dff7rkg0cjrmt2mmksbu: rba_Nds_PduRef=rba_Nds_Pdu_ESP_HAD_BACKUP_GW_Container2_ST3_ContainerIPdu
            rba_Nds_CanPduTriggering_ESP_HAD_BACKUP_GW_Container2_ST3_ESP_HAD_BACKUP_GW_Container2_ST3_Ign_Stat_ST3_2evpht35ev1p8y12nz0ebo5h3: rba_Nds_PduRef=rba_Nds_Pdu_ESP_HAD_BACKUP_GW_Container2_ST3_ESP_HAD_BACKUP_GW_Container2_ST3_Ign_Stat_ST3_secured
            rba_Nds_CanPduTriggering_ESP_HAD_BACKUP_GW_Container2_ST3_ESP_HAD_BACKUP_GW_Container2_ST3_Ign_Stat_ST3_bcjlclrj2mauvscq34e4kbcj3: rba_Nds_PduRef=rba_Nds_Pdu_ESP_HAD_BACKUP_GW_Container2_ST3_Ign_Stat_ST3
            rba_Nds_CanPduTriggering_ESP_HAD_BACKUP_GW_Container2_ST3_ESP_HAD_BACKUP_GW_Container2_ST3_PT4_PTCoor4_ST3_4jwqfrzf6ypk91w3rckoip7tp: rba_Nds_PduRef=rba_Nds_Pdu_ESP_HAD_BACKUP_GW_Container2_ST3_ESP_HAD_BACKUP_GW_Container2_ST3_PT4_PTCoor4_ST3_secured
            rba_Nds_CanPduTriggering_ESP_HAD_BACKUP_GW_Container2_ST3_ESP_HAD_BACKUP_GW_Container2_ST3_PT4_PTCoor4_ST3_9c9xmhimk3956a8bl74rmvxi7: rba_Nds_PduRef=rba_Nds_Pdu_ESP_HAD_BACKUP_GW_Container2_ST3_PT4_PTCoor4_ST3
            rba_Nds_CanPduTriggering_ESP_HAD_BACKUP_GW_Container4_ST3_377j3yoh64pojpc5ok3dvykes: rba_Nds_PduRef=rba_Nds_Pdu_ESP_HAD_BACKUP_GW_Container4_ST3_ContainerIPdu
            rba_Nds_CanPduTriggering_ESP_HAD_BACKUP_GW_Container4_ST3_ESP_HAD_BACKUP_GW_Container4_ST3_DI_OdoSpeedometer_ST3_8fnay511jh4db945s2stpdw7p: rba_Nds_PduRef=rba_Nds_Pdu_ESP_HAD_BACKUP_GW_Container4_ST3_ESP_HAD_BACKUP_GW_Container4_ST3_DI_OdoSpeedometer_ST3_secured
            rba_Nds_CanPduTriggering_ESP_HAD_BACKUP_GW_Container4_ST3_ESP_HAD_BACKUP_GW_Container4_ST3_DI_OdoSpeedometer_ST3_2wrcqkh4ub39zvlu7w28s2r1f: rba_Nds_PduRef=rba_Nds_Pdu_ESP_HAD_BACKUP_GW_Container4_ST3_DI_OdoSpeedometer_ST3
            rba_Nds_CanPduTriggering_ESP_HAD_BACKUP_GW_Container4_ST3_ESP_HAD_BACKUP_GW_Container4_ST3_DIAG_Stat_ST3_a9kzo9c723k3h5cgrsehf20w0: rba_Nds_PduRef=rba_Nds_Pdu_ESP_HAD_BACKUP_GW_Container4_ST3_DIAG_Stat_ST3
            rba_Nds_CanPduTriggering_ESP_HAD_BACKUP_GW_Container4_ST3_ESP_HAD_BACKUP_GW_Container4_ST3_PN14_Master_Stat1_ST3_11xqv03a1oeng5zctxoxlpsa: rba_Nds_PduRef=rba_Nds_Pdu_ESP_HAD_BACKUP_GW_Container4_ST3_ESP_HAD_BACKUP_GW_Container4_ST3_PN14_Master_Stat1_ST3_secured
            rba_Nds_CanPduTriggering_ESP_HAD_BACKUP_GW_Container4_ST3_ESP_HAD_BACKUP_GW_Container4_ST3_PN14_Master_Stat1_ST3_6wlpxzn4ez9a5ru3exv8xu1x7: rba_Nds_PduRef=rba_Nds_Pdu_ESP_HAD_BACKUP_GW_Container4_ST3_PN14_Master_Stat1_ST3
            rba_Nds_CanPduTriggering_IMU_A_Output_ST3_brfz9q0nahr147hbo9yhq1vvv: rba_Nds_PduRef=rba_Nds_Pdu_IMU_A_Output_ST3
            rba_Nds_CanPduTriggering_IMU_A_Output_ST3_32ru3309rvckjvcx6fmcjcw7u: rba_Nds_PduRef=rba_Nds_Pdu_IMU_A_Output_ST3_secured
            rba_Nds_CanPduTriggering_FBL_Cfg_Star3_ST3_27m9sbzvs2f0s09avctwlewte: rba_Nds_PduRef=rba_Nds_Communication/rba_Nds_Pdu_FBL_Cfg_Star3_ST3
            rba_Nds_CanPduTriggering_ESP_HAD_BACKUP_GW_Container3_ST3_es20z922k0hdxd542vyccnt5z: rba_Nds_PduRef=rba_Nds_Pdu_ESP_HAD_BACKUP_GW_Container3_ST3_ContainerIPdu
            rba_Nds_CanPduTriggering_ESP_HAD_BACKUP_GW_Container3_ST3_ESP_HAD_BACKUP_GW_Container3_ST3_VSS_TP_VIN_ST3_3331jz4zbik8yl0ehm51yf8w4: rba_Nds_PduRef=rba_Nds_Pdu_ESP_HAD_BACKUP_GW_Container3_ST3_VSS_TP_VIN_ST3
            rba_Nds_CanPduTriggering_ESP_HAD_BACKUP_GW_Container3_ST3_ESP_HAD_BACKUP_GW_Container3_ST3_VSS_TP_SharedSecret_ST3_82pb6fg4cswmgotegs6aplrj2: rba_Nds_PduRef=rba_Nds_Pdu_ESP_HAD_BACKUP_GW_Container3_ST3_VSS_TP_SharedSecret_ST3
            rba_Nds_CanPduTriggering_ESP_HAD_BACKUP_GW_Container3_ST3_ESP_HAD_BACKUP_GW_Container3_ST3_VSS_TP_SecTickCount_Lvl1_ST3_azhv8t4onxhjhi2zn8in2my2n: rba_Nds_PduRef=rba_Nds_Pdu_ESP_HAD_BACKUP_GW_Container3_ST3_VSS_TP_SecTickCount_Lvl1_ST3
            rba_Nds_CanPduTriggering_ESP_HAD_BACKUP_GW_Container3_ST3_ESP_HAD_BACKUP_GW_Container3_ST3_VSS_TP_RealTmOffset_ST3_2686huv0x9rg4cu1k20p07zrz: rba_Nds_PduRef=rba_Nds_Pdu_ESP_HAD_BACKUP_GW_Container3_ST3_VSS_TP_RealTmOffset_ST3
            rba_Nds_CanPduTriggering_ESP_HAD_BACKUP_GW_Container3_ST3_ESP_HAD_BACKUP_GW_Container3_ST3_VSS_TP_Auth_ST3_a5m1oehgi1yzcicgsdebhigxy: rba_Nds_PduRef=rba_Nds_Pdu_ESP_HAD_BACKUP_GW_Container3_ST3_VSS_TP_Auth_ST3
          rba_Nds_CanFrameTriggering_IDC_S_FSI_HAD_BACKUP_Container_ST3_bos8n1et2rfcc9ip3ug9buoj1 (rba_Nds_CanFrameTriggering): rba_Nds_CanIdentifierType=CAN_STANDARD, rba_Nds_IdentifierValue=324, rba_Nds_FrameRef=rba_Nds_Frame_IDC_S_FSI_HAD_BACKUP_Container_ST3
          3 x rba_Nds_CanPduTriggering:
            rba_Nds_CanPduTriggering_IDC_S_FSI_HAD_BACKUP_Container_ST3_1dm671vl0shzss367w9qvi14o: rba_Nds_PduRef=rba_Nds_Pdu_IDC_S_FSI_HAD_BACKUP_Container_ST3_ContainerIPdu
            rba_Nds_CanPduTriggering_IDC_S_FSI_HAD_BACKUP_Container_ST3_IDC_S_FSI_HAD_BACKUP_Container_ST3_ADAS_HAD_Stat_IDC_S_FSI_Bckp_ST3_e7ytolt7jqvzpt1pm38yc9jmy: rba_Nds_PduRef=rba_Nds_Pdu_IDC_S_FSI_HAD_BACKUP_Container_ST3_IDC_S_FSI_HAD_BACKUP_Container_ST3_ADAS_HAD_Stat_IDC_S_FSI_Bckp_ST3_secured
            rba_Nds_CanPduTriggering_IDC_S_FSI_HAD_BACKUP_Container_ST3_IDC_S_FSI_HAD_BACKUP_Container_ST3_ADAS_HAD_Stat_IDC_S_FSI_Bckp_ST3_ahdgtkk54cgxy874ini32xhdq: rba_Nds_PduRef=rba_Nds_Pdu_IDC_S_FSI_HAD_BACKUP_Container_ST3_ADAS_HAD_Stat_IDC_S_FSI_Bckp_ST3
      5 x rba_Nds_SignalGroup:
        rba_Nds_SignalGroup_VSS_TP_VIN_ST3_bz1xsv84cxzl09j028gn39p69: rba_Nds_Name=VSS_TP_VIN_ST3_bz1xsv84cxzl09j028gn39p69, rba_Nds_SignalRef=rba_Nds_Signal_VSS_TP_VIN_5_ST3, rba_Nds_SignalRef=rba_Nds_Signal_VSS_TP_VIN_7_ST3, rba_Nds_SignalRef=rba_Nds_Signal_VSS_TP_VIN_0_ST3, rba_Nds_SignalRef=rba_Nds_Signal_VSS_TP_VIN_3_ST3, rba_Nds_SignalRef=rba_Nds_Signal_VSS_TP_VIN_4_ST3, rba_Nds_SignalRef=rba_Nds_Signal_VSS_TP_VIN_6_ST3, rba_Nds_SignalRef=rba_Nds_Signal_VSS_TP_VIN_2_ST3, rba_Nds_SignalRef=rba_Nds_Signal_VSS_TP_VIN_1_ST3
        rba_Nds_SignalGroup_VSS_TP_SharedSecret_ST3_8pj4t8t4rm3tw3pk5hj7vonti: rba_Nds_Name=VSS_TP_SharedSecret_ST3_8pj4t8t4rm3tw3pk5hj7vonti, rba_Nds_SignalRef=rba_Nds_Signal_VSS_TP_SharedSecret_5_ST3, rba_Nds_SignalRef=rba_Nds_Signal_VSS_TP_SharedSecret_3_ST3, rba_Nds_SignalRef=rba_Nds_Signal_VSS_TP_SharedSecret_0_ST3, rba_Nds_SignalRef=rba_Nds_Signal_VSS_TP_SharedSecret_7_ST3, rba_Nds_SignalRef=rba_Nds_Signal_VSS_TP_SharedSecret_1_ST3, rba_Nds_SignalRef=rba_Nds_Signal_VSS_TP_SharedSecret_2_ST3, rba_Nds_SignalRef=rba_Nds_Signal_VSS_TP_SharedSecret_6_ST3, rba_Nds_SignalRef=rba_Nds_Signal_VSS_TP_SharedSecret_4_ST3
        rba_Nds_SignalGroup_VSS_TP_SecTickCount_Lvl1_ST3_mzmfdqtqz5kvv1kfpvg0kql3: rba_Nds_Name=rba_Nds_SignalGroup_VSS_TP_SecTickCount_Lvl1_ST3_mzmfdqtqz5kvv1kfpvg0kql3, rba_Nds_SignalRef=rba_Nds_Signal_VSS_TP_SecTickCount_Lvl1_4_ST3, rba_Nds_SignalRef=rba_Nds_Signal_VSS_TP_SecTickCount_Lvl1_2_ST3, rba_Nds_SignalRef=rba_Nds_Signal_VSS_TP_SecTickCount_Lvl1_0_ST3, rba_Nds_SignalRef=rba_Nds_Signal_VSS_TP_SecTickCount_Lvl1_7_ST3, rba_Nds_SignalRef=rba_Nds_Signal_VSS_TP_SecTickCount_Lvl1_1_ST3, rba_Nds_SignalRef=rba_Nds_Signal_VSS_TP_SecTickCount_Lvl1_6_ST3, rba_Nds_SignalRef=rba_Nds_Signal_VSS_TP_SecTickCount_Lvl1_5_ST3, rba_Nds_SignalRef=rba_Nds_Signal_VSS_TP_SecTickCount_Lvl1_3_ST3
        rba_Nds_SignalGroup_VSS_TP_RealTmOffset_ST3_1t7vc44gftc0wv35k5kgc2in9: rba_Nds_Name=rba_Nds_SignalGroup_VSS_TP_RealTmOffset_ST3_1t7vc44gftc0wv35k5kgc2in9, rba_Nds_SignalRef=rba_Nds_Signal_VSS_TP_RealTmOffset_2_ST3, rba_Nds_SignalRef=rba_Nds_Signal_VSS_TP_RealTmOffset_7_ST3, rba_Nds_SignalRef=rba_Nds_Signal_VSS_TP_RealTmOffset_6_ST3, rba_Nds_SignalRef=rba_Nds_Signal_VSS_TP_RealTmOffset_4_ST3, rba_Nds_SignalRef=rba_Nds_Signal_VSS_TP_RealTmOffset_5_ST3, rba_Nds_SignalRef=rba_Nds_Signal_VSS_TP_RealTmOffset_3_ST3, rba_Nds_SignalRef=rba_Nds_Signal_VSS_TP_RealTmOffset_1_ST3, rba_Nds_SignalRef=rba_Nds_Signal_VSS_TP_RealTmOffset_0_ST3
        rba_Nds_SignalGroup_VSS_TP_Auth_ST3_6j4id7sghlvlbroli4wjozjik: rba_Nds_Name=rba_Nds_SignalGroup_VSS_TP_Auth_ST3_6j4id7sghlvlbroli4wjozjik, rba_Nds_SignalRef=rba_Nds_Signal_VSS_TP_Auth_6_ST3, rba_Nds_SignalRef=rba_Nds_Signal_VSS_TP_Auth_4_ST3, rba_Nds_SignalRef=rba_Nds_Signal_VSS_TP_Auth_7_ST3, rba_Nds_SignalRef=rba_Nds_Signal_VSS_TP_Auth_2_ST3, rba_Nds_SignalRef=rba_Nds_Signal_VSS_TP_Auth_1_ST3, rba_Nds_SignalRef=rba_Nds_Signal_VSS_TP_Auth_5_ST3, rba_Nds_SignalRef=rba_Nds_Signal_VSS_TP_Auth_0_ST3, rba_Nds_SignalRef=rba_Nds_Signal_VSS_TP_Auth_3_ST3
      5 x rba_Nds_Signal, all with rba_Nds_Encoding=UNSIGNED:
        rba_Nds_Signal_Rsrv1_ADAS_HAD_Stat_IDC_S_FSI_Bckp_Pr5_ST3: rba_Nds_BitSize=5, rba_Nds_Description=Reserved for future purpose, rba_Nds_Name=Rsrv1_ADAS_HAD_Stat_IDC_S_FSI_Bckp_Pr5_ST3
          rba_Nds_NetworkRepresentation_0 (rba_Nds_NetworkRepresentation)
            rba_Nds_DirectRepresentation: rba_Nds_MaxValue=31, rba_Nds_MinValue=0
        rba_Nds_Signal_Rsrv2_ADAS_HAD_Stat_IDC_S_FSI_Bckp_Pr5_ST3: rba_Nds_BitSize=32, rba_Nds_Description=Reserved for future purpose, rba_Nds_Name=Rsrv2_ADAS_HAD_Stat_IDC_S_FSI_Bckp_Pr5_ST3
          rba_Nds_NetworkRepresentation_0 (rba_Nds_NetworkRepresentation)
            rba_Nds_DirectRepresentation: rba_Nds_MaxValue=4294967295, rba_Nds_MinValue=0
        rba_Nds_Signal_ADAS_HAD_Ext_Stat_S_FSI_Bckp_ST3: rba_Nds_BitSize=3, rba_Nds_Description=Zustand hochautomatisiertes Fahren IDC Satellite, rba_Nds_Name=ADAS_HAD_Ext_Stat_S_FSI_Bckp_ST3
          rba_Nds_NetworkRepresentation_0 (rba_Nds_NetworkRepresentation)
            rba_Nds_DirectRepresentation: rba_Nds_MaxValue=7, rba_Nds_MinValue=0
        rba_Nds_Signal_CRC_ADAS_HAD_Stat_IDC_S_FSI_Bckp_Pr5_ST3: rba_Nds_BitSize=16, rba_Nds_Description=mCRC-Checksumme der Signal Gruppe gemäß AUTOSAR Profil 5, rba_Nds_Name=CRC_ADAS_HAD_Stat_IDC_S_FSI_Bckp_Pr5_ST3, rba_Nds_SignalType=CHECKSUM
          rba_Nds_NetworkRepresentation_0 (rba_Nds_NetworkRepresentation)
            rba_Nds_DirectRepresentation: rba_Nds_MaxValue=65535, rba_Nds_MinValue=0
        rba_Nds_Signal_SQC_ADAS_HAD_Stat_IDC_S_FSI_Bckp_Pr5_ST3: rba_Nds_BitSize=8, rba_Nds_Description=Sequenzzähler, rba_Nds_Name=SQC_ADAS_HAD_Stat_IDC_S_FSI_Bckp_Pr5_ST3, rba_Nds_SignalType=ALIVECOUNTER
          rba_Nds_NetworkRepresentation_SQC_ADAS_HAD_Stat_IDC_S_FSI_Bckp_Pr5_ST3_none_1_0 (rba_Nds_NetworkRepresentation)
            rba_Nds_DirectRepresentation: rba_Nds_MaxValue=255, rba_Nds_MinValue=0
      rba_Nds_SignalGroup_ADAS_HAD_Stat_IDC_S_FSI_Bckp_Pr5_ST3_1hazv0zum1rfjs1udwdzrjfp4 (rba_Nds_SignalGroup):
        rba_Nds_Name = ADAS_HAD_Stat_IDC_S_FSI_Bckp_Pr5_ST3_1hazv0zum1rfjs1udwdzrjfp4
        rba_Nds_SignalRef = rba_Nds_Signal_ADAS_HAD_Ext_Stat_S_FSI_Bckp_ST3
        rba_Nds_SignalRef = rba_Nds_Signal_CRC_ADAS_HAD_Stat_IDC_S_FSI_Bckp_Pr5_ST3
        rba_Nds_SignalRef = rba_Nds_Signal_Rsrv1_ADAS_HAD_Stat_IDC_S_FSI_Bckp_Pr5_ST3
        rba_Nds_SignalRef = rba_Nds_Signal_Rsrv2_ADAS_HAD_Stat_IDC_S_FSI_Bckp_Pr5_ST3
        rba_Nds_SignalRef = rba_Nds_Signal_SQC_ADAS_HAD_Stat_IDC_S_FSI_Bckp_Pr5_ST3
      3 x rba_Nds_Pdu:
        rba_Nds_Pdu_IDC_S_FSI_HAD_BACKUP_Container_ST3_ADAS_HAD_Stat_IDC_S_FSI_Bckp_ST3
          rba_Nds_SignalPdu:
            rba_Nds_Description = Highly Automated Driving State
            rba_Nds_Length = 8
            rba_Nds_Name = IDC_S_FSI_HAD_BACKUP_Container_ST3_ADAS_HAD_Stat_IDC_S_FSI_Bckp_ST3
            rba_Nds_UnusedAreasDefault = 255
            5 x rba_Nds_SignalInstance, all with rba_Nds_ByteOrder=INTEL:
              rba_Nds_SignalInstance_ADAS_HAD_Ext_Stat_S_FSI_Bckp_ST3: rba_Nds_BitPosition=24, rba_Nds_SignalRef=rba_Nds_Signal_ADAS_HAD_Ext_Stat_S_FSI_Bckp_ST3
              rba_Nds_SignalInstance_CRC_ADAS_HAD_Stat_IDC_S_FSI_Bckp_Pr5_ST3: rba_Nds_BitPosition=0, rba_Nds_SignalRef=rba_Nds_Signal_CRC_ADAS_HAD_Stat_IDC_S_FSI_Bckp_Pr5_ST3
              rba_Nds_SignalInstance_SQC_ADAS_HAD_Stat_IDC_S_FSI_Bckp_Pr5_ST3: rba_Nds_BitPosition=16, rba_Nds_SignalRef=rba_Nds_Signal_SQC_ADAS_HAD_Stat_IDC_S_FSI_Bckp_Pr5_ST3
              rba_Nds_SignalInstance_Rsrv1_ADAS_HAD_Stat_IDC_S_FSI_Bckp_Pr5_ST3: rba_Nds_BitPosition=27, rba_Nds_SignalRef=rba_Nds_Signal_Rsrv1_ADAS_HAD_Stat_IDC_S_FSI_Bckp_Pr5_ST3
              rba_Nds_SignalInstance_Rsrv2_ADAS_HAD_Stat_IDC_S_FSI_Bckp_Pr5_ST3: rba_Nds_BitPosition=32, rba_Nds_SignalRef=rba_Nds_Signal_Rsrv2_ADAS_HAD_Stat_IDC_S_FSI_Bckp_Pr5_ST3
            rba_Nds_SignalGroupInstance_ADAS_HAD_Stat_IDC_S_FSI_Bckp_Pr5_ST3_1hazv0zum1rfjs1udwdzrjfp4 (rba_Nds_SignalGroupInstance): rba_Nds_SignalGroupRef=rba_Nds_SignalGroup_ADAS_HAD_Stat_IDC_S_FSI_Bckp_Pr5_ST3_1hazv0zum1rfjs1udwdzrjfp4
            rba_Nds_PduTiming
              rba_Nds_TransmissionModeDeclaration
                rba_Nds_TransmissionModeTrueTiming: rba_Nds_CycleTime=200.0, rba_Nds_StartDelay=0.0
        rba_Nds_Pdu_IDC_S_FSI_HAD_BACKUP_Container_ST3_ContainerIPdu
          rba_Nds_ContainerPdu:
            rba_Nds_Description = IDC_S_FSI_HAD_BACKUP_Container_ST3_ContainerIPdu
            rba_Nds_Name = IDC_S_FSI_HAD_BACKUP_Container_ST3_ContainerIPdu
            rba_Nds_Length = 64
            rba_Nds_UnusedAreasDefault = 0
            rba_Nds_HeaderType = SHORT_HEADER
            rba_Nds_ContainedPduTriggering = rba_Nds_CanPduTriggering_IDC_S_FSI_HAD_BACKUP_Container_ST3_IDC_S_FSI_HAD_BACKUP_Container_ST3_ADAS_HAD_Stat_IDC_S_FSI_Bckp_ST3_e7ytolt7jqvzpt1pm38yc9jmy
        rba_Nds_Pdu_IDC_S_FSI_HAD_BACKUP_Container_ST3_IDC_S_FSI_HAD_BACKUP_Container_ST3_ADAS_HAD_Stat_IDC_S_FSI_Bckp_ST3_secured
          rba_Nds_SecuredPdu:
            rba_Nds_Description = IDC_S_FSI_HAD_BACKUP_Container_ST3_IDC_S_FSI_HAD_BACKUP_Container_ST3_ADAS_HAD_Stat_IDC_S_FSI_Bckp_ST3_secured
            rba_Nds_Name = IDC_S_FSI_HAD_BACKUP_Container_ST3_IDC_S_FSI_HAD_BACKUP_Container_ST3_ADAS_HAD_Stat_IDC_S_FSI_Bckp_ST3_secured
            rba_Nds_Length = 12
            rba_Nds_AuthenticPduTriggeringRef = rba_Nds_CanPduTriggering_IDC_S_FSI_HAD_BACKUP_Container_ST3_IDC_S_FSI_HAD_BACKUP_Container_ST3_ADAS_HAD_Stat_IDC_S_FSI_Bckp_ST3_ahdgtkk54cgxy874ini32xhdq
            rba_Nds_ContainedPduProperties: rba_Nds_HeaderIdShortHeader=10660098
      rba_Nds_Frame_IDC_S_FSI_HAD_BACKUP_Container_ST3 (rba_Nds_Frame): rba_Nds_Description=IDC S FSI HAD BACKUP Container ST3, rba_Nds_Length=64, rba_Nds_Name=IDC_S_FSI_HAD_BACKUP_Container_ST3
        rba_Nds_PduInst_IDC_S_FSI_HAD_BACKUP_Container_ST3_ContainerIPdu (rba_Nds_PduInstance): rba_Nds_BitPosition=0, rba_Nds_ByteOrder=INTEL, rba_Nds_PduRef=rba_Nds_Pdu_IDC_S_FSI_HAD_BACKUP_Container_ST3_ContainerIPdu
