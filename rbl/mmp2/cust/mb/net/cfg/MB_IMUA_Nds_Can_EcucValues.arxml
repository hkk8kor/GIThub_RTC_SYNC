[part 2 of 2: package /RB/UBK/Project/EcucModuleConfigurationValuess]
AUTOSAR XML (schema 00050)
package /RB/UBK/Project/EcucModuleConfigurationValuess  (continued)
  module config rba_Nds  (continued)
    rba_Nds_Ecu: rba_Nds_Name=IMU_A
      rba_Nds_Controllers
        rba_Nds_CanController_CanIfControllerConfig_0 (rba_Nds_CanController): rba_Nds_Name=CanIfControllerConfig_0, rba_Nds_ControllerId=0
        rba_Nds_CanController_CanIfControllerConfig_1 (rba_Nds_CanController): rba_Nds_Name=CanIfControllerConfig_1, rba_Nds_ControllerId=1
      10 x rba_Nds_PduGroup:
        rba_Nds_PduGroup_TxMess_IMU_A_HAD_BACKUP: rba_Nds_Name=IPG_TxMess_IMU_A_HAD_BACKUP_CAN
        rba_Nds_PduGroup_IMU_A_HAD_BACKUP_Tx_PNC_All_Active: rba_Nds_Name=IPG_IMU_A_HAD_BACKUP_Tx_PNC_All_Active_CAN
        rba_Nds_PduGroup_IMU_A_HAD_BACKUP_Tx_PNC_20: rba_Nds_Name=IPG_IMU_A_HAD_BACKUP_Tx_PNC_20_CAN
        rba_Nds_PduGroup_IMU_A_HAD_BACKUP_Rx_PNC_All_Active: rba_Nds_Name=IPG_IMU_A_HAD_BACKUP_Rx_PNC_All_Active_CAN
        rba_Nds_PduGroup_IMU_A_HAD_BACKUP_Rx_PNC_20: rba_Nds_Name=IPG_IMU_A_HAD_BACKUP_Rx_PNC_20_CAN
        rba_Nds_PduGroup_IMU_A_IMU_INTERNAL_Tx_PNC_All_Active: rba_Nds_Name=IPG_IMU_A_IMU_INTERNAL_Tx_PNC_All_Active_CAN
        rba_Nds_PduGroup_IMU_A_IMU_INTERNAL_Tx_PNC_15_ComCtrl: rba_Nds_Name=IPG_IMU_A_IMU_INTERNAL_Tx_PNC_15_ComCtrl_CAN
        rba_Nds_PduGroup_IMU_A_IMU_INTERNAL_Tx_PNC_20: rba_Nds_Name=IPG_IMU_A_IMU_INTERNAL_Tx_PNC_20_CAN
        rba_Nds_PduGroup_IMU_A_IMU_INTERNAL_Rx_PNC_All_Active: rba_Nds_Name=IPG_IMU_A_IMU_INTERNAL_Rx_PNC_All_Active_CAN
        rba_Nds_PduGroup_IMU_A_IMU_INTERNAL_Rx_PNC_20: rba_Nds_Name=IPG_IMU_A_IMU_INTERNAL_Rx_PNC_20_CAN
      rba_Nds_EcuPdus
        6 x rba_Nds_ReceivePdu:
          rba_Nds_ReceivePdu_ESP_HAD_BACKUP_COM_Container1_ST3_BCS_Whl_Msg1_BTC_ST3
            rba_Nds_ReceiveSignalPdu:
              rba_Nds_SignalIndicationProcessing = IMMEDIATE
              rba_Nds_PduTimeoutUserCallout = rbl_CustIf_TimeOut_Cbk_BCS_Whl_Msg1_BTC_ST3
              rba_Nds_SignalPduRef = rba_Nds_Pdu_ESP_HAD_BACKUP_COM_Container1_ST3_BCS_Whl_Msg1_BTC_ST3/rba_Nds_SignalPdu
              rba_Nds_EcuReceiveProcessRef = rba_Nds_EcuReceiveProcess_20ms
              rba_Nds_PduGroupRef = rba_Nds_PduGroup_IMU_A_HAD_BACKUP_Rx_PNC_All_Active
              rba_Nds_PduGroupRef = rba_Nds_PduGroup_IMU_A_HAD_BACKUP_Rx_PNC_20
              rba_Nds_PduGroupRef = rba_Nds_PduGroup_IMU_A_HAD_BACKUP_Rx_PNC_23
              22 x rba_Nds_ReceiveSignalNetworkPort:
                rba_Nds_ReceiveSignalNetworkPort_BCS_Whl_Msg1_TmStmp_BTC_ST3: rba_Nds_InitValue=0, rba_Nds_ISignalToIPduMappingRef=BCS_Whl_Msg1_TmStmp_BTC_ST3, rba_Nds_SignalInstanceRef=rba_Nds_SignalPdu/rba_Nds_SignalInstance_BCS_Whl_Msg1_TmStmp_BTC_ST3
                rba_Nds_ReceiveSignalNetworkPort_BCS_Whl_Msg1_TmSyncStat_BTC_ST3: rba_Nds_InitValue=3, rba_Nds_ISignalToIPduMappingRef=BCS_Whl_Msg1_TmSyncStat_BTC_ST3, rba_Nds_SignalInstanceRef=rba_Nds_SignalPdu/rba_Nds_SignalInstance_BCS_Whl_Msg1_TmSyncStat_BTC_ST3
                rba_Nds_ReceiveSignalNetworkPort_CRC_BCS_Whl_Msg1_BTC_Pr5_ST3: rba_Nds_InitValue=3143, rba_Nds_ISignalToIPduMappingRef=CRC_BCS_Whl_Msg1_BTC_Pr5_ST3, rba_Nds_SignalInstanceRef=rba_Nds_SignalPdu/rba_Nds_SignalInstance_CRC_BCS_Whl_Msg1_BTC_Pr5_ST3
                rba_Nds_ReceiveSignalNetworkPort_GTS_ESP_Clk_Stat_Bckp_ST3: rba_Nds_InitValue=0, rba_Nds_ISignalToIPduMappingRef=GTS_ESP_Clk_Stat_Bckp_ST3, rba_Nds_SignalInstanceRef=rba_Nds_SignalPdu/rba_Nds_SignalInstance_GTS_ESP_Clk_Stat_Bckp_ST3
                rba_Nds_ReceiveSignalNetworkPort_SQC_BCS_Whl_Msg1_BTC_Pr5_ST3: rba_Nds_InitValue=0, rba_Nds_ISignalToIPduMappingRef=SQC_BCS_Whl_Msg1_BTC_Pr5_ST3, rba_Nds_SignalInstanceRef=rba_Nds_SignalPdu/rba_Nds_SignalInstance_SQC_BCS_Whl_Msg1_BTC_Pr5_ST3
                rba_Nds_ReceiveSignalNetworkPort_WhlDir_FL_Stat_BTC_ST3: rba_Nds_InitValue=3, rba_Nds_ISignalToIPduMappingRef=WhlDir_FL_Stat_BTC_ST3, rba_Nds_SignalInstanceRef=rba_Nds_SignalPdu/rba_Nds_SignalInstance_WhlDir_FL_Stat_BTC_ST3
                rba_Nds_ReceiveSignalNetworkPort_WhlDir_FR_Stat_BTC_ST3: rba_Nds_InitValue=3, rba_Nds_ISignalToIPduMappingRef=WhlDir_FR_Stat_BTC_ST3, rba_Nds_SignalInstanceRef=rba_Nds_SignalPdu/rba_Nds_SignalInstance_WhlDir_FR_Stat_BTC_ST3
                rba_Nds_ReceiveSignalNetworkPort_WhlDir_RL_Stat_BTC_ST3: rba_Nds_InitValue=3, rba_Nds_ISignalToIPduMappingRef=WhlDir_RL_Stat_BTC_ST3, rba_Nds_SignalInstanceRef=rba_Nds_SignalPdu/rba_Nds_SignalInstance_WhlDir_RL_Stat_BTC_ST3
                rba_Nds_ReceiveSignalNetworkPort_WhlDir_RR_Stat_BTC_ST3: rba_Nds_InitValue=3, rba_Nds_ISignalToIPduMappingRef=WhlDir_RR_Stat_BTC_ST3, rba_Nds_SignalInstanceRef=rba_Nds_SignalPdu/rba_Nds_SignalInstance_WhlDir_RR_Stat_BTC_ST3
                rba_Nds_ReceiveSignalNetworkPort_WhlPlsCnt_FL_BTC_ST3: rba_Nds_InitValue=1023, rba_Nds_ISignalToIPduMappingRef=WhlPlsCnt_FL_BTC_ST3, rba_Nds_SignalInstanceRef=rba_Nds_SignalPdu/rba_Nds_SignalInstance_WhlPlsCnt_FL_BTC_ST3
                rba_Nds_ReceiveSignalNetworkPort_WhlPlsCnt_FR_BTC_ST3: rba_Nds_InitValue=1023, rba_Nds_ISignalToIPduMappingRef=WhlPlsCnt_FR_BTC_ST3, rba_Nds_SignalInstanceRef=rba_Nds_SignalPdu/rba_Nds_SignalInstance_WhlPlsCnt_FR_BTC_ST3
                rba_Nds_ReceiveSignalNetworkPort_WhlPlsCnt_RL_BTC_ST3: rba_Nds_InitValue=1023, rba_Nds_ISignalToIPduMappingRef=WhlPlsCnt_RL_BTC_ST3, rba_Nds_SignalInstanceRef=rba_Nds_SignalPdu/rba_Nds_SignalInstance_WhlPlsCnt_RL_BTC_ST3
                rba_Nds_ReceiveSignalNetworkPort_WhlPlsCnt_RR_BTC_ST3: rba_Nds_InitValue=1023, rba_Nds_ISignalToIPduMappingRef=WhlPlsCnt_RR_BTC_ST3, rba_Nds_SignalInstanceRef=rba_Nds_SignalPdu/rba_Nds_SignalInstance_WhlPlsCnt_RR_BTC_ST3
                rba_Nds_ReceiveSignalNetworkPort_WhlRPM_FL_BTC_ST3: rba_Nds_InitValue=16383, rba_Nds_ISignalToIPduMappingRef=WhlRPM_FL_BTC_ST3, rba_Nds_SignalInstanceRef=rba_Nds_SignalPdu/rba_Nds_SignalInstance_WhlRPM_FL_BTC_ST3
                rba_Nds_ReceiveSignalNetworkPort_WhlRPM_FL_Qual_BTC_ST3: rba_Nds_InitValue=1, rba_Nds_ISignalToIPduMappingRef=WhlRPM_FL_Qual_BTC_ST3, rba_Nds_SignalInstanceRef=rba_Nds_SignalPdu/rba_Nds_SignalInstance_WhlRPM_FL_Qual_BTC_ST3
                rba_Nds_ReceiveSignalNetworkPort_WhlRPM_FR_BTC_ST3: rba_Nds_InitValue=16383, rba_Nds_ISignalToIPduMappingRef=WhlRPM_FR_BTC_ST3, rba_Nds_SignalInstanceRef=rba_Nds_SignalPdu/rba_Nds_SignalInstance_WhlRPM_FR_BTC_ST3
                rba_Nds_ReceiveSignalNetworkPort_WhlRPM_FR_Qual_BTC_ST3: rba_Nds_InitValue=1, rba_Nds_ISignalToIPduMappingRef=WhlRPM_FR_Qual_BTC_ST3, rba_Nds_SignalInstanceRef=rba_Nds_SignalPdu/rba_Nds_SignalInstance_WhlRPM_FR_Qual_BTC_ST3
                rba_Nds_ReceiveSignalNetworkPort_WhlRPM_RL_BTC_ST3: rba_Nds_InitValue=16383, rba_Nds_ISignalToIPduMappingRef=WhlRPM_RL_BTC_ST3, rba_Nds_SignalInstanceRef=rba_Nds_SignalPdu/rba_Nds_SignalInstance_WhlRPM_RL_BTC_ST3
                rba_Nds_ReceiveSignalNetworkPort_WhlRPM_RL_Qual_BTC_ST3: rba_Nds_InitValue=1, rba_Nds_ISignalToIPduMappingRef=WhlRPM_RL_Qual_BTC_ST3, rba_Nds_SignalInstanceRef=rba_Nds_SignalPdu/rba_Nds_SignalInstance_WhlRPM_RL_Qual_BTC_ST3
                rba_Nds_ReceiveSignalNetworkPort_WhlRPM_RR_BTC_ST3: rba_Nds_InitValue=16383, rba_Nds_ISignalToIPduMappingRef=WhlRPM_RR_BTC_ST3, rba_Nds_SignalInstanceRef=rba_Nds_SignalPdu/rba_Nds_SignalInstance_WhlRPM_RR_BTC_ST3
                rba_Nds_ReceiveSignalNetworkPort_WhlRPM_RR_Qual_BTC_ST3: rba_Nds_InitValue=1, rba_Nds_ISignalToIPduMappingRef=WhlRPM_RR_Qual_BTC_ST3, rba_Nds_SignalInstanceRef=rba_Nds_SignalPdu/rba_Nds_SignalInstance_WhlRPM_RR_Qual_BTC_ST3
                rba_Nds_ReceiveSignalNetworkPort_Rsrv1_BCS_Whl_Msg1_BTC_Pr5_ST3: rba_Nds_InitValue=15, rba_Nds_ISignalToIPduMappingRef=Rsrv1_BCS_Whl_Msg1_BTC_Pr5_ST3, rba_Nds_SignalInstanceRef=rba_Nds_SignalPdu/rba_Nds_SignalInstance_Rsrv1_BCS_Whl_Msg1_BTC_Pr5_ST3
              rba_Nds_ReceiveSignalGroupNetworkPort_BCS_Whl_Msg1_BTC_Pr5_ST3_3z5vvcdtzaheg7vz23u7gb0g6 (rba_Nds_ReceiveSignalGroupNetworkPort):
                rba_Nds_ISignalToIPduMappingRef = BCS_Whl_Msg1_BTC_Pr5_ST3_3z5vvcdtzaheg7vz23u7gb0g6
                rba_Nds_SignalGroupInstanceRef = rba_Nds_SignalPdu/rba_Nds_SignalGroupInstance_BCS_Whl_Msg1_BTC_Pr5_ST3_3z5vvcdtzaheg7vz23u7gb0g6
          rba_Nds_ReceivePdu_ESP_HAD_BACKUP_GW_Container2_ST3_Ign_Stat_ST3
            rba_Nds_ReceiveSignalPdu:
              rba_Nds_SignalIndicationProcessing = IMMEDIATE
              rba_Nds_PduTimeoutUserCallout = rbl_CustIf_TimeOut_Cbk_Ign_Stat_ST3
              rba_Nds_SignalPduRef = rba_Nds_Pdu_ESP_HAD_BACKUP_GW_Container2_ST3_Ign_Stat_ST3/rba_Nds_SignalPdu
              rba_Nds_EcuReceiveProcessRef = rba_Nds_EcuReceiveProcess_20ms
              rba_Nds_PduGroupRef = rba_Nds_PduGroup_IMU_A_HAD_BACKUP_Rx_PNC_All_Active
              rba_Nds_PduGroupRef = rba_Nds_PduGroup_IMU_A_HAD_BACKUP_Rx_PNC_20
              rba_Nds_PduGroupRef = rba_Nds_PduGroup_IMU_A_HAD_BACKUP_Rx_PNC_23
              rba_Nds_ReceiveSignalNetworkPort_ISw_Stat_ST3 (rba_Nds_ReceiveSignalNetworkPort):
                rba_Nds_InitValue = 7
                rba_Nds_ISignalToIPduMappingRef = ISw_Stat_ST3
                rba_Nds_SignalInstanceRef = rba_Nds_SignalPdu/rba_Nds_SignalInstance_ISw_Stat_ST3
              rba_Nds_ReceiveSignalGroupNetworkPort_Ign_Stat_Pr5_ST3_csgs1dv6drms80o1i9p49677w (rba_Nds_ReceiveSignalGroupNetworkPort):
                rba_Nds_ISignalToIPduMappingRef = Ign_Stat_Pr5_ST3_csgs1dv6drms80o1i9p49677w
                rba_Nds_SignalGroupInstanceRef = rba_Nds_SignalPdu/rba_Nds_SignalGroupInstance_Ign_Stat_Pr5_ST3_csgs1dv6drms80o1i9p49677w
              4 x rba_Nds_ReceiveSignalNetworkPort:
                rba_Nds_ReceiveSignalNetworkPort_KG_StartSw_Psd_ST3: rba_Nds_InitValue=0, rba_Nds_SignalInstanceRef=rba_Nds_SignalPdu/rba_Nds_SignalInstance_KG_StartSw_Psd_ST3
                rba_Nds_ReceiveSignalNetworkPort_SQC_Ign_Stat_Pr5_ST3: rba_Nds_InitValue=0, rba_Nds_SignalInstanceRef=rba_Nds_SignalPdu/rba_Nds_SignalInstance_SQC_Ign_Stat_Pr5_ST3
                rba_Nds_ReceiveSignalNetworkPort_Veh_Op_Mode_ST3: rba_Nds_InitValue=0, rba_Nds_SignalInstanceRef=rba_Nds_SignalPdu/rba_Nds_SignalInstance_Veh_Op_Mode_ST3
                rba_Nds_ReceiveSignalNetworkPort_CRC_Ign_Stat_Pr5_ST3: rba_Nds_InitValue=20886, rba_Nds_SignalInstanceRef=rba_Nds_SignalPdu/rba_Nds_SignalInstance_CRC_Ign_Stat_Pr5_ST3
          rba_Nds_ReceivePdu_ESP_HAD_BACKUP_GW_Container2_ST3_PT4_PTCoor4_ST3
            rba_Nds_ReceiveSignalPdu:
              rba_Nds_SignalIndicationProcessing = IMMEDIATE
              rba_Nds_PduTimeoutUserCallout = rbl_CustIf_TimeOut_Cbk_PT4_PTCoor4_ST3
              rba_Nds_SignalPduRef = rba_Nds_Pdu_ESP_HAD_BACKUP_GW_Container2_ST3_PT4_PTCoor4_ST3/rba_Nds_SignalPdu
              rba_Nds_EcuReceiveProcessRef = rba_Nds_EcuReceiveProcess_20ms
              rba_Nds_PduGroupRef = rba_Nds_PduGroup_IMU_A_HAD_BACKUP_Rx_PNC_All_Active
              rba_Nds_PduGroupRef = rba_Nds_PduGroup_IMU_A_HAD_BACKUP_Rx_PNC_20
              rba_Nds_PduGroupRef = rba_Nds_PduGroup_IMU_A_HAD_BACKUP_Rx_PNC_23
              rba_Nds_ReceiveSignalNetworkPort_PT4_PTCoor_EngStartPN14_Stat_ST3 (rba_Nds_ReceiveSignalNetworkPort):
                rba_Nds_InitValue = 0
                rba_Nds_ISignalToIPduMappingRef = PT4_PTCoor_EngStartPN14_Stat_ST3
                rba_Nds_SignalInstanceRef = rba_Nds_SignalPdu/rba_Nds_SignalInstance_PT4_PTCoor_EngStartPN14_Stat_ST3
              rba_Nds_ReceiveSignalGroupNetworkPort_PT4_PTCoor4_Pr5_ST3_af4fxb1ykieox3itqdfzs0kpb (rba_Nds_ReceiveSignalGroupNetworkPort):
                rba_Nds_ISignalToIPduMappingRef = PT4_PTCoor4_Pr5_ST3_af4fxb1ykieox3itqdfzs0kpb
                rba_Nds_SignalGroupInstanceRef = rba_Nds_SignalPdu/rba_Nds_SignalGroupInstance_PT4_PTCoor4_Pr5_ST3_af4fxb1ykieox3itqdfzs0kpb
              5 x rba_Nds_ReceiveSignalNetworkPort:
                rba_Nds_ReceiveSignalNetworkPort_Rsrv1_PT4_PTCoor_PT_Rdy_Pr5_ST3: rba_Nds_InitValue=1, rba_Nds_SignalInstanceRef=rba_Nds_SignalPdu/rba_Nds_SignalInstance_Rsrv1_PT4_PTCoor_PT_Rdy_Pr5_ST3
                rba_Nds_ReceiveSignalNetworkPort_SQC_PT4_PTCoor4_Pr5_ST3: rba_Nds_InitValue=0, rba_Nds_SignalInstanceRef=rba_Nds_SignalPdu/rba_Nds_SignalInstance_SQC_PT4_PTCoor4_Pr5_ST3
                rba_Nds_ReceiveSignalNetworkPort_PT4_PTCoor_SSA_EngSp_ST3: rba_Nds_InitValue=3, rba_Nds_SignalInstanceRef=rba_Nds_SignalPdu/rba_Nds_SignalInstance_PT4_PTCoor_SSA_EngSp_ST3
                rba_Nds_ReceiveSignalNetworkPort_PT4_PTCoor_PT_Rdy_ST3: rba_Nds_InitValue=0, rba_Nds_SignalInstanceRef=rba_Nds_SignalPdu/rba_Nds_SignalInstance_PT4_PTCoor_PT_Rdy_ST3
                rba_Nds_ReceiveSignalNetworkPort_CRC_PT4_PTCoor4_Pr5_ST3: rba_Nds_InitValue=4203, rba_Nds_SignalInstanceRef=rba_Nds_SignalPdu/rba_Nds_SignalInstance_CRC_PT4_PTCoor4_Pr5_ST3
          rba_Nds_ReceivePdu_ESP_HAD_BACKUP_GW_Container4_ST3_DI_OdoSpeedometer_ST3
            rba_Nds_ReceiveSignalPdu:
              rba_Nds_SignalIndicationProcessing = IMMEDIATE
              rba_Nds_PduTimeoutUserCallout = rbl_CustIf_TimeOut_Cbk_DI_OdoSpeedometer_ST3
              rba_Nds_SignalPduRef = rba_Nds_Pdu_ESP_HAD_BACKUP_GW_Container4_ST3_DI_OdoSpeedometer_ST3/rba_Nds_SignalPdu
              rba_Nds_EcuReceiveProcessRef = rba_Nds_EcuReceiveProcess_20ms
              rba_Nds_PduGroupRef = rba_Nds_PduGroup_IMU_A_HAD_BACKUP_Rx_PNC_All_Active
              rba_Nds_PduGroupRef = rba_Nds_PduGroup_IMU_A_HAD_BACKUP_Rx_PNC_20
              rba_Nds_PduGroupRef = rba_Nds_PduGroup_IMU_A_HAD_BACKUP_Rx_PNC_23
              rba_Nds_ReceiveSignalNetworkPort_Odo_ST3 (rba_Nds_ReceiveSignalNetworkPort): rba_Nds_InitValue=16777215, rba_Nds_ISignalToIPduMappingRef=Odo_ST3, rba_Nds_SignalInstanceRef=rba_Nds_SignalPdu/rba_Nds_SignalInstance_Odo_ST3
              rba_Nds_ReceiveSignalGroupNetworkPort_DI_Odo_Pr5_ST3_e68xmtlkywxgxsdwekdjjhw3t (rba_Nds_ReceiveSignalGroupNetworkPort):
                rba_Nds_ISignalToIPduMappingRef = DI_Odo_Pr5_ST3_e68xmtlkywxgxsdwekdjjhw3t
                rba_Nds_SignalGroupInstanceRef = rba_Nds_SignalPdu/rba_Nds_SignalGroupInstance_DI_Odo_Pr5_ST3_e68xmtlkywxgxsdwekdjjhw3t
              3 x rba_Nds_ReceiveSignalNetworkPort:
                rba_Nds_ReceiveSignalNetworkPort_CRC_DI_Odo_Pr5_ST3: rba_Nds_InitValue=8633, rba_Nds_SignalInstanceRef=rba_Nds_SignalPdu/rba_Nds_SignalInstance_CRC_DI_Odo_Pr5_ST3
                rba_Nds_ReceiveSignalNetworkPort_SQC_DI_Odo_Pr5_ST3: rba_Nds_InitValue=0, rba_Nds_SignalInstanceRef=rba_Nds_SignalPdu/rba_Nds_SignalInstance_SQC_DI_Odo_Pr5_ST3
                rba_Nds_ReceiveSignalNetworkPort_VehSpd_Disp_ST3: rba_Nds_InitValue=4095, rba_Nds_SignalInstanceRef=rba_Nds_SignalPdu/rba_Nds_SignalInstance_VehSpd_Disp_ST3
          rba_Nds_ReceivePdu_ESP_HAD_BACKUP_GW_Container4_ST3_DIAG_Stat_ST3
            rba_Nds_ReceiveSignalPdu:
              rba_Nds_SignalIndicationProcessing = IMMEDIATE
              rba_Nds_PduTimeoutUserCallout = rbl_CustIf_TimeOut_Cbk_DIAG_Stat_ST3
              rba_Nds_SignalPduRef = rba_Nds_Pdu_ESP_HAD_BACKUP_GW_Container4_ST3_DIAG_Stat_ST3/rba_Nds_SignalPdu
              rba_Nds_EcuReceiveProcessRef = rba_Nds_EcuReceiveProcess_20ms
              rba_Nds_PduGroupRef = rba_Nds_PduGroup_IMU_A_HAD_BACKUP_Rx_PNC_All_Active
              rba_Nds_PduGroupRef = rba_Nds_PduGroup_IMU_A_HAD_BACKUP_Rx_PNC_20
              rba_Nds_PduGroupRef = rba_Nds_PduGroup_IMU_A_HAD_BACKUP_Rx_PNC_23
              rba_Nds_ReceiveSignalNetworkPort_DidA_ExtTest_Pres_ST3 (rba_Nds_ReceiveSignalNetworkPort):
                rba_Nds_InitValue = 3
                rba_Nds_ISignalToIPduMappingRef = DidA_ExtTest_Pres_ST3
                rba_Nds_SignalInstanceRef = rba_Nds_SignalPdu/rba_Nds_SignalInstance_DidA_ExtTest_Pres_ST3
              rba_Nds_ReceiveSignalNetworkPort_Actv_Line_Stat_ST3 (rba_Nds_ReceiveSignalNetworkPort): rba_Nds_InitValue=0, rba_Nds_SignalInstanceRef=rba_Nds_SignalPdu/rba_Nds_SignalInstance_Actv_Line_Stat_ST3
          rba_Nds_ReceivePdu_ESP_HAD_BACKUP_GW_Container4_ST3_PN14_Master_Stat1_ST3
            rba_Nds_ReceiveSignalPdu:
              rba_Nds_SignalIndicationProcessing = IMMEDIATE
              rba_Nds_PduTimeoutUserCallout = rbl_CustIf_TimeOut_Cbk_PN14_Master_Stat1_ST3
              rba_Nds_SignalPduRef = rba_Nds_Pdu_ESP_HAD_BACKUP_GW_Container4_ST3_PN14_Master_Stat1_ST3/rba_Nds_SignalPdu
              rba_Nds_EcuReceiveProcessRef = rba_Nds_EcuReceiveProcess_20ms
              rba_Nds_PduGroupRef = rba_Nds_PduGroup_IMU_A_HAD_BACKUP_Rx_PNC_All_Active
              rba_Nds_PduGroupRef = rba_Nds_PduGroup_IMU_A_HAD_BACKUP_Rx_PNC_20
              rba_Nds_PduGroupRef = rba_Nds_PduGroup_IMU_A_HAD_BACKUP_Rx_PNC_23
              11 x rba_Nds_ReceiveSignalNetworkPort:
                rba_Nds_ReceiveSignalNetworkPort_PN14_TransMd_Stat_ST3: rba_Nds_InitValue=3, rba_Nds_ISignalToIPduMappingRef=PN14_TransMd_Stat_ST3, rba_Nds_SignalInstanceRef=rba_Nds_SignalPdu/rba_Nds_SignalInstance_PN14_TransMd_Stat_ST3
                rba_Nds_ReceiveSignalNetworkPort_PN14_DDP_Sw_Stat_ST3: rba_Nds_InitValue=0, rba_Nds_SignalInstanceRef=rba_Nds_SignalPdu/rba_Nds_SignalInstance_PN14_DDP_Sw_Stat_ST3
                rba_Nds_ReceiveSignalNetworkPort_PN14_ProdMd_Stat_ST3: rba_Nds_InitValue=7, rba_Nds_SignalInstanceRef=rba_Nds_SignalPdu/rba_Nds_SignalInstance_PN14_ProdMd_Stat_ST3
                rba_Nds_ReceiveSignalNetworkPort_PN14_SupBat_Volt_ST3: rba_Nds_InitValue=1023, rba_Nds_SignalInstanceRef=rba_Nds_SignalPdu/rba_Nds_SignalInstance_PN14_SupBat_Volt_ST3
                rba_Nds_ReceiveSignalNetworkPort_PN14_ExtBat_Charge_Actv_ST3: rba_Nds_InitValue=3, rba_Nds_SignalInstanceRef=rba_Nds_SignalPdu/rba_Nds_SignalInstance_PN14_ExtBat_Charge_Actv_ST3
                rba_Nds_ReceiveSignalNetworkPort_PN14_SupBat_Stat_ST3: rba_Nds_InitValue=127, rba_Nds_SignalInstanceRef=rba_Nds_SignalPdu/rba_Nds_SignalInstance_PN14_SupBat_Stat_ST3
                rba_Nds_ReceiveSignalNetworkPort_PN14_ProdMd_BatStat_ST3: rba_Nds_InitValue=127, rba_Nds_SignalInstanceRef=rba_Nds_SignalPdu/rba_Nds_SignalInstance_PN14_ProdMd_BatStat_ST3
                rba_Nds_ReceiveSignalNetworkPort_PN14_SupBat_Curr_ST3: rba_Nds_InitValue=8191, rba_Nds_SignalInstanceRef=rba_Nds_SignalPdu/rba_Nds_SignalInstance_PN14_SupBat_Curr_ST3
                rba_Nds_ReceiveSignalNetworkPort_PN14_SupBat_Temp_ST3: rba_Nds_InitValue=255, rba_Nds_SignalInstanceRef=rba_Nds_SignalPdu/rba_Nds_SignalInstance_PN14_SupBat_Temp_ST3
                rba_Nds_ReceiveSignalNetworkPort_PN14_DDP_Sw2_Stat_ST3: rba_Nds_InitValue=7, rba_Nds_SignalInstanceRef=rba_Nds_SignalPdu/rba_Nds_SignalInstance_PN14_DDP_Sw2_Stat_ST3
                rba_Nds_ReceiveSignalNetworkPort_PN14_PNSec_RechargeEnable_ST3: rba_Nds_InitValue=3, rba_Nds_SignalInstanceRef=rba_Nds_SignalPdu/rba_Nds_SignalInstance_PN14_PNSec_RechargeEnable_ST3
        rba_Nds_TransmitPdu_IMU_A_Output_ST3 (rba_Nds_TransmitPdu)
          rba_Nds_TransmitSignalPdu:
            rba_Nds_SignalConfirmationProcessing = IMMEDIATE
            rba_Nds_SignalPduRef = rba_Nds_Pdu_IMU_A_Output_ST3/rba_Nds_SignalPdu
            rba_Nds_PduGroupRef = rba_Nds_PduGroup_IMU_A_HAD_BACKUP_Tx_PNC_All_Active
            rba_Nds_PduGroupRef = rba_Nds_PduGroup_IMU_A_HAD_BACKUP_Tx_PNC_20
            rba_Nds_EcuTransmitProcessRef = rba_Nds_EcuTransmitProcess_5ms
            26 x rba_Nds_TransmitSignalNetworkPort, all with rba_Nds_EventTransferSignal=TRANSFER_ON_CHANGE:
              rba_Nds_TransmitSignalNetworkPort_CRC_IMU_A_Output_Pr5_ST3: rba_Nds_InitValue=19347, rba_Nds_ISignalToIPduMappingRef=CRC_IMU_A_Output_Pr5_ST3, rba_Nds_SignalInstanceRef=rba_Nds_SignalInstance_CRC_IMU_A_Output_Pr5_ST3
              rba_Nds_TransmitSignalNetworkPort_IMU_A_AngAcc_Stat_ST3: rba_Nds_InitValue=0, rba_Nds_ISignalToIPduMappingRef=IMU_A_AngAcc_Stat_ST3, rba_Nds_SignalInstanceRef=rba_Nds_SignalInstance_IMU_A_AngAcc_Stat_ST3
              rba_Nds_TransmitSignalNetworkPort_IMU_A_AngAcc_X_ST3: rba_Nds_InitValue=65535, rba_Nds_ISignalToIPduMappingRef=IMU_A_AngAcc_X_ST3, rba_Nds_SignalInstanceRef=rba_Nds_SignalInstance_IMU_A_AngAcc_X_ST3
              rba_Nds_TransmitSignalNetworkPort_IMU_A_AngAcc_Y_ST3: rba_Nds_InitValue=65535, rba_Nds_ISignalToIPduMappingRef=IMU_A_AngAcc_Y_ST3, rba_Nds_SignalInstanceRef=rba_Nds_SignalInstance_IMU_A_AngAcc_Y_ST3
              rba_Nds_TransmitSignalNetworkPort_IMU_A_AngAcc_Z_ST3: rba_Nds_InitValue=65535, rba_Nds_ISignalToIPduMappingRef=IMU_A_AngAcc_Z_ST3, rba_Nds_SignalInstanceRef=rba_Nds_SignalInstance_IMU_A_AngAcc_Z_ST3
              rba_Nds_TransmitSignalNetworkPort_IMU_A_AngRate_X_ST3: rba_Nds_InitValue=65535, rba_Nds_ISignalToIPduMappingRef=IMU_A_AngRate_X_ST3, rba_Nds_SignalInstanceRef=rba_Nds_SignalInstance_IMU_A_AngRate_X_ST3
              rba_Nds_TransmitSignalNetworkPort_IMU_A_AngRate_Y_ST3: rba_Nds_InitValue=65535, rba_Nds_ISignalToIPduMappingRef=IMU_A_AngRate_Y_ST3, rba_Nds_SignalInstanceRef=rba_Nds_SignalInstance_IMU_A_AngRate_Y_ST3
              rba_Nds_TransmitSignalNetworkPort_IMU_A_AngRate_Z_ST3: rba_Nds_InitValue=65535, rba_Nds_ISignalToIPduMappingRef=IMU_A_AngRate_Z_ST3, rba_Nds_SignalInstanceRef=rba_Nds_SignalInstance_IMU_A_AngRate_Z_ST3
              rba_Nds_TransmitSignalNetworkPort_IMU_A_AngRates_Stat_ST3: rba_Nds_InitValue=0, rba_Nds_ISignalToIPduMappingRef=IMU_A_AngRates_Stat_ST3, rba_Nds_SignalInstanceRef=rba_Nds_SignalInstance_IMU_A_AngRates_Stat_ST3
              rba_Nds_TransmitSignalNetworkPort_IMU_A_SpecForce_Stat_ST3: rba_Nds_InitValue=0, rba_Nds_ISignalToIPduMappingRef=IMU_A_SpecForce_Stat_ST3, rba_Nds_SignalInstanceRef=rba_Nds_SignalInstance_IMU_A_SpecForce_Stat_ST3
              rba_Nds_TransmitSignalNetworkPort_IMU_A_SpecForce_X_ST3: rba_Nds_InitValue=65535, rba_Nds_ISignalToIPduMappingRef=IMU_A_SpecForce_X_ST3, rba_Nds_SignalInstanceRef=rba_Nds_SignalInstance_IMU_A_SpecForce_X_ST3
              rba_Nds_TransmitSignalNetworkPort_IMU_A_SpecForce_Y_ST3: rba_Nds_InitValue=65535, rba_Nds_ISignalToIPduMappingRef=IMU_A_SpecForce_Y_ST3, rba_Nds_SignalInstanceRef=rba_Nds_SignalInstance_IMU_A_SpecForce_Y_ST3
              rba_Nds_TransmitSignalNetworkPort_IMU_A_SpecForce_Z_ST3: rba_Nds_InitValue=65535, rba_Nds_ISignalToIPduMappingRef=IMU_A_SpecForce_Z_ST3, rba_Nds_SignalInstanceRef=rba_Nds_SignalInstance_IMU_A_SpecForce_Z_ST3
              rba_Nds_TransmitSignalNetworkPort_IMU_A_Stat_ST3: rba_Nds_InitValue=0, rba_Nds_ISignalToIPduMappingRef=IMU_A_Stat_ST3, rba_Nds_SignalInstanceRef=rba_Nds_SignalInstance_IMU_A_Stat_ST3
              rba_Nds_TransmitSignalNetworkPort_IMU_A_Temp_ST3: rba_Nds_InitValue=255, rba_Nds_ISignalToIPduMappingRef=IMU_A_Temp_ST3, rba_Nds_SignalInstanceRef=rba_Nds_SignalInstance_IMU_A_Temp_ST3
              rba_Nds_TransmitSignalNetworkPort_IMU_A_TmStmp_NanoSec_ST3: rba_Nds_InitValue=0, rba_Nds_ISignalToIPduMappingRef=IMU_A_TmStmp_NanoSec_ST3, rba_Nds_SignalInstanceRef=rba_Nds_SignalInstance_IMU_A_TmStmp_NanoSec_ST3
              rba_Nds_TransmitSignalNetworkPort_IMU_A_TmStmp_Sec_ST3: rba_Nds_InitValue=0, rba_Nds_ISignalToIPduMappingRef=IMU_A_TmStmp_Sec_ST3, rba_Nds_SignalInstanceRef=rba_Nds_SignalInstance_IMU_A_TmStmp_Sec_ST3
              rba_Nds_TransmitSignalNetworkPort_IMU_A_TmSync_Stat_ST3: rba_Nds_InitValue=128, rba_Nds_ISignalToIPduMappingRef=IMU_A_TmSync_Stat_ST3, rba_Nds_SignalInstanceRef=rba_Nds_SignalInstance_IMU_A_TmSync_Stat_ST3
              rba_Nds_TransmitSignalNetworkPort_SQC_IMU_A_Output_Pr5_ST3: rba_Nds_InitValue=0, rba_Nds_ISignalToIPduMappingRef=SQC_IMU_A_Output_Pr5_ST3, rba_Nds_SignalInstanceRef=rba_Nds_SignalInstance_SQC_IMU_A_Output_Pr5_ST3
              rba_Nds_TransmitSignalNetworkPort_Rsrv01_IMU_A_Output_Pr5_ST3: rba_Nds_InitValue=511, rba_Nds_ISignalToIPduMappingRef=Rsrv01_IMU_A_Output_Pr5_ST3, rba_Nds_SignalInstanceRef=rba_Nds_SignalInstance_Rsrv01_IMU_A_Output_Pr5_ST3
              rba_Nds_TransmitSignalNetworkPort_Rsrv{02..05}_IMU_A_Output_Pr5_ST3: rba_Nds_InitValue=255, rba_Nds_ISignalToIPduMappingRef=Rsrv{02..05}_IMU_A_Output_Pr5_ST3, rba_Nds_SignalInstanceRef=rba_Nds_SignalInstance_Rsrv{02..05}_IMU_A_Output_Pr5_ST3
              rba_Nds_TransmitSignalNetworkPort_Rsrv06_IMU_A_Output_Pr5_ST3: rba_Nds_InitValue=65535, rba_Nds_ISignalToIPduMappingRef=Rsrv06_IMU_A_Output_Pr5_ST3, rba_Nds_SignalInstanceRef=rba_Nds_SignalInstance_Rsrv06_IMU_A_Output_Pr5_ST3
              rba_Nds_TransmitSignalNetworkPort_Rsrv07_IMU_A_Output_Pr5_ST3: rba_Nds_InitValue=7, rba_Nds_ISignalToIPduMappingRef=Rsrv07_IMU_A_Output_Pr5_ST3, rba_Nds_SignalInstanceRef=rba_Nds_SignalInstance_Rsrv07_IMU_A_Output_Pr5_ST3
            rba_Nds_TransmitSignalGroupNetworkPort_IMU_A_Output_Pr5_ST3_bezr5ct33mhwxias0s8rjhbne (rba_Nds_TransmitSignalGroupNetworkPort):
              rba_Nds_EventTransferSignalGroup = TRANSFER_ALWAYS
              rba_Nds_ISignalToIPduMappingRef = IMU_A_Output_Pr5_ST3_bezr5ct33mhwxias0s8rjhbne
              rba_Nds_SignalGroupInstanceRef = rba_Nds_SignalGroupInstance_IMU_A_Output_Pr5_ST3_bezr5ct33mhwxias0s8rjhbne
        rba_Nds_TransmitPdu_IMU_A_Output_Fast_ST3 (rba_Nds_TransmitPdu)
          rba_Nds_TransmitSignalPdu:
            rba_Nds_SignalConfirmationProcessing = IMMEDIATE
            rba_Nds_SignalPduRef = rba_Nds_Pdu_IMU_A_Output_Fast_ST3/rba_Nds_SignalPdu
            rba_Nds_EcuTransmitProcessRef = rba_Nds_EcuTransmitProcess_5ms
            rba_Nds_PduGroupRef = rba_Nds_PduGroup_IMU_A_IMU_INTERNAL_Tx_PNC_All_Active
            rba_Nds_PduGroupRef = rba_Nds_PduGroup_IMU_A_IMU_INTERNAL_Tx_PNC_20
            rba_Nds_PduGroupRef = rba_Nds_PduGroup_IMU_A_IMU_INTERNAL_Tx_PNC_23
            26 x rba_Nds_TransmitSignalNetworkPort, all with rba_Nds_EventTransferSignal=TRANSFER_ON_CHANGE:
              rba_Nds_TransmitSignalNetworkPort_CRC_IMU_A_Output_Fast_Pr5_ST3: rba_Nds_InitValue=19231, rba_Nds_ISignalToIPduMappingRef=CRC_IMU_A_Output_Fast_Pr5_ST3, rba_Nds_SignalInstanceRef=rba_Nds_SignalInstance_CRC_IMU_A_Output_Fast_Pr5_ST3
              rba_Nds_TransmitSignalNetworkPort_IMU_A_AngAcc_Stat_Fast_ST3: rba_Nds_InitValue=0, rba_Nds_ISignalToIPduMappingRef=IMU_A_AngAcc_Stat_Fast_ST3, rba_Nds_SignalInstanceRef=rba_Nds_SignalInstance_IMU_A_AngAcc_Stat_Fast_ST3
              rba_Nds_TransmitSignalNetworkPort_IMU_A_AngAcc_X_Fast_ST3: rba_Nds_InitValue=65535, rba_Nds_ISignalToIPduMappingRef=IMU_A_AngAcc_X_Fast_ST3, rba_Nds_SignalInstanceRef=rba_Nds_SignalInstance_IMU_A_AngAcc_X_Fast_ST3
              rba_Nds_TransmitSignalNetworkPort_IMU_A_AngAcc_Y_Fast_ST3: rba_Nds_InitValue=65535, rba_Nds_ISignalToIPduMappingRef=IMU_A_AngAcc_Y_Fast_ST3, rba_Nds_SignalInstanceRef=rba_Nds_SignalInstance_IMU_A_AngAcc_Y_Fast_ST3
              rba_Nds_TransmitSignalNetworkPort_IMU_A_AngAcc_Z_Fast_ST3: rba_Nds_InitValue=65535, rba_Nds_ISignalToIPduMappingRef=IMU_A_AngAcc_Z_Fast_ST3, rba_Nds_SignalInstanceRef=rba_Nds_SignalInstance_IMU_A_AngAcc_Z_Fast_ST3
              rba_Nds_TransmitSignalNetworkPort_IMU_A_AngRate_X_Fast_ST3: rba_Nds_InitValue=65535, rba_Nds_ISignalToIPduMappingRef=IMU_A_AngRate_X_Fast_ST3, rba_Nds_SignalInstanceRef=rba_Nds_SignalInstance_IMU_A_AngRate_X_Fast_ST3
              rba_Nds_TransmitSignalNetworkPort_IMU_A_AngRate_Y_Fast_ST3: rba_Nds_InitValue=65535, rba_Nds_ISignalToIPduMappingRef=IMU_A_AngRate_Y_Fast_ST3, rba_Nds_SignalInstanceRef=rba_Nds_SignalInstance_IMU_A_AngRate_Y_Fast_ST3
              rba_Nds_TransmitSignalNetworkPort_IMU_A_AngRate_Z_Fast_ST3: rba_Nds_InitValue=65535, rba_Nds_ISignalToIPduMappingRef=IMU_A_AngRate_Z_Fast_ST3, rba_Nds_SignalInstanceRef=rba_Nds_SignalInstance_IMU_A_AngRate_Z_Fast_ST3
              rba_Nds_TransmitSignalNetworkPort_IMU_A_AngRates_Stat_Fast_ST3: rba_Nds_InitValue=0, rba_Nds_ISignalToIPduMappingRef=IMU_A_AngRates_Stat_Fast_ST3, rba_Nds_SignalInstanceRef=rba_Nds_SignalInstance_IMU_A_AngRates_Stat_Fast_ST3
              rba_Nds_TransmitSignalNetworkPort_IMU_A_SpecForce_Stat_Fast_ST3: rba_Nds_InitValue=0, rba_Nds_ISignalToIPduMappingRef=IMU_A_SpecForce_Stat_Fast_ST3, rba_Nds_SignalInstanceRef=rba_Nds_SignalInstance_IMU_A_SpecForce_Stat_Fast_ST3
              rba_Nds_TransmitSignalNetworkPort_IMU_A_SpecForce_X_Fast_ST3: rba_Nds_InitValue=65535, rba_Nds_ISignalToIPduMappingRef=IMU_A_SpecForce_X_Fast_ST3, rba_Nds_SignalInstanceRef=rba_Nds_SignalInstance_IMU_A_SpecForce_X_Fast_ST3
              rba_Nds_TransmitSignalNetworkPort_IMU_A_SpecForce_Y_Fast_ST3: rba_Nds_InitValue=65535, rba_Nds_ISignalToIPduMappingRef=IMU_A_SpecForce_Y_Fast_ST3, rba_Nds_SignalInstanceRef=rba_Nds_SignalInstance_IMU_A_SpecForce_Y_Fast_ST3
              rba_Nds_TransmitSignalNetworkPort_IMU_A_SpecForce_Z_Fast_ST3: rba_Nds_InitValue=65535, rba_Nds_ISignalToIPduMappingRef=IMU_A_SpecForce_Z_Fast_ST3, rba_Nds_SignalInstanceRef=rba_Nds_SignalInstance_IMU_A_SpecForce_Z_Fast_ST3
              rba_Nds_TransmitSignalNetworkPort_IMU_A_Stat_Fast_ST3: rba_Nds_InitValue=0, rba_Nds_ISignalToIPduMappingRef=IMU_A_Stat_Fast_ST3, rba_Nds_SignalInstanceRef=rba_Nds_SignalInstance_IMU_A_Stat_Fast_ST3
              rba_Nds_TransmitSignalNetworkPort_IMU_A_Temp_Fast_ST3: rba_Nds_InitValue=255, rba_Nds_ISignalToIPduMappingRef=IMU_A_Temp_Fast_ST3, rba_Nds_SignalInstanceRef=rba_Nds_SignalInstance_IMU_A_Temp_Fast_ST3
              rba_Nds_TransmitSignalNetworkPort_IMU_A_TmStmp_NanoSec_Fast_ST3: rba_Nds_InitValue=0, rba_Nds_ISignalToIPduMappingRef=IMU_A_TmStmp_NanoSec_Fast_ST3, rba_Nds_SignalInstanceRef=rba_Nds_SignalInstance_IMU_A_TmStmp_NanoSec_Fast_ST3
              rba_Nds_TransmitSignalNetworkPort_IMU_A_TmStmp_Sec_Fast_ST3: rba_Nds_InitValue=0, rba_Nds_ISignalToIPduMappingRef=IMU_A_TmStmp_Sec_Fast_ST3, rba_Nds_SignalInstanceRef=rba_Nds_SignalInstance_IMU_A_TmStmp_Sec_Fast_ST3
              rba_Nds_TransmitSignalNetworkPort_IMU_A_TmSync_Stat_Fast_ST3: rba_Nds_InitValue=128, rba_Nds_ISignalToIPduMappingRef=IMU_A_TmSync_Stat_Fast_ST3, rba_Nds_SignalInstanceRef=rba_Nds_SignalInstance_IMU_A_TmSync_Stat_Fast_ST3
              rba_Nds_TransmitSignalNetworkPort_SQC_IMU_A_Output_Fast_Pr5_ST3: rba_Nds_InitValue=0, rba_Nds_ISignalToIPduMappingRef=SQC_IMU_A_Output_Fast_Pr5_ST3, rba_Nds_SignalInstanceRef=rba_Nds_SignalInstance_SQC_IMU_A_Output_Fast_Pr5_ST3
              rba_Nds_TransmitSignalNetworkPort_Rsrv01_IMU_A_Output_Fast_Pr5_ST3: rba_Nds_InitValue=511, rba_Nds_ISignalToIPduMappingRef=Rsrv01_IMU_A_Output_Fast_Pr5_ST3, rba_Nds_SignalInstanceRef=rba_Nds_SignalInstance_Rsrv01_IMU_A_Output_Fast_Pr5_ST3
              rba_Nds_TransmitSignalNetworkPort_Rsrv{02..05}_IMU_A_Output_Fast_Pr5_ST3: rba_Nds_InitValue=255, rba_Nds_ISignalToIPduMappingRef=Rsrv{02..05}_IMU_A_Output_Fast_Pr5_ST3, rba_Nds_SignalInstanceRef=rba_Nds_SignalInstance_Rsrv{02..05}_IMU_A_Output_Fast_Pr5_ST3
              rba_Nds_TransmitSignalNetworkPort_Rsrv06_IMU_A_Output_Fast_Pr5_ST3: rba_Nds_InitValue=65535, rba_Nds_ISignalToIPduMappingRef=Rsrv06_IMU_A_Output_Fast_Pr5_ST3, rba_Nds_SignalInstanceRef=rba_Nds_SignalInstance_Rsrv06_IMU_A_Output_Fast_Pr5_ST3
              rba_Nds_TransmitSignalNetworkPort_Rsrv07_IMU_A_Output_Fast_Pr5_ST3: rba_Nds_InitValue=7, rba_Nds_ISignalToIPduMappingRef=Rsrv07_IMU_A_Output_Fast_Pr5_ST3, rba_Nds_SignalInstanceRef=rba_Nds_SignalInstance_Rsrv07_IMU_A_Output_Fast_Pr5_ST3
            rba_Nds_TransmitSignalGroupNetworkPort_IMU_A_Output_Fast_Pr5_ST3_5ym0lyqjosyobfhfksta75zc4 (rba_Nds_TransmitSignalGroupNetworkPort):
              rba_Nds_EventTransferSignalGroup = TRANSFER_ALWAYS
              rba_Nds_ISignalToIPduMappingRef = IMU_A_Output_Fast_Pr5_ST3_5ym0lyqjosyobfhfksta75zc4
              rba_Nds_SignalGroupInstanceRef = rba_Nds_SignalGroupInstance_IMU_A_Output_Fast_Pr5_ST3_5ym0lyqjosyobfhfksta75zc4
        15 x rba_Nds_ReceivePdu:
          rba_Nds_ReceivePdu_ESP_HAD_BACKUP_COM_Container1_ST3_ContainerIPdu
            rba_Nds_ReceiveContainerPdu:
              rba_Nds_RxAcceptContainedPdu = ACCEPT_CONFIGURED
              rba_Nds_PduProcessing = IMMEDIATE
              rba_Nds_ContainerPduRef = rba_Nds_Pdu_ESP_HAD_BACKUP_COM_Container1_ST3_ContainerIPdu/rba_Nds_ContainerPdu
              rba_Nds_ContainedReceivePduLinkageRef = rba_Nds_CanReceivePduLinkage_ESP_HAD_BACKUP_COM_Container1_ST3_ESP_HAD_BACKUP_COM_Container1_ST3_BCS_Whl_Msg1_BTC_ST3_16ebm65e7roje1m2kqzv87azq
          rba_Nds_ReceivePdu_ESP_HAD_BACKUP_COM_Container1_ST3_ESP_HAD_BACKUP_COM_Container1_ST3_BCS_Whl_Msg1_BTC_ST3_secured
            rba_Nds_ReceiveSecuredPdu:
              rba_Nds_AuthenticReceivePduLinkageRef = rba_Nds_CanReceivePduLinkage_ESP_HAD_BACKUP_COM_Container1_ST3_ESP_HAD_BACKUP_COM_Container1_ST3_BCS_Whl_Msg1_BTC_ST3_5veu2p0tm6432xnhqor79qs7k
              rba_Nds_SecuredPduRef = rba_Nds_Pdu_ESP_HAD_BACKUP_COM_Container1_ST3_ESP_HAD_BACKUP_COM_Container1_ST3_BCS_Whl_Msg1_BTC_ST3_secured/rba_Nds_SecuredPdu
          rba_Nds_ReceivePdu_ESP_HAD_BACKUP_GW_Container2_ST3_ContainerIPdu
            rba_Nds_ReceiveContainerPdu:
              rba_Nds_RxAcceptContainedPdu = ACCEPT_ALL
              rba_Nds_PduProcessing = IMMEDIATE
              rba_Nds_QueueSize = 1
              rba_Nds_ContainerPduRef = rba_Nds_Pdu_ESP_HAD_BACKUP_GW_Container2_ST3_ContainerIPdu/rba_Nds_ContainerPdu
              rba_Nds_ContainedReceivePduLinkageRef = rba_Nds_CanReceivePduLinkage_ESP_HAD_BACKUP_GW_Container2_ST3_ESP_HAD_BACKUP_GW_Container2_ST3_Ign_Stat_ST3_2evpht35ev1p8y12nz0ebo5h3
              rba_Nds_ContainedReceivePduLinkageRef = rba_Nds_CanReceivePduLinkage_ESP_HAD_BACKUP_GW_Container2_ST3_ESP_HAD_BACKUP_GW_Container2_ST3_PT4_PTCoor4_ST3_4jwqfrzf6ypk91w3rckoip7tp
          rba_Nds_ReceivePdu_ESP_HAD_BACKUP_GW_Container2_ST3_ESP_HAD_BACKUP_GW_Container2_ST3_Ign_Stat_ST3_secured
            rba_Nds_ReceiveSecuredPdu:
              rba_Nds_AuthenticReceivePduLinkageRef = rba_Nds_CanReceivePduLinkage_ESP_HAD_BACKUP_GW_Container2_ST3_ESP_HAD_BACKUP_GW_Container2_ST3_Ign_Stat_ST3_bcjlclrj2mauvscq34e4kbcj3
              rba_Nds_SecuredPduRef = rba_Nds_Pdu_ESP_HAD_BACKUP_GW_Container2_ST3_ESP_HAD_BACKUP_GW_Container2_ST3_Ign_Stat_ST3_secured/rba_Nds_SecuredPdu
          rba_Nds_ReceivePdu_ESP_HAD_BACKUP_GW_Container2_ST3_ESP_HAD_BACKUP_GW_Container2_ST3_PT4_PTCoor4_ST3_secured
            rba_Nds_ReceiveSecuredPdu:
              rba_Nds_AuthenticReceivePduLinkageRef = rba_Nds_CanReceivePduLinkage_ESP_HAD_BACKUP_GW_Container2_ST3_ESP_HAD_BACKUP_GW_Container2_ST3_PT4_PTCoor4_ST3_9c9xmhimk3956a8bl74rmvxi7
              rba_Nds_SecuredPduRef = rba_Nds_Pdu_ESP_HAD_BACKUP_GW_Container2_ST3_ESP_HAD_BACKUP_GW_Container2_ST3_PT4_PTCoor4_ST3_secured/rba_Nds_SecuredPdu
          rba_Nds_ReceivePdu_FBL_Cfg_Star3_ST3
            rba_Nds_ReceiveSignalPdu:
              rba_Nds_SignalIndicationProcessing = IMMEDIATE
              rba_Nds_EcuReceiveProcessRef = rba_Nds_EcuReceiveProcess_20ms
              rba_Nds_PduGroupRef = rba_Nds_PduGroup_IMU_A_HAD_BACKUP_Rx_PNC_All_Active
              rba_Nds_SignalPduRef = rba_Nds_Pdu_FBL_Cfg_Star3_ST3/rba_Nds_SignalPdu
              rba_Nds_ReceiveSignalNetworkPort_Platform_Stat_Star3 (rba_Nds_ReceiveSignalNetworkPort): rba_Nds_InitValue=4, rba_Nds_SignalInstanceRef=rba_Nds_SignalPdu/rba_Nds_SignalInstance_Platform_Stat_Star3
          rba_Nds_ReceivePdu_ESP_HAD_BACKUP_GW_Container4_ST3_ContainerIPdu
            rba_Nds_ReceiveContainerPdu:
              rba_Nds_RxAcceptContainedPdu = ACCEPT_ALL
              rba_Nds_PduProcessing = IMMEDIATE
              rba_Nds_ContainerPduRef = rba_Nds_Pdu_ESP_HAD_BACKUP_GW_Container4_ST3_ContainerIPdu/rba_Nds_ContainerPdu
              rba_Nds_ContainedReceivePduLinkageRef = rba_Nds_CanReceivePduLinkage_ESP_HAD_BACKUP_GW_Container4_ST3_ESP_HAD_BACKUP_GW_Container4_ST3_DI_OdoSpeedometer_ST3_8fnay511jh4db945s2stpdw7p
              rba_Nds_ContainedReceivePduLinkageRef = rba_Nds_CanReceivePduLinkage_ESP_HAD_BACKUP_GW_Container4_ST3_ESP_HAD_BACKUP_GW_Container4_ST3_DIAG_Stat_ST3_a9kzo9c723k3h5cgrsehf20w0
              rba_Nds_ContainedReceivePduLinkageRef = rba_Nds_CanReceivePduLinkage_ESP_HAD_BACKUP_GW_Container4_ST3_ESP_HAD_BACKUP_GW_Container4_ST3_PN14_Master_Stat1_ST3_11xqv03a1oeng5zctxoxlpsa
          rba_Nds_ReceivePdu_ESP_HAD_BACKUP_GW_Container3_ST3_ContainerIPdu
            rba_Nds_ReceiveContainerPdu:
              rba_Nds_PduProcessing = IMMEDIATE
              rba_Nds_RxAcceptContainedPdu = ACCEPT_ALL
              rba_Nds_ContainerPduRef = rba_Nds_Pdu_ESP_HAD_BACKUP_GW_Container3_ST3_ContainerIPdu/rba_Nds_ContainerPdu
              rba_Nds_ContainedReceivePduLinkageRef = rba_Nds_CanReceivePduLinkage_ESP_HAD_BACKUP_GW_Container3_ST3_ESP_HAD_BACKUP_GW_Container3_ST3_VSS_TP_SecTickCount_Lvl1_ST3_azhv8t4onxhjhi2zn8in2my2n
              rba_Nds_ContainedReceivePduLinkageRef = rba_Nds_CanReceivePduLinkage_ESP_HAD_BACKUP_GW_Container3_ST3_ESP_HAD_BACKUP_GW_Container3_ST3_VSS_TP_SharedSecret_ST3_82pb6fg4cswmgotegs6aplrj2
              rba_Nds_ContainedReceivePduLinkageRef = rba_Nds_CanReceivePduLinkage_ESP_HAD_BACKUP_GW_Container3_ST3_ESP_HAD_BACKUP_GW_Container3_ST3_VSS_TP_VIN_ST3_3331jz4zbik8yl0ehm51yf8w4
              rba_Nds_ContainedReceivePduLinkageRef = rba_Nds_CanReceivePduLinkage_ESP_HAD_BACKUP_GW_Container3_ST3_ESP_HAD_BACKUP_GW_Container3_ST3_VSS_TP_Auth_ST3_a5m1oehgi1yzcicgsdebhigxy
              rba_Nds_ContainedReceivePduLinkageRef = rba_Nds_CanReceivePduLinkage_ESP_HAD_BACKUP_GW_Container3_ST3_ESP_HAD_BACKUP_GW_Container3_ST3_VSS_TP_RealTmOffset_ST3_2686huv0x9rg4cu1k20p07zrz
          rba_Nds_ReceivePdu_ESP_HAD_BACKUP_GW_Container3_ST3_VSS_TP_VIN_ST3
            rba_Nds_ReceiveSignalPdu:
              rba_Nds_SignalIndicationProcessing = IMMEDIATE
              rba_Nds_EcuReceiveProcessRef = rba_Nds_EcuReceiveProcess_20ms
              rba_Nds_SignalPduRef = rba_Nds_Pdu_ESP_HAD_BACKUP_GW_Container3_ST3_VSS_TP_VIN_ST3/rba_Nds_SignalPdu
              rba_Nds_PduGroupRef = rba_Nds_PduGroup_IMU_A_HAD_BACKUP_Rx_PNC_All_Active
              rba_Nds_PduGroupRef = rba_Nds_PduGroup_IMU_A_HAD_BACKUP_Rx_PNC_20
              rba_Nds_PduGroupRef = rba_Nds_PduGroup_IMU_A_HAD_BACKUP_Rx_PNC_23
              rba_Nds_ReceiveSignalNetworkPort_VSS_TP_VIN_ST3_bz1xsv84cxzl09j028gn39p69 (rba_Nds_ReceiveSignalGroupNetworkPort):
                rba_Nds_SignalGroupUserCallout = rbl_CustIf_SgnGrp_Cbk_VSS_TP_VIN_ST3
                rba_Nds_SignalGroupTimeoutUserCallout = rbl_CustIf_SgnGrp_Tout_Cbk_VSS_TP_VIN_ST3
                rba_Nds_SignalGroupInstanceRef = rba_Nds_SignalPdu/rba_Nds_SignalGroupInstance_VSS_TP_VIN_ST3_bz1xsv84cxzl09j028gn39p69
              8 x rba_Nds_ReceiveSignalNetworkPort, all with rba_Nds_InitValue=63:
                rba_Nds_ReceiveSignalNetworkPort_VSS_TP_VIN_{0..7}_ST3: rba_Nds_SignalInstanceRef=rba_Nds_SignalPdu/rba_Nds_SignalInstance_VSS_TP_VIN_{0..7}_ST3
          rba_Nds_ReceivePdu_ESP_HAD_BACKUP_GW_Container3_ST3_VSS_TP_SecTickCount_Lvl1_ST3
            rba_Nds_ReceiveSignalPdu:
              rba_Nds_SignalIndicationProcessing = IMMEDIATE
              rba_Nds_EcuReceiveProcessRef = rba_Nds_EcuReceiveProcess_20ms
              rba_Nds_SignalPduRef = rba_Nds_Pdu_ESP_HAD_BACKUP_GW_Container3_ST3_VSS_TP_SecTickCount_Lvl1_ST3/rba_Nds_SignalPdu
              rba_Nds_PduGroupRef = rba_Nds_PduGroup_IMU_A_HAD_BACKUP_Rx_PNC_All_Active
              rba_Nds_PduGroupRef = rba_Nds_PduGroup_IMU_A_HAD_BACKUP_Rx_PNC_20
              rba_Nds_PduGroupRef = rba_Nds_PduGroup_IMU_A_HAD_BACKUP_Rx_PNC_23
              rba_Nds_ReceiveSignalNetworkPort_VSS_TP_SecTickCount_Lvl1_ST3_mzmfdqtqz5kvv1kfpvg0kql3 (rba_Nds_ReceiveSignalGroupNetworkPort):
                rba_Nds_SignalGroupUserCallout = rbl_CustIf_SgnGrp_Cbk_VSS_TP_SecTickCount_Lvl1_ST3
                rba_Nds_SignalGroupTimeoutUserCallout = rbl_CustIf_SgnGrp_Tout_Cbk_VSS_TP_SecTickCount_Lvl1_ST3
                rba_Nds_SignalGroupInstanceRef = rba_Nds_SignalPdu/rba_Nds_SignalGroupInstance_VSS_TP_SecTickCount_Lvl1_ST3_mzmfdqtqz5kvv1kfpvg0kql3
              8 x rba_Nds_ReceiveSignalNetworkPort:
                rba_Nds_ReceiveSignalNetworkPort_VSS_TP_SecTickCount_Lvl1_0_ST3: rba_Nds_InitValue=255, rba_Nds_InitValue=255, rba_Nds_SignalInstanceRef=rba_Nds_SignalPdu/rba_Nds_SignalInstance_VSS_TP_SecTickCount_Lvl1_0_ST3
                rba_Nds_ReceiveSignalNetworkPort_VSS_TP_SecTickCount_Lvl1_{1..7}_ST3: rba_Nds_InitValue=255, rba_Nds_SignalInstanceRef=rba_Nds_SignalPdu/rba_Nds_SignalInstance_VSS_TP_SecTickCount_Lvl1_{1..7}_ST3
          rba_Nds_ReceivePdu_ESP_HAD_BACKUP_GW_Container3_ST3_VSS_TP_SharedSecret_ST3
            rba_Nds_ReceiveSignalPdu:
              rba_Nds_SignalIndicationProcessing = IMMEDIATE
              rba_Nds_EcuReceiveProcessRef = rba_Nds_EcuReceiveProcess_20ms
              rba_Nds_SignalPduRef = rba_Nds_Pdu_ESP_HAD_BACKUP_GW_Container3_ST3_VSS_TP_SharedSecret_ST3/rba_Nds_SignalPdu
              rba_Nds_PduGroupRef = rba_Nds_PduGroup_IMU_A_HAD_BACKUP_Rx_PNC_All_Active
              rba_Nds_PduGroupRef = rba_Nds_PduGroup_IMU_A_HAD_BACKUP_Rx_PNC_20
              rba_Nds_PduGroupRef = rba_Nds_PduGroup_IMU_A_HAD_BACKUP_Rx_PNC_23
              rba_Nds_ReceiveSignalNetworkPort_VSS_TP_SharedSecret_ST3_8pj4t8t4rm3tw3pk5hj7vonti (rba_Nds_ReceiveSignalGroupNetworkPort):
                rba_Nds_SignalGroupUserCallout = rbl_CustIf_SgnGrp_Cbk_VSS_TP_SharedSecret_ST3
                rba_Nds_SignalGroupInstanceRef = rba_Nds_SignalPdu/rba_Nds_SignalGroupInstance_VSS_TP_SharedSecret_ST3_8pj4t8t4rm3tw3pk5hj7vonti
              8 x rba_Nds_ReceiveSignalNetworkPort, all with rba_Nds_InitValue=255:
                rba_Nds_ReceiveSignalNetworkPort_VSS_TP_SharedSecret_{0..7}_ST3: rba_Nds_SignalInstanceRef=rba_Nds_SignalPdu/rba_Nds_SignalInstance_VSS_TP_SharedSecret_{0..7}_ST3
          rba_Nds_ReceivePdu_ESP_HAD_BACKUP_GW_Container3_ST3_VSS_TP_RealTmOffset_ST3
            rba_Nds_ReceiveSignalPdu:
              rba_Nds_SignalIndicationProcessing = IMMEDIATE
              rba_Nds_EcuReceiveProcessRef = rba_Nds_EcuReceiveProcess_20ms
              rba_Nds_SignalPduRef = rba_Nds_Pdu_ESP_HAD_BACKUP_GW_Container3_ST3_VSS_TP_RealTmOffset_ST3/rba_Nds_SignalPdu
              rba_Nds_PduGroupRef = rba_Nds_PduGroup_IMU_A_HAD_BACKUP_Rx_PNC_All_Active
              rba_Nds_PduGroupRef = rba_Nds_PduGroup_IMU_A_HAD_BACKUP_Rx_PNC_20
              rba_Nds_PduGroupRef = rba_Nds_PduGroup_IMU_A_HAD_BACKUP_Rx_PNC_23
              rba_Nds_ReceiveSignalNetworkPort_VSS_TP_RealTmOffset_ST3_1t7vc44gftc0wv35k5kgc2in9 (rba_Nds_ReceiveSignalGroupNetworkPort):
                rba_Nds_SignalGroupUserCallout = rbl_CustIf_SgnGrp_Cbk_VSS_TP_RealTmOffset_ST3
                rba_Nds_SignalGroupInstanceRef = rba_Nds_SignalPdu/rba_Nds_SignalGroupInstance_VSS_TP_RealTmOffset_ST3_1t7vc44gftc0wv35k5kgc2in9
              8 x rba_Nds_ReceiveSignalNetworkPort, all with rba_Nds_InitValue=255:
                rba_Nds_ReceiveSignalNetworkPort_VSS_TP_RealTmOffset_{0..7}_ST3: rba_Nds_SignalInstanceRef=rba_Nds_SignalPdu/rba_Nds_SignalInstance_VSS_TP_RealTmOffset_{0..7}_ST3
          rba_Nds_ReceivePdu_ESP_HAD_BACKUP_GW_Container3_ST3_VSS_TP_Auth_ST3
            rba_Nds_ReceiveSignalPdu:
              rba_Nds_SignalIndicationProcessing = IMMEDIATE
              rba_Nds_EcuReceiveProcessRef = rba_Nds_EcuReceiveProcess_20ms
              rba_Nds_SignalPduRef = rba_Nds_Pdu_ESP_HAD_BACKUP_GW_Container3_ST3_VSS_TP_Auth_ST3/rba_Nds_SignalPdu
              rba_Nds_PduGroupRef = rba_Nds_PduGroup_IMU_A_HAD_BACKUP_Rx_PNC_All_Active
              rba_Nds_PduGroupRef = rba_Nds_PduGroup_IMU_A_HAD_BACKUP_Rx_PNC_20
              rba_Nds_PduGroupRef = rba_Nds_PduGroup_IMU_A_HAD_BACKUP_Rx_PNC_23
              rba_Nds_ReceiveSignalNetworkPort_VSS_TP_Auth_ST3_6j4id7sghlvlbroli4wjozjik (rba_Nds_ReceiveSignalGroupNetworkPort):
                rba_Nds_SignalGroupUserCallout = rbl_CustIf_SgnGrp_Cbk_VSS_TP_Auth_ST3
                rba_Nds_SignalGroupInstanceRef = rba_Nds_SignalPdu/rba_Nds_SignalGroupInstance_VSS_TP_Auth_ST3_6j4id7sghlvlbroli4wjozjik
              8 x rba_Nds_ReceiveSignalNetworkPort, all with rba_Nds_InitValue=255:
                rba_Nds_ReceiveSignalNetworkPort_VSS_TP_Auth_{0..7}_ST3: rba_Nds_SignalInstanceRef=rba_Nds_SignalPdu/rba_Nds_SignalInstance_VSS_TP_Auth_{0..7}_ST3
          rba_Nds_ReceivePdu_ESP_HAD_BACKUP_GW_Container4_ST3_ESP_HAD_BACKUP_GW_Container4_ST3_DI_OdoSpeedometer_ST3_secured
            rba_Nds_ReceiveSecuredPdu:
              rba_Nds_AuthenticReceivePduLinkageRef = rba_Nds_CanReceivePduLinkage_ESP_HAD_BACKUP_GW_Container4_ST3_ESP_HAD_BACKUP_GW_Container4_ST3_DI_OdoSpeedometer_ST3_2wrcqkh4ub39zvlu7w28s2r1f
              rba_Nds_SecuredPduRef = rba_Nds_Pdu_ESP_HAD_BACKUP_GW_Container4_ST3_ESP_HAD_BACKUP_GW_Container4_ST3_DI_OdoSpeedometer_ST3_secured/rba_Nds_SecuredPdu
          rba_Nds_ReceivePdu_ESP_HAD_BACKUP_GW_Container4_ST3_ESP_HAD_BACKUP_GW_Container4_ST3_PN14_Master_Stat1_ST3_secured
            rba_Nds_ReceiveSecuredPdu:
              rba_Nds_AuthenticReceivePduLinkageRef = rba_Nds_CanReceivePduLinkage_ESP_HAD_BACKUP_GW_Container4_ST3_ESP_HAD_BACKUP_GW_Container4_ST3_PN14_Master_Stat1_ST3_6wlpxzn4ez9a5ru3exv8xu1x7
              rba_Nds_SecuredPduRef = rba_Nds_Pdu_ESP_HAD_BACKUP_GW_Container4_ST3_ESP_HAD_BACKUP_GW_Container4_ST3_PN14_Master_Stat1_ST3_secured/rba_Nds_SecuredPdu
        14 x rba_Nds_TransmitPdu:
          rba_Nds_TransmitPdu_IMU_A_Output_ST3_secured
            rba_Nds_TransmitSecuredPdu:
              rba_Nds_AuthenticTransmitPduLinkageRef = rba_Nds_CanTransmitPduLinkage_IMU_A_Output_ST3_brfz9q0nahr147hbo9yhq1vvv
              rba_Nds_SecuredPduRef = rba_Nds_Pdu_IMU_A_Output_ST3_secured/rba_Nds_SecuredPdu
          rba_Nds_TransmitPdu_IMU_A_Output_Fast_ST3_secured
            rba_Nds_TransmitSecuredPdu:
              rba_Nds_AuthenticTransmitPduLinkageRef = rba_Nds_CanTransmitPduLinkage_IMU_A_Output_Fast_ST3_9j5x7ag429n202ymo68kf1vn0
              rba_Nds_SecuredPduRef = rba_Nds_Pdu_IMU_A_Output_Fast_ST3_secured/rba_Nds_SecuredPdu
          rba_Nds_TransmitPdu_FBL_Cfg_Star3_ST3
            rba_Nds_TransmitGatewayPdu: rba_Nds_PduRef=rba_Nds_Communication/rba_Nds_Pdu_FBL_Cfg_Star3_ST3
          rba_Nds_TransmitPdu_DI_OdoSpeedometer_ST3
            rba_Nds_TransmitGatewayPdu: rba_Nds_PduRef=rba_Nds_Pdu_DI_OdoSpeedometer_ST3
          rba_Nds_TransmitPdu_DIAG_Stat_ST3
            rba_Nds_TransmitGatewayPdu: rba_Nds_PduRef=rba_Nds_Pdu_DIAG_Stat_ST3
          rba_Nds_TransmitPdu_Ign_Stat_ST3_secured
            rba_Nds_TransmitGatewayPdu: rba_Nds_PduRef=rba_Nds_Pdu_Ign_Stat_ST3_secured
          rba_Nds_TransmitPdu_BCS_Whl_Msg1_BTC_ST3_secured
            rba_Nds_TransmitGatewayPdu: rba_Nds_PduRef=rba_Nds_Pdu_BCS_Whl_Msg1_BTC_ST3_secured
          rba_Nds_TransmitPdu_PT4_PTCoor4_ST3_secured
            rba_Nds_TransmitGatewayPdu: rba_Nds_PduRef=rba_Nds_Pdu_PT4_PTCoor4_ST3_secured
          rba_Nds_TransmitPdu_PN14_Master_Stat1_ST3_secured
            rba_Nds_TransmitGatewayPdu: rba_Nds_PduRef=rba_Nds_Pdu_PN14_Master_Stat1_ST3_secured
          rba_Nds_TransmitPdu_VSS_TP_VIN_ST3
            rba_Nds_TransmitGatewayPdu: rba_Nds_PduRef=rba_Nds_Pdu_VSS_TP_VIN_ST3
          rba_Nds_TransmitPdu_VSS_TP_SharedSecret_ST3
            rba_Nds_TransmitGatewayPdu: rba_Nds_PduRef=rba_Nds_Pdu_VSS_TP_SharedSecret_ST3
          rba_Nds_TransmitPdu_VSS_TP_SecTickCount_Lvl1_ST3
            rba_Nds_TransmitGatewayPdu: rba_Nds_PduRef=rba_Nds_Pdu_VSS_TP_SecTickCount_Lvl1_ST3
          rba_Nds_TransmitPdu_VSS_TP_RealTmOffset_ST3
            rba_Nds_TransmitGatewayPdu: rba_Nds_PduRef=rba_Nds_Pdu_VSS_TP_RealTmOffset_ST3
          rba_Nds_TransmitPdu_VSS_TP_Auth_ST3
            rba_Nds_TransmitGatewayPdu: rba_Nds_PduRef=rba_Nds_Pdu_VSS_TP_Auth_ST3
        3 x rba_Nds_ReceivePdu:
          rba_Nds_ReceivePdu_IDC_S_FSI_HAD_BACKUP_Container_ST3_ADAS_HAD_Stat_IDC_S_FSI_Bckp_ST3
            rba_Nds_ReceiveSignalPdu:
              rba_Nds_SignalIndicationProcessing = IMMEDIATE
              rba_Nds_PduTimeoutUserCallout = rbl_CustIf_TimeOut_Cbk_ADAS_HAD_Stat_IDC_S_FSI_Bckp_ST3
              rba_Nds_SignalPduRef = rba_Nds_Pdu_IDC_S_FSI_HAD_BACKUP_Container_ST3_ADAS_HAD_Stat_IDC_S_FSI_Bckp_ST3/rba_Nds_SignalPdu
              rba_Nds_PduGroupRef = rba_Nds_PduGroup_IMU_A_HAD_BACKUP_Rx_PNC_All_Active
              rba_Nds_PduGroupRef = rba_Nds_PduGroup_IMU_A_HAD_BACKUP_Rx_PNC_20
              rba_Nds_EcuReceiveProcessRef = rba_Nds_EcuReceiveProcess_20ms
              5 x rba_Nds_ReceiveSignalNetworkPort:
                rba_Nds_ReceiveSignalNetworkPort_ADAS_HAD_Ext_Stat_S_FSI_Bckp_ST3: rba_Nds_InitValue=7, rba_Nds_ISignalToIPduMappingRef=ADAS_HAD_Ext_Stat_S_FSI_Bckp_ST3, rba_Nds_SignalInstanceRef=rba_Nds_SignalInstance_ADAS_HAD_Ext_Stat_S_FSI_Bckp_ST3
                rba_Nds_ReceiveSignalNetworkPort_CRC_ADAS_HAD_Stat_IDC_S_FSI_Bckp_Pr5_ST3: rba_Nds_InitValue=49689, rba_Nds_ISignalToIPduMappingRef=CRC_ADAS_HAD_Stat_IDC_S_FSI_Bckp_Pr5_ST3, rba_Nds_SignalInstanceRef=rba_Nds_SignalInstance_CRC_ADAS_HAD_Stat_IDC_S_FSI_Bckp_Pr5_ST3
                rba_Nds_ReceiveSignalNetworkPort_SQC_ADAS_HAD_Stat_IDC_S_FSI_Bckp_Pr5_ST3: rba_Nds_InitValue=0, rba_Nds_ISignalToIPduMappingRef=SQC_ADAS_HAD_Stat_IDC_S_FSI_Bckp_Pr5_ST3, rba_Nds_SignalInstanceRef=rba_Nds_SignalInstance_SQC_ADAS_HAD_Stat_IDC_S_FSI_Bckp_Pr5_ST3
                rba_Nds_ReceiveSignalNetworkPort_Rsrv1_ADAS_HAD_Stat_IDC_S_FSI_Bckp_Pr5_ST3: rba_Nds_InitValue=31, rba_Nds_ISignalToIPduMappingRef=Rsrv1_ADAS_HAD_Stat_IDC_S_FSI_Bckp_Pr5_ST3, rba_Nds_SignalInstanceRef=rba_Nds_SignalInstance_Rsrv1_ADAS_HAD_Stat_IDC_S_FSI_Bckp_Pr5_ST3
                rba_Nds_ReceiveSignalNetworkPort_Rsrv2_ADAS_HAD_Stat_IDC_S_FSI_Bckp_Pr5_ST3: rba_Nds_InitValue=4294967295, rba_Nds_ISignalToIPduMappingRef=Rsrv2_ADAS_HAD_Stat_IDC_S_FSI_Bckp_Pr5_ST3, rba_Nds_SignalInstanceRef=rba_Nds_SignalInstance_Rsrv2_ADAS_HAD_Stat_IDC_S_FSI_Bckp_Pr5_ST3
              rba_Nds_ReceiveSignalGroupNetworkPort_ADAS_HAD_Stat_IDC_S_FSI_Bckp_Pr5_ST3_1hazv0zum1rfjs1udwdzrjfp4 (rba_Nds_ReceiveSignalGroupNetworkPort):
                rba_Nds_ISignalToIPduMappingRef = ADAS_HAD_Stat_IDC_S_FSI_Bckp_Pr5_ST3_1hazv0zum1rfjs1udwdzrjfp4
                rba_Nds_SignalGroupInstanceRef = rba_Nds_SignalGroupInstance_ADAS_HAD_Stat_IDC_S_FSI_Bckp_Pr5_ST3_1hazv0zum1rfjs1udwdzrjfp4
          rba_Nds_ReceivePdu_IDC_S_FSI_HAD_BACKUP_Container_ST3_ContainerIPdu
            rba_Nds_ReceiveContainerPdu:
              rba_Nds_RxAcceptContainedPdu = ACCEPT_CONFIGURED
              rba_Nds_PduProcessing = IMMEDIATE
              rba_Nds_ContainerPduRef = rba_Nds_Pdu_IDC_S_FSI_HAD_BACKUP_Container_ST3_ContainerIPdu/rba_Nds_ContainerPdu
              rba_Nds_ContainedReceivePduLinkageRef = rba_Nds_CanReceivePduLinkage_IDC_S_FSI_HAD_BACKUP_Container_ST3_IDC_S_FSI_HAD_BACKUP_Container_ST3_ADAS_HAD_Stat_IDC_S_FSI_Bckp_ST3_e7ytolt7jqvzpt1pm38yc9jmy
          rba_Nds_ReceivePdu_IDC_S_FSI_HAD_BACKUP_Container_ST3_IDC_S_FSI_HAD_BACKUP_Container_ST3_ADAS_HAD_Stat_IDC_S_FSI_Bckp_ST3_secured
            rba_Nds_ReceiveSecuredPdu:
              rba_Nds_AuthenticReceivePduLinkageRef = rba_Nds_CanReceivePduLinkage_IDC_S_FSI_HAD_BACKUP_Container_ST3_IDC_S_FSI_HAD_BACKUP_Container_ST3_ADAS_HAD_Stat_IDC_S_FSI_Bckp_ST3_ahdgtkk54cgxy874ini32xhdq
              rba_Nds_SecuredPduRef = rba_Nds_Pdu_IDC_S_FSI_HAD_BACKUP_Container_ST3_IDC_S_FSI_HAD_BACKUP_Container_ST3_ADAS_HAD_Stat_IDC_S_FSI_Bckp_ST3_secured/rba_Nds_SecuredPdu
      rba_Nds_Connectors
        rba_Nds_CanConnector_IMU_INTERNAL (rba_Nds_CanConnector): rba_Nds_CanControllerRef=rba_Nds_CanController_CanIfControllerConfig_0, rba_Nds_CanNetworkRef=rba_Nds_CanNetwork_IMU_INTERNAL
          rba_Nds_CanTransmitPduLinkage_IMU_A_Output_Fast_ST3_9j5x7ag429n202ymo68kf1vn0 (rba_Nds_CanTransmitPduLinkage):
            rba_Nds_CanPduTriggeringRef = rba_Nds_CanPduTriggering_IMU_A_Output_Fast_ST3_9j5x7ag429n202ymo68kf1vn0
            rba_Nds_TransmitPduRef = rba_Nds_TransmitPdu_IMU_A_Output_Fast_ST3
          12 x rba_Nds_CanTransmitFrame, all with rba_Nds_FramePollingPeriod=5:
            rba_Nds_CanTransmitFrame_FBL_CFG_Star3_ST3_cldjru6psp0a48ztyemlm017u: rba_Nds_CanFrameTxBehavior=CAN_20, rba_Nds_CanFrameTriggeringRef=rba_Nds_CanFrameTriggering_FBL_CFG_Star3_ST3_cldjru6psp0a48ztyemlm017u, rba_Nds_CanTransmitPduLinkageRef=rba_Nds_CanTransmitPduLinkage_FBL_Cfg_Star3_ST3_99p3uqy39g6epfv2pbzswmxpx
            rba_Nds_CanTransmitFrame_DI_OdoSpeedometer_ST3_8mlouci43d97tcfc95n5bqkid: rba_Nds_CanFrameTxBehavior=CAN_FD, rba_Nds_CanFrameTriggeringRef=rba_Nds_CanFrameTriggering_DI_OdoSpeedometer_ST3_8mlouci43d97tcfc95n5bqkid, rba_Nds_CanTransmitPduLinkageRef=rba_Nds_CanTransmitPduLinkage_DI_OdoSpeedometer_ST3_d51h7apu0p6erk4x2uv7ypbjk
            rba_Nds_CanTransmitFrame_DIAG_Stat_ST3_dt8bq8tgaz165b4x6hqjhzofe: rba_Nds_CanFrameTxBehavior=CAN_FD, rba_Nds_CanFrameTriggeringRef=rba_Nds_CanFrameTriggering_DIAG_Stat_ST3_dt8bq8tgaz165b4x6hqjhzofe, rba_Nds_CanTransmitPduLinkageRef=rba_Nds_CanTransmitPduLinkage_DIAG_Stat_ST3_7wcdjjvxsq7cvcqwamzuwla9r
            rba_Nds_CanTransmitFrame_Ign_Stat_ST3_azv2kpz5f3i2ckijly43qh64y: rba_Nds_CanFrameTxBehavior=CAN_FD, rba_Nds_CanFrameTriggeringRef=rba_Nds_CanFrameTriggering_Ign_Stat_ST3_azv2kpz5f3i2ckijly43qh64y, rba_Nds_CanTransmitPduLinkageRef=rba_Nds_CanTransmitPduLinkage_Ign_Stat_ST3_6g0xknvbw6ctbm94m0moj11hz
            rba_Nds_CanTransmitFrame_BCS_Whl_Msg1_BTC_ST3_88gp48lncz4sl99hiznckz4ft: rba_Nds_CanFrameTxBehavior=CAN_FD, rba_Nds_CanFrameTriggeringRef=rba_Nds_CanFrameTriggering_BCS_Whl_Msg1_BTC_ST3_88gp48lncz4sl99hiznckz4ft, rba_Nds_CanTransmitPduLinkageRef=rba_Nds_CanTransmitPduLinkage_BCS_Whl_Msg1_BTC_ST3_8a04iqb2oetawgg1tamq1ygln
            rba_Nds_CanTransmitFrame_PT4_PTCoor4_SecOC_ST3_3p7mhse2f5pn836ryyf6obbjo: rba_Nds_CanFrameTxBehavior=CAN_FD, rba_Nds_CanFrameTriggeringRef=rba_Nds_CanFrameTriggering_PT4_PTCoor4_SecOC_ST3_3p7mhse2f5pn836ryyf6obbjo, rba_Nds_CanTransmitPduLinkageRef=rba_Nds_CanTransmitPduLinkage_PT4_PTCoor4_ST3_7k5tx1ze82mns06hxebn4axs5
            rba_Nds_CanTransmitFrame_PN14_Master_Stat1_SecOC_ST3_eos1ildj6v44zy7pnb4ojc1r4: rba_Nds_CanFrameTxBehavior=CAN_FD, rba_Nds_CanFrameTriggeringRef=rba_Nds_CanFrameTriggering_PN14_Master_Stat1_SecOC_ST3_eos1ildj6v44zy7pnb4ojc1r4, rba_Nds_CanTransmitPduLinkageRef=rba_Nds_CanTransmitPduLinkage_PN14_Master_Stat1_ST3_ck5rf1gmu93402vsfgdnyzarn
            rba_Nds_CanTransmitFrame_VSS_TP_VIN_ST3_zo0ajku7bsc0uzxi9vkshgiq: rba_Nds_CanFrameTxBehavior=CAN_FD, rba_Nds_CanFrameTriggeringRef=rba_Nds_CanFrameTriggering_VSS_TP_VIN_ST3_zo0ajku7bsc0uzxi9vkshgiq, rba_Nds_CanTransmitPduLinkageRef=rba_Nds_CanReceivePduLinkage_VSS_TP_VIN_ST3_4nk9rxvqgs3grjwivgjcdu51j
            rba_Nds_CanTransmitFrame_VSS_TP_SharedSecret_ST3_2qm4y40dwmslooj3ccjmc5rvn: rba_Nds_CanFrameTxBehavior=CAN_FD, rba_Nds_CanFrameTriggeringRef=rba_Nds_CanFrameTriggering_VSS_TP_SharedSecret_ST3_2qm4y40dwmslooj3ccjmc5rvn, rba_Nds_CanTransmitPduLinkageRef=rba_Nds_CanReceivePduLinkage_VSS_TP_SharedSecret_ST3_88tqqosaxmp4sl3xcmxab9vk5
            rba_Nds_CanTransmitFrame_VSS_TP_SecTickCount_Lvl1_ST3_e35z9ulel939vqa575s89n6fb: rba_Nds_CanFrameTxBehavior=CAN_FD, rba_Nds_CanFrameTriggeringRef=rba_Nds_CanFrameTriggering_VSS_TP_SecTickCount_Lvl1_ST3_e35z9ulel939vqa575s89n6fb, rba_Nds_CanTransmitPduLinkageRef=rba_Nds_CanReceivePduLinkage_VSS_TP_SecTickCount_Lvl1_ST3_6z5nkrjami4ggt3euhfetk7ow
            rba_Nds_CanTransmitFrame_VSS_TP_RealTmOffset_ST3_6pqq39zzkyaxjkhkpx4w6k2cd: rba_Nds_CanFrameTxBehavior=CAN_FD, rba_Nds_CanFrameTriggeringRef=rba_Nds_CanFrameTriggering_VSS_TP_RealTmOffset_ST3_6pqq39zzkyaxjkhkpx4w6k2cd, rba_Nds_CanTransmitPduLinkageRef=rba_Nds_CanReceivePduLinkage_VSS_TP_RealTmOffset_ST3_4fzwxp0omvccavnefvnhtwbc7
            rba_Nds_CanTransmitFrame_VSS_TP_Auth_ST3_b0vczbv4viw3unw4ui2xxf7i9: rba_Nds_CanFrameTxBehavior=CAN_FD, rba_Nds_CanFrameTriggeringRef=rba_Nds_CanFrameTriggering_VSS_TP_Auth_ST3_b0vczbv4viw3unw4ui2xxf7i9, rba_Nds_CanTransmitPduLinkageRef=rba_Nds_CanReceivePduLinkage_VSS_TP_Auth_ST3_7ysnahxb0suco3wwriicgs0im
          rba_Nds_CanTransmitPduLinkage_IMU_A_Output_Fast_ST3_bqi5o7xakr4svvuyh363ta1md (rba_Nds_CanTransmitPduLinkage):
            rba_Nds_CanPduTriggeringRef = rba_Nds_CanPduTriggering_IMU_A_Output_Fast_ST3_bqi5o7xakr4svvuyh363ta1md
            rba_Nds_TransmitPduRef = rba_Nds_TransmitPdu_IMU_A_Output_Fast_ST3_secured
          rba_Nds_CanTransmitFrame_IMU_A_Output_Fast_ST3_d33wkvtuwgnwwqqgrob3dgi12 (rba_Nds_CanTransmitFrame):
            rba_Nds_FramePollingPeriod = 5
            rba_Nds_CanFrameTxBehavior = CAN_FD
            rba_Nds_CanFrameTriggeringRef = rba_Nds_CanFrameTriggering_IMU_A_Output_Fast_ST3_d33wkvtuwgnwwqqgrob3dgi12
            rba_Nds_CanTransmitPduLinkageRef = rba_Nds_CanTransmitPduLinkage_IMU_A_Output_Fast_ST3_bqi5o7xakr4svvuyh363ta1md
          12 x rba_Nds_CanTransmitPduLinkage:
            rba_Nds_CanTransmitPduLinkage_FBL_Cfg_Star3_ST3_99p3uqy39g6epfv2pbzswmxpx: rba_Nds_CanPduTriggeringRef=rba_Nds_CanPduTriggering_FBL_Cfg_Star3_ST3_99p3uqy39g6epfv2pbzswmxpx, rba_Nds_TransmitPduRef=rba_Nds_TransmitPdu_FBL_Cfg_Star3_ST3
            rba_Nds_CanTransmitPduLinkage_DI_OdoSpeedometer_ST3_d51h7apu0p6erk4x2uv7ypbjk: rba_Nds_CanPduTriggeringRef=rba_Nds_CanPduTriggering_DI_OdoSpeedometer_ST3_d51h7apu0p6erk4x2uv7ypbjk, rba_Nds_TransmitPduRef=rba_Nds_TransmitPdu_DI_OdoSpeedometer_ST3
            rba_Nds_CanTransmitPduLinkage_DIAG_Stat_ST3_7wcdjjvxsq7cvcqwamzuwla9r: rba_Nds_CanPduTriggeringRef=rba_Nds_CanPduTriggering_DIAG_Stat_ST3_7wcdjjvxsq7cvcqwamzuwla9r, rba_Nds_TransmitPduRef=rba_Nds_TransmitPdu_DIAG_Stat_ST3
            rba_Nds_CanTransmitPduLinkage_Ign_Stat_ST3_6g0xknvbw6ctbm94m0moj11hz: rba_Nds_CanPduTriggeringRef=rba_Nds_CanPduTriggering_Ign_Stat_ST3_6g0xknvbw6ctbm94m0moj11hz, rba_Nds_TransmitPduRef=rba_Nds_TransmitPdu_Ign_Stat_ST3_secured
            rba_Nds_CanTransmitPduLinkage_BCS_Whl_Msg1_BTC_ST3_8a04iqb2oetawgg1tamq1ygln: rba_Nds_CanPduTriggeringRef=rba_Nds_CanPduTriggering_BCS_Whl_Msg1_BTC_ST3_8a04iqb2oetawgg1tamq1ygln, rba_Nds_TransmitPduRef=rba_Nds_TransmitPdu_BCS_Whl_Msg1_BTC_ST3_secured
            rba_Nds_CanTransmitPduLinkage_PT4_PTCoor4_ST3_7k5tx1ze82mns06hxebn4axs5: rba_Nds_CanPduTriggeringRef=rba_Nds_CanPduTriggering_PT4_PTCoor4_ST3_7k5tx1ze82mns06hxebn4axs5, rba_Nds_TransmitPduRef=rba_Nds_TransmitPdu_PT4_PTCoor4_ST3_secured
            rba_Nds_CanTransmitPduLinkage_PN14_Master_Stat1_ST3_ck5rf1gmu93402vsfgdnyzarn: rba_Nds_CanPduTriggeringRef=rba_Nds_CanPduTriggering_PN14_Master_Stat1_ST3_ck5rf1gmu93402vsfgdnyzarn, rba_Nds_TransmitPduRef=rba_Nds_TransmitPdu_PN14_Master_Stat1_ST3_secured
            rba_Nds_CanReceivePduLinkage_VSS_TP_VIN_ST3_4nk9rxvqgs3grjwivgjcdu51j: rba_Nds_CanPduTriggeringRef=rba_Nds_CanPduTriggering_VSS_TP_VIN_ST3_4nk9rxvqgs3grjwivgjcdu51j, rba_Nds_TransmitPduRef=rba_Nds_TransmitPdu_VSS_TP_VIN_ST3
            rba_Nds_CanReceivePduLinkage_VSS_TP_SharedSecret_ST3_88tqqosaxmp4sl3xcmxab9vk5: rba_Nds_CanPduTriggeringRef=rba_Nds_CanPduTriggering_VSS_TP_SharedSecret_ST3_88tqqosaxmp4sl3xcmxab9vk5, rba_Nds_TransmitPduRef=rba_Nds_TransmitPdu_VSS_TP_SharedSecret_ST3
            rba_Nds_CanReceivePduLinkage_VSS_TP_SecTickCount_Lvl1_ST3_6z5nkrjami4ggt3euhfetk7ow: rba_Nds_CanPduTriggeringRef=rba_Nds_CanPduTriggering_VSS_TP_SecTickCount_Lvl1_ST3_6z5nkrjami4ggt3euhfetk7ow, rba_Nds_TransmitPduRef=rba_Nds_TransmitPdu_VSS_TP_SecTickCount_Lvl1_ST3
            rba_Nds_CanReceivePduLinkage_VSS_TP_RealTmOffset_ST3_4fzwxp0omvccavnefvnhtwbc7: rba_Nds_CanPduTriggeringRef=rba_Nds_CanPduTriggering_VSS_TP_RealTmOffset_ST3_4fzwxp0omvccavnefvnhtwbc7, rba_Nds_TransmitPduRef=rba_Nds_TransmitPdu_VSS_TP_RealTmOffset_ST3
            rba_Nds_CanReceivePduLinkage_VSS_TP_Auth_ST3_7ysnahxb0suco3wwriicgs0im: rba_Nds_CanPduTriggeringRef=rba_Nds_CanPduTriggering_VSS_TP_Auth_ST3_7ysnahxb0suco3wwriicgs0im, rba_Nds_TransmitPduRef=rba_Nds_TransmitPdu_VSS_TP_Auth_ST3
        rba_Nds_CanConnector_HAD_BACKUP (rba_Nds_CanConnector): rba_Nds_CanControllerRef=rba_Nds_CanController_CanIfControllerConfig_1, rba_Nds_CanNetworkRef=rba_Nds_CanNetwork_HAD_BACKUP
          3 x rba_Nds_CanReceivePduLinkage:
            rba_Nds_CanReceivePduLinkage_ESP_HAD_BACKUP_COM_Container1_ST3_9wgr7acccdjxfn4xsmzzlmfj6: rba_Nds_CanPduTriggeringRef=rba_Nds_CanPduTriggering_ESP_HAD_BACKUP_COM_Container1_ST3_9wgr7acccdjxfn4xsmzzlmfj6, rba_Nds_ReceivePduRef=rba_Nds_ReceivePdu_ESP_HAD_BACKUP_COM_Container1_ST3_ContainerIPdu
            rba_Nds_CanReceivePduLinkage_ESP_HAD_BACKUP_COM_Container1_ST3_ESP_HAD_BACKUP_COM_Container1_ST3_BCS_Whl_Msg1_BTC_ST3_16ebm65e7roje1m2kqzv87azq: rba_Nds_CanPduTriggeringRef=rba_Nds_CanPduTriggering_ESP_HAD_BACKUP_COM_Container1_ST3_ESP_HAD_BACKUP_COM_Container1_ST3_BCS_Whl_Msg1_BTC_ST3_16ebm65e7roje1m2kqzv87azq, rba_Nds_ReceivePduRef=rba_Nds_ReceivePdu_ESP_HAD_BACKUP_COM_Container1_ST3_ESP_HAD_BACKUP_COM_Container1_ST3_BCS_Whl_Msg1_BTC_ST3_secured
            rba_Nds_CanReceivePduLinkage_ESP_HAD_BACKUP_COM_Container1_ST3_ESP_HAD_BACKUP_COM_Container1_ST3_BCS_Whl_Msg1_BTC_ST3_5veu2p0tm6432xnhqor79qs7k: rba_Nds_CanPduTriggeringRef=rba_Nds_CanPduTriggering_ESP_HAD_BACKUP_COM_Container1_ST3_ESP_HAD_BACKUP_COM_Container1_ST3_BCS_Whl_Msg1_BTC_ST3_5veu2p0tm6432xnhqor79qs7k, rba_Nds_ReceivePduRef=rba_Nds_ReceivePdu_ESP_HAD_BACKUP_COM_Container1_ST3_BCS_Whl_Msg1_BTC_ST3
          rba_Nds_CanReceiveFrame_FBL_CFG_Star3_ST3_16bmiwrdd9xf3hibeboe5uaeu (rba_Nds_CanReceiveFrame):
            rba_Nds_CanFrameRxBehavior = CAN_FD
            rba_Nds_FramePollingPeriod = 5
            rba_Nds_CanFrameTriggeringRef = rba_Nds_CanFrameTriggering_FBL_CFG_Star3_ST3_16bmiwrdd9xf3hibeboe5uaeu
            rba_Nds_CanReceivePduLinkageRef = rba_Nds_CanReceivePduLinkage_FBL_Cfg_Star3_ST3_27m9sbzvs2f0s09avctwlewte
          rba_Nds_CanReceiveFrame_ESP_HAD_BACKUP_GW_Container3_ST3_22qnrsrd5p7i7sxhq5h7qa6eh (rba_Nds_CanReceiveFrame):
            rba_Nds_CanFrameRxBehavior = CAN_FD
            rba_Nds_FramePollingPeriod = 5
            rba_Nds_CanFrameTriggeringRef = rba_Nds_CanFrameTriggering_ESP_HAD_BACKUP_GW_Container3_ST3_22qnrsrd5p7i7sxhq5h7qa6eh
            rba_Nds_CanReceivePduLinkageRef = rba_Nds_CanReceivePduLinkage_ESP_HAD_BACKUP_GW_Container3_ST3_es20z922k0hdxd542vyccnt5z
          11 x rba_Nds_CanReceivePduLinkage:
            rba_Nds_CanReceivePduLinkage_ESP_HAD_BACKUP_GW_Container2_ST3_aadd7dff7rkg0cjrmt2mmksbu: rba_Nds_CanPduTriggeringRef=rba_Nds_CanPduTriggering_ESP_HAD_BACKUP_GW_Container2_ST3_aadd7dff7rkg0cjrmt2mmksbu, rba_Nds_ReceivePduRef=rba_Nds_ReceivePdu_ESP_HAD_BACKUP_GW_Container2_ST3_ContainerIPdu
            rba_Nds_CanReceivePduLinkage_ESP_HAD_BACKUP_GW_Container2_ST3_ESP_HAD_BACKUP_GW_Container2_ST3_Ign_Stat_ST3_2evpht35ev1p8y12nz0ebo5h3: rba_Nds_CanPduTriggeringRef=rba_Nds_CanPduTriggering_ESP_HAD_BACKUP_GW_Container2_ST3_ESP_HAD_BACKUP_GW_Container2_ST3_Ign_Stat_ST3_2evpht35ev1p8y12nz0ebo5h3, rba_Nds_ReceivePduRef=rba_Nds_ReceivePdu_ESP_HAD_BACKUP_GW_Container2_ST3_ESP_HAD_BACKUP_GW_Container2_ST3_Ign_Stat_ST3_secured
            rba_Nds_CanReceivePduLinkage_ESP_HAD_BACKUP_GW_Container2_ST3_ESP_HAD_BACKUP_GW_Container2_ST3_Ign_Stat_ST3_bcjlclrj2mauvscq34e4kbcj3: rba_Nds_CanPduTriggeringRef=rba_Nds_CanPduTriggering_ESP_HAD_BACKUP_GW_Container2_ST3_ESP_HAD_BACKUP_GW_Container2_ST3_Ign_Stat_ST3_bcjlclrj2mauvscq34e4kbcj3, rba_Nds_ReceivePduRef=rba_Nds_ReceivePdu_ESP_HAD_BACKUP_GW_Container2_ST3_Ign_Stat_ST3
            rba_Nds_CanReceivePduLinkage_ESP_HAD_BACKUP_GW_Container2_ST3_ESP_HAD_BACKUP_GW_Container2_ST3_PT4_PTCoor4_ST3_4jwqfrzf6ypk91w3rckoip7tp: rba_Nds_CanPduTriggeringRef=rba_Nds_CanPduTriggering_ESP_HAD_BACKUP_GW_Container2_ST3_ESP_HAD_BACKUP_GW_Container2_ST3_PT4_PTCoor4_ST3_4jwqfrzf6ypk91w3rckoip7tp, rba_Nds_ReceivePduRef=rba_Nds_ReceivePdu_ESP_HAD_BACKUP_GW_Container2_ST3_ESP_HAD_BACKUP_GW_Container2_ST3_PT4_PTCoor4_ST3_secured
            rba_Nds_CanReceivePduLinkage_ESP_HAD_BACKUP_GW_Container2_ST3_ESP_HAD_BACKUP_GW_Container2_ST3_PT4_PTCoor4_ST3_9c9xmhimk3956a8bl74rmvxi7: rba_Nds_CanPduTriggeringRef=rba_Nds_CanPduTriggering_ESP_HAD_BACKUP_GW_Container2_ST3_ESP_HAD_BACKUP_GW_Container2_ST3_PT4_PTCoor4_ST3_9c9xmhimk3956a8bl74rmvxi7, rba_Nds_ReceivePduRef=rba_Nds_ReceivePdu_ESP_HAD_BACKUP_GW_Container2_ST3_PT4_PTCoor4_ST3
            rba_Nds_CanReceivePduLinkage_ESP_HAD_BACKUP_GW_Container4_ST3_377j3yoh64pojpc5ok3dvykes: rba_Nds_CanPduTriggeringRef=rba_Nds_CanPduTriggering_ESP_HAD_BACKUP_GW_Container4_ST3_377j3yoh64pojpc5ok3dvykes, rba_Nds_ReceivePduRef=rba_Nds_ReceivePdu_ESP_HAD_BACKUP_GW_Container4_ST3_ContainerIPdu
            rba_Nds_CanReceivePduLinkage_ESP_HAD_BACKUP_GW_Container4_ST3_ESP_HAD_BACKUP_GW_Container4_ST3_DI_OdoSpeedometer_ST3_8fnay511jh4db945s2stpdw7p: rba_Nds_CanPduTriggeringRef=rba_Nds_CanPduTriggering_ESP_HAD_BACKUP_GW_Container4_ST3_ESP_HAD_BACKUP_GW_Container4_ST3_DI_OdoSpeedometer_ST3_8fnay511jh4db945s2stpdw7p, rba_Nds_ReceivePduRef=rba_Nds_ReceivePdu_ESP_HAD_BACKUP_GW_Container4_ST3_ESP_HAD_BACKUP_GW_Container4_ST3_DI_OdoSpeedometer_ST3_secured
            rba_Nds_CanReceivePduLinkage_ESP_HAD_BACKUP_GW_Container4_ST3_ESP_HAD_BACKUP_GW_Container4_ST3_DI_OdoSpeedometer_ST3_2wrcqkh4ub39zvlu7w28s2r1f: rba_Nds_CanPduTriggeringRef=rba_Nds_CanPduTriggering_ESP_HAD_BACKUP_GW_Container4_ST3_ESP_HAD_BACKUP_GW_Container4_ST3_DI_OdoSpeedometer_ST3_2wrcqkh4ub39zvlu7w28s2r1f, rba_Nds_ReceivePduRef=rba_Nds_ReceivePdu_ESP_HAD_BACKUP_GW_Container4_ST3_DI_OdoSpeedometer_ST3
            rba_Nds_CanReceivePduLinkage_ESP_HAD_BACKUP_GW_Container4_ST3_ESP_HAD_BACKUP_GW_Container4_ST3_DIAG_Stat_ST3_a9kzo9c723k3h5cgrsehf20w0: rba_Nds_CanPduTriggeringRef=rba_Nds_CanPduTriggering_ESP_HAD_BACKUP_GW_Container4_ST3_ESP_HAD_BACKUP_GW_Container4_ST3_DIAG_Stat_ST3_a9kzo9c723k3h5cgrsehf20w0, rba_Nds_ReceivePduRef=rba_Nds_ReceivePdu_ESP_HAD_BACKUP_GW_Container4_ST3_DIAG_Stat_ST3
            rba_Nds_CanReceivePduLinkage_ESP_HAD_BACKUP_GW_Container4_ST3_ESP_HAD_BACKUP_GW_Container4_ST3_PN14_Master_Stat1_ST3_11xqv03a1oeng5zctxoxlpsa: rba_Nds_CanPduTriggeringRef=rba_Nds_CanPduTriggering_ESP_HAD_BACKUP_GW_Container4_ST3_ESP_HAD_BACKUP_GW_Container4_ST3_PN14_Master_Stat1_ST3_11xqv03a1oeng5zctxoxlpsa, rba_Nds_ReceivePduRef=rba_Nds_ReceivePdu_ESP_HAD_BACKUP_GW_Container4_ST3_ESP_HAD_BACKUP_GW_Container4_ST3_PN14_Master_Stat1_ST3_secured
            rba_Nds_CanReceivePduLinkage_ESP_HAD_BACKUP_GW_Container4_ST3_ESP_HAD_BACKUP_GW_Container4_ST3_PN14_Master_Stat1_ST3_6wlpxzn4ez9a5ru3exv8xu1x7: rba_Nds_CanPduTriggeringRef=rba_Nds_CanPduTriggering_ESP_HAD_BACKUP_GW_Container4_ST3_ESP_HAD_BACKUP_GW_Container4_ST3_PN14_Master_Stat1_ST3_6wlpxzn4ez9a5ru3exv8xu1x7, rba_Nds_ReceivePduRef=rba_Nds_ReceivePdu_ESP_HAD_BACKUP_GW_Container4_ST3_PN14_Master_Stat1_ST3
          3 x rba_Nds_CanReceiveFrame, all with rba_Nds_FramePollingPeriod=5, rba_Nds_CanFrameRxBehavior=CAN_FD:
            rba_Nds_CanReceiveFrame_ESP_HAD_BACKUP_COM_Container1_ST3_m7h6933xsls2hbt3g5pz7rbf: rba_Nds_CanFrameTriggeringRef=rba_Nds_CanFrameTriggering_ESP_HAD_BACKUP_COM_Container1_ST3_m7h6933xsls2hbt3g5pz7rbf, rba_Nds_CanReceivePduLinkageRef=rba_Nds_CanReceivePduLinkage_ESP_HAD_BACKUP_COM_Container1_ST3_9wgr7acccdjxfn4xsmzzlmfj6
            rba_Nds_CanReceiveFrame_ESP_HAD_BACKUP_GW_Container2_ST3_deec5dnwupxl75uf6xumsqsv3: rba_Nds_CanFrameTriggeringRef=rba_Nds_CanFrameTriggering_ESP_HAD_BACKUP_GW_Container2_ST3_deec5dnwupxl75uf6xumsqsv3, rba_Nds_CanReceivePduLinkageRef=rba_Nds_CanReceivePduLinkage_ESP_HAD_BACKUP_GW_Container2_ST3_aadd7dff7rkg0cjrmt2mmksbu
            rba_Nds_CanReceiveFrame_ESP_HAD_BACKUP_GW_Container4_ST3_66g2nnp4u3e1cromt6kb2ifeb: rba_Nds_CanFrameTriggeringRef=rba_Nds_CanFrameTriggering_ESP_HAD_BACKUP_GW_Container4_ST3_66g2nnp4u3e1cromt6kb2ifeb, rba_Nds_CanReceivePduLinkageRef=rba_Nds_CanReceivePduLinkage_ESP_HAD_BACKUP_GW_Container4_ST3_377j3yoh64pojpc5ok3dvykes
          7 x rba_Nds_CanReceivePduLinkage:
            rba_Nds_CanReceivePduLinkage_FBL_Cfg_Star3_ST3_27m9sbzvs2f0s09avctwlewte: rba_Nds_CanPduTriggeringRef=rba_Nds_CanPduTriggering_FBL_Cfg_Star3_ST3_27m9sbzvs2f0s09avctwlewte, rba_Nds_ReceivePduRef=rba_Nds_ReceivePdu_FBL_Cfg_Star3_ST3
            rba_Nds_CanReceivePduLinkage_ESP_HAD_BACKUP_GW_Container3_ST3_es20z922k0hdxd542vyccnt5z: rba_Nds_CanPduTriggeringRef=rba_Nds_CanPduTriggering_ESP_HAD_BACKUP_GW_Container3_ST3_es20z922k0hdxd542vyccnt5z, rba_Nds_ReceivePduRef=rba_Nds_ReceivePdu_ESP_HAD_BACKUP_GW_Container3_ST3_ContainerIPdu
            rba_Nds_CanReceivePduLinkage_ESP_HAD_BACKUP_GW_Container3_ST3_ESP_HAD_BACKUP_GW_Container3_ST3_VSS_TP_VIN_ST3_3331jz4zbik8yl0ehm51yf8w4: rba_Nds_CanPduTriggeringRef=rba_Nds_CanPduTriggering_ESP_HAD_BACKUP_GW_Container3_ST3_ESP_HAD_BACKUP_GW_Container3_ST3_VSS_TP_VIN_ST3_3331jz4zbik8yl0ehm51yf8w4, rba_Nds_ReceivePduRef=rba_Nds_ReceivePdu_ESP_HAD_BACKUP_GW_Container3_ST3_VSS_TP_VIN_ST3
            rba_Nds_CanReceivePduLinkage_ESP_HAD_BACKUP_GW_Container3_ST3_ESP_HAD_BACKUP_GW_Container3_ST3_VSS_TP_SharedSecret_ST3_82pb6fg4cswmgotegs6aplrj2: rba_Nds_CanPduTriggeringRef=rba_Nds_CanPduTriggering_ESP_HAD_BACKUP_GW_Container3_ST3_ESP_HAD_BACKUP_GW_Container3_ST3_VSS_TP_SharedSecret_ST3_82pb6fg4cswmgotegs6aplrj2, rba_Nds_ReceivePduRef=rba_Nds_ReceivePdu_ESP_HAD_BACKUP_GW_Container3_ST3_VSS_TP_SharedSecret_ST3
            rba_Nds_CanReceivePduLinkage_ESP_HAD_BACKUP_GW_Container3_ST3_ESP_HAD_BACKUP_GW_Container3_ST3_VSS_TP_SecTickCount_Lvl1_ST3_azhv8t4onxhjhi2zn8in2my2n: rba_Nds_CanPduTriggeringRef=rba_Nds_CanPduTriggering_ESP_HAD_BACKUP_GW_Container3_ST3_ESP_HAD_BACKUP_GW_Container3_ST3_VSS_TP_SecTickCount_Lvl1_ST3_azhv8t4onxhjhi2zn8in2my2n, rba_Nds_ReceivePduRef=rba_Nds_ReceivePdu_ESP_HAD_BACKUP_GW_Container3_ST3_VSS_TP_SecTickCount_Lvl1_ST3
            rba_Nds_CanReceivePduLinkage_ESP_HAD_BACKUP_GW_Container3_ST3_ESP_HAD_BACKUP_GW_Container3_ST3_VSS_TP_RealTmOffset_ST3_2686huv0x9rg4cu1k20p07zrz: rba_Nds_CanPduTriggeringRef=rba_Nds_CanPduTriggering_ESP_HAD_BACKUP_GW_Container3_ST3_ESP_HAD_BACKUP_GW_Container3_ST3_VSS_TP_RealTmOffset_ST3_2686huv0x9rg4cu1k20p07zrz, rba_Nds_ReceivePduRef=rba_Nds_ReceivePdu_ESP_HAD_BACKUP_GW_Container3_ST3_VSS_TP_RealTmOffset_ST3
            rba_Nds_CanReceivePduLinkage_ESP_HAD_BACKUP_GW_Container3_ST3_ESP_HAD_BACKUP_GW_Container3_ST3_VSS_TP_Auth_ST3_a5m1oehgi1yzcicgsdebhigxy: rba_Nds_CanPduTriggeringRef=rba_Nds_CanPduTriggering_ESP_HAD_BACKUP_GW_Container3_ST3_ESP_HAD_BACKUP_GW_Container3_ST3_VSS_TP_Auth_ST3_a5m1oehgi1yzcicgsdebhigxy, rba_Nds_ReceivePduRef=rba_Nds_ReceivePdu_ESP_HAD_BACKUP_GW_Container3_ST3_VSS_TP_Auth_ST3
          rba_Nds_CanTransmitPduLinkage_IMU_A_Output_ST3_brfz9q0nahr147hbo9yhq1vvv (rba_Nds_CanTransmitPduLinkage):
            rba_Nds_CanPduTriggeringRef = rba_Nds_CanPduTriggering_IMU_A_Output_ST3_brfz9q0nahr147hbo9yhq1vvv
            rba_Nds_TransmitPduRef = rba_Nds_TransmitPdu_IMU_A_Output_ST3
          rba_Nds_CanTransmitPduLinkage_IMU_A_Output_ST3_32ru3309rvckjvcx6fmcjcw7u (rba_Nds_CanTransmitPduLinkage):
            rba_Nds_CanPduTriggeringRef = rba_Nds_CanPduTriggering_IMU_A_Output_ST3_32ru3309rvckjvcx6fmcjcw7u
            rba_Nds_TransmitPduRef = rba_Nds_TransmitPdu_IMU_A_Output_ST3_secured
          rba_Nds_CanTransmitFrame_IMU_A_Output_ST3_a6686b0hkqb3mtkryedfilug7 (rba_Nds_CanTransmitFrame):
            rba_Nds_FramePollingPeriod = 5
            rba_Nds_CanFrameTxBehavior = CAN_FD
            rba_Nds_CanFrameTriggeringRef = rba_Nds_CanFrameTriggering_IMU_A_Output_ST3_a6686b0hkqb3mtkryedfilug7
            rba_Nds_CanTransmitPduLinkageRef = rba_Nds_CanTransmitPduLinkage_IMU_A_Output_ST3_32ru3309rvckjvcx6fmcjcw7u
          3 x rba_Nds_CanReceivePduLinkage:
            rba_Nds_CanReceivePduLinkage_IDC_S_FSI_HAD_BACKUP_Container_ST3_1dm671vl0shzss367w9qvi14o: rba_Nds_CanPduTriggeringRef=rba_Nds_CanPduTriggering_IDC_S_FSI_HAD_BACKUP_Container_ST3_1dm671vl0shzss367w9qvi14o, rba_Nds_ReceivePduRef=rba_Nds_ReceivePdu_IDC_S_FSI_HAD_BACKUP_Container_ST3_ContainerIPdu
            rba_Nds_CanReceivePduLinkage_IDC_S_FSI_HAD_BACKUP_Container_ST3_IDC_S_FSI_HAD_BACKUP_Container_ST3_ADAS_HAD_Stat_IDC_S_FSI_Bckp_ST3_e7ytolt7jqvzpt1pm38yc9jmy: rba_Nds_CanPduTriggeringRef=rba_Nds_CanPduTriggering_IDC_S_FSI_HAD_BACKUP_Container_ST3_IDC_S_FSI_HAD_BACKUP_Container_ST3_ADAS_HAD_Stat_IDC_S_FSI_Bckp_ST3_e7ytolt7jqvzpt1pm38yc9jmy, rba_Nds_ReceivePduRef=rba_Nds_ReceivePdu_IDC_S_FSI_HAD_BACKUP_Container_ST3_IDC_S_FSI_HAD_BACKUP_Container_ST3_ADAS_HAD_Stat_IDC_S_FSI_Bckp_ST3_secured
            rba_Nds_CanReceivePduLinkage_IDC_S_FSI_HAD_BACKUP_Container_ST3_IDC_S_FSI_HAD_BACKUP_Container_ST3_ADAS_HAD_Stat_IDC_S_FSI_Bckp_ST3_ahdgtkk54cgxy874ini32xhdq: rba_Nds_CanPduTriggeringRef=rba_Nds_CanPduTriggering_IDC_S_FSI_HAD_BACKUP_Container_ST3_IDC_S_FSI_HAD_BACKUP_Container_ST3_ADAS_HAD_Stat_IDC_S_FSI_Bckp_ST3_ahdgtkk54cgxy874ini32xhdq, rba_Nds_ReceivePduRef=rba_Nds_ReceivePdu_IDC_S_FSI_HAD_BACKUP_Container_ST3_ADAS_HAD_Stat_IDC_S_FSI_Bckp_ST3
          rba_Nds_CanReceiveFrame_IDC_S_FSI_HAD_BACKUP_Container_ST3_bos8n1et2rfcc9ip3ug9buoj1 (rba_Nds_CanReceiveFrame):
            rba_Nds_FramePollingPeriod = 5
            rba_Nds_CanFrameRxBehavior = CAN_FD
            rba_Nds_CanFrameTriggeringRef = rba_Nds_CanFrameTriggering_IDC_S_FSI_HAD_BACKUP_Container_ST3_bos8n1et2rfcc9ip3ug9buoj1
            rba_Nds_CanReceivePduLinkageRef = rba_Nds_CanReceivePduLinkage_IDC_S_FSI_HAD_BACKUP_Container_ST3_1dm671vl0shzss367w9qvi14o
      rba_Nds_Gateway
        12 x rba_Nds_PduMapping:
          rba_Nds_PduMapping_0_FBL_Cfg_Star3_ST3_99p3uqy39g6epfv2pbzswmxpx
            rba_Nds_SourcePdu: rba_Nds_ReceivePduLinkageRef=rba_Nds_CanReceivePduLinkage_FBL_Cfg_Star3_ST3_27m9sbzvs2f0s09avctwlewte
            rba_Nds_TargetPdu: rba_Nds_TransmitPduLinkageRef=rba_Nds_CanTransmitPduLinkage_FBL_Cfg_Star3_ST3_99p3uqy39g6epfv2pbzswmxpx
          rba_Nds_PduMapping_2_DI_OdoSpeedometer_ST3_d51h7apu0p6erk4x2uv7ypbjk
            rba_Nds_SourcePdu:
              rba_Nds_ReceivePduLinkageRef = rba_Nds_CanReceivePduLinkage_ESP_HAD_BACKUP_GW_Container4_ST3_ESP_HAD_BACKUP_GW_Container4_ST3_DI_OdoSpeedometer_ST3_2wrcqkh4ub39zvlu7w28s2r1f
            rba_Nds_TargetPdu: rba_Nds_TransmitPduLinkageRef=rba_Nds_CanTransmitPduLinkage_DI_OdoSpeedometer_ST3_d51h7apu0p6erk4x2uv7ypbjk
          rba_Nds_PduMapping_6_DIAG_Stat_ST3_7wcdjjvxsq7cvcqwamzuwla9r
            rba_Nds_SourcePdu:
              rba_Nds_ReceivePduLinkageRef = rba_Nds_CanReceivePduLinkage_ESP_HAD_BACKUP_GW_Container4_ST3_ESP_HAD_BACKUP_GW_Container4_ST3_DIAG_Stat_ST3_a9kzo9c723k3h5cgrsehf20w0
            rba_Nds_TargetPdu: rba_Nds_TransmitPduLinkageRef=rba_Nds_CanTransmitPduLinkage_DIAG_Stat_ST3_7wcdjjvxsq7cvcqwamzuwla9r
          rba_Nds_PduMapping_3_Ign_Stat_ST3_6g0xknvbw6ctbm94m0moj11hz
            rba_Nds_SourcePdu:
              rba_Nds_ReceivePduLinkageRef = rba_Nds_CanReceivePduLinkage_ESP_HAD_BACKUP_GW_Container2_ST3_ESP_HAD_BACKUP_GW_Container2_ST3_Ign_Stat_ST3_2evpht35ev1p8y12nz0ebo5h3
            rba_Nds_TargetPdu: rba_Nds_TransmitPduLinkageRef=rba_Nds_CanTransmitPduLinkage_Ign_Stat_ST3_6g0xknvbw6ctbm94m0moj11hz
          rba_Nds_PduMapping_4_BCS_Whl_Msg1_BTC_ST3_8a04iqb2oetawgg1tamq1ygln
            rba_Nds_SourcePdu:
              rba_Nds_ReceivePduLinkageRef = rba_Nds_CanReceivePduLinkage_ESP_HAD_BACKUP_COM_Container1_ST3_ESP_HAD_BACKUP_COM_Container1_ST3_BCS_Whl_Msg1_BTC_ST3_16ebm65e7roje1m2kqzv87azq
            rba_Nds_TargetPdu: rba_Nds_TransmitPduLinkageRef=rba_Nds_CanTransmitPduLinkage_BCS_Whl_Msg1_BTC_ST3_8a04iqb2oetawgg1tamq1ygln
          rba_Nds_PduMapping_5_PT4_PTCoor4_ST3_7k5tx1ze82mns06hxebn4axs5
            rba_Nds_SourcePdu:
              rba_Nds_ReceivePduLinkageRef = rba_Nds_CanReceivePduLinkage_ESP_HAD_BACKUP_GW_Container2_ST3_ESP_HAD_BACKUP_GW_Container2_ST3_PT4_PTCoor4_ST3_4jwqfrzf6ypk91w3rckoip7tp
            rba_Nds_TargetPdu: rba_Nds_TransmitPduLinkageRef=rba_Nds_CanTransmitPduLinkage_PT4_PTCoor4_ST3_7k5tx1ze82mns06hxebn4axs5
          rba_Nds_PduMapping_1_PN14_Master_Stat1_ST3_ck5rf1gmu93402vsfgdnyzarn
            rba_Nds_SourcePdu:
              rba_Nds_ReceivePduLinkageRef = rba_Nds_CanReceivePduLinkage_ESP_HAD_BACKUP_GW_Container4_ST3_ESP_HAD_BACKUP_GW_Container4_ST3_PN14_Master_Stat1_ST3_11xqv03a1oeng5zctxoxlpsa
            rba_Nds_TargetPdu: rba_Nds_TransmitPduLinkageRef=rba_Nds_CanTransmitPduLinkage_PN14_Master_Stat1_ST3_ck5rf1gmu93402vsfgdnyzarn
          rba_Nds_PduMapping_7_VSS_TP_VIN_ST3_4nk9rxvqgs3grjwivgjcdu51j
            rba_Nds_SourcePdu:
              rba_Nds_ReceivePduLinkageRef = rba_Nds_CanReceivePduLinkage_ESP_HAD_BACKUP_GW_Container3_ST3_ESP_HAD_BACKUP_GW_Container3_ST3_VSS_TP_VIN_ST3_3331jz4zbik8yl0ehm51yf8w4
            rba_Nds_TargetPdu: rba_Nds_TransmitPduLinkageRef=rba_Nds_CanReceivePduLinkage_VSS_TP_VIN_ST3_4nk9rxvqgs3grjwivgjcdu51j
          rba_Nds_PduMapping_8_VSS_TP_SharedSecret_ST3_88tqqosaxmp4sl3xcmxab9vk5
            rba_Nds_SourcePdu:
              rba_Nds_ReceivePduLinkageRef = rba_Nds_CanReceivePduLinkage_ESP_HAD_BACKUP_GW_Container3_ST3_ESP_HAD_BACKUP_GW_Container3_ST3_VSS_TP_SharedSecret_ST3_82pb6fg4cswmgotegs6aplrj2
            rba_Nds_TargetPdu: rba_Nds_TransmitPduLinkageRef=rba_Nds_CanReceivePduLinkage_VSS_TP_SharedSecret_ST3_88tqqosaxmp4sl3xcmxab9vk5
          rba_Nds_PduMapping_9_VSS_TP_SecTickCount_Lvl1_ST3_6z5nkrjami4ggt3euhfetk7ow
            rba_Nds_SourcePdu:
              rba_Nds_ReceivePduLinkageRef = rba_Nds_CanReceivePduLinkage_ESP_HAD_BACKUP_GW_Container3_ST3_ESP_HAD_BACKUP_GW_Container3_ST3_VSS_TP_SecTickCount_Lvl1_ST3_azhv8t4onxhjhi2zn8in2my2n
            rba_Nds_TargetPdu: rba_Nds_TransmitPduLinkageRef=rba_Nds_CanReceivePduLinkage_VSS_TP_SecTickCount_Lvl1_ST3_6z5nkrjami4ggt3euhfetk7ow
          rba_Nds_PduMapping_10_VSS_TP_RealTmOffset_ST3_4fzwxp0omvccavnefvnhtwbc7
            rba_Nds_SourcePdu:
              rba_Nds_ReceivePduLinkageRef = rba_Nds_CanReceivePduLinkage_ESP_HAD_BACKUP_GW_Container3_ST3_ESP_HAD_BACKUP_GW_Container3_ST3_VSS_TP_RealTmOffset_ST3_2686huv0x9rg4cu1k20p07zrz
            rba_Nds_TargetPdu: rba_Nds_TransmitPduLinkageRef=rba_Nds_CanReceivePduLinkage_VSS_TP_RealTmOffset_ST3_4fzwxp0omvccavnefvnhtwbc7
          rba_Nds_PduMapping_11_VSS_TP_Auth_ST3_7ysnahxb0suco3wwriicgs0im
            rba_Nds_SourcePdu:
              rba_Nds_ReceivePduLinkageRef = rba_Nds_CanReceivePduLinkage_ESP_HAD_BACKUP_GW_Container3_ST3_ESP_HAD_BACKUP_GW_Container3_ST3_VSS_TP_Auth_ST3_a5m1oehgi1yzcicgsdebhigxy
            rba_Nds_TargetPdu: rba_Nds_TransmitPduLinkageRef=rba_Nds_CanReceivePduLinkage_VSS_TP_Auth_ST3_7ysnahxb0suco3wwriicgs0im
      rba_Nds_EcuProcesses
        rba_Nds_EcuReceiveProcess_20ms (rba_Nds_EcuReceiveProcess): rba_Nds_Name=ComScl_Rx_Proc_20ms, rba_Nds_Period=20, rba_Nds_IsDefaultProcess=true
        rba_Nds_EcuTransmitProcess_5ms (rba_Nds_EcuTransmitProcess): rba_Nds_IsDefaultProcess=true, rba_Nds_Period=5, rba_Nds_Name=ComScl_Tx_Proc_5ms
      rba_Nds_SignalProcessing
        96 x rba_Nds_ReceiveSignalProcessing:
          rba_Nds_ReceiveSignalProcessing_CRC_Ign_Stat_Pr5_ST3: rba_Nds_ReceiveApplicationPortRef=rba_Nds_ReceiveGroupSignalApplicationPort_CRC_Ign_Stat_Pr5_ST3, rba_Nds_ReceiveNetworkPortRef=rba_Nds_ReceiveSignalNetworkPort_CRC_Ign_Stat_Pr5_ST3
          rba_Nds_ReceiveSignalProcessing_SQC_Ign_Stat_Pr5_ST3: rba_Nds_ReceiveApplicationPortRef=rba_Nds_ReceiveGroupSignalApplicationPort_SQC_Ign_Stat_Pr5_ST3, rba_Nds_ReceiveNetworkPortRef=rba_Nds_ReceiveSignalNetworkPort_SQC_Ign_Stat_Pr5_ST3
          rba_Nds_ReceiveSignalProcessing_KG_StartSw_Psd_ST3: rba_Nds_ReceiveApplicationPortRef=rba_Nds_ReceiveGroupSignalApplicationPort_KG_StartSw_Psd_ST3, rba_Nds_ReceiveNetworkPortRef=rba_Nds_ReceiveSignalNetworkPort_KG_StartSw_Psd_ST3
          rba_Nds_ReceiveSignalProcessing_Veh_Op_Mode_ST3: rba_Nds_ReceiveNetworkPortRef=rba_Nds_ReceiveSignalNetworkPort_Veh_Op_Mode_ST3, rba_Nds_ReceiveApplicationPortRef=rba_Nds_ReceiveGroupSignalApplicationPort_Veh_Op_Mode_ST3
          rba_Nds_ReceiveSignalProcessing_ISw_Stat_ST3: rba_Nds_ReceiveNetworkPortRef=rba_Nds_ReceiveSignalNetworkPort_ISw_Stat_ST3, rba_Nds_ReceiveApplicationPortRef=rba_Nds_ReceiveGroupSignalApplicationPort_ISw_Stat_ST3
          rba_Nds_ReceiveSignalProcessing_CRC_PT4_PTCoor4_Pr5_ST3: rba_Nds_ReceiveApplicationPortRef=rba_Nds_ReceiveGroupSignalApplicationPort_CRC_PT4_PTCoor4_Pr5_ST3, rba_Nds_ReceiveNetworkPortRef=rba_Nds_ReceiveSignalNetworkPort_CRC_PT4_PTCoor4_Pr5_ST3
          rba_Nds_ReceiveSignalProcessing_SQC_PT4_PTCoor4_Pr5_ST3: rba_Nds_ReceiveApplicationPortRef=rba_Nds_ReceiveGroupSignalApplicationPort_SQC_PT4_PTCoor4_Pr5_ST3, rba_Nds_ReceiveNetworkPortRef=rba_Nds_ReceiveSignalNetworkPort_SQC_PT4_PTCoor4_Pr5_ST3
          rba_Nds_ReceiveSignalProcessing_Rsrv1_PT4_PTCoor_PT_Rdy_Pr5_ST3: rba_Nds_ReceiveApplicationPortRef=rba_Nds_ReceiveGroupSignalApplicationPort_Rsrv1_PT4_PTCoor_PT_Rdy_Pr5_ST3, rba_Nds_ReceiveNetworkPortRef=rba_Nds_ReceiveSignalNetworkPort_Rsrv1_PT4_PTCoor_PT_Rdy_Pr5_ST3
          rba_Nds_ReceiveSignalProcessing_PT4_PTCoor_PT_Rdy_ST3: rba_Nds_ReceiveApplicationPortRef=rba_Nds_ReceiveGroupSignalApplicationPort_PT4_PTCoor_PT_Rdy_ST3, rba_Nds_ReceiveNetworkPortRef=rba_Nds_ReceiveSignalNetworkPort_PT4_PTCoor_PT_Rdy_ST3
          rba_Nds_ReceiveSignalProcessing_PT4_PTCoor_SSA_EngSp_ST3: rba_Nds_ReceiveApplicationPortRef=rba_Nds_ReceiveGroupSignalApplicationPort_PT4_PTCoor_SSA_EngSp_ST3, rba_Nds_ReceiveNetworkPortRef=rba_Nds_ReceiveSignalNetworkPort_PT4_PTCoor_SSA_EngSp_ST3
          rba_Nds_ReceiveSignalProcessing_PT4_PTCoor_EngStartPN14_Stat_ST3: rba_Nds_ReceiveNetworkPortRef=rba_Nds_ReceiveSignalNetworkPort_PT4_PTCoor_EngStartPN14_Stat_ST3, rba_Nds_ReceiveApplicationPortRef=rba_Nds_ReceiveGroupSignalApplicationPort_PT4_PTCoor_EngStartPN14_Stat_ST3
          rba_Nds_ReceiveSignalProcessing_CRC_DI_Odo_Pr5_ST3: rba_Nds_ReceiveApplicationPortRef=rba_Nds_ReceiveGroupSignalApplicationPort_CRC_DI_Odo_Pr5_ST3, rba_Nds_ReceiveNetworkPortRef=rba_Nds_ReceiveSignalNetworkPort_CRC_DI_Odo_Pr5_ST3
          rba_Nds_ReceiveSignalProcessing_SQC_DI_Odo_Pr5_ST3: rba_Nds_ReceiveApplicationPortRef=rba_Nds_ReceiveGroupSignalApplicationPort_SQC_DI_Odo_Pr5_ST3, rba_Nds_ReceiveNetworkPortRef=rba_Nds_ReceiveSignalNetworkPort_SQC_DI_Odo_Pr5_ST3
          rba_Nds_ReceiveSignalProcessing_Odo_ST3: rba_Nds_ReceiveApplicationPortRef=rba_Nds_ReceiveGroupSignalApplicationPort_Odo_ST3, rba_Nds_ReceiveNetworkPortRef=rba_Nds_ReceiveSignalNetworkPort_Odo_ST3
          rba_Nds_ReceiveSignalProcessing_CRC_BCS_Whl_Msg1_BTC_Pr5_ST3: rba_Nds_ReceiveApplicationPortRef=rba_Nds_ReceiveGroupSignalApplicationPort_CRC_BCS_Whl_Msg1_BTC_Pr5_ST3, rba_Nds_ReceiveNetworkPortRef=rba_Nds_ReceiveSignalNetworkPort_CRC_BCS_Whl_Msg1_BTC_Pr5_ST3
          rba_Nds_ReceiveSignalProcessing_SQC_BCS_Whl_Msg1_BTC_Pr5_ST3: rba_Nds_ReceiveApplicationPortRef=rba_Nds_ReceiveGroupSignalApplicationPort_SQC_BCS_Whl_Msg1_BTC_Pr5_ST3, rba_Nds_ReceiveNetworkPortRef=rba_Nds_ReceiveSignalNetworkPort_SQC_BCS_Whl_Msg1_BTC_Pr5_ST3
          rba_Nds_ReceiveSignalProcessing_WhlPlsCnt_RL_BTC_ST3: rba_Nds_ReceiveApplicationPortRef=rba_Nds_ReceiveGroupSignalApplicationPort_WhlPlsCnt_RL_BTC_ST3, rba_Nds_ReceiveNetworkPortRef=rba_Nds_ReceiveSignalNetworkPort_WhlPlsCnt_RL_BTC_ST3
          rba_Nds_ReceiveSignalProcessing_WhlDir_FL_Stat_BTC_ST3: rba_Nds_ReceiveApplicationPortRef=rba_Nds_ReceiveGroupSignalApplicationPort_WhlDir_FL_Stat_BTC_ST3, rba_Nds_ReceiveNetworkPortRef=rba_Nds_ReceiveSignalNetworkPort_WhlDir_FL_Stat_BTC_ST3
          rba_Nds_ReceiveSignalProcessing_WhlDir_FR_Stat_BTC_ST3: rba_Nds_ReceiveApplicationPortRef=rba_Nds_ReceiveGroupSignalApplicationPort_WhlDir_FR_Stat_BTC_ST3, rba_Nds_ReceiveNetworkPortRef=rba_Nds_ReceiveSignalNetworkPort_WhlDir_FR_Stat_BTC_ST3
          rba_Nds_ReceiveSignalProcessing_WhlDir_RL_Stat_BTC_ST3: rba_Nds_ReceiveApplicationPortRef=rba_Nds_ReceiveGroupSignalApplicationPort_WhlDir_RL_Stat_BTC_ST3, rba_Nds_ReceiveNetworkPortRef=rba_Nds_ReceiveSignalNetworkPort_WhlDir_RL_Stat_BTC_ST3
          rba_Nds_ReceiveSignalProcessing_WhlRPM_FL_BTC_ST3: rba_Nds_ReceiveApplicationPortRef=rba_Nds_ReceiveGroupSignalApplicationPort_WhlRPM_FL_BTC_ST3, rba_Nds_ReceiveNetworkPortRef=rba_Nds_ReceiveSignalNetworkPort_WhlRPM_FL_BTC_ST3
          rba_Nds_ReceiveSignalProcessing_WhlRPM_FL_Qual_BTC_ST3: rba_Nds_ReceiveApplicationPortRef=rba_Nds_ReceiveGroupSignalApplicationPort_WhlRPM_FL_Qual_BTC_ST3, rba_Nds_ReceiveNetworkPortRef=rba_Nds_ReceiveSignalNetworkPort_WhlRPM_FL_Qual_BTC_ST3
          rba_Nds_ReceiveSignalProcessing_WhlRPM_FR_BTC_ST3: rba_Nds_ReceiveApplicationPortRef=rba_Nds_ReceiveGroupSignalApplicationPort_WhlRPM_FR_BTC_ST3, rba_Nds_ReceiveNetworkPortRef=rba_Nds_ReceiveSignalNetworkPort_WhlRPM_FR_BTC_ST3
          rba_Nds_ReceiveSignalProcessing_WhlRPM_FR_Qual_BTC_ST3: rba_Nds_ReceiveApplicationPortRef=rba_Nds_ReceiveGroupSignalApplicationPort_WhlRPM_FR_Qual_BTC_ST3, rba_Nds_ReceiveNetworkPortRef=rba_Nds_ReceiveSignalNetworkPort_WhlRPM_FR_Qual_BTC_ST3
          rba_Nds_ReceiveSignalProcessing_WhlRPM_RL_BTC_ST3: rba_Nds_ReceiveNetworkPortRef=rba_Nds_ReceiveSignalNetworkPort_WhlRPM_RL_BTC_ST3, rba_Nds_ReceiveApplicationPortRef=rba_Nds_ReceiveGroupSignalApplicationPort_WhlRPM_RL_BTC_ST3
          rba_Nds_ReceiveSignalProcessing_WhlRPM_RL_Qual_BTC_ST3: rba_Nds_ReceiveApplicationPortRef=rba_Nds_ReceiveGroupSignalApplicationPort_WhlRPM_RL_Qual_BTC_ST3, rba_Nds_ReceiveNetworkPortRef=rba_Nds_ReceiveSignalNetworkPort_WhlRPM_RL_Qual_BTC_ST3
          rba_Nds_ReceiveSignalProcessing_WhlRPM_RR_BTC_ST3: rba_Nds_ReceiveApplicationPortRef=rba_Nds_ReceiveGroupSignalApplicationPort_WhlRPM_RR_BTC_ST3, rba_Nds_ReceiveNetworkPortRef=rba_Nds_ReceiveSignalNetworkPort_WhlRPM_RR_BTC_ST3
          rba_Nds_ReceiveSignalProcessing_WhlRPM_RR_Qual_BTC_ST3: rba_Nds_ReceiveApplicationPortRef=rba_Nds_ReceiveGroupSignalApplicationPort_WhlRPM_RR_Qual_BTC_ST3, rba_Nds_ReceiveNetworkPortRef=rba_Nds_ReceiveSignalNetworkPort_WhlRPM_RR_Qual_BTC_ST3
          rba_Nds_ReceiveSignalProcessing_WhlPlsCnt_FL_BTC_ST3: rba_Nds_ReceiveApplicationPortRef=rba_Nds_ReceiveGroupSignalApplicationPort_WhlPlsCnt_FL_BTC_ST3, rba_Nds_ReceiveNetworkPortRef=rba_Nds_ReceiveSignalNetworkPort_WhlPlsCnt_FL_BTC_ST3
          rba_Nds_ReceiveSignalProcessing_WhlPlsCnt_FR_BTC_ST3: rba_Nds_ReceiveApplicationPortRef=rba_Nds_ReceiveGroupSignalApplicationPort_WhlPlsCnt_FR_BTC_ST3, rba_Nds_ReceiveNetworkPortRef=rba_Nds_ReceiveSignalNetworkPort_WhlPlsCnt_FR_BTC_ST3
          rba_Nds_ReceiveSignalProcessing_WhlPlsCnt_RR_BTC_ST3: rba_Nds_ReceiveApplicationPortRef=rba_Nds_ReceiveGroupSignalApplicationPort_WhlPlsCnt_RR_BTC_ST3, rba_Nds_ReceiveNetworkPortRef=rba_Nds_ReceiveSignalNetworkPort_WhlPlsCnt_RR_BTC_ST3
          rba_Nds_ReceiveSignalProcessing_WhlDir_RR_Stat_BTC_ST3: rba_Nds_ReceiveApplicationPortRef=rba_Nds_ReceiveGroupSignalApplicationPort_WhlDir_RR_Stat_BTC_ST3, rba_Nds_ReceiveNetworkPortRef=rba_Nds_ReceiveSignalNetworkPort_WhlDir_RR_Stat_BTC_ST3
          rba_Nds_ReceiveSignalProcessing_BCS_Whl_Msg1_TmStmp_BTC_ST3: rba_Nds_ReceiveApplicationPortRef=rba_Nds_ReceiveGroupSignalApplicationPort_BCS_Whl_Msg1_TmStmp_BTC_ST3, rba_Nds_ReceiveNetworkPortRef=rba_Nds_ReceiveSignalNetworkPort_BCS_Whl_Msg1_TmStmp_BTC_ST3
          rba_Nds_ReceiveSignalProcessing_BCS_Whl_Msg1_TmSyncStat_BTC_ST3: rba_Nds_ReceiveApplicationPortRef=rba_Nds_ReceiveGroupSignalApplicationPort_BCS_Whl_Msg1_TmSyncStat_BTC_ST3, rba_Nds_ReceiveNetworkPortRef=rba_Nds_ReceiveSignalNetworkPort_BCS_Whl_Msg1_TmSyncStat_BTC_ST3
          rba_Nds_ReceiveSignalProcessing_GTS_ESP_Clk_Stat_Bckp_ST3: rba_Nds_ReceiveApplicationPortRef=rba_Nds_ReceiveGroupSignalApplicationPort_GTS_ESP_Clk_Stat_Bckp_ST3, rba_Nds_ReceiveNetworkPortRef=rba_Nds_ReceiveSignalNetworkPort_GTS_ESP_Clk_Stat_Bckp_ST3
          rba_Nds_ReceiveSignalProcessing_Rsrv1_BCS_Whl_Msg1_BTC_Pr5_ST3: rba_Nds_ReceiveApplicationPortRef=rba_Nds_ReceiveGroupSignalApplicationPort_Rsrv1_BCS_Whl_Msg1_BTC_Pr5_ST3, rba_Nds_ReceiveNetworkPortRef=rba_Nds_ReceiveSignalNetworkPort_Rsrv1_BCS_Whl_Msg1_BTC_Pr5_ST3
          rba_Nds_ReceiveSignalProcessing_VehSpd_Disp_ST3: rba_Nds_ReceiveApplicationPortRef=rba_Nds_ReceiveSignalApplicationPort_VehSpd_Disp_ST3, rba_Nds_ReceiveNetworkPortRef=rba_Nds_ReceiveSignalNetworkPort_VehSpd_Disp_ST3
          rba_Nds_ReceiveSignalProcessing_PN14_DDP_Sw_Stat_ST3: rba_Nds_ReceiveApplicationPortRef=rba_Nds_ReceiveSignalApplicationPort_PN14_DDP_Sw_Stat_ST3, rba_Nds_ReceiveNetworkPortRef=rba_Nds_ReceiveSignalNetworkPort_PN14_DDP_Sw_Stat_ST3
          rba_Nds_ReceiveSignalProcessing_PN14_ExtBat_Charge_Actv_ST3: rba_Nds_ReceiveApplicationPortRef=rba_Nds_ReceiveSignalApplicationPort_PN14_ExtBat_Charge_Actv_ST3, rba_Nds_ReceiveNetworkPortRef=rba_Nds_ReceiveSignalNetworkPort_PN14_ExtBat_Charge_Actv_ST3
          rba_Nds_ReceiveSignalProcessing_PN14_SupBat_Stat_ST3: rba_Nds_ReceiveApplicationPortRef=rba_Nds_ReceiveSignalApplicationPort_PN14_SupBat_Stat_ST3, rba_Nds_ReceiveNetworkPortRef=rba_Nds_ReceiveSignalNetworkPort_PN14_SupBat_Stat_ST3
          rba_Nds_ReceiveSignalProcessing_PN14_TransMd_Stat_ST3: rba_Nds_ReceiveApplicationPortRef=rba_Nds_ReceiveSignalApplicationPort_PN14_TransMd_Stat_ST3, rba_Nds_ReceiveNetworkPortRef=rba_Nds_ReceiveSignalNetworkPort_PN14_TransMd_Stat_ST3
          rba_Nds_ReceiveSignalProcessing_PN14_SupBat_Volt_ST3: rba_Nds_ReceiveApplicationPortRef=rba_Nds_ReceiveSignalApplicationPort_PN14_SupBat_Volt_ST3, rba_Nds_ReceiveNetworkPortRef=rba_Nds_ReceiveSignalNetworkPort_PN14_SupBat_Volt_ST3
          rba_Nds_ReceiveSignalProcessing_PN14_ProdMd_BatStat_ST3: rba_Nds_ReceiveApplicationPortRef=rba_Nds_ReceiveSignalApplicationPort_PN14_ProdMd_BatStat_ST3, rba_Nds_ReceiveNetworkPortRef=rba_Nds_ReceiveSignalNetworkPort_PN14_ProdMd_BatStat_ST3
          rba_Nds_ReceiveSignalProcessing_PN14_SupBat_Curr_ST3: rba_Nds_ReceiveApplicationPortRef=rba_Nds_ReceiveSignalApplicationPort_PN14_SupBat_Curr_ST3, rba_Nds_ReceiveNetworkPortRef=rba_Nds_ReceiveSignalNetworkPort_PN14_SupBat_Curr_ST3
          rba_Nds_ReceiveSignalProcessing_PN14_SupBat_Temp_ST3: rba_Nds_ReceiveApplicationPortRef=rba_Nds_ReceiveSignalApplicationPort_PN14_SupBat_Temp_ST3, rba_Nds_ReceiveNetworkPortRef=rba_Nds_ReceiveSignalNetworkPort_PN14_SupBat_Temp_ST3
          rba_Nds_ReceiveSignalProcessing_PN14_ProdMd_Stat_ST3: rba_Nds_ReceiveApplicationPortRef=rba_Nds_ReceiveSignalApplicationPort_PN14_ProdMd_Stat_ST3, rba_Nds_ReceiveNetworkPortRef=rba_Nds_ReceiveSignalNetworkPort_PN14_ProdMd_Stat_ST3
          rba_Nds_ReceiveSignalProcessing_PN14_DDP_Sw2_Stat_ST3: rba_Nds_ReceiveApplicationPortRef=rba_Nds_ReceiveSignalApplicationPort_PN14_DDP_Sw2_Stat_ST3, rba_Nds_ReceiveNetworkPortRef=rba_Nds_ReceiveSignalNetworkPort_PN14_DDP_Sw2_Stat_ST3
          rba_Nds_ReceiveSignalProcessing_PN14_PNSec_RechargeEnable_ST3: rba_Nds_ReceiveApplicationPortRef=rba_Nds_ReceiveSignalApplicationPort_PN14_PNSec_RechargeEnable_ST3, rba_Nds_ReceiveNetworkPortRef=rba_Nds_ReceiveSignalNetworkPort_PN14_PNSec_RechargeEnable_ST3
          rba_Nds_ReceiveSignalProcessing_DidA_ExtTest_Pres_ST3: rba_Nds_ReceiveApplicationPortRef=rba_Nds_ReceiveSignalApplicationPort_DidA_ExtTest_Pres_ST3, rba_Nds_ReceiveNetworkPortRef=rba_Nds_ReceiveSignalNetworkPort_DidA_ExtTest_Pres_ST3
          rba_Nds_ReceiveSignalProcessing_Actv_Line_Stat_ST3: rba_Nds_ReceiveApplicationPortRef=rba_Nds_ReceiveSignalApplicationPort_Actv_Line_Stat_ST3, rba_Nds_ReceiveNetworkPortRef=rba_Nds_ReceiveSignalNetworkPort_Actv_Line_Stat_ST3
          rba_Nds_ReceiveSignalProcessing_Platform_Stat_Star3: rba_Nds_ReceiveApplicationPortRef=rba_Nds_ReceiveSignalApplicationPort_Platform_Stat_Star3, rba_Nds_ReceiveNetworkPortRef=rba_Nds_ReceiveSignalNetworkPort_Platform_Stat_Star3
          rba_Nds_ReceiveSignalProcessing_VSS_TP_VIN_7_ST3: rba_Nds_ReceiveApplicationPortRef=rba_Nds_ReceiveGroupSignalApplicationPort_VSS_TP_VIN_7_ST3, rba_Nds_ReceiveNetworkPortRef=rba_Nds_ReceiveSignalNetworkPort_VSS_TP_VIN_7_ST3
          rba_Nds_ReceiveSignalProcessing_VSS_TP_VIN_6_ST3: rba_Nds_ReceiveApplicationPortRef=rba_Nds_ReceiveGroupSignalApplicationPort_VSS_TP_VIN_6_ST3, rba_Nds_ReceiveNetworkPortRef=rba_Nds_ReceiveSignalNetworkPort_VSS_TP_VIN_6_ST3
          rba_Nds_ReceiveSignalProcessing_VSS_TP_VIN_5_ST3: rba_Nds_ReceiveApplicationPortRef=rba_Nds_ReceiveGroupSignalApplicationPort_VSS_TP_VIN_5_ST3, rba_Nds_ReceiveNetworkPortRef=rba_Nds_ReceiveSignalNetworkPort_VSS_TP_VIN_5_ST3
          rba_Nds_ReceiveSignalProcessing_VSS_TP_VIN_4_ST3: rba_Nds_ReceiveApplicationPortRef=rba_Nds_ReceiveGroupSignalApplicationPort_VSS_TP_VIN_4_ST3, rba_Nds_ReceiveNetworkPortRef=rba_Nds_ReceiveSignalNetworkPort_VSS_TP_VIN_4_ST3
          rba_Nds_ReceiveSignalProcessing_VSS_TP_VIN_3_ST3: rba_Nds_ReceiveApplicationPortRef=rba_Nds_ReceiveGroupSignalApplicationPort_VSS_TP_VIN_3_ST3, rba_Nds_ReceiveNetworkPortRef=rba_Nds_ReceiveSignalNetworkPort_VSS_TP_VIN_3_ST3
          rba_Nds_ReceiveSignalProcessing_VSS_TP_VIN_2_ST3: rba_Nds_ReceiveApplicationPortRef=rba_Nds_ReceiveGroupSignalApplicationPort_VSS_TP_VIN_2_ST3, rba_Nds_ReceiveNetworkPortRef=rba_Nds_ReceiveSignalNetworkPort_VSS_TP_VIN_2_ST3
          rba_Nds_ReceiveSignalProcessing_VSS_TP_VIN_1_ST3: rba_Nds_ReceiveApplicationPortRef=rba_Nds_ReceiveGroupSignalApplicationPort_VSS_TP_VIN_1_ST3, rba_Nds_ReceiveNetworkPortRef=rba_Nds_ReceiveSignalNetworkPort_VSS_TP_VIN_1_ST3
          rba_Nds_ReceiveSignalProcessing_VSS_TP_VIN_0_ST3: rba_Nds_ReceiveApplicationPortRef=rba_Nds_ReceiveGroupSignalApplicationPort_VSS_TP_VIN_0_ST3, rba_Nds_ReceiveNetworkPortRef=rba_Nds_ReceiveSignalNetworkPort_VSS_TP_VIN_0_ST3
          rba_Nds_ReceiveSignalProcessing_VSS_TP_SharedSecret_7_ST3: rba_Nds_ReceiveApplicationPortRef=rba_Nds_ReceiveGroupSignalApplicationPort_VSS_TP_SharedSecret_7_ST3, rba_Nds_ReceiveNetworkPortRef=rba_Nds_ReceiveSignalNetworkPort_VSS_TP_SharedSecret_7_ST3
          rba_Nds_ReceiveSignalProcessing_VSS_TP_SharedSecret_6_ST3: rba_Nds_ReceiveApplicationPortRef=rba_Nds_ReceiveGroupSignalApplicationPort_VSS_TP_SharedSecret_6_ST3, rba_Nds_ReceiveNetworkPortRef=rba_Nds_ReceiveSignalNetworkPort_VSS_TP_SharedSecret_6_ST3
          rba_Nds_ReceiveSignalProcessing_VSS_TP_SharedSecret_5_ST3: rba_Nds_ReceiveApplicationPortRef=rba_Nds_ReceiveGroupSignalApplicationPort_VSS_TP_SharedSecret_5_ST3, rba_Nds_ReceiveNetworkPortRef=rba_Nds_ReceiveSignalNetworkPort_VSS_TP_SharedSecret_5_ST3
          rba_Nds_ReceiveSignalProcessing_VSS_TP_SharedSecret_4_ST3: rba_Nds_ReceiveApplicationPortRef=rba_Nds_ReceiveGroupSignalApplicationPort_VSS_TP_SharedSecret_4_ST3, rba_Nds_ReceiveNetworkPortRef=rba_Nds_ReceiveSignalNetworkPort_VSS_TP_SharedSecret_4_ST3
          rba_Nds_ReceiveSignalProcessing_VSS_TP_SharedSecret_3_ST3: rba_Nds_ReceiveApplicationPortRef=rba_Nds_ReceiveGroupSignalApplicationPort_VSS_TP_SharedSecret_3_ST3, rba_Nds_ReceiveNetworkPortRef=rba_Nds_ReceiveSignalNetworkPort_VSS_TP_SharedSecret_3_ST3
          rba_Nds_ReceiveSignalProcessing_VSS_TP_SharedSecret_2_ST3: rba_Nds_ReceiveApplicationPortRef=rba_Nds_ReceiveGroupSignalApplicationPort_VSS_TP_SharedSecret_2_ST3, rba_Nds_ReceiveNetworkPortRef=rba_Nds_ReceiveSignalNetworkPort_VSS_TP_SharedSecret_2_ST3
          rba_Nds_ReceiveSignalProcessing_VSS_TP_SharedSecret_1_ST3: rba_Nds_ReceiveApplicationPortRef=rba_Nds_ReceiveGroupSignalApplicationPort_VSS_TP_SharedSecret_1_ST3, rba_Nds_ReceiveNetworkPortRef=rba_Nds_ReceiveSignalNetworkPort_VSS_TP_SharedSecret_1_ST3
          rba_Nds_ReceiveSignalProcessing_VSS_TP_SharedSecret_0_ST3: rba_Nds_ReceiveApplicationPortRef=rba_Nds_ReceiveGroupSignalApplicationPort_VSS_TP_SharedSecret_0_ST3, rba_Nds_ReceiveNetworkPortRef=rba_Nds_ReceiveSignalNetworkPort_VSS_TP_SharedSecret_0_ST3
          rba_Nds_ReceiveSignalProcessing_VSS_TP_SecTickCount_Lvl1_7_ST3: rba_Nds_ReceiveApplicationPortRef=rba_Nds_ReceiveGroupSignalApplicationPort_VSS_TP_SecTickCount_Lvl1_7_ST3, rba_Nds_ReceiveNetworkPortRef=rba_Nds_ReceiveSignalNetworkPort_VSS_TP_SecTickCount_Lvl1_7_ST3
          rba_Nds_ReceiveSignalProcessing_VSS_TP_SecTickCount_Lvl1_6_ST3: rba_Nds_ReceiveNetworkPortRef=rba_Nds_ReceiveSignalNetworkPort_VSS_TP_SecTickCount_Lvl1_6_ST3, rba_Nds_ReceiveApplicationPortRef=rba_Nds_ReceiveGroupSignalApplicationPort_VSS_TP_SecTickCount_Lvl1_6_ST3
          rba_Nds_ReceiveSignalProcessing_VSS_TP_SecTickCount_Lvl1_5_ST3: rba_Nds_ReceiveApplicationPortRef=rba_Nds_ReceiveGroupSignalApplicationPort_VSS_TP_SecTickCount_Lvl1_5_ST3, rba_Nds_ReceiveNetworkPortRef=rba_Nds_ReceiveSignalNetworkPort_VSS_TP_SecTickCount_Lvl1_5_ST3
          rba_Nds_ReceiveSignalProcessing_VSS_TP_SecTickCount_Lvl1_4_ST3: rba_Nds_ReceiveApplicationPortRef=rba_Nds_ReceiveGroupSignalApplicationPort_VSS_TP_SecTickCount_Lvl1_4_ST3, rba_Nds_ReceiveNetworkPortRef=rba_Nds_ReceiveSignalNetworkPort_VSS_TP_SecTickCount_Lvl1_4_ST3
          rba_Nds_ReceiveSignalProcessing_VSS_TP_SecTickCount_Lvl1_3_ST3: rba_Nds_ReceiveApplicationPortRef=rba_Nds_ReceiveGroupSignalApplicationPort_VSS_TP_SecTickCount_Lvl1_3_ST3, rba_Nds_ReceiveNetworkPortRef=rba_Nds_ReceiveSignalNetworkPort_VSS_TP_SecTickCount_Lvl1_3_ST3
          rba_Nds_ReceiveSignalProcessing_VSS_TP_SecTickCount_Lvl1_2_ST3: rba_Nds_ReceiveApplicationPortRef=rba_Nds_ReceiveGroupSignalApplicationPort_VSS_TP_SecTickCount_Lvl1_2_ST3, rba_Nds_ReceiveNetworkPortRef=rba_Nds_ReceiveSignalNetworkPort_VSS_TP_SecTickCount_Lvl1_2_ST3
          rba_Nds_ReceiveSignalProcessing_VSS_TP_SecTickCount_Lvl1_1_ST3: rba_Nds_ReceiveApplicationPortRef=rba_Nds_ReceiveGroupSignalApplicationPort_VSS_TP_SecTickCount_Lvl1_1_ST3, rba_Nds_ReceiveNetworkPortRef=rba_Nds_ReceiveSignalNetworkPort_VSS_TP_SecTickCount_Lvl1_1_ST3
          rba_Nds_ReceiveSignalProcessing_VSS_TP_SecTickCount_Lvl1_0_ST3: rba_Nds_ReceiveApplicationPortRef=rba_Nds_ReceiveGroupSignalApplicationPort_VSS_TP_SecTickCount_Lvl1_0_ST3, rba_Nds_ReceiveNetworkPortRef=rba_Nds_ReceiveSignalNetworkPort_VSS_TP_SecTickCount_Lvl1_0_ST3
          rba_Nds_ReceiveSignalProcessing_VSS_TP_RealTmOffset_7_ST3: rba_Nds_ReceiveNetworkPortRef=rba_Nds_ReceiveSignalNetworkPort_VSS_TP_RealTmOffset_7_ST3, rba_Nds_ReceiveApplicationPortRef=rba_Nds_ReceiveGroupSignalApplicationPort_VSS_TP_RealTmOffset_7_ST3
          rba_Nds_ReceiveSignalProcessing_VSS_TP_RealTmOffset_6_ST3: rba_Nds_ReceiveApplicationPortRef=rba_Nds_ReceiveGroupSignalApplicationPort_VSS_TP_RealTmOffset_6_ST3, rba_Nds_ReceiveNetworkPortRef=rba_Nds_ReceiveSignalNetworkPort_VSS_TP_RealTmOffset_6_ST3
          rba_Nds_ReceiveSignalProcessing_VSS_TP_RealTmOffset_5_ST3: rba_Nds_ReceiveApplicationPortRef=rba_Nds_ReceiveGroupSignalApplicationPort_VSS_TP_RealTmOffset_5_ST3, rba_Nds_ReceiveNetworkPortRef=rba_Nds_ReceiveSignalNetworkPort_VSS_TP_RealTmOffset_5_ST3
          rba_Nds_ReceiveSignalProcessing_VSS_TP_RealTmOffset_4_ST3: rba_Nds_ReceiveApplicationPortRef=rba_Nds_ReceiveGroupSignalApplicationPort_VSS_TP_RealTmOffset_4_ST3, rba_Nds_ReceiveNetworkPortRef=rba_Nds_ReceiveSignalNetworkPort_VSS_TP_RealTmOffset_4_ST3
          rba_Nds_ReceiveSignalProcessing_VSS_TP_RealTmOffset_3_ST3: rba_Nds_ReceiveApplicationPortRef=rba_Nds_ReceiveGroupSignalApplicationPort_VSS_TP_RealTmOffset_3_ST3, rba_Nds_ReceiveNetworkPortRef=rba_Nds_ReceiveSignalNetworkPort_VSS_TP_RealTmOffset_3_ST3
          rba_Nds_ReceiveSignalProcessing_VSS_TP_RealTmOffset_2_ST3: rba_Nds_ReceiveApplicationPortRef=rba_Nds_ReceiveGroupSignalApplicationPort_VSS_TP_RealTmOffset_2_ST3, rba_Nds_ReceiveNetworkPortRef=rba_Nds_ReceiveSignalNetworkPort_VSS_TP_RealTmOffset_2_ST3
          rba_Nds_ReceiveSignalProcessing_VSS_TP_RealTmOffset_1_ST3: rba_Nds_ReceiveApplicationPortRef=rba_Nds_ReceiveGroupSignalApplicationPort_VSS_TP_RealTmOffset_1_ST3, rba_Nds_ReceiveNetworkPortRef=rba_Nds_ReceiveSignalNetworkPort_VSS_TP_RealTmOffset_1_ST3
          rba_Nds_ReceiveSignalProcessing_VSS_TP_RealTmOffset_0_ST3: rba_Nds_ReceiveApplicationPortRef=rba_Nds_ReceiveGroupSignalApplicationPort_VSS_TP_RealTmOffset_0_ST3, rba_Nds_ReceiveNetworkPortRef=rba_Nds_ReceiveSignalNetworkPort_VSS_TP_RealTmOffset_0_ST3
          rba_Nds_ReceiveSignalProcessing_VSS_TP_Auth_7_ST3: rba_Nds_ReceiveApplicationPortRef=rba_Nds_ReceiveGroupSignalApplicationPort_VSS_TP_Auth_7_ST3, rba_Nds_ReceiveNetworkPortRef=rba_Nds_ReceiveSignalNetworkPort_VSS_TP_Auth_7_ST3
          rba_Nds_ReceiveSignalProcessing_VSS_TP_Auth_6_ST3: rba_Nds_ReceiveApplicationPortRef=rba_Nds_ReceiveGroupSignalApplicationPort_VSS_TP_Auth_6_ST3, rba_Nds_ReceiveNetworkPortRef=rba_Nds_ReceiveSignalNetworkPort_VSS_TP_Auth_6_ST3
          rba_Nds_ReceiveSignalProcessing_VSS_TP_Auth_5_ST3: rba_Nds_ReceiveApplicationPortRef=rba_Nds_ReceiveGroupSignalApplicationPort_VSS_TP_Auth_5_ST3, rba_Nds_ReceiveNetworkPortRef=rba_Nds_ReceiveSignalNetworkPort_VSS_TP_Auth_5_ST3
          rba_Nds_ReceiveSignalProcessing_VSS_TP_Auth_4_ST3: rba_Nds_ReceiveApplicationPortRef=rba_Nds_ReceiveGroupSignalApplicationPort_VSS_TP_Auth_4_ST3, rba_Nds_ReceiveNetworkPortRef=rba_Nds_ReceiveSignalNetworkPort_VSS_TP_Auth_4_ST3
          rba_Nds_ReceiveSignalProcessing_VSS_TP_Auth_3_ST3: rba_Nds_ReceiveApplicationPortRef=rba_Nds_ReceiveGroupSignalApplicationPort_VSS_TP_Auth_3_ST3, rba_Nds_ReceiveNetworkPortRef=rba_Nds_ReceiveSignalNetworkPort_VSS_TP_Auth_3_ST3
          rba_Nds_ReceiveSignalProcessing_VSS_TP_Auth_2_ST3: rba_Nds_ReceiveApplicationPortRef=rba_Nds_ReceiveGroupSignalApplicationPort_VSS_TP_Auth_2_ST3, rba_Nds_ReceiveNetworkPortRef=rba_Nds_ReceiveSignalNetworkPort_VSS_TP_Auth_2_ST3
          rba_Nds_ReceiveSignalProcessing_VSS_TP_Auth_1_ST3: rba_Nds_ReceiveApplicationPortRef=rba_Nds_ReceiveGroupSignalApplicationPort_VSS_TP_Auth_1_ST3, rba_Nds_ReceiveNetworkPortRef=rba_Nds_ReceiveSignalNetworkPort_VSS_TP_Auth_1_ST3
          rba_Nds_ReceiveSignalProcessing_VSS_TP_Auth_0_ST3: rba_Nds_ReceiveApplicationPortRef=rba_Nds_ReceiveGroupSignalApplicationPort_VSS_TP_Auth_0_ST3, rba_Nds_ReceiveNetworkPortRef=rba_Nds_ReceiveSignalNetworkPort_VSS_TP_Auth_0_ST3
          rba_Nds_ReceiveSignalProcessing_CRC_ADAS_HAD_Stat_IDC_S_FSI_Bckp_Pr5_ST3: rba_Nds_ReceiveApplicationPortRef=rba_Nds_ReceiveGroupSignalApplicationPort_CRC_ADAS_HAD_Stat_IDC_S_FSI_Bckp_Pr5_ST3, rba_Nds_ReceiveNetworkPortRef=rba_Nds_ReceiveSignalNetworkPort_CRC_ADAS_HAD_Stat_IDC_S_FSI_Bckp_Pr5_ST3
          rba_Nds_ReceiveSignalProcessing_SQC_ADAS_HAD_Stat_IDC_S_FSI_Bckp_Pr5_ST3: rba_Nds_ReceiveApplicationPortRef=rba_Nds_ReceiveGroupSignalApplicationPort_SQC_ADAS_HAD_Stat_IDC_S_FSI_Bckp_Pr5_ST3, rba_Nds_ReceiveNetworkPortRef=rba_Nds_ReceiveSignalNetworkPort_SQC_ADAS_HAD_Stat_IDC_S_FSI_Bckp_Pr5_ST3
          rba_Nds_ReceiveSignalProcessing_ADAS_HAD_Ext_Stat_S_FSI_Bckp_ST3: rba_Nds_ReceiveApplicationPortRef=rba_Nds_ReceiveGroupSignalApplicationPort_ADAS_HAD_Ext_Stat_S_FSI_Bckp_ST3, rba_Nds_ReceiveNetworkPortRef=rba_Nds_ReceiveSignalNetworkPort_ADAS_HAD_Ext_Stat_S_FSI_Bckp_ST3
          rba_Nds_ReceiveSignalProcessing_Rsrv1_ADAS_HAD_Stat_IDC_S_FSI_Bckp_Pr5_ST3: rba_Nds_ReceiveApplicationPortRef=rba_Nds_ReceiveGroupSignalApplicationPort_Rsrv1_ADAS_HAD_Stat_IDC_S_FSI_Bckp_Pr5_ST3, rba_Nds_ReceiveNetworkPortRef=rba_Nds_ReceiveSignalNetworkPort_Rsrv1_ADAS_HAD_Stat_IDC_S_FSI_Bckp_Pr5_ST3
          rba_Nds_ReceiveSignalProcessing_Rsrv2_ADAS_HAD_Stat_IDC_S_FSI_Bckp_Pr5_ST3: rba_Nds_ReceiveApplicationPortRef=rba_Nds_ReceiveGroupSignalApplicationPort_Rsrv2_ADAS_HAD_Stat_IDC_S_FSI_Bckp_Pr5_ST3, rba_Nds_ReceiveNetworkPortRef=rba_Nds_ReceiveSignalNetworkPort_Rsrv2_ADAS_HAD_Stat_IDC_S_FSI_Bckp_Pr5_ST3
        48 x rba_Nds_TransmitSignalProcessing:
          rba_Nds_TransmitSignalProcessing_IMU_A_AngAcc_X_ST3: rba_Nds_TransmitApplicationPortRef=rba_Nds_TransmitGroupSignalApplicationPort_IMU_A_AngAcc_X_ST3, rba_Nds_TransmitNetworkPortRef=rba_Nds_TransmitSignalNetworkPort_IMU_A_AngAcc_X_ST3
          rba_Nds_TransmitSignalProcessing_IMU_A_AngAcc_Y_ST3: rba_Nds_TransmitApplicationPortRef=rba_Nds_TransmitGroupSignalApplicationPort_IMU_A_AngAcc_Y_ST3, rba_Nds_TransmitNetworkPortRef=rba_Nds_TransmitSignalNetworkPort_IMU_A_AngAcc_Y_ST3
          rba_Nds_TransmitSignalProcessing_IMU_A_AngAcc_Z_ST3: rba_Nds_TransmitApplicationPortRef=rba_Nds_TransmitGroupSignalApplicationPort_IMU_A_AngAcc_Z_ST3, rba_Nds_TransmitNetworkPortRef=rba_Nds_TransmitSignalNetworkPort_IMU_A_AngAcc_Z_ST3
          rba_Nds_TransmitSignalProcessing_IMU_A_AngRate_X_ST3: rba_Nds_TransmitApplicationPortRef=rba_Nds_TransmitGroupSignalApplicationPort_IMU_A_AngRate_X_ST3, rba_Nds_TransmitNetworkPortRef=rba_Nds_TransmitSignalNetworkPort_IMU_A_AngRate_X_ST3
          rba_Nds_TransmitSignalProcessing_IMU_A_AngRate_Y_ST3: rba_Nds_TransmitApplicationPortRef=rba_Nds_TransmitGroupSignalApplicationPort_IMU_A_AngRate_Y_ST3, rba_Nds_TransmitNetworkPortRef=rba_Nds_TransmitSignalNetworkPort_IMU_A_AngRate_Y_ST3
          rba_Nds_TransmitSignalProcessing_IMU_A_AngRate_Z_ST3: rba_Nds_TransmitApplicationPortRef=rba_Nds_TransmitGroupSignalApplicationPort_IMU_A_AngRate_Z_ST3, rba_Nds_TransmitNetworkPortRef=rba_Nds_TransmitSignalNetworkPort_IMU_A_AngRate_Z_ST3
          rba_Nds_TransmitSignalProcessing_IMU_A_SpecForce_X_ST3: rba_Nds_TransmitApplicationPortRef=rba_Nds_TransmitGroupSignalApplicationPort_IMU_A_SpecForce_X_ST3, rba_Nds_TransmitNetworkPortRef=rba_Nds_TransmitSignalNetworkPort_IMU_A_SpecForce_X_ST3
          rba_Nds_TransmitSignalProcessing_IMU_A_SpecForce_Y_ST3: rba_Nds_TransmitApplicationPortRef=rba_Nds_TransmitGroupSignalApplicationPort_IMU_A_SpecForce_Y_ST3, rba_Nds_TransmitNetworkPortRef=rba_Nds_TransmitSignalNetworkPort_IMU_A_SpecForce_Y_ST3
          rba_Nds_TransmitSignalProcessing_IMU_A_SpecForce_Z_ST3: rba_Nds_TransmitApplicationPortRef=rba_Nds_TransmitGroupSignalApplicationPort_IMU_A_SpecForce_Z_ST3, rba_Nds_TransmitNetworkPortRef=rba_Nds_TransmitSignalNetworkPort_IMU_A_SpecForce_Z_ST3
          rba_Nds_TransmitSignalProcessing_IMU_A_AngAcc_Stat_ST3: rba_Nds_TransmitApplicationPortRef=rba_Nds_TransmitGroupSignalApplicationPort_IMU_A_AngAcc_Stat_ST3, rba_Nds_TransmitNetworkPortRef=rba_Nds_TransmitSignalNetworkPort_IMU_A_AngAcc_Stat_ST3
          rba_Nds_TransmitSignalProcessing_IMU_A_AngRate_Stat_ST3: rba_Nds_TransmitApplicationPortRef=rba_Nds_TransmitGroupSignalApplicationPort_IMU_A_AngRates_Stat_ST3, rba_Nds_TransmitNetworkPortRef=rba_Nds_TransmitSignalNetworkPort_IMU_A_AngRates_Stat_ST3
          rba_Nds_TransmitSignalProcessing_IMU_A_SpecForce_Stat_ST3: rba_Nds_TransmitApplicationPortRef=rba_Nds_TransmitGroupSignalApplicationPort_IMU_A_SpecForce_Stat_ST3, rba_Nds_TransmitNetworkPortRef=rba_Nds_TransmitSignalNetworkPort_IMU_A_SpecForce_Stat_ST3
          rba_Nds_TransmitSignalProcessing_IMU_A_Temp_ST3: rba_Nds_TransmitApplicationPortRef=rba_Nds_TransmitGroupSignalApplicationPort_IMU_A_Temp_ST3, rba_Nds_TransmitNetworkPortRef=rba_Nds_TransmitSignalNetworkPort_IMU_A_Temp_ST3
          rba_Nds_TransmitSignalProcessing_IMU_A_TmStmp_NanoSec_ST3: rba_Nds_TransmitApplicationPortRef=rba_Nds_TransmitGroupSignalApplicationPort_IMU_A_TmStmp_NanoSec_ST3, rba_Nds_TransmitNetworkPortRef=rba_Nds_TransmitSignalNetworkPort_IMU_A_TmStmp_NanoSec_ST3
          rba_Nds_TransmitSignalProcessing_IMU_A_TmStmp_Sec_ST3: rba_Nds_TransmitApplicationPortRef=rba_Nds_TransmitGroupSignalApplicationPort_IMU_A_TmStmp_Sec_ST3, rba_Nds_TransmitNetworkPortRef=rba_Nds_TransmitSignalNetworkPort_IMU_A_TmStmp_Sec_ST3
          rba_Nds_TransmitSignalProcessing_IMU_A_TmSync_Stat_ST3: rba_Nds_TransmitApplicationPortRef=rba_Nds_TransmitGroupSignalApplicationPort_IMU_A_TmSync_Stat_ST3, rba_Nds_TransmitNetworkPortRef=rba_Nds_TransmitSignalNetworkPort_IMU_A_TmSync_Stat_ST3
          rba_Nds_TransmitSignalProcessing_IMU_A_Stat_ST3: rba_Nds_TransmitApplicationPortRef=rba_Nds_TransmitGroupSignalApplicationPort_IMU_A_Stat_ST3, rba_Nds_TransmitNetworkPortRef=rba_Nds_TransmitSignalNetworkPort_IMU_A_Stat_ST3
          rba_Nds_TransmitSignalProcessing_Rsrv{01..07}_IMU_A_Output_Pr5_ST3: rba_Nds_TransmitApplicationPortRef=rba_Nds_TransmitGroupSignalApplicationPort_Rsrv{01..07}_IMU_A_Output_Pr5_ST3, rba_Nds_TransmitNetworkPortRef=rba_Nds_TransmitSignalNetworkPort_Rsrv{01..07}_IMU_A_Output_Pr5_ST3
          rba_Nds_TransmitSignalProcessing_Rsrv{01..07}_IMU_A_Output_Fast_Pr5_ST3: rba_Nds_TransmitApplicationPortRef=rba_Nds_TransmitGroupSignalApplicationPort_Rsrv{01..07}_IMU_A_Output_Pr5_ST3, rba_Nds_TransmitNetworkPortRef=rba_Nds_TransmitSignalNetworkPort_Rsrv{01..07}_IMU_A_Output_Fast_Pr5_ST3
          rba_Nds_TransmitSignalProcessing_IMU_A_AngAcc_X_Fast_ST3: rba_Nds_TransmitApplicationPortRef=rba_Nds_TransmitGroupSignalApplicationPort_IMU_A_AngAcc_X_ST3, rba_Nds_TransmitNetworkPortRef=rba_Nds_TransmitSignalNetworkPort_IMU_A_AngAcc_X_Fast_ST3
          rba_Nds_TransmitSignalProcessing_IMU_A_AngAcc_Y_Fast_ST3: rba_Nds_TransmitApplicationPortRef=rba_Nds_TransmitGroupSignalApplicationPort_IMU_A_AngAcc_Y_ST3, rba_Nds_TransmitNetworkPortRef=rba_Nds_TransmitSignalNetworkPort_IMU_A_AngAcc_Y_Fast_ST3
          rba_Nds_TransmitSignalProcessing_IMU_A_AngAcc_Z_Fast_ST3: rba_Nds_TransmitApplicationPortRef=rba_Nds_TransmitGroupSignalApplicationPort_IMU_A_AngAcc_Z_ST3, rba_Nds_TransmitNetworkPortRef=rba_Nds_TransmitSignalNetworkPort_IMU_A_AngAcc_Z_Fast_ST3
          rba_Nds_TransmitSignalProcessing_IMU_A_AngAcc_Stat_Fast_ST3: rba_Nds_TransmitApplicationPortRef=rba_Nds_TransmitGroupSignalApplicationPort_IMU_A_AngAcc_Stat_ST3, rba_Nds_TransmitNetworkPortRef=rba_Nds_TransmitSignalNetworkPort_IMU_A_AngAcc_Stat_Fast_ST3
          rba_Nds_TransmitSignalProcessing_IMU_A_AngRate_X_Fast_ST3: rba_Nds_TransmitApplicationPortRef=rba_Nds_TransmitGroupSignalApplicationPort_IMU_A_AngRate_X_ST3, rba_Nds_TransmitNetworkPortRef=rba_Nds_TransmitSignalNetworkPort_IMU_A_AngRate_X_Fast_ST3
          rba_Nds_TransmitSignalProcessing_IMU_A_AngRate_Y_Fast_ST3: rba_Nds_TransmitApplicationPortRef=rba_Nds_TransmitGroupSignalApplicationPort_IMU_A_AngRate_Y_ST3, rba_Nds_TransmitNetworkPortRef=rba_Nds_TransmitSignalNetworkPort_IMU_A_AngRate_Y_Fast_ST3
          rba_Nds_TransmitSignalProcessing_IMU_A_AngRate_Z_Fast_ST3: rba_Nds_TransmitApplicationPortRef=rba_Nds_TransmitGroupSignalApplicationPort_IMU_A_AngRate_Z_ST3, rba_Nds_TransmitNetworkPortRef=rba_Nds_TransmitSignalNetworkPort_IMU_A_AngRate_Z_Fast_ST3
          rba_Nds_TransmitSignalProcessing_IMU_A_AngRate_Stat_Fast_ST3: rba_Nds_TransmitApplicationPortRef=rba_Nds_TransmitGroupSignalApplicationPort_IMU_A_AngRates_Stat_ST3, rba_Nds_TransmitNetworkPortRef=rba_Nds_TransmitSignalNetworkPort_IMU_A_AngRates_Stat_Fast_ST3
          rba_Nds_TransmitSignalProcessing_IMU_A_SpecForce_X_Fast_ST3: rba_Nds_TransmitApplicationPortRef=rba_Nds_TransmitGroupSignalApplicationPort_IMU_A_SpecForce_X_ST3, rba_Nds_TransmitNetworkPortRef=rba_Nds_TransmitSignalNetworkPort_IMU_A_SpecForce_X_Fast_ST3
          rba_Nds_TransmitSignalProcessing_IMU_A_SpecForce_Y_Fast_ST3: rba_Nds_TransmitApplicationPortRef=rba_Nds_TransmitGroupSignalApplicationPort_IMU_A_SpecForce_Y_ST3, rba_Nds_TransmitNetworkPortRef=rba_Nds_TransmitSignalNetworkPort_IMU_A_SpecForce_Y_Fast_ST3
          rba_Nds_TransmitSignalProcessing_IMU_A_SpecForce_Z_Fast_ST3: rba_Nds_TransmitApplicationPortRef=rba_Nds_TransmitGroupSignalApplicationPort_IMU_A_SpecForce_Z_ST3, rba_Nds_TransmitNetworkPortRef=rba_Nds_TransmitSignalNetworkPort_IMU_A_SpecForce_Z_Fast_ST3
          rba_Nds_TransmitSignalProcessing_IMU_A_SpecForce_Stat_Fast_ST3: rba_Nds_TransmitApplicationPortRef=rba_Nds_TransmitGroupSignalApplicationPort_IMU_A_SpecForce_Stat_ST3, rba_Nds_TransmitNetworkPortRef=rba_Nds_TransmitSignalNetworkPort_IMU_A_SpecForce_Stat_Fast_ST3
          rba_Nds_TransmitSignalProcessing_IMU_A_Stat_Fast_ST3: rba_Nds_TransmitApplicationPortRef=rba_Nds_TransmitGroupSignalApplicationPort_IMU_A_Stat_ST3, rba_Nds_TransmitNetworkPortRef=rba_Nds_TransmitSignalNetworkPort_IMU_A_Stat_Fast_ST3
          rba_Nds_TransmitSignalProcessing_IMU_A_Temp_Fast_ST3: rba_Nds_TransmitApplicationPortRef=rba_Nds_TransmitGroupSignalApplicationPort_IMU_A_Temp_ST3, rba_Nds_TransmitNetworkPortRef=rba_Nds_TransmitSignalNetworkPort_IMU_A_Temp_Fast_ST3
          rba_Nds_TransmitSignalProcessing_IMU_A_TmStmp_NanoSec_Fast_ST3: rba_Nds_TransmitApplicationPortRef=rba_Nds_TransmitGroupSignalApplicationPort_IMU_A_TmStmp_NanoSec_ST3, rba_Nds_TransmitNetworkPortRef=rba_Nds_TransmitSignalNetworkPort_IMU_A_TmStmp_NanoSec_Fast_ST3
          rba_Nds_TransmitSignalProcessing_IMU_A_TmStmp_Sec_Fast_ST3: rba_Nds_TransmitApplicationPortRef=rba_Nds_TransmitGroupSignalApplicationPort_IMU_A_TmStmp_Sec_ST3, rba_Nds_TransmitNetworkPortRef=rba_Nds_TransmitSignalNetworkPort_IMU_A_TmStmp_Sec_Fast_ST3
          rba_Nds_TransmitSignalProcessing_IMU_A_TmSync_Stat_Fast_ST3: rba_Nds_TransmitApplicationPortRef=rba_Nds_TransmitGroupSignalApplicationPort_IMU_A_TmSync_Stat_ST3, rba_Nds_TransmitNetworkPortRef=rba_Nds_TransmitSignalNetworkPort_IMU_A_TmSync_Stat_Fast_ST3
      4 x rba_Nds_PduGroup:
        rba_Nds_PduGroup_IMU_A_HAD_BACKUP_Tx_PNC_23: rba_Nds_Name=IPG_IMU_A_HAD_BACKUP_Tx_PNC_23_CAN
        rba_Nds_PduGroup_IMU_A_HAD_BACKUP_Rx_PNC_23: rba_Nds_Name=IPG_IMU_A_HAD_BACKUP_Rx_PNC_23_CAN
        rba_Nds_PduGroup_IMU_A_IMU_INTERNAL_Tx_PNC_23: rba_Nds_Name=IPG_IMU_A_IMU_INTERNAL_Tx_PNC_23_CAN
        rba_Nds_PduGroup_IMU_A_IMU_INTERNAL_Rx_PNC_23: rba_Nds_Name=IPG_IMU_A_IMU_INTERNAL_Rx_PNC_23_CAN
      rba_Nds_ApplicationPorts
        15 x rba_Nds_ReceiveSignalApplicationPort:
          rba_Nds_ReceiveSignalApplicationPort_PN14_DDP_Sw_Stat_ST3: rba_Nds_Name=PN14_DDP_Sw_Stat_ST3, rba_Nds_DataType=UINT8, rba_Nds_InitValue=0
            rba_Nds_ApplicationRepresentation_0 (rba_Nds_ApplicationRepresentation)
              rba_Nds_DirectRepresentation: rba_Nds_MinValue=0, rba_Nds_MaxValue=7
          rba_Nds_ReceiveSignalApplicationPort_PN14_ExtBat_Charge_Actv_ST3: rba_Nds_Name=PN14_ExtBat_Charge_Actv_ST3, rba_Nds_DataType=UINT8, rba_Nds_InitValue=3
            rba_Nds_ApplicationRepresentation_0 (rba_Nds_ApplicationRepresentation)
              rba_Nds_DirectRepresentation: rba_Nds_MinValue=1, rba_Nds_MaxValue=3
          rba_Nds_ReceiveSignalApplicationPort_PN14_SupBat_Stat_ST3: rba_Nds_Name=PN14_SupBat_Stat_ST3, rba_Nds_DataType=UINT8, rba_Nds_InitValue=127
            rba_Nds_ApplicationRepresentation_0 (rba_Nds_ApplicationRepresentation)
              rba_Nds_DirectRepresentation: rba_Nds_MinValue=0, rba_Nds_MaxValue=127
          rba_Nds_ReceiveSignalApplicationPort_PN14_TransMd_Stat_ST3: rba_Nds_Name=PN14_TransMd_Stat_ST3, rba_Nds_DataType=UINT8
            rba_Nds_ApplicationRepresentation_0 (rba_Nds_ApplicationRepresentation)
              rba_Nds_DirectRepresentation: rba_Nds_MinValue=0, rba_Nds_MaxValue=3
          rba_Nds_ReceiveSignalApplicationPort_PN14_SupBat_Volt_ST3: rba_Nds_Name=PN14_SupBat_Volt_ST3, rba_Nds_DataType=UINT16
            rba_Nds_ApplicationRepresentation_0 (rba_Nds_ApplicationRepresentation)
              rba_Nds_DirectRepresentation: rba_Nds_MinValue=0, rba_Nds_MaxValue=1023
          rba_Nds_ReceiveSignalApplicationPort_PN14_ProdMd_BatStat_ST3: rba_Nds_Name=PN14_ProdMd_BatStat_ST3, rba_Nds_DataType=UINT8, rba_Nds_InitValue=127
            rba_Nds_ApplicationRepresentation_0 (rba_Nds_ApplicationRepresentation)
              rba_Nds_DirectRepresentation: rba_Nds_MinValue=0, rba_Nds_MaxValue=127
          rba_Nds_ReceiveSignalApplicationPort_PN14_SupBat_Curr_ST3: rba_Nds_DataType=UINT16, rba_Nds_Name=PN14_SupBat_Curr_ST3, rba_Nds_InitValue=8191
            rba_Nds_ApplicationRepresentation_0 (rba_Nds_ApplicationRepresentation)
              rba_Nds_DirectRepresentation: rba_Nds_MinValue=0, rba_Nds_MaxValue=8191
          rba_Nds_ReceiveSignalApplicationPort_PN14_SupBat_Temp_ST3: rba_Nds_Name=PN14_SupBat_Temp_ST3, rba_Nds_DataType=UINT8, rba_Nds_InitValue=255
            rba_Nds_ApplicationRepresentation_0 (rba_Nds_ApplicationRepresentation)
              rba_Nds_DirectRepresentation: rba_Nds_MinValue=0, rba_Nds_MaxValue=255
          rba_Nds_ReceiveSignalApplicationPort_PN14_ProdMd_Stat_ST3: rba_Nds_DataType=UINT8, rba_Nds_Name=PN14_ProdMd_Stat_ST3
            rba_Nds_ApplicationRepresentation_0 (rba_Nds_ApplicationRepresentation)
              rba_Nds_DirectRepresentation: rba_Nds_MinValue=0, rba_Nds_MaxValue=7
          rba_Nds_ReceiveSignalApplicationPort_PN14_DDP_Sw2_Stat_ST3: rba_Nds_DataType=UINT8, rba_Nds_Name=PN14_DDP_Sw2_Stat_ST3, rba_Nds_InitValue=7
            rba_Nds_ApplicationRepresentation_0 (rba_Nds_ApplicationRepresentation)
              rba_Nds_DirectRepresentation: rba_Nds_MinValue=0, rba_Nds_MaxValue=7
          rba_Nds_ReceiveSignalApplicationPort_PN14_PNSec_RechargeEnable_ST3: rba_Nds_Name=PN14_PNSec_RechargeEnable_ST3, rba_Nds_DataType=UINT8, rba_Nds_InitValue=3
            rba_Nds_ApplicationRepresentation_0 (rba_Nds_ApplicationRepresentation)
              rba_Nds_DirectRepresentation: rba_Nds_MinValue=1, rba_Nds_MaxValue=3
          rba_Nds_ReceiveSignalApplicationPort_VehSpd_Disp_ST3: rba_Nds_Name=VehSpd_Disp_ST3, rba_Nds_DataType=UINT16
            rba_Nds_ApplicationRepresentation_0 (rba_Nds_ApplicationRepresentation)
              rba_Nds_DirectRepresentation: rba_Nds_MinValue=0, rba_Nds_MaxValue=4095
          rba_Nds_ReceiveSignalApplicationPort_Actv_Line_Stat_ST3: rba_Nds_DataType=UINT8, rba_Nds_Name=Actv_Line_Stat_ST3, rba_Nds_InitValue=0
            rba_Nds_ApplicationRepresentation_0 (rba_Nds_ApplicationRepresentation)
              rba_Nds_DirectRepresentation: rba_Nds_MinValue=0, rba_Nds_MaxValue=3
          rba_Nds_ReceiveSignalApplicationPort_DidA_ExtTest_Pres_ST3: rba_Nds_Name=DidA_ExtTest_Pres_ST3, rba_Nds_DataType=UINT8, rba_Nds_InitValue=3
            rba_Nds_ApplicationRepresentation_0 (rba_Nds_ApplicationRepresentation)
              rba_Nds_DirectRepresentation: rba_Nds_MinValue=1, rba_Nds_MaxValue=3
          rba_Nds_ReceiveSignalApplicationPort_Platform_Stat_Star3: rba_Nds_Name=Platform_Stat_Star3, rba_Nds_DataType=UINT8
            rba_Nds_ApplicationRepresentation_0 (rba_Nds_ApplicationRepresentation)
              rba_Nds_DirectRepresentation: rba_Nds_MinValue=0, rba_Nds_MaxValue=255
        10 x rba_Nds_ReceiveSignalGroupApplicationPort:
          rba_Nds_ReceiveSignalGroupApplicationPort_Ign_Stat_ST3: rba_Nds_Name=Ign_Stat_ST3, rba_Nds_PortType=rbl_CustIf_Ign_Stat_ST3_t, rba_Nds_Description=application port for igntion signal
            5 x rba_Nds_ReceiveGroupSignalApplicationPort:
              rba_Nds_ReceiveGroupSignalApplicationPort_CRC_Ign_Stat_Pr5_ST3: rba_Nds_DataType=UINT16, rba_Nds_Name=CRC_Ign_Stat_Pr5_ST3
                rba_Nds_ApplicationRepresentation_0 (rba_Nds_ApplicationRepresentation)
                  rba_Nds_DirectRepresentation: rba_Nds_MinValue=0, rba_Nds_MaxValue=65535
              rba_Nds_ReceiveGroupSignalApplicationPort_SQC_Ign_Stat_Pr5_ST3: rba_Nds_DataType=UINT8, rba_Nds_Name=SQC_Ign_Stat_Pr5_ST3
                rba_Nds_ApplicationRepresentation_0 (rba_Nds_ApplicationRepresentation)
                  rba_Nds_DirectRepresentation: rba_Nds_MinValue=0, rba_Nds_MaxValue=255
              rba_Nds_ReceiveGroupSignalApplicationPort_KG_StartSw_Psd_ST3: rba_Nds_DataType=BOOLEAN, rba_Nds_Name=KG_StartSw_Psd_ST3
                rba_Nds_ApplicationRepresentation_0 (rba_Nds_ApplicationRepresentation)
                  rba_Nds_DirectRepresentation: rba_Nds_MinValue=0, rba_Nds_MaxValue=1
              rba_Nds_ReceiveGroupSignalApplicationPort_Veh_Op_Mode_ST3: rba_Nds_DataType=UINT8, rba_Nds_Name=Veh_Op_Mode_ST3
                rba_Nds_ApplicationRepresentation_0 (rba_Nds_ApplicationRepresentation)
                  rba_Nds_DirectRepresentation: rba_Nds_MinValue=0, rba_Nds_MaxValue=15
              rba_Nds_ReceiveGroupSignalApplicationPort_ISw_Stat_ST3: rba_Nds_Name=ISw_Stat_ST3, rba_Nds_DataType=UINT8
                rba_Nds_ApplicationRepresentation_0 (rba_Nds_ApplicationRepresentation)
                  rba_Nds_DirectRepresentation: rba_Nds_MinValue=0, rba_Nds_MaxValue=7
          rba_Nds_ReceiveSignalGroupApplicationPort_PT4_PTCoor4_ST3: rba_Nds_Name=PT4_PTCoor4_ST3, rba_Nds_PortType=rbl_CustIf_PT4_PTCoor4_ST3_t
            6 x rba_Nds_ReceiveGroupSignalApplicationPort:
              rba_Nds_ReceiveGroupSignalApplicationPort_PT4_PTCoor_PT_Rdy_ST3: rba_Nds_Name=PT4_PTCoor_PT_Rdy_ST3, rba_Nds_DataType=UINT8, rba_Nds_InitValue=0
                rba_Nds_ApplicationRepresentation_0 (rba_Nds_ApplicationRepresentation)
                  rba_Nds_DirectRepresentation: rba_Nds_MinValue=0, rba_Nds_MaxValue=3
              rba_Nds_ReceiveGroupSignalApplicationPort_PT4_PTCoor_EngStartPN14_Stat_ST3: rba_Nds_DataType=UINT8, rba_Nds_Name=PT4_PTCoor_EngStartPN14_Stat_ST3, rba_Nds_InitValue=0
                rba_Nds_ApplicationRepresentation_0 (rba_Nds_ApplicationRepresentation)
                  rba_Nds_DirectRepresentation: rba_Nds_MinValue=0, rba_Nds_MaxValue=7
              rba_Nds_ReceiveGroupSignalApplicationPort_CRC_PT4_PTCoor4_Pr5_ST3: rba_Nds_DataType=UINT16, rba_Nds_Name=CRC_PT4_PTCoor4_Pr5_ST3, rba_Nds_InitValue=4203
                rba_Nds_ApplicationRepresentation_0 (rba_Nds_ApplicationRepresentation)
                  rba_Nds_DirectRepresentation: rba_Nds_MinValue=0, rba_Nds_MaxValue=65535
              rba_Nds_ReceiveGroupSignalApplicationPort_Rsrv1_PT4_PTCoor_PT_Rdy_Pr5_ST3: rba_Nds_Name=Rsrv1_PT4_PTCoor_PT_Rdy_Pr5_ST3, rba_Nds_DataType=UINT8, rba_Nds_InitValue=1
                rba_Nds_ApplicationRepresentation_0 (rba_Nds_ApplicationRepresentation)
                  rba_Nds_DirectRepresentation: rba_Nds_MinValue=0, rba_Nds_MaxValue=1
              rba_Nds_ReceiveGroupSignalApplicationPort_PT4_PTCoor_SSA_EngSp_ST3: rba_Nds_Name=PT4_PTCoor_SSA_EngSp_ST3, rba_Nds_DataType=UINT8, rba_Nds_InitValue=3
                rba_Nds_ApplicationRepresentation_0 (rba_Nds_ApplicationRepresentation)
                  rba_Nds_DirectRepresentation: rba_Nds_MinValue=0, rba_Nds_MaxValue=3
              rba_Nds_ReceiveGroupSignalApplicationPort_SQC_PT4_PTCoor4_Pr5_ST3: rba_Nds_Name=SQC_PT4_PTCoor4_Pr5_ST3, rba_Nds_DataType=UINT8, rba_Nds_InitValue=0
                rba_Nds_ApplicationRepresentation_0 (rba_Nds_ApplicationRepresentation)
                  rba_Nds_DirectRepresentation: rba_Nds_MinValue=0, rba_Nds_MaxValue=255
          rba_Nds_ReceiveSignalGroupApplicationPort_DI_OdoSpeedometer_ST3: rba_Nds_Name=DI_OdoSpeedometer_ST3, rba_Nds_PortType=rbl_CustIf_DI_OdoSpeedometer_ST3_t
            3 x rba_Nds_ReceiveGroupSignalApplicationPort:
              rba_Nds_ReceiveGroupSignalApplicationPort_CRC_DI_Odo_Pr5_ST3: rba_Nds_Name=CRC_DI_Odo_Pr5_ST3, rba_Nds_DataType=UINT16
                rba_Nds_ApplicationRepresentation_0 (rba_Nds_ApplicationRepresentation)
                  rba_Nds_DirectRepresentation: rba_Nds_MinValue=0, rba_Nds_MaxValue=65535
              rba_Nds_ReceiveGroupSignalApplicationPort_SQC_DI_Odo_Pr5_ST3: rba_Nds_Name=SQC_DI_Odo_Pr5_ST3, rba_Nds_DataType=UINT8
                rba_Nds_ApplicationRepresentation_0 (rba_Nds_ApplicationRepresentation)
                  rba_Nds_DirectRepresentation: rba_Nds_MinValue=0, rba_Nds_MaxValue=255
              rba_Nds_ReceiveGroupSignalApplicationPort_Odo_ST3: rba_Nds_Name=Odo_ST3, rba_Nds_DataType=UINT32
                rba_Nds_ApplicationRepresentation_0 (rba_Nds_ApplicationRepresentation)
                  rba_Nds_DirectRepresentation: rba_Nds_MinValue=0, rba_Nds_MaxValue=16777215
          rba_Nds_ReceiveSignalGroupApplicationPort_BCS_Whl_Msg1_BTC_Pr5_ST3: rba_Nds_Name=BCS_Whl_Msg1_BTC_Pr5_ST3, rba_Nds_PortType=rbl_CustIf_BCS_Whl_Msg1_BTC_Pr5_ST3_st
            22 x rba_Nds_ReceiveGroupSignalApplicationPort:
              rba_Nds_ReceiveGroupSignalApplicationPort_WhlRPM_FL_Qual_BTC_ST3: rba_Nds_Name=WhlRPM_FL_Qual_BTC_ST3, rba_Nds_DataType=UINT8
                rba_Nds_ApplicationRepresentation_0 (rba_Nds_ApplicationRepresentation)
                  rba_Nds_DirectRepresentation: rba_Nds_MinValue=0, rba_Nds_MaxValue=2
              rba_Nds_ReceiveGroupSignalApplicationPort_WhlDir_FR_Stat_BTC_ST3: rba_Nds_Name=WhlDir_FR_Stat_BTC_ST3, rba_Nds_DataType=UINT8
                rba_Nds_ApplicationRepresentation_0 (rba_Nds_ApplicationRepresentation)
                  rba_Nds_DirectRepresentation: rba_Nds_MinValue=0, rba_Nds_MaxValue=3
              rba_Nds_ReceiveGroupSignalApplicationPort_BCS_Whl_Msg1_TmSyncStat_BTC_ST3: rba_Nds_DataType=UINT8, rba_Nds_Name=BCS_Whl_Msg1_TmSyncStat_BTC_ST3
                rba_Nds_ApplicationRepresentation_0 (rba_Nds_ApplicationRepresentation)
                  rba_Nds_DirectRepresentation: rba_Nds_MinValue=0, rba_Nds_MaxValue=2
              rba_Nds_ReceiveGroupSignalApplicationPort_CRC_BCS_Whl_Msg1_BTC_Pr5_ST3: rba_Nds_Name=CRC_BCS_Whl_Msg1_BTC_Pr5_ST3, rba_Nds_DataType=UINT16
                rba_Nds_ApplicationRepresentation_0 (rba_Nds_ApplicationRepresentation)
                  rba_Nds_DirectRepresentation: rba_Nds_MinValue=0, rba_Nds_MaxValue=65535
              rba_Nds_ReceiveGroupSignalApplicationPort_WhlPlsCnt_RR_BTC_ST3: rba_Nds_Name=WhlPlsCnt_RR_BTC_ST3, rba_Nds_DataType=UINT16
                rba_Nds_ApplicationRepresentation_0 (rba_Nds_ApplicationRepresentation)
                  rba_Nds_DirectRepresentation: rba_Nds_MinValue=0, rba_Nds_MaxValue=1023
              rba_Nds_ReceiveGroupSignalApplicationPort_SQC_BCS_Whl_Msg1_BTC_Pr5_ST3: rba_Nds_Name=SQC_BCS_Whl_Msg1_BTC_Pr5_ST3, rba_Nds_DataType=UINT8
                rba_Nds_ApplicationRepresentation_0 (rba_Nds_ApplicationRepresentation)
                  rba_Nds_DirectRepresentation: rba_Nds_MinValue=0, rba_Nds_MaxValue=255
              rba_Nds_ReceiveGroupSignalApplicationPort_BCS_Whl_Msg1_TmStmp_BTC_ST3: rba_Nds_Name=BCS_Whl_Msg1_TmStmp_BTC_ST3, rba_Nds_DataType=UINT16
                rba_Nds_ApplicationRepresentation_BCS_Whl_Msg1_TmStmp_BTC_ST3 (rba_Nds_ApplicationRepresentation)
                  rba_Nds_DirectRepresentation: rba_Nds_MinValue=0, rba_Nds_MaxValue=65535
              rba_Nds_ReceiveGroupSignalApplicationPort_WhlDir_FL_Stat_BTC_ST3: rba_Nds_Name=WhlDir_FL_Stat_BTC_ST3, rba_Nds_DataType=UINT8
                rba_Nds_ApplicationRepresentation_0 (rba_Nds_ApplicationRepresentation)
                  rba_Nds_DirectRepresentation: rba_Nds_MinValue=0, rba_Nds_MaxValue=3
              rba_Nds_ReceiveGroupSignalApplicationPort_WhlDir_RR_Stat_BTC_ST3: rba_Nds_Name=WhlDir_RR_Stat_BTC_ST3, rba_Nds_DataType=UINT8
                rba_Nds_ApplicationRepresentation_0 (rba_Nds_ApplicationRepresentation)
                  rba_Nds_DirectRepresentation: rba_Nds_MinValue=0, rba_Nds_MaxValue=3
              rba_Nds_ReceiveGroupSignalApplicationPort_WhlRPM_RR_Qual_BTC_ST3: rba_Nds_Name=WhlRPM_RR_Qual_BTC_ST3, rba_Nds_DataType=UINT8
                rba_Nds_ApplicationRepresentation_0 (rba_Nds_ApplicationRepresentation)
                  rba_Nds_DirectRepresentation: rba_Nds_MinValue=0, rba_Nds_MaxValue=2
              rba_Nds_ReceiveGroupSignalApplicationPort_WhlRPM_FL_BTC_ST3: rba_Nds_Name=WhlRPM_FL_BTC_ST3, rba_Nds_DataType=UINT16
                rba_Nds_ApplicationRepresentation_0 (rba_Nds_ApplicationRepresentation)
                  rba_Nds_DirectRepresentation: rba_Nds_MinValue=0, rba_Nds_MaxValue=16383
              rba_Nds_ReceiveGroupSignalApplicationPort_WhlRPM_FR_Qual_BTC_ST3: rba_Nds_DataType=UINT8, rba_Nds_Name=WhlRPM_FR_Qual_BTC_ST3
                rba_Nds_ApplicationRepresentation_0 (rba_Nds_ApplicationRepresentation)
                  rba_Nds_DirectRepresentation: rba_Nds_MinValue=0, rba_Nds_MaxValue=2
              rba_Nds_ReceiveGroupSignalApplicationPort_WhlPlsCnt_FR_BTC_ST3: rba_Nds_Name=WhlPlsCnt_FR_BTC_ST3, rba_Nds_DataType=UINT16
                rba_Nds_ApplicationRepresentation_0 (rba_Nds_ApplicationRepresentation)
                  rba_Nds_DirectRepresentation: rba_Nds_MinValue=0, rba_Nds_MaxValue=1023
              rba_Nds_ReceiveGroupSignalApplicationPort_Rsrv1_BCS_Whl_Msg1_BTC_Pr5_ST3: rba_Nds_Name=Rsrv1_BCS_Whl_Msg1_BTC_Pr5_ST3, rba_Nds_DataType=UINT8
                rba_Nds_ApplicationRepresentation_0 (rba_Nds_ApplicationRepresentation)
                  rba_Nds_DirectRepresentation: rba_Nds_MinValue=0, rba_Nds_MaxValue=15
              rba_Nds_ReceiveGroupSignalApplicationPort_WhlPlsCnt_FL_BTC_ST3: rba_Nds_Name=WhlPlsCnt_FL_BTC_ST3, rba_Nds_DataType=UINT16
                rba_Nds_ApplicationRepresentation_0 (rba_Nds_ApplicationRepresentation)
                  rba_Nds_DirectRepresentation: rba_Nds_MinValue=0, rba_Nds_MaxValue=1023
              rba_Nds_ReceiveGroupSignalApplicationPort_WhlRPM_RR_BTC_ST3: rba_Nds_Name=WhlRPM_RR_BTC_ST3, rba_Nds_DataType=UINT16
                rba_Nds_ApplicationRepresentation_0 (rba_Nds_ApplicationRepresentation)
                  rba_Nds_DirectRepresentation: rba_Nds_MinValue=0, rba_Nds_MaxValue=16383
              rba_Nds_ReceiveGroupSignalApplicationPort_WhlDir_RL_Stat_BTC_ST3: rba_Nds_Name=WhlDir_RL_Stat_BTC_ST3, rba_Nds_DataType=UINT8
                rba_Nds_ApplicationRepresentation_0 (rba_Nds_ApplicationRepresentation)
                  rba_Nds_DirectRepresentation: rba_Nds_MinValue=0, rba_Nds_MaxValue=3
              rba_Nds_ReceiveGroupSignalApplicationPort_WhlPlsCnt_RL_BTC_ST3: rba_Nds_Name=WhlPlsCnt_RL_BTC_ST3, rba_Nds_DataType=UINT16
                rba_Nds_ApplicationRepresentation_0 (rba_Nds_ApplicationRepresentation)
                  rba_Nds_DirectRepresentation: rba_Nds_MaxValue=1023, rba_Nds_MinValue=0
              rba_Nds_ReceiveGroupSignalApplicationPort_WhlRPM_RL_Qual_BTC_ST3: rba_Nds_DataType=UINT8, rba_Nds_Name=WhlRPM_RL_Qual_BTC_ST3
                rba_Nds_ApplicationRepresentation_0 (rba_Nds_ApplicationRepresentation)
                  rba_Nds_DirectRepresentation: rba_Nds_MinValue=0, rba_Nds_MaxValue=2
              rba_Nds_ReceiveGroupSignalApplicationPort_WhlRPM_FR_BTC_ST3: rba_Nds_DataType=UINT16, rba_Nds_Name=WhlRPM_FR_BTC_ST3
                rba_Nds_ApplicationRepresentation_0 (rba_Nds_ApplicationRepresentation)
                  rba_Nds_DirectRepresentation: rba_Nds_MinValue=0, rba_Nds_MaxValue=16383
              rba_Nds_ReceiveGroupSignalApplicationPort_WhlRPM_RL_BTC_ST3: rba_Nds_Name=WhlRPM_RL_BTC_ST3, rba_Nds_DataType=UINT16
                rba_Nds_ApplicationRepresentation_0 (rba_Nds_ApplicationRepresentation)
                  rba_Nds_DirectRepresentation: rba_Nds_MinValue=0, rba_Nds_MaxValue=16383
              rba_Nds_ReceiveGroupSignalApplicationPort_GTS_ESP_Clk_Stat_Bckp_ST3: rba_Nds_Name=GTS_ESP_Clk_Stat_Bckp_ST3, rba_Nds_DataType=UINT8
                rba_Nds_ApplicationRepresentation_0 (rba_Nds_ApplicationRepresentation)
                  rba_Nds_DirectRepresentation: rba_Nds_MinValue=0, rba_Nds_MaxValue=3
          rba_Nds_ReceiveSignalGroupApplicationPort_VSS_TP_VIN_ST3: rba_Nds_Name=VSS_TP_VIN_ST3, rba_Nds_PortType=rbl_CustIf_VSS_TP_VIN_t
            8 x rba_Nds_ReceiveGroupSignalApplicationPort, all with rba_Nds_DataType=UINT8:
              rba_Nds_ReceiveGroupSignalApplicationPort_VSS_TP_VIN_0_ST3: rba_Nds_Name=VSS_TP_VIN_0_ST3
                rba_Nds_ApplicationRepresentation_0 (rba_Nds_ApplicationRepresentation)
                  rba_Nds_DirectRepresentation: rba_Nds_MaxValue=255, rba_Nds_MinValue=0
              rba_Nds_ReceiveGroupSignalApplicationPort_VSS_TP_VIN_1_ST3: rba_Nds_Name=VSS_TP_VIN_1_ST3
                rba_Nds_ApplicationRepresentation_0 (rba_Nds_ApplicationRepresentation)
                  rba_Nds_DirectRepresentation: rba_Nds_MaxValue=255, rba_Nds_MinValue=0
              rba_Nds_ReceiveGroupSignalApplicationPort_VSS_TP_VIN_2_ST3: rba_Nds_Name=VSS_TP_VIN_2_ST3
                rba_Nds_ApplicationRepresentation_0 (rba_Nds_ApplicationRepresentation)
                  rba_Nds_DirectRepresentation: rba_Nds_MaxValue=255, rba_Nds_MinValue=0
              rba_Nds_ReceiveGroupSignalApplicationPort_VSS_TP_VIN_3_ST3: rba_Nds_Name=VSS_TP_VIN_3_ST3
                rba_Nds_ApplicationRepresentation_0 (rba_Nds_ApplicationRepresentation)
                  rba_Nds_DirectRepresentation: rba_Nds_MaxValue=255, rba_Nds_MinValue=0
              rba_Nds_ReceiveGroupSignalApplicationPort_VSS_TP_VIN_4_ST3: rba_Nds_Name=VSS_TP_VIN_4_ST3
                rba_Nds_ApplicationRepresentation_0 (rba_Nds_ApplicationRepresentation)
                  rba_Nds_DirectRepresentation: rba_Nds_MaxValue=255, rba_Nds_MinValue=0
              rba_Nds_ReceiveGroupSignalApplicationPort_VSS_TP_VIN_5_ST3: rba_Nds_Name=VSS_TP_VIN_5_ST3
                rba_Nds_ApplicationRepresentation_0 (rba_Nds_ApplicationRepresentation)
                  rba_Nds_DirectRepresentation: rba_Nds_MaxValue=255, rba_Nds_MinValue=0
              rba_Nds_ReceiveGroupSignalApplicationPort_VSS_TP_VIN_6_ST3: rba_Nds_Name=VSS_TP_VIN_6_ST3
                rba_Nds_ApplicationRepresentation_0 (rba_Nds_ApplicationRepresentation)
                  rba_Nds_DirectRepresentation: rba_Nds_MaxValue=255, rba_Nds_MinValue=0
              rba_Nds_ReceiveGroupSignalApplicationPort_VSS_TP_VIN_7_ST3: rba_Nds_Name=VSS_TP_VIN_7_ST3
                rba_Nds_ApplicationRepresentation_0 (rba_Nds_ApplicationRepresentation)
                  rba_Nds_DirectRepresentation: rba_Nds_MaxValue=255, rba_Nds_MinValue=0
          rba_Nds_ReceiveSignalGroupApplicationPort_VSS_TP_SharedSecret_ST3: rba_Nds_Name=VSS_TP_SharedSecret_ST3, rba_Nds_PortType=rbl_CustIf_VSS_TP_SharedSecret_t
            8 x rba_Nds_ReceiveGroupSignalApplicationPort, all with rba_Nds_DataType=UINT8:
              rba_Nds_ReceiveGroupSignalApplicationPort_VSS_TP_SharedSecret_0_ST3: rba_Nds_Name=VSS_TP_SharedSecret_0_ST3
                rba_Nds_ApplicationRepresentation_0 (rba_Nds_ApplicationRepresentation)
                  rba_Nds_DirectRepresentation: rba_Nds_MaxValue=255, rba_Nds_MinValue=0
              rba_Nds_ReceiveGroupSignalApplicationPort_VSS_TP_SharedSecret_1_ST3: rba_Nds_Name=VSS_TP_SharedSecret_1_ST3
                rba_Nds_ApplicationRepresentation_0 (rba_Nds_ApplicationRepresentation)
                  rba_Nds_DirectRepresentation: rba_Nds_MaxValue=255, rba_Nds_MinValue=0
              rba_Nds_ReceiveGroupSignalApplicationPort_VSS_TP_SharedSecret_2_ST3: rba_Nds_Name=VSS_TP_SharedSecret_2_ST3
                rba_Nds_ApplicationRepresentation_0 (rba_Nds_ApplicationRepresentation)
                  rba_Nds_DirectRepresentation: rba_Nds_MaxValue=255, rba_Nds_MinValue=0
              rba_Nds_ReceiveGroupSignalApplicationPort_VSS_TP_SharedSecret_3_ST3: rba_Nds_Name=VSS_TP_SharedSecret_3_ST3
                rba_Nds_ApplicationRepresentation_0 (rba_Nds_ApplicationRepresentation)
                  rba_Nds_DirectRepresentation: rba_Nds_MaxValue=255, rba_Nds_MinValue=0
              rba_Nds_ReceiveGroupSignalApplicationPort_VSS_TP_SharedSecret_4_ST3: rba_Nds_Name=VSS_TP_SharedSecret_4_ST3
                rba_Nds_ApplicationRepresentation_0 (rba_Nds_ApplicationRepresentation)
                  rba_Nds_DirectRepresentation: rba_Nds_MaxValue=255, rba_Nds_MinValue=0
              rba_Nds_ReceiveGroupSignalApplicationPort_VSS_TP_SharedSecret_5_ST3: rba_Nds_Name=VSS_TP_SharedSecret_5_ST3
                rba_Nds_ApplicationRepresentation_0 (rba_Nds_ApplicationRepresentation)
                  rba_Nds_DirectRepresentation: rba_Nds_MaxValue=255, rba_Nds_MinValue=0
              rba_Nds_ReceiveGroupSignalApplicationPort_VSS_TP_SharedSecret_6_ST3: rba_Nds_Name=VSS_TP_SharedSecret_6_ST3
                rba_Nds_ApplicationRepresentation_0 (rba_Nds_ApplicationRepresentation)
                  rba_Nds_DirectRepresentation: rba_Nds_MaxValue=255, rba_Nds_MinValue=0
              rba_Nds_ReceiveGroupSignalApplicationPort_VSS_TP_SharedSecret_7_ST3: rba_Nds_Name=VSS_TP_SharedSecret_7_ST3
                rba_Nds_ApplicationRepresentation_0 (rba_Nds_ApplicationRepresentation)
                  rba_Nds_DirectRepresentation: rba_Nds_MaxValue=255, rba_Nds_MinValue=0
          rba_Nds_ReceiveSignalGroupApplicationPort_VSS_TP_SecTickCount_Lvl1_ST3: rba_Nds_Name=VSS_TP_SecTickCount_Lvl1_ST3, rba_Nds_PortType=rbl_CustIf_VSS_TP_SecTickCount_Lvl1_ST3_t
            8 x rba_Nds_ReceiveGroupSignalApplicationPort, all with rba_Nds_DataType=UINT8:
              rba_Nds_ReceiveGroupSignalApplicationPort_VSS_TP_SecTickCount_Lvl1_0_ST3: rba_Nds_Name=VSS_TP_SecTickCount_Lvl1_0_ST3
                rba_Nds_ApplicationRepresentation_0 (rba_Nds_ApplicationRepresentation)
                  rba_Nds_DirectRepresentation: rba_Nds_MaxValue=255, rba_Nds_MinValue=0
              rba_Nds_ReceiveGroupSignalApplicationPort_VSS_TP_SecTickCount_Lvl1_1_ST3: rba_Nds_Name=VSS_TP_SecTickCount_Lvl1_1_ST3
                rba_Nds_ApplicationRepresentation_0 (rba_Nds_ApplicationRepresentation)
                  rba_Nds_DirectRepresentation: rba_Nds_MaxValue=255, rba_Nds_MinValue=0
              rba_Nds_ReceiveGroupSignalApplicationPort_VSS_TP_SecTickCount_Lvl1_2_ST3: rba_Nds_Name=VSS_TP_SecTickCount_Lvl1_2_ST3
                rba_Nds_ApplicationRepresentation_0 (rba_Nds_ApplicationRepresentation)
                  rba_Nds_DirectRepresentation: rba_Nds_MaxValue=255, rba_Nds_MinValue=0
              rba_Nds_ReceiveGroupSignalApplicationPort_VSS_TP_SecTickCount_Lvl1_3_ST3: rba_Nds_Name=VSS_TP_SecTickCount_Lvl1_3_ST3
                rba_Nds_ApplicationRepresentation_0 (rba_Nds_ApplicationRepresentation)
                  rba_Nds_DirectRepresentation: rba_Nds_MaxValue=255, rba_Nds_MinValue=0
              rba_Nds_ReceiveGroupSignalApplicationPort_VSS_TP_SecTickCount_Lvl1_4_ST3: rba_Nds_Name=VSS_TP_SecTickCount_Lvl1_4_ST3
                rba_Nds_ApplicationRepresentation_0 (rba_Nds_ApplicationRepresentation)
                  rba_Nds_DirectRepresentation: rba_Nds_MaxValue=255, rba_Nds_MinValue=0
              rba_Nds_ReceiveGroupSignalApplicationPort_VSS_TP_SecTickCount_Lvl1_5_ST3: rba_Nds_Name=VSS_TP_SecTickCount_Lvl1_5_ST3
                rba_Nds_ApplicationRepresentation_0 (rba_Nds_ApplicationRepresentation)
                  rba_Nds_DirectRepresentation: rba_Nds_MaxValue=255, rba_Nds_MinValue=0
              rba_Nds_ReceiveGroupSignalApplicationPort_VSS_TP_SecTickCount_Lvl1_6_ST3: rba_Nds_Name=VSS_TP_SecTickCount_Lvl1_6_ST3
                rba_Nds_ApplicationRepresentation_0 (rba_Nds_ApplicationRepresentation)
                  rba_Nds_DirectRepresentation: rba_Nds_MaxValue=255, rba_Nds_MinValue=0
              rba_Nds_ReceiveGroupSignalApplicationPort_VSS_TP_SecTickCount_Lvl1_7_ST3: rba_Nds_Name=VSS_TP_SecTickCount_Lvl1_7_ST3
                rba_Nds_ApplicationRepresentation_0 (rba_Nds_ApplicationRepresentation)
                  rba_Nds_DirectRepresentation: rba_Nds_MaxValue=255, rba_Nds_MinValue=0
          rba_Nds_ReceiveSignalGroupApplicationPort_VSS_TP_RealTmOffset_ST3: rba_Nds_Name=VSS_TP_RealTmOffset_ST3, rba_Nds_PortType=rbl_CustIf_VSS_TP_RealTmOffset_ST3_t
            8 x rba_Nds_ReceiveGroupSignalApplicationPort, all with rba_Nds_DataType=UINT8:
              rba_Nds_ReceiveGroupSignalApplicationPort_VSS_TP_RealTmOffset_0_ST3: rba_Nds_Name=VSS_TP_RealTmOffset_0_ST3
                rba_Nds_ApplicationRepresentation_0 (rba_Nds_ApplicationRepresentation)
                  rba_Nds_DirectRepresentation: rba_Nds_MaxValue=255, rba_Nds_MinValue=0
              rba_Nds_ReceiveGroupSignalApplicationPort_VSS_TP_RealTmOffset_1_ST3: rba_Nds_Name=VSS_TP_RealTmOffset_1_ST3
                rba_Nds_ApplicationRepresentation_0 (rba_Nds_ApplicationRepresentation)
                  rba_Nds_DirectRepresentation: rba_Nds_MaxValue=255, rba_Nds_MinValue=0
              rba_Nds_ReceiveGroupSignalApplicationPort_VSS_TP_RealTmOffset_2_ST3: rba_Nds_Name=VSS_TP_RealTmOffset_2_ST3
                rba_Nds_ApplicationRepresentation_0 (rba_Nds_ApplicationRepresentation)
                  rba_Nds_DirectRepresentation: rba_Nds_MaxValue=255, rba_Nds_MinValue=0
              rba_Nds_ReceiveGroupSignalApplicationPort_VSS_TP_RealTmOffset_3_ST3: rba_Nds_Name=VSS_TP_RealTmOffset_3_ST3
                rba_Nds_ApplicationRepresentation_0 (rba_Nds_ApplicationRepresentation)
                  rba_Nds_DirectRepresentation: rba_Nds_MaxValue=255, rba_Nds_MinValue=0
              rba_Nds_ReceiveGroupSignalApplicationPort_VSS_TP_RealTmOffset_4_ST3: rba_Nds_Name=VSS_TP_RealTmOffset_4_ST3
                rba_Nds_ApplicationRepresentation_0 (rba_Nds_ApplicationRepresentation)
                  rba_Nds_DirectRepresentation: rba_Nds_MaxValue=255, rba_Nds_MinValue=0
              rba_Nds_ReceiveGroupSignalApplicationPort_VSS_TP_RealTmOffset_5_ST3: rba_Nds_Name=VSS_TP_RealTmOffset_5_ST3
                rba_Nds_ApplicationRepresentation_0 (rba_Nds_ApplicationRepresentation)
                  rba_Nds_DirectRepresentation: rba_Nds_MaxValue=255, rba_Nds_MinValue=0
              rba_Nds_ReceiveGroupSignalApplicationPort_VSS_TP_RealTmOffset_6_ST3: rba_Nds_Name=VSS_TP_RealTmOffset_6_ST3
                rba_Nds_ApplicationRepresentation_0 (rba_Nds_ApplicationRepresentation)
                  rba_Nds_DirectRepresentation: rba_Nds_MaxValue=255, rba_Nds_MinValue=0
              rba_Nds_ReceiveGroupSignalApplicationPort_VSS_TP_RealTmOffset_7_ST3: rba_Nds_Name=VSS_TP_RealTmOffset_7_ST3
                rba_Nds_ApplicationRepresentation_0 (rba_Nds_ApplicationRepresentation)
                  rba_Nds_DirectRepresentation: rba_Nds_MaxValue=255, rba_Nds_MinValue=0
          rba_Nds_ReceiveSignalGroupApplicationPort_VSS_TP_Auth_ST3: rba_Nds_Name=VSS_TP_Auth_ST3, rba_Nds_PortType=rbl_CustIf_VSS_TP_Auth_ST3_t
            8 x rba_Nds_ReceiveGroupSignalApplicationPort, all with rba_Nds_DataType=UINT8:
              rba_Nds_ReceiveGroupSignalApplicationPort_VSS_TP_Auth_0_ST3: rba_Nds_Name=VSS_TP_Auth_0_ST3
                rba_Nds_ApplicationRepresentation_0 (rba_Nds_ApplicationRepresentation)
                  rba_Nds_DirectRepresentation: rba_Nds_MaxValue=255, rba_Nds_MinValue=0
              rba_Nds_ReceiveGroupSignalApplicationPort_VSS_TP_Auth_1_ST3: rba_Nds_Name=VSS_TP_Auth_1_ST3
                rba_Nds_ApplicationRepresentation_0 (rba_Nds_ApplicationRepresentation)
                  rba_Nds_DirectRepresentation: rba_Nds_MaxValue=255, rba_Nds_MinValue=0
              rba_Nds_ReceiveGroupSignalApplicationPort_VSS_TP_Auth_2_ST3: rba_Nds_Name=VSS_TP_Auth_2_ST3
                rba_Nds_ApplicationRepresentation_0 (rba_Nds_ApplicationRepresentation)
                  rba_Nds_DirectRepresentation: rba_Nds_MaxValue=255, rba_Nds_MinValue=0
              rba_Nds_ReceiveGroupSignalApplicationPort_VSS_TP_Auth_3_ST3: rba_Nds_Name=VSS_TP_Auth_3_ST3
                rba_Nds_ApplicationRepresentation_0 (rba_Nds_ApplicationRepresentation)
                  rba_Nds_DirectRepresentation: rba_Nds_MaxValue=255, rba_Nds_MinValue=0
              rba_Nds_ReceiveGroupSignalApplicationPort_VSS_TP_Auth_4_ST3: rba_Nds_Name=VSS_TP_Auth_4_ST3
                rba_Nds_ApplicationRepresentation_0 (rba_Nds_ApplicationRepresentation)
                  rba_Nds_DirectRepresentation: rba_Nds_MaxValue=255, rba_Nds_MinValue=0
              rba_Nds_ReceiveGroupSignalApplicationPort_VSS_TP_Auth_5_ST3: rba_Nds_Name=VSS_TP_Auth_5_ST3
                rba_Nds_ApplicationRepresentation_0 (rba_Nds_ApplicationRepresentation)
                  rba_Nds_DirectRepresentation: rba_Nds_MaxValue=255, rba_Nds_MinValue=0
              rba_Nds_ReceiveGroupSignalApplicationPort_VSS_TP_Auth_6_ST3: rba_Nds_Name=VSS_TP_Auth_6_ST3
                rba_Nds_ApplicationRepresentation_0 (rba_Nds_ApplicationRepresentation)
                  rba_Nds_DirectRepresentation: rba_Nds_MaxValue=255, rba_Nds_MinValue=0
              rba_Nds_ReceiveGroupSignalApplicationPort_VSS_TP_Auth_7_ST3: rba_Nds_Name=VSS_TP_Auth_7_ST3
                rba_Nds_ApplicationRepresentation_0 (rba_Nds_ApplicationRepresentation)
                  rba_Nds_DirectRepresentation: rba_Nds_MaxValue=255, rba_Nds_MinValue=0
          rba_Nds_ReceiveSignalGroupApplicationPort_ADAS_HAD_Stat_IDC_S_FSI_Bckp_ST3: rba_Nds_Name=ADAS_HAD_Stat_IDC_S_FSI_Bckp_ST3, rba_Nds_PortType=rbl_CustIf_ADAS_HAD_Stat_IDC_S_FSI_Bckp_ST3_t
            5 x rba_Nds_ReceiveGroupSignalApplicationPort:
              rba_Nds_ReceiveGroupSignalApplicationPort_CRC_ADAS_HAD_Stat_IDC_S_FSI_Bckp_Pr5_ST3: rba_Nds_DataType=UINT16, rba_Nds_Name=CRC_ADAS_HAD_Stat_IDC_S_FSI_Bckp_Pr5_ST3
                rba_Nds_ApplicationRepresentation_0 (rba_Nds_ApplicationRepresentation)
                  rba_Nds_DirectRepresentation
              rba_Nds_ReceiveGroupSignalApplicationPort_SQC_ADAS_HAD_Stat_IDC_S_FSI_Bckp_Pr5_ST3: rba_Nds_DataType=UINT8, rba_Nds_Name=SQC_ADAS_HAD_Stat_IDC_S_FSI_Bckp_Pr5_ST3
                rba_Nds_ApplicationRepresentation_0 (rba_Nds_ApplicationRepresentation)
                  rba_Nds_DirectRepresentation
              rba_Nds_ReceiveGroupSignalApplicationPort_ADAS_HAD_Ext_Stat_S_FSI_Bckp_ST3: rba_Nds_DataType=UINT8, rba_Nds_Name=ADAS_HAD_Ext_Stat_S_FSI_Bckp_ST3
                rba_Nds_ApplicationRepresentation_0 (rba_Nds_ApplicationRepresentation)
                  rba_Nds_DirectRepresentation
              rba_Nds_ReceiveGroupSignalApplicationPort_Rsrv1_ADAS_HAD_Stat_IDC_S_FSI_Bckp_Pr5_ST3: rba_Nds_DataType=UINT8, rba_Nds_Name=Rsrv1_ADAS_HAD_Stat_IDC_S_FSI_Bckp_Pr5_ST3
                rba_Nds_ApplicationRepresentation_0 (rba_Nds_ApplicationRepresentation)
                  rba_Nds_DirectRepresentation
              rba_Nds_ReceiveGroupSignalApplicationPort_Rsrv2_ADAS_HAD_Stat_IDC_S_FSI_Bckp_Pr5_ST3: rba_Nds_DataType=UINT32, rba_Nds_Name=Rsrv2_ADAS_HAD_Stat_IDC_S_FSI_Bckp_Pr5_ST3
                rba_Nds_ApplicationRepresentation_0 (rba_Nds_ApplicationRepresentation)
                  rba_Nds_DirectRepresentation
        rba_Nds_TransmitSignalGroupApplicationPort_1 (rba_Nds_TransmitSignalGroupApplicationPort): rba_Nds_Name=rbl_CustIf_IMU_OutPutMsg_ST3, rba_Nds_PortType=rbl_CustIf_OutputMsg_ST3_st, rba_Nds_Description=IMU output signals
          26 x rba_Nds_TransmitGroupSignalApplicationPort:
            rba_Nds_TransmitGroupSignalApplicationPort_IMU_A_AngAcc_X_ST3: rba_Nds_Name=AngaccX, rba_Nds_DataType=UINT16, rba_Nds_Description=angular acceleration
              rba_Nds_ApplicationRepresentation_IMU_A_AngAcc_X_ST3 (rba_Nds_ApplicationRepresentation)
                rba_Nds_DirectRepresentation: rba_Nds_MaxValue=65535, rba_Nds_MinValue=0
            rba_Nds_TransmitGroupSignalApplicationPort_IMU_A_AngAcc_Y_ST3: rba_Nds_DataType=UINT16, rba_Nds_Description=angular accelerationY, rba_Nds_Name=AngaccY
              rba_Nds_ApplicationRepresentation_IMU_A_AngAcc_Y_ST3 (rba_Nds_ApplicationRepresentation)
                rba_Nds_DirectRepresentation: rba_Nds_MaxValue=65535, rba_Nds_MinValue=0
            rba_Nds_TransmitGroupSignalApplicationPort_IMU_A_AngAcc_Z_ST3: rba_Nds_Name=AngaccZ, rba_Nds_Description=angular acceleration Z, rba_Nds_DataType=UINT16
              rba_Nds_ApplicationRepresentation_IMU_A_AngAcc_Z_ST3 (rba_Nds_ApplicationRepresentation)
                rba_Nds_DirectRepresentation: rba_Nds_MaxValue=65535, rba_Nds_MinValue=0
            rba_Nds_TransmitGroupSignalApplicationPort_IMU_A_AngRate_X_ST3: rba_Nds_Name=RateX, rba_Nds_Description=rate x, rba_Nds_DataType=UINT16
              rba_Nds_ApplicationRepresentation_IMU_A_AngRate_X_ST3 (rba_Nds_ApplicationRepresentation)
                rba_Nds_DirectRepresentation: rba_Nds_MaxValue=65535, rba_Nds_MinValue=0
            rba_Nds_TransmitGroupSignalApplicationPort_IMU_A_AngRate_Y_ST3: rba_Nds_DataType=UINT16, rba_Nds_Name=RateY, rba_Nds_Description=rate Y
              rba_Nds_ApplicationRepresentation_IMU_A_AngRate_Y_ST3 (rba_Nds_ApplicationRepresentation)
                rba_Nds_DirectRepresentation: rba_Nds_MaxValue=65535, rba_Nds_MinValue=0
            rba_Nds_TransmitGroupSignalApplicationPort_IMU_A_AngRate_Z_ST3: rba_Nds_Name=RateZ, rba_Nds_Description=rate Z, rba_Nds_DataType=UINT16
              rba_Nds_ApplicationRepresentation_IMU_A_AngRate_Z_ST3 (rba_Nds_ApplicationRepresentation)
                rba_Nds_DirectRepresentation: rba_Nds_MaxValue=65535, rba_Nds_MinValue=0
            rba_Nds_TransmitGroupSignalApplicationPort_IMU_A_SpecForce_X_ST3: rba_Nds_Name=AccX, rba_Nds_Description=Acceleration X, rba_Nds_DataType=UINT16
              rba_Nds_ApplicationRepresentation_IMU_A_SpecForce_X_ST3 (rba_Nds_ApplicationRepresentation)
                rba_Nds_DirectRepresentation: rba_Nds_MaxValue=65535, rba_Nds_MinValue=0
            rba_Nds_TransmitGroupSignalApplicationPort_IMU_A_SpecForce_Y_ST3: rba_Nds_Name=AccY, rba_Nds_Description=Acceleration Y, rba_Nds_DataType=UINT16
              rba_Nds_ApplicationRepresentation_IMU_A_SpecForce_Y_ST3 (rba_Nds_ApplicationRepresentation)
                rba_Nds_DirectRepresentation: rba_Nds_MaxValue=65535, rba_Nds_MinValue=0
            rba_Nds_TransmitGroupSignalApplicationPort_IMU_A_SpecForce_Z_ST3: rba_Nds_Name=AccZ, rba_Nds_Description=Acceleration Z, rba_Nds_DataType=UINT16
              rba_Nds_ApplicationRepresentation_IMU_A_SpecForce_Z_ST3 (rba_Nds_ApplicationRepresentation)
                rba_Nds_DirectRepresentation: rba_Nds_MaxValue=65535, rba_Nds_MinValue=0
            rba_Nds_TransmitGroupSignalApplicationPort_IMU_A_AngAcc_Stat_ST3: rba_Nds_Name=AngAccStat, rba_Nds_Description=angular Acceleration status, rba_Nds_DataType=UINT8
              rba_Nds_ApplicationRepresentation_IMU_A_AngAcc_Stat_ST3 (rba_Nds_ApplicationRepresentation)
                rba_Nds_DirectRepresentation: rba_Nds_MaxValue=7, rba_Nds_MinValue=0
            rba_Nds_TransmitGroupSignalApplicationPort_IMU_A_AngRates_Stat_ST3: rba_Nds_DataType=UINT8, rba_Nds_Description=rate status, rba_Nds_Name=RateStat
              rba_Nds_ApplicationRepresentation_IMU_A_AngRates_Stat_ST3 (rba_Nds_ApplicationRepresentation)
                rba_Nds_DirectRepresentation: rba_Nds_MinValue=0, rba_Nds_MaxValue=7
            rba_Nds_TransmitGroupSignalApplicationPort_IMU_A_SpecForce_Stat_ST3: rba_Nds_Description=acceleration status, rba_Nds_DataType=UINT8, rba_Nds_Name=AccStat
              rba_Nds_ApplicationRepresentation_IMU_A_SpecForce_Stat_ST3 (rba_Nds_ApplicationRepresentation)
                rba_Nds_DirectRepresentation: rba_Nds_MaxValue=7, rba_Nds_MinValue=0
            rba_Nds_TransmitGroupSignalApplicationPort_IMU_A_Temp_ST3: rba_Nds_DataType=UINT8, rba_Nds_Name=Tempvalue, rba_Nds_Description=temperature
              rba_Nds_ApplicationRepresentation_IMU_A_Temp_ST3 (rba_Nds_ApplicationRepresentation)
                rba_Nds_DirectRepresentation: rba_Nds_MaxValue=255, rba_Nds_MinValue=0
            rba_Nds_TransmitGroupSignalApplicationPort_IMU_A_Stat_ST3: rba_Nds_Name=ImuStat, rba_Nds_DataType=UINT8, rba_Nds_Description=IMU status
              rba_Nds_ApplicationRepresentation_IMU_A_Stat_ST3 (rba_Nds_ApplicationRepresentation)
                rba_Nds_DirectRepresentation: rba_Nds_MaxValue=7, rba_Nds_MinValue=0
            rba_Nds_TransmitGroupSignalApplicationPort_IMU_A_TmStmp_Sec_ST3: rba_Nds_DataType=UINT32, rba_Nds_Name=TempStampsec, rba_Nds_Description=time stamp in seconds
              rba_Nds_ApplicationRepresentation_IMU_A_TmStmp_Sec_ST3 (rba_Nds_ApplicationRepresentation)
                rba_Nds_DirectRepresentation: rba_Nds_MinValue=0, rba_Nds_MaxValue=4294967295
            rba_Nds_TransmitGroupSignalApplicationPort_IMU_A_TmStmp_NanoSec_ST3: rba_Nds_DataType=UINT32, rba_Nds_Name=TempStampnanosec, rba_Nds_Description=time stamp in nano second
              rba_Nds_ApplicationRepresentation_IMU_A_TmStmp_NanoSec_ST3 (rba_Nds_ApplicationRepresentation)
                rba_Nds_DirectRepresentation: rba_Nds_MinValue=0, rba_Nds_MaxValue=4294967295
            rba_Nds_TransmitGroupSignalApplicationPort_IMU_A_TmSync_Stat_ST3: rba_Nds_DataType=UINT8, rba_Nds_Name=TymsyncStat, rba_Nds_Description=time stamp value
              rba_Nds_ApplicationRepresentation_IMU_A_TmSync_Stat_ST3 (rba_Nds_ApplicationRepresentation)
                rba_Nds_DirectRepresentation: rba_Nds_MinValue=0, rba_Nds_MaxValue=128
            rba_Nds_TransmitGroupSignalApplicationPort_SQC_IMU_A_Output_Pr5_ST3: rba_Nds_Name=Sqc, rba_Nds_DataType=UINT8, rba_Nds_Description=sequence counter
              rba_Nds_ApplicationRepresentation_SQC_IMU_A_Output_Pr5_ST3 (rba_Nds_ApplicationRepresentation)
                rba_Nds_DirectRepresentation: rba_Nds_MinValue=0, rba_Nds_MaxValue=255
            TransmitGroupSignalApplicationPort_CRC_IMU_A_Output_Pr5_ST3: rba_Nds_DataType=UINT16, rba_Nds_Name=Crc, rba_Nds_Description=Crc
              rba_Nds_ApplicationRepresentation_CRC_IMU_A_Output_Pr5_ST3 (rba_Nds_ApplicationRepresentation)
                rba_Nds_DirectRepresentation: rba_Nds_MinValue=0, rba_Nds_MaxValue=65535
            rba_Nds_TransmitGroupSignalApplicationPort_Rsrv01_IMU_A_Output_Pr5_ST3: rba_Nds_Name=Reserved_1, rba_Nds_Description=reserved, rba_Nds_DataType=UINT16
              rba_Nds_ApplicationRepresentation_Rsrv01_IMU_A_Output_Pr5_ST3 (rba_Nds_ApplicationRepresentation)
                rba_Nds_DirectRepresentation: rba_Nds_MinValue=0, rba_Nds_MaxValue=511
            rba_Nds_TransmitGroupSignalApplicationPort_Rsrv02_IMU_A_Output_Pr5_ST3: rba_Nds_Name=Reserved_2, rba_Nds_DataType=UINT8, rba_Nds_Description=reserved
              rba_Nds_ApplicationRepresentation_Rsrv02_IMU_A_Output_Pr5_ST3 (rba_Nds_ApplicationRepresentation)
                rba_Nds_DirectRepresentation: rba_Nds_MinValue=0, rba_Nds_MaxValue=255
            rba_Nds_TransmitGroupSignalApplicationPort_Rsrv03_IMU_A_Output_Pr5_ST3: rba_Nds_Name=Reserved_3, rba_Nds_DataType=UINT8, rba_Nds_Description=reserved
              rba_Nds_ApplicationRepresentation_Rsrv03_IMU_A_Output_Pr5_ST3 (rba_Nds_ApplicationRepresentation)
                rba_Nds_DirectRepresentation: rba_Nds_MinValue=0, rba_Nds_MaxValue=255
            rba_Nds_TransmitGroupSignalApplicationPort_Rsrv04_IMU_A_Output_Pr5_ST3: rba_Nds_Name=Reserved_4, rba_Nds_DataType=UINT8, rba_Nds_Description=reserved
              rba_Nds_ApplicationRepresentation_Rsrv04_IMU_A_Output_Pr5_ST3 (rba_Nds_ApplicationRepresentation)
                rba_Nds_DirectRepresentation: rba_Nds_MinValue=0, rba_Nds_MaxValue=255
            rba_Nds_TransmitGroupSignalApplicationPort_Rsrv05_IMU_A_Output_Pr5_ST3: rba_Nds_Name=Reserved_5, rba_Nds_DataType=UINT8, rba_Nds_Description=reserved
              rba_Nds_ApplicationRepresentation_Rsrv05_IMU_A_Output_Pr5_ST3 (rba_Nds_ApplicationRepresentation)
                rba_Nds_DirectRepresentation: rba_Nds_MaxValue=255, rba_Nds_MinValue=0
            rba_Nds_TransmitGroupSignalApplicationPort_Rsrv06_IMU_A_Output_Pr5_ST3: rba_Nds_Name=Reserved_6, rba_Nds_DataType=UINT16, rba_Nds_Description=reserved
              rba_Nds_ApplicationRepresentation_Rsrv06_IMU_A_Output_Pr5_ST3 (rba_Nds_ApplicationRepresentation)
                rba_Nds_DirectRepresentation: rba_Nds_MinValue=0, rba_Nds_MaxValue=65535
            rba_Nds_TransmitGroupSignalApplicationPort_Rsrv07_IMU_A_Output_Pr5_ST3: rba_Nds_Name=Reserved_7, rba_Nds_DataType=UINT8, rba_Nds_Description=reserved
              rba_Nds_ApplicationRepresentation_Rsrv07_IMU_A_Output_Pr5_ST3 (rba_Nds_ApplicationRepresentation)
                rba_Nds_DirectRepresentation: rba_Nds_MaxValue=7, rba_Nds_MinValue=0
    rba_Nds_Project: rba_Nds_ProjectName=MyProject, rba_Nds_Editor=rba_Nds, rba_Nds_Department=CAP-SST/ESA2, rba_Nds_Baseline=01.2020
  module config rba_Nds_Cc
    rba_Nds_Cc_SignalEvaluations
    rba_Nds_Cc_NdsApplicationPortMappings
      15 x rba_Nds_Cc_NdsReceiveSignalApplicationPortMapping, all with rba_Nds_Cc_MessageInterfaceType=RBMESG:
        rba_Nds_Cc_NdsReceiveSignalApplicationPortMapping_VehSpd_Disp_ST3: rba_Nds_Cc_NdsReceiveSignalApplicationPortRef=rba_Nds_ReceiveSignalApplicationPort_VehSpd_Disp_ST3
        rba_Nds_Cc_NdsReceiveSignalApplicationPortMapping_Actv_Line_Stat_ST3: rba_Nds_Cc_NdsReceiveSignalApplicationPortRef=rba_Nds_ReceiveSignalApplicationPort_Actv_Line_Stat_ST3
        rba_Nds_Cc_NdsReceiveSignalApplicationPortMapping_DidA_ExtTest_Pres_ST3: rba_Nds_Cc_NdsReceiveSignalApplicationPortRef=rba_Nds_ReceiveSignalApplicationPort_DidA_ExtTest_Pres_ST3
        rba_Nds_Cc_NdsReceiveSignalApplicationPortMapping_PN14_TransMd_Stat_ST3: rba_Nds_Cc_NdsReceiveSignalApplicationPortRef=rba_Nds_ReceiveSignalApplicationPort_PN14_TransMd_Stat_ST3
        rba_Nds_Cc_NdsReceiveSignalApplicationPortMapping_PN14_SupBat_Stat_ST3: rba_Nds_Cc_NdsReceiveSignalApplicationPortRef=rba_Nds_ReceiveSignalApplicationPort_PN14_SupBat_Stat_ST3
        rba_Nds_Cc_NdsReceiveSignalApplicationPortMapping_PN14_ExtBat_Charge_Actv_ST3: rba_Nds_Cc_NdsReceiveSignalApplicationPortRef=rba_Nds_ReceiveSignalApplicationPort_PN14_ExtBat_Charge_Actv_ST3
        rba_Nds_Cc_NdsReceiveSignalApplicationPortMapping_PN14_DDP_Sw_Stat_ST3: rba_Nds_Cc_NdsReceiveSignalApplicationPortRef=rba_Nds_ReceiveSignalApplicationPort_PN14_DDP_Sw_Stat_ST3
        rba_Nds_Cc_NdsReceiveSignalApplicationPortMapping_PN14_SupBat_Volt_ST3: rba_Nds_Cc_NdsReceiveSignalApplicationPortRef=rba_Nds_ReceiveSignalApplicationPort_PN14_SupBat_Volt_ST3
        rba_Nds_Cc_NdsReceiveSignalApplicationPortMapping_PN14_ProdMd_BatStat_ST3: rba_Nds_Cc_NdsReceiveSignalApplicationPortRef=rba_Nds_ReceiveSignalApplicationPort_PN14_ProdMd_BatStat_ST3
        rba_Nds_Cc_NdsReceiveSignalApplicationPortMapping_PN14_SupBat_Curr_ST3: rba_Nds_Cc_NdsReceiveSignalApplicationPortRef=rba_Nds_ReceiveSignalApplicationPort_PN14_SupBat_Curr_ST3
        rba_Nds_Cc_NdsReceiveSignalApplicationPortMapping_PN14_SupBat_Temp_ST3: rba_Nds_Cc_NdsReceiveSignalApplicationPortRef=rba_Nds_ReceiveSignalApplicationPort_PN14_SupBat_Temp_ST3
        rba_Nds_Cc_NdsReceiveSignalApplicationPortMapping_PN14_ProdMd_Stat_ST3: rba_Nds_Cc_NdsReceiveSignalApplicationPortRef=rba_Nds_ReceiveSignalApplicationPort_PN14_ProdMd_Stat_ST3
        rba_Nds_Cc_NdsReceiveSignalApplicationPortMapping_PN14_DDP_Sw2_Stat_ST3: rba_Nds_Cc_NdsReceiveSignalApplicationPortRef=rba_Nds_ReceiveSignalApplicationPort_PN14_DDP_Sw2_Stat_ST3
        rba_Nds_Cc_NdsReceiveSignalApplicationPortMapping_PN14_PNSec_RechargeEnable_ST3: rba_Nds_Cc_NdsReceiveSignalApplicationPortRef=rba_Nds_ReceiveSignalApplicationPort_PN14_PNSec_RechargeEnable_ST3
        rba_Nds_Cc_NdsReceiveSignalApplicationPortMapping_Platform_Stat_Star3: rba_Nds_Cc_NdsReceiveSignalApplicationPortRef=rba_Nds_ReceiveSignalApplicationPort_Platform_Stat_Star3
      10 x rba_Nds_Cc_NdsReceiveSignalGroupApplicationPortMapping, all with rba_Nds_Cc_MessageInterfaceType=RBMESG:
        rba_Nds_Cc_NdsReceiveSignalGroupApplicationPortMapping_Odo_ST3: rba_Nds_Cc_NdsReceiveSignalGroupApplicationPortRef=rba_Nds_ReceiveSignalGroupApplicationPort_DI_OdoSpeedometer_ST3
        rba_Nds_Cc_NdsReceiveSignalGroupApplicationPortMapping_Ign_Stat_ST3: rba_Nds_Cc_NdsReceiveSignalGroupApplicationPortRef=rba_Nds_ReceiveSignalGroupApplicationPort_Ign_Stat_ST3
        rba_Nds_Cc_NdsReceiveSignalGroupApplicationPortMapping_PT4_PTCoor4_ST3: rba_Nds_Cc_NdsReceiveSignalGroupApplicationPortRef=rba_Nds_ReceiveSignalGroupApplicationPort_PT4_PTCoor4_ST3
        rba_Nds_Cc_NdsReceiveSignalGroupApplicationPortMapping_BCS_Whl_Msg1_BTC_Pr5_ST3: rba_Nds_Cc_NdsReceiveSignalGroupApplicationPortRef=rba_Nds_ReceiveSignalGroupApplicationPort_BCS_Whl_Msg1_BTC_Pr5_ST3
        rba_Nds_Cc_NdsReceiveSignalGroupApplicationPortMapping_VSS_TP_VIN_ST3: rba_Nds_Cc_NdsReceiveSignalGroupApplicationPortRef=rba_Nds_ReceiveSignalGroupApplicationPort_VSS_TP_VIN_ST3
        rba_Nds_Cc_NdsReceiveSignalGroupApplicationPortMapping_VSS_TP_SharedSecret_ST3: rba_Nds_Cc_NdsReceiveSignalGroupApplicationPortRef=rba_Nds_ReceiveSignalGroupApplicationPort_VSS_TP_SharedSecret_ST3
        rba_Nds_Cc_NdsReceiveSignalGroupApplicationPortMapping_VSS_TP_SecTickCount_Lvl1_ST3: rba_Nds_Cc_NdsReceiveSignalGroupApplicationPortRef=rba_Nds_ReceiveSignalGroupApplicationPort_VSS_TP_SecTickCount_Lvl1_ST3
        rba_Nds_Cc_NdsReceiveSignalGroupApplicationPortMapping_VSS_TP_RealTmOffset_ST3: rba_Nds_Cc_NdsReceiveSignalGroupApplicationPortRef=rba_Nds_ReceiveSignalGroupApplicationPort_VSS_TP_RealTmOffset_ST3
        rba_Nds_Cc_NdsReceiveSignalGroupApplicationPortMapping_VSS_TP_Auth_ST3: rba_Nds_Cc_NdsReceiveSignalGroupApplicationPortRef=rba_Nds_ReceiveSignalGroupApplicationPort_VSS_TP_Auth_ST3
        rba_Nds_Cc_NdsReceiveSignalGroupApplicationPortMapping_ADAS_HAD_Stat_IDC_S_FSI_Bckp_ST3: rba_Nds_Cc_NdsReceiveSignalGroupApplicationPortRef=rba_Nds_ReceiveSignalGroupApplicationPort_ADAS_HAD_Stat_IDC_S_FSI_Bckp_ST3
      rba_Nds_Cc_NdsTransmitSignalGroupApplicationPortMapping_0 (rba_Nds_Cc_NdsTransmitSignalGroupApplicationPortMapping): rba_Nds_Cc_MessageInterfaceType=RBMESG, rba_Nds_Cc_NdsTransmitSignalGroupApplicationPortRef=rba_Nds_TransmitSignalGroupApplicationPort_1
    rba_Nds_Cc_SignalGroupProtections
      5 x rba_Nds_Cc_ReceiveSignalGroupProtection:
        rba_Nds_Cc_ReceiveSignalGroupProtection_Ign_Stat_ST3: rba_Nds_Cc_ReceiveSignalGroupNetworkPortRef=rba_Nds_ReceiveSignalGroupNetworkPort_Ign_Stat_Pr5_ST3_csgs1dv6drms80o1i9p49677w
          rba_Nds_Cc_Checksum
            rba_Nds_Cc_DemReporting_0 (rba_Nds_Cc_DemReporting): rba_Nds_Cc_DemEventName=RBL_CUSTIF_SAFETY_Ign_Stat_ST3, rba_Nds_Cc_DemEventRef=RBL_CUSTIF_SAFETY_Ign_Stat_ST3
            rba_Nds_Cc_Function: rba_Nds_Cc_Name=e2e_p05
          rba_Nds_Cc_Timeout
            rba_Nds_Cc_DemReporting_0 (rba_Nds_Cc_DemReporting): rba_Nds_Cc_DemEventName=RBL_CUSTIF_TIMEOUT_Ign_Stat_ST3, rba_Nds_Cc_DemEventRef=RBL_CUSTIF_TIMEOUT_Ign_Stat_ST3
          rba_Nds_Cc_Counter
            rba_Nds_Cc_DemReporting_0 (rba_Nds_Cc_DemReporting): rba_Nds_Cc_DemEventName=RBL_CUSTIF_SQC_Ign_Stat_ST3, rba_Nds_Cc_DemEventRef=RBL_CUSTIF_SQC_Ign_Stat_ST3
            rba_Nds_Cc_Function: rba_Nds_Cc_Name=e2e_p05
        rba_Nds_Cc_ReceiveSignalGroupProtection_PT4_PTCoor4_ST3: rba_Nds_Cc_ReceiveSignalGroupNetworkPortRef=rba_Nds_ReceiveSignalGroupNetworkPort_PT4_PTCoor4_Pr5_ST3_af4fxb1ykieox3itqdfzs0kpb
          rba_Nds_Cc_Checksum
            rba_Nds_Cc_DemReporting_0 (rba_Nds_Cc_DemReporting): rba_Nds_Cc_DemEventName=RBL_CUSTIF_SAFETY_PT4_PTCoor4_ST3, rba_Nds_Cc_DemEventRef=RBL_CUSTIF_SAFETY_PT4_PTCoor4_ST3
            rba_Nds_Cc_Function: rba_Nds_Cc_Name=e2e_p05
          rba_Nds_Cc_Timeout
            rba_Nds_Cc_DemReporting_0 (rba_Nds_Cc_DemReporting): rba_Nds_Cc_DemEventName=RBL_CUSTIF_TIMEOUT_PT4_PTCoor4_ST3, rba_Nds_Cc_DemEventRef=RBL_CUSTIF_TIMEOUT_PT4_PTCoor4_ST3
          rba_Nds_Cc_Counter
            rba_Nds_Cc_DemReporting_0 (rba_Nds_Cc_DemReporting): rba_Nds_Cc_DemEventName=RBL_CUSTIF_SQC_PT4_PTCoor4_ST3, rba_Nds_Cc_DemEventRef=RBL_CUSTIF_SQC_PT4_PTCoor4_ST3
            rba_Nds_Cc_Function: rba_Nds_Cc_Name=e2e_p05
        rba_Nds_Cc_ReceiveSignalGroupProtection_BCS_Whl_Msg1_BTC_ST3: rba_Nds_Cc_ReceiveSignalGroupNetworkPortRef=rba_Nds_ReceiveSignalGroupNetworkPort_BCS_Whl_Msg1_BTC_Pr5_ST3_3z5vvcdtzaheg7vz23u7gb0g6
          rba_Nds_Cc_Checksum
            rba_Nds_Cc_DemReporting_0 (rba_Nds_Cc_DemReporting): rba_Nds_Cc_DemEventName=RBL_CUSTIF_SAFETY_BCS_Whl_Msg1_BTC_ST3, rba_Nds_Cc_DemEventRef=RBL_CUSTIF_SAFETY_BCS_Whl_Msg1_BTC_ST3
            rba_Nds_Cc_Function: rba_Nds_Cc_Name=e2e_p05
          rba_Nds_Cc_Timeout
            rba_Nds_Cc_DemReporting_BCS_Whl_Msg1_BTC_ST3 (rba_Nds_Cc_DemReporting): rba_Nds_Cc_DemEventName=RBL_CUSTIF_TIMEOUT_BCS_Whl_Msg1_BTC_ST3, rba_Nds_Cc_DemEventRef=RBL_CUSTIF_TIMEOUT_BCS_Whl_Msg1_BTC_ST3
          rba_Nds_Cc_Counter
            rba_Nds_Cc_DemReporting_0 (rba_Nds_Cc_DemReporting): rba_Nds_Cc_DemEventName=RBL_CUSTIF_SQC_BCS_Whl_Msg1_BTC_ST3, rba_Nds_Cc_DemEventRef=RBL_CUSTIF_SQC_BCS_Whl_Msg1_BTC_ST3
            rba_Nds_Cc_Function: rba_Nds_Cc_Name=e2e_p05
        rba_Nds_Cc_ReceiveSignalGroupProtection_ADAS_HAD_Stat_IDC_S_FSI_Bckp_ST3: rba_Nds_Cc_ReceiveSignalGroupNetworkPortRef=rba_Nds_ReceiveSignalGroupNetworkPort_ADAS_HAD_Stat_IDC_S_FSI_Bckp_Pr5_ST3_1hazv0zum1rfjs1udwdzrjfp4
          rba_Nds_Cc_Checksum
            rba_Nds_Cc_DemReporting_0 (rba_Nds_Cc_DemReporting):
              rba_Nds_Cc_DemEventName = RBL_CUSTIF_SAFETY_HAD_Stat_IDC_S_FSI_Bckp_Pr5_ST3
              rba_Nds_Cc_DemEventRef = RBL_CUSTIF_SAFETY_HAD_Stat_IDC_S_FSI_Bckp_Pr5_ST3
            rba_Nds_Cc_Function: rba_Nds_Cc_Name=e2e_p05
          rba_Nds_Cc_Counter
            rba_Nds_Cc_DemReporting_0 (rba_Nds_Cc_DemReporting): rba_Nds_Cc_DemEventName=RBL_CUSTIF_SQC_HAD_Stat_IDC_S_FSI_Bckp_Pr5_ST3, rba_Nds_Cc_DemEventRef=RBL_CUSTIF_SQC_HAD_Stat_IDC_S_FSI_Bckp_Pr5_ST3
            rba_Nds_Cc_Function: rba_Nds_Cc_Name=e2e_p05
          rba_Nds_Cc_Timeout
            rba_Nds_Cc_DemReporting_0 (rba_Nds_Cc_DemReporting):
              rba_Nds_Cc_DemEventName = RBL_CUSTIF_TIMEOUT_HAD_Stat_IDC_S_FSI_Bckp_Pr5_ST3
              rba_Nds_Cc_DemEventRef = RBL_CUSTIF_TIMEOUT_HAD_Stat_IDC_S_FSI_Bckp_Pr5_ST3
        rba_Nds_Cc_ReceiveSignalGroupProtection_DI_OdoSpeedometer_ST3: rba_Nds_Cc_ReceiveSignalGroupNetworkPortRef=rba_Nds_ReceiveSignalGroupNetworkPort_DI_Odo_Pr5_ST3_e68xmtlkywxgxsdwekdjjhw3t
          rba_Nds_Cc_Checksum
            rba_Nds_Cc_DemReporting_0 (rba_Nds_Cc_DemReporting): rba_Nds_Cc_DemEventName=RBL_CUSTIF_SAFETY_DI_OdoSpeedometer_ST3, rba_Nds_Cc_DemEventRef=RBL_CUSTIF_SAFETY_DI_OdoSpeedometer_ST3
            rba_Nds_Cc_Function: rba_Nds_Cc_Name=e2e_p05
          rba_Nds_Cc_Counter
            rba_Nds_Cc_DemReporting_0 (rba_Nds_Cc_DemReporting): rba_Nds_Cc_DemEventName=RBL_CUSTIF_SQC_DI_OdoSpeedometer_ST3, rba_Nds_Cc_DemEventRef=RBL_CUSTIF_SQC_DI_OdoSpeedometer_ST3
            rba_Nds_Cc_Function: rba_Nds_Cc_Name=e2e_p05
          rba_Nds_Cc_Timeout
            rba_Nds_Cc_DemReporting_0 (rba_Nds_Cc_DemReporting): rba_Nds_Cc_DemEventName=RBL_CUSTIF_TIMEOUT_DI_OdoSpeedometer_ST3, rba_Nds_Cc_DemEventRef=RBL_CUSTIF_TIMEOUT_DI_OdoSpeedometer_ST3
      rba_Nds_Cc_TransmitSignalGroupProtection_IMU_A_Output_Pr5_ST3 (rba_Nds_Cc_TransmitSignalGroupProtection):
        rba_Nds_Cc_ProcessingAssignment = TRANSMIT
        rba_Nds_Cc_TransmitSignalGroupNetworkPortRef = rba_Nds_TransmitSignalGroupNetworkPort_IMU_A_Output_Pr5_ST3_bezr5ct33mhwxias0s8rjhbne
        rba_Nds_Cc_Counter
          rba_Nds_Cc_Function: rba_Nds_Cc_Name=e2e_p05
        rba_Nds_Cc_Checksum
          rba_Nds_Cc_Function: rba_Nds_Cc_Name=e2e_p05
      rba_Nds_Cc_TransmitSignalGroupProtection_IMU_A_Output_Fast_Pr5_ST3 (rba_Nds_Cc_TransmitSignalGroupProtection):
        rba_Nds_Cc_ProcessingAssignment = TRANSMIT
        rba_Nds_Cc_TransmitSignalGroupNetworkPortRef = rba_Nds_TransmitSignalGroupNetworkPort_IMU_A_Output_Fast_Pr5_ST3_5ym0lyqjosyobfhfksta75zc4
        rba_Nds_Cc_Checksum
          rba_Nds_Cc_Function: rba_Nds_Cc_Name=e2e_p05
        rba_Nds_Cc_Counter
          rba_Nds_Cc_Function: rba_Nds_Cc_Name=e2e_p05
    rba_Nds_Cc_PduProtections
      4 x rba_Nds_Cc_ReceivePduProtection:
        rba_Nds_Cc_ReceivePduProtection_FBL_Cfg_Star3_ST3: rba_Nds_Cc_ReceiveSignalPduRef=rba_Nds_ReceivePdu_FBL_Cfg_Star3_ST3/rba_Nds_ReceiveSignalPdu
          rba_Nds_Cc_Timeout
            rba_Nds_Cc_DemReporting_0 (rba_Nds_Cc_DemReporting): rba_Nds_Cc_DemEventName=RBL_CUSTIF_TIMEOUT_FBL_Cfg_Star3_ST3, rba_Nds_Cc_DemEventRef=RBL_CUSTIF_TIMEOUT_FBL_Cfg_Star3_ST3
        rba_Nds_Cc_ReceivePduProtection_PN14_Master_Stat1_ST3: rba_Nds_Cc_ReceiveSignalPduRef=rba_Nds_ReceivePdu_ESP_HAD_BACKUP_GW_Container4_ST3_PN14_Master_Stat1_ST3/rba_Nds_ReceiveSignalPdu
          rba_Nds_Cc_Timeout
            rba_Nds_Cc_DemReporting: rba_Nds_Cc_DemEventName=RBL_CUSTIF_TIMEOUT_PN14_Master_Stat1_ST3, rba_Nds_Cc_DemEventRef=RBL_CUSTIF_TIMEOUT_PN14_Master_Stat1_ST3
        rba_Nds_Cc_ReceivePduProtection_DIAG_Stat_ST3: rba_Nds_Cc_ReceiveSignalPduRef=rba_Nds_ReceivePdu_ESP_HAD_BACKUP_GW_Container4_ST3_DIAG_Stat_ST3/rba_Nds_ReceiveSignalPdu
          rba_Nds_Cc_Timeout
            rba_Nds_Cc_DemReporting_0 (rba_Nds_Cc_DemReporting): rba_Nds_Cc_DemEventName=RBL_CUSTIF_TIMEOUT_DIAG_Stat_ST3, rba_Nds_Cc_DemEventRef=RBL_CUSTIF_TIMEOUT_DIAG_Stat_ST3
        rba_Nds_Cc_ReceivePduProtection_DI_OdoSpeedometer_ST3: rba_Nds_Cc_ReceiveSignalPduRef=rba_Nds_ReceivePdu_ESP_HAD_BACKUP_GW_Container4_ST3_DI_OdoSpeedometer_ST3/rba_Nds_ReceiveSignalPdu
          rba_Nds_Cc_Timeout
            rba_Nds_Cc_DemReporting_0 (rba_Nds_Cc_DemReporting): rba_Nds_Cc_DemEventName=RBL_CUSTIF_TIMEOUT_DI_OdoSpeedometer_ST3, rba_Nds_Cc_DemEventRef=RBL_CUSTIF_TIMEOUT_DI_OdoSpeedometer_ST3
