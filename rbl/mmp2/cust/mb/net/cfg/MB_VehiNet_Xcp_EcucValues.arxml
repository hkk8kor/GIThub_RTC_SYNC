AUTOSAR XML (schema 4-0-2)
package /RB/UBK/Project/EcucModuleConfigurationValuess
  module config Can
    CanConfigSet
      XcpXMT (CanHardwareObject):
        CanHandleType = FULL
        CanIdType = STANDARD
        CanObjectType = TRANSMIT
        CanControllerRef = CanIfControllerConfig_1
        CanMainFunctionRWPeriodRef = CanMainFunctionRWPeriods_5ms
      XcpRCV (CanHardwareObject):
        CanHandleType = FULL
        CanIdType = STANDARD
        CanObjectType = RECEIVE
        CanControllerRef = CanIfControllerConfig_1
        CanMainFunctionRWPeriodRef = CanMainFunctionRWPeriods_5ms
        CanHwFilter_0 (CanHwFilter): CanHwFilterCode=819, CanHwFilterMask=2047
  module config CanIf
    CanIfInitCfg: CanIfInitCfgSet=not_supported
      CanIfBufferCfg_XcpXMT (CanIfBufferCfg): CanIfBufferSize=0, CanIfBufferHthRef=CanIfInitHohCfg/XcpXMT
      CanIfInitHohCfg
        XcpRCV (CanIfHrhCfg): CanIfHrhCanCtrlIdRef=CanIfControllerConfig_1, CanIfHrhIdSymRef=CanConfigSet/XcpRCV
        XcpXMT (CanIfHthCfg): CanIfHthCanCtrlIdRef=CanIfControllerConfig_1, CanIfHthIdSymRef=CanConfigSet/XcpXMT
      XcpRCV (CanIfRxPduCfg):
        CanIfRxPduCanId = 819
        CanIfRxPduCanIdType = STANDARD_FD_CAN
        CanIfRxPduReadData = false
        CanIfRxPduReadNotifyStatus = true
        CanIfRxPduUserRxIndicationName = Xcp_CanIfRxIndication
        CanIfRxPduUserRxIndicationUL = XCP
        CanIfRxPduDataLength = 0
        CanIfRxPduHrhIdRef = CanIfInitHohCfg/XcpRCV
        CanIfRxPduRef = CanIf2XcpRx_CMD
      XcpXMT (CanIfTxPduCfg):
        CanIfTxPduCanId = 1911
        CanIfTxPduCanIdType = STANDARD_FD_CAN
        CanIfTxPduReadNotifyStatus = true
        CanIfTxPduTruncation = true
        CanIfTxPduType = STATIC
        CanIfTxPduUserTxConfirmationName = Xcp_CanIfTxConfirmation
        CanIfTxPduUserTxConfirmationUL = XCP
        CanIfTxPduBufferRef = CanIfBufferCfg_XcpXMT
        CanIfTxPduRef = Xcp2CanIfTx_RES
  module config EcuC
    EcucConfigSet
      EcucPduCollection
        3 x Pdu, all with PduLength=64:
          Xcp2CanIfTx_RES
          CanIf2XcpRx_CMD
          CanIf2Xcp_RxStim
  module config Xcp
    XcpConfig
      XcpCommunicationChannel_0 (XcpCommunicationChannel):
        XcpDaqMemoryLimit = 16384
        XcpDaqMemoryLimitEmulationDevice = 0
        XcpDaqOverloadIndication = OVERLOAD_INDICATION_EVENT
        XcpIdentificationFieldType = ABSOLUTE
        XcpMaxCto = 64
        XcpMaxDto = 64
        XcpTransportLayerName = CAN_0_PL0
        XcpTimestampType = NO_TIME_STAMP
        XcpTransportLayerType = CAN
        XcpRx_CMD (XcpRxPdu): XcpRxPacketType=CMD_STIM, XcpRxPduRef=CanIf2XcpRx_CMD
        XcpTx_RES (XcpTxPdu): XcpTxPacketType=RES_ERR_EV_SERV_DAQ, XcpTxPduRef=Xcp2CanIfTx_RES
      8 x XcpEventChannel, all with XcpEventChannelType=DAQ:
        MTTask500us: XcpEventChannelName=c_MT_Default_Task_500us, XcpEventChannelPriority=141, XcpEventChannelShortName=500_us, XcpEventChannelTimeCycle=5, XcpEventChannelTimeUnit=TIMESTAMP_UNIT_100US
        MTTask1ms: XcpEventChannelName=c_MT_Default_Task_1ms, XcpEventChannelPriority=140, XcpEventChannelShortName=1_ms, XcpEventChannelTimeCycle=1, XcpEventChannelTimeUnit=TIMESTAMP_UNIT_1MS
        MTTaskx1: XcpEventChannelName=c_MT_Default_Task_x1, XcpEventChannelPriority=139, XcpEventChannelShortName=x1, XcpEventChannelTimeCycle=5, XcpEventChannelTimeUnit=TIMESTAMP_UNIT_1MS
        MTTaskx2: XcpEventChannelName=c_MT_Default_Task_x2, XcpEventChannelPriority=138, XcpEventChannelShortName=x2, XcpEventChannelTimeCycle=1, XcpEventChannelTimeUnit=TIMESTAMP_UNIT_10MS
        MTTaskx4: XcpEventChannelName=c_MT_Default_Task_x4, XcpEventChannelPriority=137, XcpEventChannelShortName=x4, XcpEventChannelTimeCycle=2, XcpEventChannelTimeUnit=TIMESTAMP_UNIT_10MS
        MTTaskx8: XcpEventChannelName=c_MT_Default_Task_x8, XcpEventChannelPriority=136, XcpEventChannelShortName=x8, XcpEventChannelTimeCycle=4, XcpEventChannelTimeUnit=TIMESTAMP_UNIT_10MS
        MTTaskx24: XcpEventChannelName=c_MT_Default_Task_x24, XcpEventChannelPriority=135, XcpEventChannelShortName=x24, XcpEventChannelTimeCycle=12, XcpEventChannelTimeUnit=TIMESTAMP_UNIT_10MS
        StAsyDbug: XcpEventChannelName=c_StartupAsyncDebug, XcpEventChannelPriority=134, XcpEventChannelShortName=StAsyDbug, XcpEventChannelTimeCycle=1, XcpEventChannelTimeUnit=TIMESTAMP_UNIT_1MS
    XcpGeneral:
      XcpBlockTransferDownload = false
      XcpBlockTransferUpload = false
      XcpCalibrationCal = true
      XcpCmdReceivedNotification = false
      XcpCommandChecksum = true
      XcpCommandGetDaqListMode = true
      XcpCommandGetId = true
      XcpCommandReadDaq = true
      XcpCommandsGetDaqInfo = true
      XcpDaqMemoryLimit = 21384
      XcpDevErrorDetect = false
      XcpEthMainFunctionPeriod = 0
      XcpMainFunctionPeriod = 0.01
      XcpMemoryReadProtection = false
      XcpMemoryWriteProtection = true
      XcpPageSwitchingPag = false
      XcpProductLine = CSMOSAR
      XcpResumeMode = true
      XcpSeedAndKey = true
      XcpSeedAndKeyExternalFunction = SeedNKeyXcp.dll
      XcpSynchronousDataAcquisitionDaq = true
      XcpSynchronousDataStimulationStim = false
      XcpTimestampTicks = 1
      XcpTimestampUnit = TIMESTAMP_UNIT_1US
      XcpUploadDownloadMemoryAccessByAppl = false
      XcpVersion = VERSION_1_2
      XcpVersionInfoApi = false
    XcpA2LFile: XcpTimeoutT1=25, XcpTimeoutT2=25, XcpTimeoutT7=200
