AUTOSAR XML (schema 4-2-2)
package /RB/UBK/Project/EcucModuleConfigurationValuess
  module config Can
    CanConfigSet
      5 x CanHardwareObject, all with CanFdPaddingValue=0, CanRbTxConfirmation=false, CanControllerRef=CanIfControllerConfig_2:
        ECU_Stat_IMU_B_DRIVING_ST3_ECU_Stat_IMU_B_DRIVING_ST3_9gx75oerwjcv2p44te3ujb3i6_DRIVING_DRIVING_OUT: CanHandleType=FULL, CanIdType=EXTENDED, CanObjectType=TRANSMIT, CanMainFunctionRWPeriodRef=CanMainFunctionRWPeriods_5ms
        Meas_IMU_D_ST3_Meas_IMU_D_ST3_bemvw6wo0cm3kjn9qx58q6k4p_DRIVING_DRIVING_OUT: CanHandleType=FULL, CanIdType=EXTENDED, CanObjectType=TRANSMIT, CanMainFunctionRWPeriodRef=CanMainFunctionRWPeriods_5ms
        GTS_Powertrain_CAN_ST3_GTS_Powertrain_CAN_ST3_bfjd1c4c4h59zrv73ktpjgpo6_DRIVING_DRIVING_IN: CanRbDedicatedTxBuffer=0, CanTriggerTransmitEnable=0, CanHandleType=FULL, CanIdType=STANDARD, CanObjectType=RECEIVE
          CanHwFilter_123 (CanHwFilter): CanHwFilterCode=123, CanHwFilterMask=2047
        NM_IMU_B_ST3_NM_IMU_B_ST3_cv4dtcmsty3v1eswmmt9el4ga_DRIVING_DRIVING_OUT: CanObjectType=TRANSMIT, CanHandleType=FULL, CanIdType=EXTENDED, CanMainFunctionRWPeriodRef=CanMainFunctionRWPeriods_5ms
        NM_Dummy_ST3_NM_Dummy_ST3_9v3d1gl8vye09x8qngb7pnawb_DRIVING_DRIVING_IN: CanObjectType=RECEIVE, CanIdType=EXTENDED, CanHandleType=BASIC, CanMainFunctionRWPeriodRef=CanMainFunctionRWPeriods_5ms
          CanHwFilter_339869696_339873791 (CanHwFilter): CanHwFilterCode=339869696, CanHwFilterMask=536866816
  module config CanIf
    CanIfInitCfg
      3 x CanIfBufferCfg, all with CanIfBufferSize=0:
        Bu_ECU_Stat_IMU_B_DRIVING_ST3_ECU_Stat_IMU_B_DRIVING_ST3_9gx75oerwjcv2p44te3ujb3i6_DRIVING_DRIVING_OUT: CanIfBufferHthRef=CanIfInitHohCfg/ECU_Stat_IMU_B_DRIVING_ST3_ECU_Stat_IMU_B_DRIVING_ST3_9gx75oerwjcv2p44te3ujb3i6_DRIVING_DRIVING_OUT
        Bu_Meas_IMU_D_ST3_Meas_IMU_D_ST3_bemvw6wo0cm3kjn9qx58q6k4p_DRIVING_DRIVING_OUT: CanIfBufferHthRef=CanIfInitHohCfg/Meas_IMU_D_ST3_Meas_IMU_D_ST3_bemvw6wo0cm3kjn9qx58q6k4p_DRIVING_DRIVING_OUT
        Bu_NM_IMU_B_ST3_NM_IMU_B_ST3_cv4dtcmsty3v1eswmmt9el4ga_DRIVING_DRIVING_OUT: CanIfBufferHthRef=CanIfInitHohCfg/NM_IMU_B_ST3_NM_IMU_B_ST3_cv4dtcmsty3v1eswmmt9el4ga_DRIVING_DRIVING_OUT
      CanIfInitHohCfg
        ECU_Stat_IMU_B_DRIVING_ST3_ECU_Stat_IMU_B_DRIVING_ST3_9gx75oerwjcv2p44te3ujb3i6_DRIVING_DRIVING_OUT (CanIfHthCfg):
          CanIfHthCanCtrlIdRef = CanIfControllerConfig_2
          CanIfHthIdSymRef = CanConfigSet/ECU_Stat_IMU_B_DRIVING_ST3_ECU_Stat_IMU_B_DRIVING_ST3_9gx75oerwjcv2p44te3ujb3i6_DRIVING_DRIVING_OUT
        NM_Dummy_ST3_NM_Dummy_ST3_9v3d1gl8vye09x8qngb7pnawb_DRIVING_DRIVING_IN (CanIfHrhCfg):
          CanIfHrhCanCtrlIdRef = CanIfControllerConfig_2
          CanIfHrhIdSymRef = CanConfigSet/NM_Dummy_ST3_NM_Dummy_ST3_9v3d1gl8vye09x8qngb7pnawb_DRIVING_DRIVING_IN
          CanIfHrhRangeCfg: CanIfHrhRangeRxPduLowerCanId=339869696, CanIfHrhRangeRxPduUpperCanId=339873791, CanIfHrhRangeRxPduRangeCanIdType=EXTENDED
        Meas_IMU_D_ST3_Meas_IMU_D_ST3_bemvw6wo0cm3kjn9qx58q6k4p_DRIVING_DRIVING_OUT (CanIfHthCfg):
          CanIfHthCanCtrlIdRef = CanIfControllerConfig_2
          CanIfHthIdSymRef = CanConfigSet/Meas_IMU_D_ST3_Meas_IMU_D_ST3_bemvw6wo0cm3kjn9qx58q6k4p_DRIVING_DRIVING_OUT
        GTS_Powertrain_CAN_ST3_GTS_Powertrain_CAN_ST3_bfjd1c4c4h59zrv73ktpjgpo6_DRIVING_DRIVING_IN (CanIfHrhCfg):
          CanIfHrhCanCtrlIdRef = CanIfControllerConfig_2
          CanIfHrhIdSymRef = CanConfigSet/GTS_Powertrain_CAN_ST3_GTS_Powertrain_CAN_ST3_bfjd1c4c4h59zrv73ktpjgpo6_DRIVING_DRIVING_IN
        NM_IMU_B_ST3_NM_IMU_B_ST3_cv4dtcmsty3v1eswmmt9el4ga_DRIVING_DRIVING_OUT (CanIfHthCfg):
          CanIfHthCanCtrlIdRef = CanIfControllerConfig_2
          CanIfHthIdSymRef = CanConfigSet/NM_IMU_B_ST3_NM_IMU_B_ST3_cv4dtcmsty3v1eswmmt9el4ga_DRIVING_DRIVING_OUT
      ECU_Stat_IMU_B_DRIVING_ST3_ECU_Stat_IMU_B_DRIVING_ST3_9gx75oerwjcv2p44te3ujb3i6_DRIVING_DRIVING_OUT (CanIfTxPduCfg):
        CanIfTxPduCanId = 373424491
        CanIfTxPduCanIdType = EXTENDED_FD_CAN
        CanIfTxPduReadNotifyStatus = false
        CanIfTxPduTruncation = false
        CanIfTxPduUserTxConfirmationName = PduR_CanIfTxConfirmation
        CanIfTxPduUserTxConfirmationUL = PDUR
        CanIfTxPduBufferRef = Bu_ECU_Stat_IMU_B_DRIVING_ST3_ECU_Stat_IMU_B_DRIVING_ST3_9gx75oerwjcv2p44te3ujb3i6_DRIVING_DRIVING_OUT
        CanIfTxPduRef = ECU_Stat_IMU_B_DRIVING_ST3_PduR2CanIf_DRIVING_CAN
      NM_Dummy_ST3_NM_Dummy_ST3_9v3d1gl8vye09x8qngb7pnawb_DRIVING_DRIVING_IN (CanIfRxPduCfg):
        CanIfRxPduCanIdType = EXTENDED_CAN
        CanIfRxPduDataLength = 8
        CanIfRxPduUserRxIndicationName = CanNm_RxIndication
        CanIfRxPduUserRxIndicationUL = CAN_NM
        CanIfRxPduReadData = false
        CanIfRxPduReadNotifyStatus = false
        CanIfRxPduHrhIdRef = CanIfInitHohCfg/NM_Dummy_ST3_NM_Dummy_ST3_9v3d1gl8vye09x8qngb7pnawb_DRIVING_DRIVING_IN
        CanIfRxPduRef = NM_Dummy_ST3_CanIf2CanNm_DRIVING_CAN
        CanIfRxPduCanIdRange: CanIfRxPduCanIdRangeLowerCanId=339869696, CanIfRxPduCanIdRangeUpperCanId=339873791
      Meas_IMU_D_ST3_Meas_IMU_D_ST3_bemvw6wo0cm3kjn9qx58q6k4p_DRIVING_DRIVING_OUT (CanIfTxPduCfg):
        CanIfTxPduCanId = 417426576
        CanIfTxPduCanIdType = EXTENDED_FD_CAN
        CanIfTxPduReadNotifyStatus = false
        CanIfTxPduTruncation = false
        CanIfTxPduUserTxConfirmationName = PduR_CanIfTxConfirmation
        CanIfTxPduUserTxConfirmationUL = PDUR
        CanIfTxPduBufferRef = Bu_Meas_IMU_D_ST3_Meas_IMU_D_ST3_bemvw6wo0cm3kjn9qx58q6k4p_DRIVING_DRIVING_OUT
        CanIfTxPduRef = EcucPduCollection/Meas_IMU_D_ST3_PduR2CanIf_DRIVING_CAN
      GTS_Powertrain_CAN_ST3_GTS_Powertrain_CAN_ST3_bfjd1c4c4h59zrv73ktpjgpo6_DRIVING_DRIVING_IN (CanIfRxPduCfg):
        CanIfRxPduReadData = 0
        CanIfRxPduReadNotifyStatus = 0
        CanIfRxPduCanId = 123
        CanIfRxPduCanIdType = STANDARD_FD_CAN
        CanIfRxPduDataLength = 8
        CanIfRxPduUserRxIndicationName = CanTSyn_RxIndication
        CanIfRxPduUserRxIndicationUL = CAN_TSYN
        CanIfRxPduHrhIdRef = CanIfInitHohCfg/GTS_Powertrain_CAN_ST3_GTS_Powertrain_CAN_ST3_bfjd1c4c4h59zrv73ktpjgpo6_DRIVING_DRIVING_IN
        CanIfRxPduRef = GTS_Powertrain_CAN_ST3_GTS_Powertrain_CAN_ST3_DRIVING_DRIVING_IN
      NM_IMU_B_ST3_NM_IMU_B_ST3_cv4dtcmsty3v1eswmmt9el4ga_DRIVING_DRIVING_OUT (CanIfTxPduCfg):
        CanIfTxPduCanId = 339870059
        CanIfTxPduCanIdType = EXTENDED_CAN
        CanIfTxPduUserTxConfirmationName = CanNm_TxConfirmation
        CanIfTxPduUserTxConfirmationUL = CAN_NM
        CanIfTxPduPnFilterPdu = false
        CanIfTxPduReadNotifyStatus = false
        CanIfTxPduTruncation = false
        CanIfTxPduType = STATIC
        CanIfTxPduBufferRef = Bu_NM_IMU_B_ST3_NM_IMU_B_ST3_cv4dtcmsty3v1eswmmt9el4ga_DRIVING_DRIVING_OUT
        CanIfTxPduRef = NM_IMU_B_ST3_CanNm2CanIf_DRIVING_CAN
  module config Com
    ComConfig
      3 x ComIPdu, all with ComIPduDirection=SEND, ComIPduSignalProcessing=DEFERRED, ComIPduType=NORMAL:
        IP_ECU_Stat_IMU_B_DRIVING_ST3_CAN_Tx: ComIPduSignalRef=S_Awake_Diag_Actv_IMU_B_ST3_DRIVING_CAN_Tx, ComIPduSignalRef=S_Awake_NwStart_IMU_B_ST3_DRIVING_CAN_Tx, ComIPduSignalRef=S_ECU_Id_IMU_B_ST3_DRIVING_CAN_Tx, ComIPduSignalRef=S_NwId_Rsrv_ST3_DRIVING_CAN_Tx, ComIPduSignalRef=S_WakeupRsn_IMU_B_ST3_DRIVING_CAN_Tx, ComPduIdRef=ECU_Stat_IMU_B_DRIVING_ST3_Com2PduR_DRIVING_CAN, ComIPduGroupRef=IPG_IMU_B_IMU_B_DRIVING_CAN_Tx_PNC_All_Active_CAN, ComIPduGroupRef=IPG_IMU_B_IMU_B_DRIVING_CAN_Tx_PNC_20_CAN, ComIPduGroupRef=IPG_IMU_B_DRIVING_Tx_PNC_23_CAN
          ComTxIPdu: ComTxIPduUnusedAreasDefault=0, ComMinimumDelayTime=1.0
            ComTxModeTrue
              ComTxMode: ComTxModeMode=MIXED, ComTxModeTimeOffset=0.005, ComTxModeTimePeriod=1.0
        IP_Meas_IMU_D_ST3_DRIVING_CAN_Tx: ComIPduGroupRef=IPG_IMU_B_IMU_B_DRIVING_CAN_Tx_PNC_All_Active_CAN, ComIPduGroupRef=IPG_IMU_B_IMU_B_DRIVING_CAN_Tx_PNC_20_CAN, ComIPduSignalGroupRef=SG_Meas_IMU_D_ST3_aza6ns1u50ccdg7pxk0f64ws6_DRIVING_CAN_Tx, ComPduIdRef=EcucPduCollection/Meas_IMU_D_ST3_Com2PduR_DRIVING_CAN
          ComTxIPdu: ComMinimumDelayTime=0.02, ComTxIPduUnusedAreasDefault=0
            ComTxModeTrue
              ComTxMode: ComTxModeMode=DIRECT, ComTxModeNumberOfRepetitions=0
        IP_NM_IMU_B_ST3_DRIVING_CAN_Tx: ComPduIdRef=NM_IMU_B_ST3_Com2PduR_DRIVING_CAN, ComIPduSignalRef=S_NM_IMU_B_ST3_PNC_DRIVING_CAN_Tx
          ComTxIPdu: ComTxIPduUnusedAreasDefault=0
            ComTxModeTrue
              ComTxMode: ComTxModeMode=NONE
      15 x ComIPduGroup:
        IPG_IMU_B_IMU_B_DRIVING_CAN_Tx_PNC_All_Active_CAN
        IPG_IMU_B_IMU_B_DRIVING_CAN_Tx_PNC_20_CAN
        IPG_IMU_B_IMU_INTERNAL_Rx_PNC_All_Active_CAN
        IPG_IMU_B_IMU_INTERNAL_Rx_PNC_15_ComCtrl_CAN
        IPG_IMU_B_IMU_INTERNAL_Rx_PNC_20_CAN
        IPG_IMU_B_IMU_INTERNAL_Tx_PNC_All_Active_CAN
        IPG_IMU_B_IMU_INTERNAL_Tx_PNC_20_CAN
        IPG_IMU_B_DRIVING_Tx_PNC_23_CAN
        IPG_TxMess_IMU_B_DRIVING_CAN
        IPG_IMU_B_HAD_IMU_Tx_PNC_23_CAN
        IPG_IMU_B_IMU_INTERNAL_Rx_PNC_23_CAN
        IPG_IMU_B_IMU_INTERNAL_Tx_PNC_23_CAN
        IPG_TxMess_IMU_B_IMU_INTERNAL_CAN
        IPG_IMU_B_IMU_INTERNAL_Rx_PNC_20_CAN
        IPG_IMU_B_IMU_INTERNAL_Rx_PNC_All_Active_CAN
      6 x ComSignal:
        S_Awake_Diag_Actv_IMU_B_ST3_DRIVING_CAN_Tx: ComBitPosition=30, ComBitSize=1, ComSignalEndianness=LITTLE_ENDIAN, ComSignalType=BOOLEAN, ComTransferProperty=TRIGGERED, ComSignalInitValue=0, ComSystemTemplateSystemSignalRef=Awake_Diag_Actv_IMU_B_ST3
        S_Awake_NwStart_IMU_B_ST3_DRIVING_CAN_Tx: ComBitPosition=31, ComBitSize=1, ComSignalEndianness=LITTLE_ENDIAN, ComSignalType=BOOLEAN, ComTransferProperty=TRIGGERED, ComSignalInitValue=0, ComSystemTemplateSystemSignalRef=Awake_NwStart_IMU_B_ST3
        S_ECU_Id_IMU_B_ST3_DRIVING_CAN_Tx: ComBitPosition=0, ComBitSize=12, ComSignalEndianness=LITTLE_ENDIAN, ComSignalType=UINT16, ComTransferProperty=TRIGGERED, ComSignalInitValue=363, ComSystemTemplateSystemSignalRef=ECU_Id_IMU_B_ST3
        S_NwId_Rsrv_ST3_DRIVING_CAN_Tx: ComBitPosition=12, ComBitSize=8, ComSignalEndianness=LITTLE_ENDIAN, ComSignalType=UINT8, ComTransferProperty=TRIGGERED, ComSignalInitValue=46, ComSystemTemplateSystemSignalRef=NwId_IMU_B_DRIVING_CAN_ST3
        S_WakeupRsn_IMU_B_ST3_DRIVING_CAN_Tx: ComBitPosition=20, ComBitSize=10, ComSignalEndianness=LITTLE_ENDIAN, ComSignalType=UINT16, ComTransferProperty=TRIGGERED, ComSystemTemplateSystemSignalRef=WakeupRsn_IMU_B_ST3
        S_NM_IMU_B_ST3_PNC_DRIVING_CAN_Tx: ComBitPosition=8, ComSignalEndianness=opaque, ComSignalInitValue=0 0 0 0 0 0 0, ComSignalLength=7, ComSignalType=UINT8_N, ComTransferProperty=PENDING, ComSystemTemplateSystemSignalRef=NM_IMU_B_ST3_PNC
      SG_Meas_IMU_D_ST3_aza6ns1u50ccdg7pxk0f64ws6_DRIVING_CAN_Tx (ComSignalGroup): ComSignalGroupArrayAccess=false, ComTransferProperty=TRIGGERED, ComSystemTemplateSignalGroupRef=Meas_IMU_D_ST3_aza6ns1u50ccdg7pxk0f64ws6
        64 x ComGroupSignal, all with ComBitSize=8, ComSignalEndianness=LITTLE_ENDIAN, ComSignalType=UINT8, ComSignalInitValue=0:
          GS_Meas_IMU_D_01_ST3_DRIVING_CAN_Tx: ComBitPosition=0, ComSystemTemplateSystemSignalRef=Meas_IMU_D_01_ST3
          GS_Meas_IMU_D_02_ST3_DRIVING_CAN_Tx: ComBitPosition=8, ComSystemTemplateSystemSignalRef=Meas_IMU_D_02_ST3
          GS_Meas_IMU_D_03_ST3_DRIVING_CAN_Tx: ComBitPosition=16, ComSystemTemplateSystemSignalRef=Meas_IMU_D_03_ST3
          GS_Meas_IMU_D_04_ST3_DRIVING_CAN_Tx: ComBitPosition=24, ComSystemTemplateSystemSignalRef=Meas_IMU_D_04_ST3
          GS_Meas_IMU_D_05_ST3_DRIVING_CAN_Tx: ComBitPosition=32, ComSystemTemplateSystemSignalRef=Meas_IMU_D_05_ST3
          GS_Meas_IMU_D_06_ST3_DRIVING_CAN_Tx: ComBitPosition=40, ComSystemTemplateSystemSignalRef=Meas_IMU_D_06_ST3
          GS_Meas_IMU_D_07_ST3_DRIVING_CAN_Tx: ComBitPosition=48, ComSystemTemplateSystemSignalRef=Meas_IMU_D_07_ST3
          GS_Meas_IMU_D_08_ST3_DRIVING_CAN_Tx: ComBitPosition=56, ComSystemTemplateSystemSignalRef=Meas_IMU_D_08_ST3
          GS_Meas_IMU_D_09_ST3_DRIVING_CAN_Tx: ComBitPosition=64, ComSystemTemplateSystemSignalRef=Meas_IMU_D_09_ST3
          GS_Meas_IMU_D_10_ST3_DRIVING_CAN_Tx: ComBitPosition=72, ComSystemTemplateSystemSignalRef=Meas_IMU_D_10_ST3
          GS_Meas_IMU_D_11_ST3_DRIVING_CAN_Tx: ComBitPosition=80, ComSystemTemplateSystemSignalRef=Meas_IMU_D_11_ST3
          GS_Meas_IMU_D_12_ST3_DRIVING_CAN_Tx: ComBitPosition=88, ComSystemTemplateSystemSignalRef=Meas_IMU_D_12_ST3
          GS_Meas_IMU_D_13_ST3_DRIVING_CAN_Tx: ComBitPosition=96, ComSystemTemplateSystemSignalRef=Meas_IMU_D_13_ST3
          GS_Meas_IMU_D_14_ST3_DRIVING_CAN_Tx: ComBitPosition=104, ComSystemTemplateSystemSignalRef=Meas_IMU_D_14_ST3
          GS_Meas_IMU_D_15_ST3_DRIVING_CAN_Tx: ComBitPosition=112, ComSystemTemplateSystemSignalRef=Meas_IMU_D_15_ST3
          GS_Meas_IMU_D_16_ST3_DRIVING_CAN_Tx: ComBitPosition=120, ComSystemTemplateSystemSignalRef=Meas_IMU_D_16_ST3
          GS_Meas_IMU_D_17_ST3_DRIVING_CAN_Tx: ComBitPosition=128, ComSystemTemplateSystemSignalRef=Meas_IMU_D_17_ST3
          GS_Meas_IMU_D_18_ST3_DRIVING_CAN_Tx: ComBitPosition=136, ComSystemTemplateSystemSignalRef=Meas_IMU_D_18_ST3
          GS_Meas_IMU_D_19_ST3_DRIVING_CAN_Tx: ComBitPosition=144, ComSystemTemplateSystemSignalRef=Meas_IMU_D_19_ST3
          GS_Meas_IMU_D_20_ST3_DRIVING_CAN_Tx: ComBitPosition=152, ComSystemTemplateSystemSignalRef=Meas_IMU_D_20_ST3
          GS_Meas_IMU_D_21_ST3_DRIVING_CAN_Tx: ComBitPosition=160, ComSystemTemplateSystemSignalRef=Meas_IMU_D_21_ST3
          GS_Meas_IMU_D_22_ST3_DRIVING_CAN_Tx: ComBitPosition=168, ComSystemTemplateSystemSignalRef=Meas_IMU_D_22_ST3
          GS_Meas_IMU_D_23_ST3_DRIVING_CAN_Tx: ComBitPosition=176, ComSystemTemplateSystemSignalRef=Meas_IMU_D_23_ST3
          GS_Meas_IMU_D_24_ST3_DRIVING_CAN_Tx: ComBitPosition=184, ComSystemTemplateSystemSignalRef=Meas_IMU_D_24_ST3
          GS_Meas_IMU_D_25_ST3_DRIVING_CAN_Tx: ComBitPosition=192, ComSystemTemplateSystemSignalRef=Meas_IMU_D_25_ST3
          GS_Meas_IMU_D_26_ST3_DRIVING_CAN_Tx: ComBitPosition=200, ComSystemTemplateSystemSignalRef=Meas_IMU_D_26_ST3
          GS_Meas_IMU_D_27_ST3_DRIVING_CAN_Tx: ComBitPosition=208, ComSystemTemplateSystemSignalRef=Meas_IMU_D_27_ST3
          GS_Meas_IMU_D_28_ST3_DRIVING_CAN_Tx: ComBitPosition=216, ComSystemTemplateSystemSignalRef=Meas_IMU_D_28_ST3
          GS_Meas_IMU_D_29_ST3_DRIVING_CAN_Tx: ComBitPosition=224, ComSystemTemplateSystemSignalRef=Meas_IMU_D_29_ST3
          GS_Meas_IMU_D_30_ST3_DRIVING_CAN_Tx: ComBitPosition=232, ComSystemTemplateSystemSignalRef=Meas_IMU_D_30_ST3
          GS_Meas_IMU_D_31_ST3_DRIVING_CAN_Tx: ComBitPosition=240, ComSystemTemplateSystemSignalRef=Meas_IMU_D_31_ST3
          GS_Meas_IMU_D_32_ST3_DRIVING_CAN_Tx: ComBitPosition=248, ComSystemTemplateSystemSignalRef=Meas_IMU_D_32_ST3
          GS_Meas_IMU_D_33_ST3_DRIVING_CAN_Tx: ComBitPosition=256, ComSystemTemplateSystemSignalRef=Meas_IMU_D_33_ST3
          GS_Meas_IMU_D_34_ST3_DRIVING_CAN_Tx: ComBitPosition=264, ComSystemTemplateSystemSignalRef=Meas_IMU_D_34_ST3
          GS_Meas_IMU_D_35_ST3_DRIVING_CAN_Tx: ComBitPosition=272, ComSystemTemplateSystemSignalRef=Meas_IMU_D_35_ST3
          GS_Meas_IMU_D_36_ST3_DRIVING_CAN_Tx: ComBitPosition=280, ComSystemTemplateSystemSignalRef=Meas_IMU_D_36_ST3
          GS_Meas_IMU_D_37_ST3_DRIVING_CAN_Tx: ComBitPosition=288, ComSystemTemplateSystemSignalRef=Meas_IMU_D_37_ST3
          GS_Meas_IMU_D_38_ST3_DRIVING_CAN_Tx: ComBitPosition=296, ComSystemTemplateSystemSignalRef=Meas_IMU_D_38_ST3
          GS_Meas_IMU_D_39_ST3_DRIVING_CAN_Tx: ComBitPosition=304, ComSystemTemplateSystemSignalRef=Meas_IMU_D_39_ST3
          GS_Meas_IMU_D_40_ST3_DRIVING_CAN_Tx: ComBitPosition=312, ComSystemTemplateSystemSignalRef=Meas_IMU_D_40_ST3
          GS_Meas_IMU_D_41_ST3_DRIVING_CAN_Tx: ComBitPosition=320, ComSystemTemplateSystemSignalRef=Meas_IMU_D_41_ST3
          GS_Meas_IMU_D_42_ST3_DRIVING_CAN_Tx: ComBitPosition=328, ComSystemTemplateSystemSignalRef=Meas_IMU_D_42_ST3
          GS_Meas_IMU_D_43_ST3_DRIVING_CAN_Tx: ComBitPosition=336, ComSystemTemplateSystemSignalRef=Meas_IMU_D_43_ST3
          GS_Meas_IMU_D_44_ST3_DRIVING_CAN_Tx: ComBitPosition=344, ComSystemTemplateSystemSignalRef=Meas_IMU_D_44_ST3
          GS_Meas_IMU_D_45_ST3_DRIVING_CAN_Tx: ComBitPosition=352, ComSystemTemplateSystemSignalRef=Meas_IMU_D_45_ST3
          GS_Meas_IMU_D_46_ST3_DRIVING_CAN_Tx: ComBitPosition=360, ComSystemTemplateSystemSignalRef=Meas_IMU_D_46_ST3
          GS_Meas_IMU_D_47_ST3_DRIVING_CAN_Tx: ComBitPosition=368, ComSystemTemplateSystemSignalRef=Meas_IMU_D_47_ST3
          GS_Meas_IMU_D_48_ST3_DRIVING_CAN_Tx: ComBitPosition=376, ComSystemTemplateSystemSignalRef=Meas_IMU_D_48_ST3
          GS_Meas_IMU_D_49_ST3_DRIVING_CAN_Tx: ComBitPosition=384, ComSystemTemplateSystemSignalRef=Meas_IMU_D_49_ST3
          GS_Meas_IMU_D_50_ST3_DRIVING_CAN_Tx: ComBitPosition=392, ComSystemTemplateSystemSignalRef=Meas_IMU_D_50_ST3
          GS_Meas_IMU_D_51_ST3_DRIVING_CAN_Tx: ComBitPosition=400, ComSystemTemplateSystemSignalRef=Meas_IMU_D_51_ST3
          GS_Meas_IMU_D_52_ST3_DRIVING_CAN_Tx: ComBitPosition=408, ComSystemTemplateSystemSignalRef=Meas_IMU_D_52_ST3
          GS_Meas_IMU_D_53_ST3_DRIVING_CAN_Tx: ComBitPosition=416, ComSystemTemplateSystemSignalRef=Meas_IMU_D_53_ST3
          GS_Meas_IMU_D_54_ST3_DRIVING_CAN_Tx: ComBitPosition=424, ComSystemTemplateSystemSignalRef=Meas_IMU_D_54_ST3
          GS_Meas_IMU_D_55_ST3_DRIVING_CAN_Tx: ComBitPosition=432, ComSystemTemplateSystemSignalRef=Meas_IMU_D_55_ST3
          GS_Meas_IMU_D_56_ST3_DRIVING_CAN_Tx: ComBitPosition=440, ComSystemTemplateSystemSignalRef=Meas_IMU_D_56_ST3
          GS_Meas_IMU_D_57_ST3_DRIVING_CAN_Tx: ComBitPosition=448, ComSystemTemplateSystemSignalRef=Meas_IMU_D_57_ST3
          GS_Meas_IMU_D_58_ST3_DRIVING_CAN_Tx: ComBitPosition=456, ComSystemTemplateSystemSignalRef=Meas_IMU_D_58_ST3
          GS_Meas_IMU_D_59_ST3_DRIVING_CAN_Tx: ComBitPosition=464, ComSystemTemplateSystemSignalRef=Meas_IMU_D_59_ST3
          GS_Meas_IMU_D_60_ST3_DRIVING_CAN_Tx: ComBitPosition=472, ComSystemTemplateSystemSignalRef=Meas_IMU_D_60_ST3
          GS_Meas_IMU_D_61_ST3_DRIVING_CAN_Tx: ComBitPosition=480, ComSystemTemplateSystemSignalRef=Meas_IMU_D_61_ST3
          GS_Meas_IMU_D_62_ST3_DRIVING_CAN_Tx: ComBitPosition=488, ComSystemTemplateSystemSignalRef=Meas_IMU_D_62_ST3
          GS_Meas_IMU_D_63_ST3_DRIVING_CAN_Tx: ComBitPosition=496, ComSystemTemplateSystemSignalRef=Meas_IMU_D_63_ST3
          GS_Meas_IMU_D_64_ST3_DRIVING_CAN_Tx: ComBitPosition=504, ComSystemTemplateSystemSignalRef=Meas_IMU_D_64_ST3
  module config EcuC
    EcucConfigSet
      EcucPduCollection: PduIdTypeEnum=uint16, PduLengthTypeEnum=uint16
        15 x Pdu:
          NM_IMU_B_ST3_CanNm2CanIf_DRIVING_CAN: PduLength=8, SysTPduToFrameTriggeringRef=NM_IMU_B_ST3_5n3tsppcblgyfz59fa3fxhygu
          NM_Dummy_ST3_CanIf2CanNm_DRIVING_CAN: PduLength=8, SysTPduToFrameTriggeringRef=NM_Dummy_ST3_4gvn7tmtsz96dqioyz0hd4kkn
          ECU_Stat_IMU_B_DRIVING_ST3_Com2PduR_DRIVING_CAN: PduLength=8, SysTPduToPduTriggeringRef=ECU_Stat_IMU_B_IMU_B_DRIVING_CAN_ST3_88u6ujntcym4u4ntb27fc40ar
          ECU_Stat_IMU_B_DRIVING_ST3_PduR2CanIf_DRIVING_CAN: PduLength=8, SysTPduToPduTriggeringRef=ECU_Stat_IMU_B_IMU_B_DRIVING_CAN_ST3_88u6ujntcym4u4ntb27fc40ar
          NM_IMU_B_ST3_Com2PduR_DRIVING_CAN: PduLength=8, SysTPduToFrameTriggeringRef=NM_IMU_B_ST3_5n3tsppcblgyfz59fa3fxhygu
          NM_IMU_B_ST3_ERA_PduR2Com_DRIVING_CAN: PduLength=8, SysTPduToFrameTriggeringRef=NM_IMU_B_ST3_5n3tsppcblgyfz59fa3fxhygu
          NM_IMU_B_ST3_ERA_PduR2Com_INTERNAL_CAN: PduLength=8, SysTPduToFrameTriggeringRef=NM_IMU_B_ST3_5n3tsppcblgyfz59fa3fxhygu
          NM_IMU_B_ST3_ERA_PduR2Com_HAD_IMU_CAN: PduLength=8, SysTPduToFrameTriggeringRef=NM_IMU_B_ST3_5n3tsppcblgyfz59fa3fxhygu
          NM_IMU_B_ST3_ERA_CanNm2PduR_DRIVING_CAN: PduLength=8, SysTPduToFrameTriggeringRef=NM_IMU_B_ST3_5n3tsppcblgyfz59fa3fxhygu
          NM_IMU_B_ST3_ERA_CanNm2PduR_INTERNAL_CAN: PduLength=8, SysTPduToFrameTriggeringRef=NM_IMU_B_ST3_5n3tsppcblgyfz59fa3fxhygu
          NM_IMU_B_ST3_ERA_CanNm2PduR_HAD_IMU_CAN: PduLength=8, SysTPduToFrameTriggeringRef=NM_IMU_B_ST3_5n3tsppcblgyfz59fa3fxhygu
          NM_IMU_B_ST3_PduR2CanNm_DRIVING_CAN: PduLength=8, SysTPduToFrameTriggeringRef=NM_IMU_B_ST3_5n3tsppcblgyfz59fa3fxhygu
          Meas_IMU_D_ST3_Com2PduR_DRIVING_CAN: PduLength=64, SysTPduToPduTriggeringRef=Meas_IMU_D_ST3_20wdgpjj946a2dm25zsfv2ttl
          Meas_IMU_D_ST3_PduR2CanIf_DRIVING_CAN: PduLength=64, SysTPduToPduTriggeringRef=Meas_IMU_D_ST3_20wdgpjj946a2dm25zsfv2ttl
          GTS_Powertrain_CAN_ST3_GTS_Powertrain_CAN_ST3_DRIVING_DRIVING_IN: PduLength=8
  module config PduR
    CanNm (PduRBswModules):
      PduRCancelReceive = false
      PduRCancelTransmit = false
      PduRCommunicationInterface = true
      PduRLowerModule = true
      PduRTransportProtocol = false
      PduRTriggertransmit = true
      PduRTxConfirmation = true
      PduRUpperModule = false
      PduRBswModuleRef = CanNm
    PduRGeneral:
      PduRDevErrorDetect = false
      PduRZeroCostOperation = false
      PduRRbQueueingSupport = false
      PduRRbIFGatewayOperation = true
      PduRRbGwTpWithLimitedBuffer = false
      PduRRbDsmReInitEnabled = false
      PduRVersionInfoApi = false
    PduRRoutingPaths
      ECU_Stat_IMU_B_IMU_B_DRIVING_CAN_ST3_PduR2CanIf_IMU_B_DRIVING_CAN_CAN (PduRDestPdu): PduRDestPduDataProvision=PDUR_DIRECT, PduRDestPduRef=ECU_Stat_IMU_B_DRIVING_ST3_PduR2CanIf_DRIVING_CAN
      Meas_IMU_D_ST3_PduR2CanIf_DRIVING_CAN (PduRDestPdu): PduRDestPduDataProvision=PDUR_DIRECT, PduRDestPduRef=EcucPduCollection/Meas_IMU_D_ST3_PduR2CanIf_DRIVING_CAN
      ECU_Stat_IMU_B_DRIVING_ST3_Com2CanIf_DRIVING_CAN (PduRRoutingPath):
        PduRDestPduRRef = ECU_Stat_IMU_B_IMU_B_DRIVING_CAN_ST3_PduR2CanIf_IMU_B_DRIVING_CAN_CAN
        PduRSrcPduRRef = ECU_Stat_IMU_B_IMU_B_DRIVING_CAN_ST3_Com2PduR_IMU_B_DRIVING_CAN_CAN
      Meas_IMU_D_ST3_Com2CanIf_DRIVING_CAN (PduRRoutingPath): PduRDestPduRRef=PduRRoutingPaths/Meas_IMU_D_ST3_PduR2CanIf_DRIVING_CAN, PduRSrcPduRRef=PduRRoutingPaths/Meas_IMU_D_ST3_Com2PduR_DRIVING_CAN
      ECU_Stat_IMU_B_IMU_B_DRIVING_CAN_ST3_Com2PduR_IMU_B_DRIVING_CAN_CAN (PduRSrcPdu): PduRSrcPduRef=ECU_Stat_IMU_B_DRIVING_ST3_Com2PduR_DRIVING_CAN
      Meas_IMU_D_ST3_Com2PduR_DRIVING_CAN (PduRSrcPdu): PduRSrcPduRef=EcucPduCollection/Meas_IMU_D_ST3_Com2PduR_DRIVING_CAN
  module config CanNm
