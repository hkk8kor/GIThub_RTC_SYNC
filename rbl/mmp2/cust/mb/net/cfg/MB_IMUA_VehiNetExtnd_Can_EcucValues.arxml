AUTOSAR XML (schema 4-2-2)
package /RB/UBK/Project/EcucModuleConfigurationValuess
  module config Can
    CanConfigSet
      14 x CanHardwareObject, all with CanFdPaddingValue=0:
        GTS_Main_CAN_ST3_GTS_Main_CAN_ST3_f3ngr2mgh7ij5tktyk1o5ahui_HAD_BACKUP_HAD_BACKUP_IN: CanHandleType=FULL, CanIdType=STANDARD, CanObjectType=RECEIVE, CanControllerRef=CanIfControllerConfig_1
          CanHwFilter_121 (CanHwFilter): CanHwFilterCode=121, CanHwFilterMask=2047
        IMU_B_Output_ST3_IMU_B_Output_ST3_cvwgbah9by246et0yw6ftuq1e_HAD_BACKUP_HAD_BACKUP_OUT: CanHandleType=FULL, CanIdType=STANDARD, CanObjectType=TRANSMIT, CanControllerRef=CanIfControllerConfig_1
        NM_IMU_A_ST3_NM_IMU_A_ST3_mqes5157d517lzmkzlhjas48_HAD_BACKUP_HAD_BACKUP_OUT: CanHandleType=FULL, CanIdType=EXTENDED, CanObjectType=TRANSMIT, CanControllerRef=CanIfControllerConfig_1, CanMainFunctionRWPeriodRef=CanMainFunctionRWPeriods_5ms
        NM_Dummy_ST3_NM_Dummy_ST3_5v44zxwqibhgfzivqlgrinq52_HAD_BACKUP_HAD_BACKUP_IN: CanHandleType=BASIC, CanIdType=EXTENDED, CanObjectType=RECEIVE, CanControllerRef=CanIfControllerConfig_1, CanMainFunctionRWPeriodRef=CanMainFunctionRWPeriods_5ms
          CanHwFilter_339869696_339873791 (CanHwFilter): CanHwFilterCode=339869696, CanHwFilterMask=536866816
        ECU_Stat_IMU_A_ST3_ECU_Stat_IMU_A_ST3_aex3322f36mc6lh9solc55ki7_HAD_BACKUP_HAD_BACKUP_OUT: CanHandleType=FULL, CanIdType=EXTENDED, CanObjectType=TRANSMIT, CanControllerRef=CanIfControllerConfig_1, CanMainFunctionRWPeriodRef=CanMainFunctionRWPeriods_5ms
        GTS_Main_CAN_ST3_GTS_Main_CAN_ST3_3roc9cgit8y88llo701fz09aw_IMU_INTERNAL_IMU_INTERNAL_OUT: CanHandleType=FULL, CanIdType=STANDARD, CanObjectType=TRANSMIT, CanControllerRef=CanIfControllerConfig_0
        IMU_B_Output_ST3_IMU_B_Output_ST3_867n3yp1q4vwzcxr3cdsioonf_IMU_INTERNAL_IMU_INTERNAL_IN: CanHandleType=FULL, CanIdType=STANDARD, CanObjectType=RECEIVE, CanControllerRef=CanIfControllerConfig_0
          CanHwFilter_934 (CanHwFilter): CanHwFilterCode=934, CanHwFilterMask=2047
        IMU_A_HAD_BACKUP_COM_Container1_ST3_IMU_A_HAD_BACKUP_COM_Container1_ST3_c0akuwucqk1bxnpja1dfcudm3_HAD_BACKUP_HAD_BACKUP_OUT: CanHandleType=FULL, CanIdType=STANDARD, CanObjectType=TRANSMIT, CanControllerRef=CanIfControllerConfig_1, CanMainFunctionRWPeriodRef=CanMainFunctionRWPeriods_5ms
        IMU_A_HAD_BACKUP_GW_Container1_ST3_IMU_A_HAD_BACKUP_GW_Container1_ST3_roywpbiicz3ehpmr7k0lzj66_HAD_BACKUP_HAD_BACKUP_OUT: CanHandleType=FULL, CanIdType=STANDARD, CanObjectType=TRANSMIT, CanControllerRef=CanIfControllerConfig_1, CanMainFunctionRWPeriodRef=CanMainFunctionRWPeriods_5ms
        ECU_Stat_IMU_B_ST3_ECU_Stat_IMU_B_ST3_7e1x143vymagm1ezvyz5npfy4_IMU_INTERNAL_IMU_INTERNAL_IN: CanHandleType=FULL, CanIdType=EXTENDED, CanObjectType=RECEIVE, CanControllerRef=CanIfControllerConfig_0, CanMainFunctionRWPeriodRef=CanMainFunctionRWPeriods_5ms
          CanHwFilter_373424491 (CanHwFilter): CanHwFilterCode=373424491, CanHwFilterMask=536870911
        ROE_IMU_B_ST3_ROE_IMU_B_ST3_d4w0rsqy5i9ayk13lul7n8ule_IMU_INTERNAL_IMU_INTERNAL_IN: CanHandleType=FULL, CanIdType=EXTENDED, CanObjectType=RECEIVE, CanControllerRef=CanIfControllerConfig_0, CanMainFunctionRWPeriodRef=CanMainFunctionRWPeriods_5ms
          CanHwFilter_417426176 (CanHwFilter): CanHwFilterCode=417426176, CanHwFilterMask=536870911
        Meas_IMU_A_ST3_Meas_IMU_A_ST3_bxis0tfg6gwef0ybcs7e7x8gd_HAD_BACKUP_HAD_BACKUP_OUT: CanHandleType=FULL, CanIdType=EXTENDED, CanObjectType=TRANSMIT, CanControllerRef=CanIfControllerConfig_1, CanMainFunctionRWPeriodRef=CanMainFunctionRWPeriods_5ms
        NM_IMU_A_ST3_NM_IMU_A_ST3_6vo2o7b9cyd47cbahjaygi9t7_IMU_INTERNAL_IMU_INTERNAL_OUT: CanIdType=EXTENDED, CanObjectType=TRANSMIT, CanHandleType=FULL, CanControllerRef=CanIfControllerConfig_0, CanMainFunctionRWPeriodRef=CanMainFunctionRWPeriods_5ms
        NM_Dummy_ST3_NM_Dummy_ST3_47cxd2tpch3havy6ru1a9do2q_IMU_INTERNAL_IMU_INTERNAL_IN: CanHandleType=BASIC, CanIdType=EXTENDED, CanObjectType=RECEIVE, CanControllerRef=CanIfControllerConfig_0, CanMainFunctionRWPeriodRef=CanMainFunctionRWPeriods_5ms
          CanHwFilter_339869696_339873791 (CanHwFilter): CanHwFilterCode=339869696, CanHwFilterMask=536866816
    CanGeneral:
      CanIndex = 0
      CanMainFunctionBusoffPeriod = 0.005
      CanMainFunctionModePeriod = 0.005
      CanRbDynamicMCANIpDetection = true
      CanRbErrorPassiveProcessing = ON
      CanRbLiteConfiguration = false
      CanVersionInfoApi = false
      CanDemEventParameterRefs: CanRbDynCreate_CAN_E_TIMEOUT=Disabled, CAN_E_TIMEOUT=CAN_E_TIMEOUT
  module config CanIf
    CanIfInitCfg
      8 x CanIfBufferCfg, all with CanIfBufferSize=0:
        Bu_IMU_B_Output_ST3_IMU_B_Output_ST3_cvwgbah9by246et0yw6ftuq1e_HAD_BACKUP_HAD_BACKUP_OUT: CanIfBufferHthRef=CanIfInitHohCfg/IMU_B_Output_ST3_IMU_B_Output_ST3_cvwgbah9by246et0yw6ftuq1e_HAD_BACKUP_HAD_BACKUP_OUT
        Bu_NM_IMU_A_ST3_NM_IMU_A_ST3_mqes5157d517lzmkzlhjas48_HAD_BACKUP_HAD_BACKUP_OUT: CanIfBufferHthRef=CanIfInitHohCfg/NM_IMU_A_ST3_NM_IMU_A_ST3_mqes5157d517lzmkzlhjas48_HAD_BACKUP_HAD_BACKUP_OUT
        Bu_ECU_Stat_IMU_A_ST3_ECU_Stat_IMU_A_ST3_aex3322f36mc6lh9solc55ki7_HAD_BACKUP_HAD_BACKUP_OUT: CanIfBufferHthRef=CanIfInitHohCfg/ECU_Stat_IMU_A_ST3_ECU_Stat_IMU_A_ST3_aex3322f36mc6lh9solc55ki7_HAD_BACKUP_HAD_BACKUP_OUT
        Bu_GTS_Main_CAN_ST3_GTS_Main_CAN_ST3_3roc9cgit8y88llo701fz09aw_IMU_INTERNAL_IMU_INTERNAL_OUT: CanIfBufferHthRef=CanIfInitHohCfg/GTS_Main_CAN_ST3_GTS_Main_CAN_ST3_3roc9cgit8y88llo701fz09aw_IMU_INTERNAL_IMU_INTERNAL_OUT
        Bu_IMU_A_HAD_BACKUP_COM_Container1_ST3_IMU_A_HAD_BACKUP_COM_Container1_ST3_c0akuwucqk1bxnpja1dfcudm3_HAD_BACKUP_HAD_BACKUP_OUT: CanIfBufferHthRef=CanIfInitHohCfg/IMU_A_HAD_BACKUP_COM_Container1_ST3_IMU_A_HAD_BACKUP_COM_Container1_ST3_c0akuwucqk1bxnpja1dfcudm3_HAD_BACKUP_HAD_BACKUP_OUT
        Bu_IMU_A_HAD_BACKUP_GW_Container1_ST3_IMU_A_HAD_BACKUP_GW_Container1_ST3_roywpbiicz3ehpmr7k0lzj66_HAD_BACKUP_HAD_BACKUP_OUT: CanIfBufferHthRef=CanIfInitHohCfg/IMU_A_HAD_BACKUP_GW_Container1_ST3_IMU_A_HAD_BACKUP_GW_Container1_ST3_roywpbiicz3ehpmr7k0lzj66_HAD_BACKUP_HAD_BACKUP_OUT
        Bu_Meas_IMU_A_ST3_Meas_IMU_A_ST3_bxis0tfg6gwef0ybcs7e7x8gd_HAD_BACKUP_HAD_BACKUP_OUT: CanIfBufferHthRef=CanIfInitHohCfg/Meas_IMU_A_ST3_Meas_IMU_A_ST3_bxis0tfg6gwef0ybcs7e7x8gd_HAD_BACKUP_HAD_BACKUP_OUT
        Bu_NM_IMU_A_ST3_NM_IMU_A_ST3_6vo2o7b9cyd47cbahjaygi9t7_IMU_INTERNAL_IMU_INTERNAL_OUT: CanIfBufferHthRef=CanIfInitHohCfg/NM_IMU_A_ST3_NM_IMU_A_ST3_6vo2o7b9cyd47cbahjaygi9t7_IMU_INTERNAL_IMU_INTERNAL_OUT
      CanIfInitHohCfg
        6 x CanIfHrhCfg:
          GTS_Main_CAN_ST3_GTS_Main_CAN_ST3_f3ngr2mgh7ij5tktyk1o5ahui_HAD_BACKUP_HAD_BACKUP_IN: CanIfHrhCanCtrlIdRef=CanIfControllerConfig_1, CanIfHrhIdSymRef=CanConfigSet/GTS_Main_CAN_ST3_GTS_Main_CAN_ST3_f3ngr2mgh7ij5tktyk1o5ahui_HAD_BACKUP_HAD_BACKUP_IN
          NM_Dummy_ST3_NM_Dummy_ST3_5v44zxwqibhgfzivqlgrinq52_HAD_BACKUP_HAD_BACKUP_IN: CanIfHrhCanCtrlIdRef=CanIfControllerConfig_1, CanIfHrhIdSymRef=CanConfigSet/NM_Dummy_ST3_NM_Dummy_ST3_5v44zxwqibhgfzivqlgrinq52_HAD_BACKUP_HAD_BACKUP_IN
            CanIfHrhRangeCfg: CanIfHrhRangeRxPduLowerCanId=339869696, CanIfHrhRangeRxPduRangeCanIdType=EXTENDED, CanIfHrhRangeRxPduUpperCanId=339873791
          IMU_B_Output_ST3_IMU_B_Output_ST3_867n3yp1q4vwzcxr3cdsioonf_IMU_INTERNAL_IMU_INTERNAL_IN: CanIfHrhCanCtrlIdRef=CanIfControllerConfig_0, CanIfHrhIdSymRef=CanConfigSet/IMU_B_Output_ST3_IMU_B_Output_ST3_867n3yp1q4vwzcxr3cdsioonf_IMU_INTERNAL_IMU_INTERNAL_IN
          ECU_Stat_IMU_B_ST3_ECU_Stat_IMU_B_ST3_7e1x143vymagm1ezvyz5npfy4_IMU_INTERNAL_IMU_INTERNAL_IN: CanIfHrhCanCtrlIdRef=CanIfControllerConfig_0, CanIfHrhIdSymRef=CanConfigSet/ECU_Stat_IMU_B_ST3_ECU_Stat_IMU_B_ST3_7e1x143vymagm1ezvyz5npfy4_IMU_INTERNAL_IMU_INTERNAL_IN
          ROE_IMU_B_ST3_ROE_IMU_B_ST3_d4w0rsqy5i9ayk13lul7n8ule_IMU_INTERNAL_IMU_INTERNAL_IN: CanIfHrhCanCtrlIdRef=CanIfControllerConfig_0, CanIfHrhIdSymRef=CanConfigSet/ROE_IMU_B_ST3_ROE_IMU_B_ST3_d4w0rsqy5i9ayk13lul7n8ule_IMU_INTERNAL_IMU_INTERNAL_IN
          NM_Dummy_ST3_NM_Dummy_ST3_47cxd2tpch3havy6ru1a9do2q_IMU_INTERNAL_IMU_INTERNAL_IN: CanIfHrhCanCtrlIdRef=CanIfControllerConfig_0, CanIfHrhIdSymRef=CanConfigSet/NM_Dummy_ST3_NM_Dummy_ST3_47cxd2tpch3havy6ru1a9do2q_IMU_INTERNAL_IMU_INTERNAL_IN
            CanIfHrhRangeCfg: CanIfHrhRangeRxPduLowerCanId=339869696, CanIfHrhRangeRxPduRangeCanIdType=EXTENDED, CanIfHrhRangeRxPduUpperCanId=339873791
        8 x CanIfHthCfg:
          IMU_B_Output_ST3_IMU_B_Output_ST3_cvwgbah9by246et0yw6ftuq1e_HAD_BACKUP_HAD_BACKUP_OUT: CanIfHthCanCtrlIdRef=CanIfControllerConfig_1, CanIfHthIdSymRef=CanConfigSet/IMU_B_Output_ST3_IMU_B_Output_ST3_cvwgbah9by246et0yw6ftuq1e_HAD_BACKUP_HAD_BACKUP_OUT
          NM_IMU_A_ST3_NM_IMU_A_ST3_mqes5157d517lzmkzlhjas48_HAD_BACKUP_HAD_BACKUP_OUT: CanIfHthCanCtrlIdRef=CanIfControllerConfig_1, CanIfHthIdSymRef=CanConfigSet/NM_IMU_A_ST3_NM_IMU_A_ST3_mqes5157d517lzmkzlhjas48_HAD_BACKUP_HAD_BACKUP_OUT
          ECU_Stat_IMU_A_ST3_ECU_Stat_IMU_A_ST3_aex3322f36mc6lh9solc55ki7_HAD_BACKUP_HAD_BACKUP_OUT: CanIfHthCanCtrlIdRef=CanIfControllerConfig_1, CanIfHthIdSymRef=CanConfigSet/ECU_Stat_IMU_A_ST3_ECU_Stat_IMU_A_ST3_aex3322f36mc6lh9solc55ki7_HAD_BACKUP_HAD_BACKUP_OUT
          GTS_Main_CAN_ST3_GTS_Main_CAN_ST3_3roc9cgit8y88llo701fz09aw_IMU_INTERNAL_IMU_INTERNAL_OUT: CanIfHthCanCtrlIdRef=CanIfControllerConfig_0, CanIfHthIdSymRef=CanConfigSet/GTS_Main_CAN_ST3_GTS_Main_CAN_ST3_3roc9cgit8y88llo701fz09aw_IMU_INTERNAL_IMU_INTERNAL_OUT
          IMU_A_HAD_BACKUP_COM_Container1_ST3_IMU_A_HAD_BACKUP_COM_Container1_ST3_c0akuwucqk1bxnpja1dfcudm3_HAD_BACKUP_HAD_BACKUP_OUT: CanIfHthCanCtrlIdRef=CanIfControllerConfig_1, CanIfHthIdSymRef=CanConfigSet/IMU_A_HAD_BACKUP_COM_Container1_ST3_IMU_A_HAD_BACKUP_COM_Container1_ST3_c0akuwucqk1bxnpja1dfcudm3_HAD_BACKUP_HAD_BACKUP_OUT
          IMU_A_HAD_BACKUP_GW_Container1_ST3_IMU_A_HAD_BACKUP_GW_Container1_ST3_roywpbiicz3ehpmr7k0lzj66_HAD_BACKUP_HAD_BACKUP_OUT: CanIfHthCanCtrlIdRef=CanIfControllerConfig_1, CanIfHthIdSymRef=CanConfigSet/IMU_A_HAD_BACKUP_GW_Container1_ST3_IMU_A_HAD_BACKUP_GW_Container1_ST3_roywpbiicz3ehpmr7k0lzj66_HAD_BACKUP_HAD_BACKUP_OUT
          Meas_IMU_A_ST3_Meas_IMU_A_ST3_bxis0tfg6gwef0ybcs7e7x8gd_HAD_BACKUP_HAD_BACKUP_OUT: CanIfHthCanCtrlIdRef=CanIfControllerConfig_1, CanIfHthIdSymRef=CanConfigSet/Meas_IMU_A_ST3_Meas_IMU_A_ST3_bxis0tfg6gwef0ybcs7e7x8gd_HAD_BACKUP_HAD_BACKUP_OUT
          NM_IMU_A_ST3_NM_IMU_A_ST3_6vo2o7b9cyd47cbahjaygi9t7_IMU_INTERNAL_IMU_INTERNAL_OUT: CanIfHthCanCtrlIdRef=CanIfControllerConfig_0, CanIfHthIdSymRef=CanConfigSet/NM_IMU_A_ST3_NM_IMU_A_ST3_6vo2o7b9cyd47cbahjaygi9t7_IMU_INTERNAL_IMU_INTERNAL_OUT
      6 x CanIfRxPduCfg:
        GTS_Main_CAN_ST3_GTS_Main_CAN_ST3_f3ngr2mgh7ij5tktyk1o5ahui_HAD_BACKUP_HAD_BACKUP_IN: CanIfRxPduCanId=121, CanIfRxPduCanIdType=STANDARD_FD_CAN, CanIfRxPduDataLength=8, CanIfRxPduReadData=false, CanIfRxPduReadNotifyStatus=false, CanIfRxPduUserRxIndicationName=CanTSyn_RxIndication, CanIfRxPduUserRxIndicationUL=CAN_TSYN, CanIfRxPduHrhIdRef=CanIfInitHohCfg/GTS_Main_CAN_ST3_GTS_Main_CAN_ST3_f3ngr2mgh7ij5tktyk1o5ahui_HAD_BACKUP_HAD_BACKUP_IN, CanIfRxPduRef=GTS_Main_CAN_ST3_CanIf2CanTSyn_HAD_BACKUP_CAN
        NM_Dummy_ST3_NM_Dummy_ST3_5v44zxwqibhgfzivqlgrinq52_HAD_BACKUP_HAD_BACKUP_IN: CanIfRxPduCanIdType=EXTENDED_NO_FD_CAN, CanIfRxPduDataLength=8, CanIfRxPduReadData=false, CanIfRxPduReadNotifyStatus=false, CanIfRxPduUserRxIndicationName=CanNm_RxIndication, CanIfRxPduUserRxIndicationUL=CAN_NM, CanIfRxPduHrhIdRef=CanIfInitHohCfg/NM_Dummy_ST3_NM_Dummy_ST3_5v44zxwqibhgfzivqlgrinq52_HAD_BACKUP_HAD_BACKUP_IN, CanIfRxPduRef=NM_Dummy_ST3_CanIf2CanNm_HAD_BACKUP_CAN
          CanIfRxPduCanIdRange: CanIfRxPduCanIdRangeLowerCanId=339869696, CanIfRxPduCanIdRangeUpperCanId=339873791
        IMU_B_Output_ST3_IMU_B_Output_ST3_867n3yp1q4vwzcxr3cdsioonf_IMU_INTERNAL_IMU_INTERNAL_IN: CanIfRxPduCanId=934, CanIfRxPduCanIdType=STANDARD_FD_CAN, CanIfRxPduDataLength=44, CanIfRxPduUserRxIndicationName=PduR_CanIfRxIndication, CanIfRxPduUserRxIndicationUL=PDUR, CanIfRxPduHrhIdRef=CanIfInitHohCfg/IMU_B_Output_ST3_IMU_B_Output_ST3_867n3yp1q4vwzcxr3cdsioonf_IMU_INTERNAL_IMU_INTERNAL_IN, CanIfRxPduRef=EcucPduCollection/IMU_B_Output_ST3_secured_CanIf2PduR_IMU_INTERNAL_CAN
        ECU_Stat_IMU_B_ST3_ECU_Stat_IMU_B_ST3_7e1x143vymagm1ezvyz5npfy4_IMU_INTERNAL_IMU_INTERNAL_IN: CanIfRxPduCanId=373424491, CanIfRxPduCanIdType=EXTENDED_FD_CAN, CanIfRxPduDataLength=8, CanIfRxPduReadData=false, CanIfRxPduReadNotifyStatus=false, CanIfRxPduUserRxIndicationName=PduR_CanIfRxIndication, CanIfRxPduUserRxIndicationUL=PDUR, CanIfRxPduHrhIdRef=CanIfInitHohCfg/ECU_Stat_IMU_B_ST3_ECU_Stat_IMU_B_ST3_7e1x143vymagm1ezvyz5npfy4_IMU_INTERNAL_IMU_INTERNAL_IN, CanIfRxPduRef=EcucPduCollection/ECU_Stat_IMU_B_ST3_CanIf2PduR_IMU_INTERNAL_CAN
        ROE_IMU_B_ST3_ROE_IMU_B_ST3_d4w0rsqy5i9ayk13lul7n8ule_IMU_INTERNAL_IMU_INTERNAL_IN: CanIfRxPduCanId=417426176, CanIfRxPduCanIdType=EXTENDED_FD_CAN, CanIfRxPduDataLength=8, CanIfRxPduReadData=false, CanIfRxPduReadNotifyStatus=false, CanIfRxPduUserRxIndicationName=PduR_CanIfRxIndication, CanIfRxPduUserRxIndicationUL=PDUR, CanIfRxPduHrhIdRef=CanIfInitHohCfg/ROE_IMU_B_ST3_ROE_IMU_B_ST3_d4w0rsqy5i9ayk13lul7n8ule_IMU_INTERNAL_IMU_INTERNAL_IN, CanIfRxPduRef=EcucPduCollection/ROE_IMU_B_ST3_CanIf2PduR_IMU_INTERNAL_CAN
        NM_Dummy_ST3_NM_Dummy_ST3_47cxd2tpch3havy6ru1a9do2q_IMU_INTERNAL_IMU_INTERNAL_IN: CanIfRxPduCanIdType=EXTENDED_NO_FD_CAN, CanIfRxPduDataLength=8, CanIfRxPduUserRxIndicationName=CanNm_RxIndication, CanIfRxPduUserRxIndicationUL=CAN_NM, CanIfRxPduReadData=false, CanIfRxPduReadNotifyStatus=false, CanIfRxPduHrhIdRef=CanIfInitHohCfg/NM_Dummy_ST3_NM_Dummy_ST3_47cxd2tpch3havy6ru1a9do2q_IMU_INTERNAL_IMU_INTERNAL_IN, CanIfRxPduRef=NM_Dummy_ST3_CanIf2CanNm_IMU_INTERNAL_CAN
          CanIfRxPduCanIdRange: CanIfRxPduCanIdRangeLowerCanId=339869696, CanIfRxPduCanIdRangeUpperCanId=339873791
      8 x CanIfTxPduCfg, all with CanIfTxPduReadNotifyStatus=false, CanIfTxPduType=STATIC:
        IMU_B_Output_ST3_IMU_B_Output_ST3_cvwgbah9by246et0yw6ftuq1e_HAD_BACKUP_HAD_BACKUP_OUT: CanIfTxPduCanId=934, CanIfTxPduCanIdType=STANDARD_FD_CAN, CanIfTxPduTruncation=true, CanIfTxPduUserTxConfirmationName=PduR_CanIfTxConfirmation, CanIfTxPduUserTxConfirmationUL=PDUR, CanIfTxPduBufferRef=Bu_IMU_B_Output_ST3_IMU_B_Output_ST3_cvwgbah9by246et0yw6ftuq1e_HAD_BACKUP_HAD_BACKUP_OUT, CanIfTxPduRef=EcucPduCollection/IMU_B_Output_ST3_secured_PduR2CanIf_HAD_BACKUP_CAN
        NM_IMU_A_ST3_NM_IMU_A_ST3_mqes5157d517lzmkzlhjas48_HAD_BACKUP_HAD_BACKUP_OUT: CanIfTxPduCanId=339870058, CanIfTxPduCanIdType=EXTENDED_CAN, CanIfTxPduTruncation=false, CanIfTxPduUserTxConfirmationName=CanNm_TxConfirmation, CanIfTxPduUserTxConfirmationUL=CAN_NM, CanIfTxPduBufferRef=Bu_NM_IMU_A_ST3_NM_IMU_A_ST3_mqes5157d517lzmkzlhjas48_HAD_BACKUP_HAD_BACKUP_OUT, CanIfTxPduRef=EcucPduCollection/NM_IMU_A_ST3_CanNm2CanIf_HAD_BACKUP_CAN
        ECU_Stat_IMU_A_ST3_ECU_Stat_IMU_A_ST3_aex3322f36mc6lh9solc55ki7_HAD_BACKUP_HAD_BACKUP_OUT: CanIfTxPduCanId=373424490, CanIfTxPduCanIdType=EXTENDED_FD_CAN, CanIfTxPduTruncation=false, CanIfTxPduUserTxConfirmationName=PduR_CanIfTxConfirmation, CanIfTxPduUserTxConfirmationUL=PDUR, CanIfTxPduBufferRef=Bu_ECU_Stat_IMU_A_ST3_ECU_Stat_IMU_A_ST3_aex3322f36mc6lh9solc55ki7_HAD_BACKUP_HAD_BACKUP_OUT, CanIfTxPduRef=EcucPduCollection/ECU_Stat_IMU_A_ST3_PduR2CanIf_HAD_BACKUP_CAN
        GTS_Main_CAN_ST3_GTS_Main_CAN_ST3_3roc9cgit8y88llo701fz09aw_IMU_INTERNAL_IMU_INTERNAL_OUT: CanIfTxPduCanId=121, CanIfTxPduCanIdType=STANDARD_FD_CAN, CanIfTxPduTruncation=false, CanIfTxPduUserTxConfirmationName=CanTSyn_TxConfirmation, CanIfTxPduUserTxConfirmationUL=CAN_TSYN, CanIfTxPduBufferRef=Bu_GTS_Main_CAN_ST3_GTS_Main_CAN_ST3_3roc9cgit8y88llo701fz09aw_IMU_INTERNAL_IMU_INTERNAL_OUT, CanIfTxPduRef=GTS_Main_CAN_ST3_CanTSyn2CanIf_IMU_INTERNAL_CAN
        IMU_A_HAD_BACKUP_COM_Container1_ST3_IMU_A_HAD_BACKUP_COM_Container1_ST3_c0akuwucqk1bxnpja1dfcudm3_HAD_BACKUP_HAD_BACKUP_OUT: CanIfTxPduCanId=150, CanIfTxPduCanIdType=STANDARD_FD_CAN, CanIfTxPduTruncation=false, CanIfTxPduUserTxConfirmationName=PduR_CanIfTxConfirmation, CanIfTxPduUserTxConfirmationUL=PDUR, CanIfTxPduBufferRef=Bu_IMU_A_HAD_BACKUP_COM_Container1_ST3_IMU_A_HAD_BACKUP_COM_Container1_ST3_c0akuwucqk1bxnpja1dfcudm3_HAD_BACKUP_HAD_BACKUP_OUT, CanIfTxPduRef=EcucPduCollection/IMU_A_HAD_BACKUP_COM_Container1_ST3_ContainerIPdu_PduR2CanIf_HAD_BACKUP_CAN
        IMU_A_HAD_BACKUP_GW_Container1_ST3_IMU_A_HAD_BACKUP_GW_Container1_ST3_roywpbiicz3ehpmr7k0lzj66_HAD_BACKUP_HAD_BACKUP_OUT: CanIfTxPduCanId=156, CanIfTxPduCanIdType=STANDARD_FD_CAN, CanIfTxPduTruncation=false, CanIfTxPduUserTxConfirmationName=PduR_CanIfTxConfirmation, CanIfTxPduUserTxConfirmationUL=PDUR, CanIfTxPduBufferRef=Bu_IMU_A_HAD_BACKUP_GW_Container1_ST3_IMU_A_HAD_BACKUP_GW_Container1_ST3_roywpbiicz3ehpmr7k0lzj66_HAD_BACKUP_HAD_BACKUP_OUT, CanIfTxPduRef=EcucPduCollection/IMU_A_HAD_BACKUP_GW_Container1_ST3_ContainerIPdu_PduR2CanIf_HAD_BACKUP_CAN
        Meas_IMU_A_ST3_Meas_IMU_A_ST3_bxis0tfg6gwef0ybcs7e7x8gd_HAD_BACKUP_HAD_BACKUP_OUT: CanIfTxPduCanId=417426064, CanIfTxPduCanIdType=EXTENDED_FD_CAN, CanIfTxPduTruncation=false, CanIfTxPduUserTxConfirmationName=PduR_CanIfTxConfirmation, CanIfTxPduUserTxConfirmationUL=PDUR, CanIfTxPduBufferRef=Bu_Meas_IMU_A_ST3_Meas_IMU_A_ST3_bxis0tfg6gwef0ybcs7e7x8gd_HAD_BACKUP_HAD_BACKUP_OUT, CanIfTxPduRef=EcucPduCollection/Meas_IMU_A_ST3_PduR2CanIf_HAD_BACKUP_CAN
        NM_IMU_A_ST3_NM_IMU_A_ST3_6vo2o7b9cyd47cbahjaygi9t7_IMU_INTERNAL_IMU_INTERNAL_OUT: CanIfTxPduCanId=339870058, CanIfTxPduCanIdType=EXTENDED_CAN, CanIfTxPduUserTxConfirmationName=CanNm_TxConfirmation, CanIfTxPduUserTxConfirmationUL=CAN_NM, CanIfTxPduTruncation=false, CanIfTxPduBufferRef=Bu_NM_IMU_A_ST3_NM_IMU_A_ST3_6vo2o7b9cyd47cbahjaygi9t7_IMU_INTERNAL_IMU_INTERNAL_OUT, CanIfTxPduRef=NM_IMU_A_ST3_CanNm2CanIf_IMU_INTERNAL_CAN
  module config CanNm: implementation-config-variant=VARIANT-PRE-COMPILE
    CanNmGlobalConfig
      CanNmCC_HAD_BACKUP_1 (CanNmChannelConfig):
        CanNmActiveWakeupBitEnabled = true
        CanNmAllNmMessagesKeepAwake = true
        CanNmBusLoadReductionActive = false
        CanNmCarWakeUpFilterEnabled = false
        CanNmCarWakeUpRxEnabled = false
        CanNmImmediateNmCycleTime = 0.02
        CanNmImmediateNmTransmissions = 6
        CanNmMsgCycleOffset = 0
        CanNmMsgCycleTime = 1.0
        CanNmMsgTimeoutTime = 0.5
        CanNmNodeDetectionEnabled = false
        CanNmNodeId = 1
        CanNmNodeIdEnabled = false
        CanNmPduCbvPosition = CANNM_PDU_BYTE_0
        CanNmPduNidPosition = CANNM_PDU_OFF
        CanNmPnEnabled = true
        CanNmRemoteSleepIndTime = 2.5
        CanNmRepeatMessageTime = 3.0
        CanNmRepeatMsgIndEnabled = false
        CanNmTimeoutTime = 2.5
        CanNmWaitBusSleepTime = 1.5
        CanNmPnEraCalcEnabled = true
        CanNmComMNetworkHandleRef = ComMChannel_Can1
        CanNmPnEraRxNSduRef = EcucPduCollection/NM_IMU_A_ST3_ERA_CanNm2PduR_HAD_BACKUP_CAN
        NM_Dummy_ST3_HAD_BACKUP (CanNmRxPdu): CanNmRxPduRef=NM_Dummy_ST3_CanIf2CanNm_HAD_BACKUP_CAN
        NM_IMU_A_ST3_CanNm2CanIf_HAD_BACKUP_CAN (CanNmTxPdu): CanNmTxPduRef=EcucPduCollection/NM_IMU_A_ST3_CanNm2CanIf_HAD_BACKUP_CAN
        NM_IMU_A_ST3_PduR2CanNm_HAD_BACKUP_CAN (CanNmUserDataTxPdu): CanNmTxUserDataPduRef=EcucPduCollection/NM_IMU_A_ST3_PduR2CanNm_HAD_BACKUP_CAN
      CanNmCC_IMU_INTERNAL_2 (CanNmChannelConfig):
        CanNmBusLoadReductionActive = false
        CanNmImmediateNmCycleTime = 0.02
        CanNmImmediateNmTransmissions = 6
        CanNmMsgCycleOffset = 0.0
        CanNmMsgCycleTime = 1.0
        CanNmMsgTimeoutTime = 0.5
        CanNmPduCbvPosition = CANNM_PDU_BYTE_0
        CanNmPduNidPosition = CANNM_PDU_OFF
        CanNmPnEnabled = true
        CanNmRemoteSleepIndTime = 2.5
        CanNmRepeatMessageTime = 3.0
        CanNmTimeoutTime = 2.5
        CanNmWaitBusSleepTime = 1.5
        CanNmNodeId = 0
        CanNmNodeIdEnabled = false
        CanNmNodeDetectionEnabled = false
        CanNmRepeatMsgIndEnabled = false
        CanNmCarWakeUpRxEnabled = false
        CanNmActiveWakeupBitEnabled = true
        CanNmAllNmMessagesKeepAwake = true
        CanNmCarWakeUpFilterEnabled = false
        CanNmPnEraCalcEnabled = true
        CanNmComMNetworkHandleRef = ComMChannel_Can
        CanNmPnEraRxNSduRef = EcucPduCollection/NM_IMU_A_ST3_ERA_CanNm2PduR_IMU_INTERNAL_CAN
        NM_Dummy_ST3_IMU_INTERNAL (CanNmRxPdu): CanNmRxPduRef=NM_Dummy_ST3_CanIf2CanNm_IMU_INTERNAL_CAN
        NM_IMU_A_ST3_IMU_INTERNAL (CanNmTxPdu): CanNmTxPduRef=NM_IMU_A_ST3_CanNm2CanIf_IMU_INTERNAL_CAN
        NM_IMU_A_ST3_UserData_IMU_INTERNAL (CanNmUserDataTxPdu): CanNmTxUserDataPduRef=EcucPduCollection/NM_IMU_A_ST3_PduR2CanNm_IMU_INTERNAL_CAN
  module config Com
    ComConfig
      5 x ComIPdu, all with ComIPduDirection=SEND, ComIPduSignalProcessing=DEFERRED, ComIPduType=NORMAL:
        IP_IMU_A_HAD_BACKUP_COM_Container1_ST3_ROE_IMU_A_ST3_CAN_Tx: ComIPduSignalGroupRef=SG_ROE_IMU_A_ST3_edm6y60q0qq6e5iaka50e3c31_HAD_BACKUP_CAN_Tx, ComPduIdRef=EcucPduCollection/IMU_A_HAD_BACKUP_COM_Container1_ST3_ROE_IMU_A_ST3_Com2PduR_HAD_BACKUP_CAN, ComIPduGroupRef=IPG_IMU_A_HAD_BACKUP_Tx_PNC_All_Active_CAN, ComIPduGroupRef=IPG_IMU_A_HAD_BACKUP_Tx_PNC_20_CAN, ComIPduGroupRef=IPG_IMU_A_HAD_BACKUP_Tx_PNC_23_CAN
          ComTxIPdu: ComMinimumDelayTime=0.2, ComTxIPduUnusedAreasDefault=0
            ComTxModeTrue
              ComTxMode: ComTxModeMode=DIRECT, ComTxModeNumberOfRepetitions=0
        IP_ECU_Stat_IMU_A_ST3_HAD_BACKUP_CAN_Tx: ComIPduSignalRef=S_Awake_Diag_Actv_IMU_A_ST3_HAD_BACKUP_CAN_Tx, ComIPduSignalRef=S_Awake_NwStart_IMU_A_ST3_HAD_BACKUP_CAN_Tx, ComIPduSignalRef=S_ECU_Id_IMU_A_ST3_HAD_BACKUP_CAN_Tx, ComIPduSignalRef=S_WakeupRsn_IMU_A_ST3_HAD_BACKUP_CAN_Tx, ComIPduSignalRef=S_NwId_Rsrv_ST3_HAD_BACKUP_CAN_Tx, ComPduIdRef=EcucPduCollection/ECU_Stat_IMU_A_ST3_Com2PduR_HAD_BACKUP_CAN, ComIPduGroupRef=IPG_IMU_A_HAD_BACKUP_Tx_PNC_All_Active_CAN, ComIPduGroupRef=IPG_IMU_A_HAD_BACKUP_Tx_PNC_20_CAN, ComIPduGroupRef=IPG_IMU_A_HAD_BACKUP_Tx_PNC_23_CAN
          ComTxIPdu: ComTxIPduUnusedAreasDefault=0, ComMinimumDelayTime=1
            ComTxModeTrue
              ComTxMode: ComTxModeMode=MIXED, ComTxModeTimeOffset=0.005, ComTxModeTimePeriod=1.0
        IP_NM_IMU_A_ST3_HAD_BACKUP_CAN_Tx: ComIPduSignalRef=S_NM_IMU_A_ST3_PNC_HAD_BACKUP_CAN_Tx, ComPduIdRef=EcucPduCollection/NM_IMU_A_ST3_Com2PduR_HAD_BACKUP_CAN, ComIPduGroupRef=IPG_IMU_A_NM_TX_All_CAN
          ComTxIPdu: ComTxIPduUnusedAreasDefault=0
            ComTxModeTrue
              ComTxMode: ComTxModeMode=NONE
        IP_Meas_IMU_A_ST3_HAD_BACKUP_CAN_Tx: ComIPduSignalGroupRef=SG_Meas_IMU_A_ST3_3n5lsz3gjs8xv6brvjbxgbhhx_HAD_BACKUP_CAN_Tx, ComPduIdRef=EcucPduCollection/Meas_IMU_A_ST3_Com2PduR_HAD_BACKUP_CAN, ComIPduGroupRef=IPG_TxMess_IMU_A_HAD_BACKUP_CAN
          ComTxIPdu: ComMinimumDelayTime=0.5, ComTxIPduUnusedAreasDefault=0
            ComTxModeTrue
              ComTxMode: ComTxModeMode=DIRECT, ComTxModeNumberOfRepetitions=0
        IP_NM_IMU_A_ST3_IMU_INTERNAL_CAN_Tx: ComIPduSignalRef=S_NM_IMU_A_ST3_PNC_IMU_INTERNAL_CAN_Tx, ComPduIdRef=EcucPduCollection/NM_IMU_A_ST3_Com2PduR_IMU_INTERNAL_CAN, ComIPduGroupRef=IPG_IMU_A_NM_TX_All_CAN
          ComTxIPdu: ComTxIPduUnusedAreasDefault=0
            ComTxModeTrue
              ComTxMode: ComTxModeMode=NONE
      3 x ComIPduGroup:
        IPG_IMU_A_HAD_BACKUP_Rx_PNC_All_Active_CAN
        IPG_IMU_A_HAD_BACKUP_Tx_PNC_All_Active_CAN
        IPG_IMU_A_HAD_BACKUP_Tx_PNC_20_CAN
      IP_NmPnEiraRxNSduRef_INTERNAL_CAN_Rx (ComIPdu):
        ComIPduDirection = RECEIVE
        ComIPduType = NORMAL
        ComIPduSignalProcessing = DEFERRED
        ComPduIdRef = EcucPduCollection/NmPnEiraRxNSduRef_CAN_PduR2Com_IMU_INTERNAL_CAN
        ComIPduSignalRef = S_NM_IMU_A_Eira_INTERNAL_CAN_Rx
      11 x ComIPduGroup:
        IPG_IMU_A_HAD_BACKUP_Rx_PNC_20_CAN
        IPG_IMU_A_IMU_INTERNAL_Tx_PNC_All_Active_CAN
        IPG_IMU_A_IMU_INTERNAL_Tx_PNC_15_ComCtrl_CAN
        IPG_IMU_A_IMU_INTERNAL_Tx_PNC_20_CAN
        IPG_IMU_A_IMU_INTERNAL_Rx_PNC_All_Active_CAN
        IPG_IMU_A_IMU_INTERNAL_Rx_PNC_20_CAN
        IPG_IMU_A_HAD_BACKUP_Tx_PNC_23_CAN
        IPG_IMU_A_HAD_BACKUP_Rx_PNC_23_CAN
        IPG_IMU_A_IMU_INTERNAL_Tx_PNC_23_CAN
        IPG_IMU_A_IMU_INTERNAL_Rx_PNC_23_CAN
        IPG_TxMess_IMU_A_HAD_BACKUP_CAN
      ComMainFunctionRx: ComMainRxTimeBase=0.005, ComMainRxPartitionRef=EcucPartition_0
      ComMainFunctionTx: ComMainTxTimeBase=0.005, ComMainTxPartitionRef=EcucPartition_0
      7 x ComSignal:
        S_Awake_Diag_Actv_IMU_A_ST3_HAD_BACKUP_CAN_Tx: ComBitPosition=30, ComBitSize=1, ComSignalEndianness=LITTLE_ENDIAN, ComSignalType=BOOLEAN, ComTransferProperty=TRIGGERED, ComSystemTemplateSystemSignalRef=Awake_Diag_Actv_IMU_A_ST3
        S_Awake_NwStart_IMU_A_ST3_HAD_BACKUP_CAN_Tx: ComBitPosition=31, ComBitSize=1, ComSignalEndianness=LITTLE_ENDIAN, ComSignalType=BOOLEAN, ComTransferProperty=TRIGGERED, ComSystemTemplateSystemSignalRef=Awake_NwStart_IMU_A_ST3
        S_ECU_Id_IMU_A_ST3_HAD_BACKUP_CAN_Tx: ComBitPosition=0, ComBitSize=12, ComSignalEndianness=LITTLE_ENDIAN, ComSignalType=UINT16, ComTransferProperty=TRIGGERED, ComSystemTemplateSystemSignalRef=ECU_Id_IMU_A_ST3
        S_WakeupRsn_IMU_A_ST3_HAD_BACKUP_CAN_Tx: ComBitPosition=20, ComBitSize=10, ComSignalEndianness=LITTLE_ENDIAN, ComSignalType=UINT16, ComTransferProperty=TRIGGERED, ComSystemTemplateSystemSignalRef=WakeupRsn_IMU_A_ST3
        S_NwId_Rsrv_ST3_HAD_BACKUP_CAN_Tx: ComBitPosition=12, ComBitSize=8, ComSignalEndianness=LITTLE_ENDIAN, ComSignalType=UINT8, ComTransferProperty=TRIGGERED, ComSystemTemplateSystemSignalRef=NwId_Rsrv_ST3
        S_NM_IMU_A_ST3_PNC_HAD_BACKUP_CAN_Tx: ComBitPosition=8, ComSignalEndianness=opaque, ComSignalLength=7, ComSignalType=UINT8_N, ComTransferProperty=PENDING, ComBitSize=56, ComSystemTemplateSystemSignalRef=NM_IMU_A_ST3_PNC
        S_NM_IMU_A_ST3_PNC_IMU_INTERNAL_CAN_Tx: ComBitPosition=8, ComSignalEndianness=opaque, ComSignalInitValue=0 0 0 0 0 0 0, ComSignalLength=7, ComSignalType=UINT8_N, ComTransferProperty=PENDING, ComBitSize=56, ComSystemTemplateSystemSignalRef=NM_IMU_A_ST3_PNC
      SG_ROE_IMU_A_ST3_edm6y60q0qq6e5iaka50e3c31_HAD_BACKUP_CAN_Tx (ComSignalGroup): ComSignalGroupArrayAccess=false, ComTransferProperty=TRIGGERED, ComSystemTemplateSignalGroupRef=ROE_IMU_A_ST3_edm6y60q0qq6e5iaka50e3c31
        8 x ComGroupSignal, all with ComBitSize=8, ComSignalEndianness=LITTLE_ENDIAN, ComSignalInitValue=0, ComSignalType=UINT8:
          GS_ROE_0_IMU_A_ST3_HAD_BACKUP_CAN_Tx: ComBitPosition=0, ComSystemTemplateSystemSignalRef=ROE_0_IMU_A_ST3
          GS_ROE_1_IMU_A_ST3_HAD_BACKUP_CAN_Tx: ComBitPosition=8, ComSystemTemplateSystemSignalRef=ROE_1_IMU_A_ST3
          GS_ROE_2_IMU_A_ST3_HAD_BACKUP_CAN_Tx: ComBitPosition=16, ComSystemTemplateSystemSignalRef=ROE_2_IMU_A_ST3
          GS_ROE_3_IMU_A_ST3_HAD_BACKUP_CAN_Tx: ComBitPosition=24, ComSystemTemplateSystemSignalRef=ROE_3_IMU_A_ST3
          GS_ROE_4_IMU_A_ST3_HAD_BACKUP_CAN_Tx: ComBitPosition=32, ComSystemTemplateSystemSignalRef=ROE_4_IMU_A_ST3
          GS_ROE_5_IMU_A_ST3_HAD_BACKUP_CAN_Tx: ComBitPosition=40, ComSystemTemplateSystemSignalRef=ROE_5_IMU_A_ST3
          GS_ROE_6_IMU_A_ST3_HAD_BACKUP_CAN_Tx: ComBitPosition=48, ComSystemTemplateSystemSignalRef=ROE_6_IMU_A_ST3
          GS_ROE_7_IMU_A_ST3_HAD_BACKUP_CAN_Tx: ComBitPosition=56, ComSystemTemplateSystemSignalRef=ROE_7_IMU_A_ST3
      SG_Meas_IMU_A_ST3_3n5lsz3gjs8xv6brvjbxgbhhx_HAD_BACKUP_CAN_Tx (ComSignalGroup): ComSignalGroupArrayAccess=false, ComTransferProperty=TRIGGERED, ComSystemTemplateSignalGroupRef=Meas_IMU_A_ST3_3n5lsz3gjs8xv6brvjbxgbhhx
        64 x ComGroupSignal, all with ComBitSize=8, ComSignalEndianness=LITTLE_ENDIAN, ComSignalInitValue=0, ComSignalType=UINT8:
          GS_Meas_IMU_A_01_ST3_HAD_BACKUP_CAN_Tx: ComBitPosition=0, ComSystemTemplateSystemSignalRef=Meas_IMU_A_01_ST3
          GS_Meas_IMU_A_02_ST3_HAD_BACKUP_CAN_Tx: ComBitPosition=8, ComSystemTemplateSystemSignalRef=Meas_IMU_A_02_ST3
          GS_Meas_IMU_A_03_ST3_HAD_BACKUP_CAN_Tx: ComBitPosition=16, ComSystemTemplateSystemSignalRef=Meas_IMU_A_03_ST3
          GS_Meas_IMU_A_04_ST3_HAD_BACKUP_CAN_Tx: ComBitPosition=24, ComSystemTemplateSystemSignalRef=Meas_IMU_A_04_ST3
          GS_Meas_IMU_A_05_ST3_HAD_BACKUP_CAN_Tx: ComBitPosition=32, ComSystemTemplateSystemSignalRef=Meas_IMU_A_05_ST3
          GS_Meas_IMU_A_06_ST3_HAD_BACKUP_CAN_Tx: ComBitPosition=40, ComSystemTemplateSystemSignalRef=Meas_IMU_A_06_ST3
          GS_Meas_IMU_A_07_ST3_HAD_BACKUP_CAN_Tx: ComBitPosition=48, ComSystemTemplateSystemSignalRef=Meas_IMU_A_07_ST3
          GS_Meas_IMU_A_08_ST3_HAD_BACKUP_CAN_Tx: ComBitPosition=56, ComSystemTemplateSystemSignalRef=Meas_IMU_A_08_ST3
          GS_Meas_IMU_A_09_ST3_HAD_BACKUP_CAN_Tx: ComBitPosition=64, ComSystemTemplateSystemSignalRef=Meas_IMU_A_09_ST3
          GS_Meas_IMU_A_10_ST3_HAD_BACKUP_CAN_Tx: ComBitPosition=72, ComSystemTemplateSystemSignalRef=Meas_IMU_A_10_ST3
          GS_Meas_IMU_A_11_ST3_HAD_BACKUP_CAN_Tx: ComBitPosition=80, ComSystemTemplateSystemSignalRef=Meas_IMU_A_11_ST3
          GS_Meas_IMU_A_12_ST3_HAD_BACKUP_CAN_Tx: ComBitPosition=88, ComSystemTemplateSystemSignalRef=Meas_IMU_A_12_ST3
          GS_Meas_IMU_A_13_ST3_HAD_BACKUP_CAN_Tx: ComBitPosition=96, ComSystemTemplateSystemSignalRef=Meas_IMU_A_13_ST3
          GS_Meas_IMU_A_14_ST3_HAD_BACKUP_CAN_Tx: ComBitPosition=104, ComSystemTemplateSystemSignalRef=Meas_IMU_A_14_ST3
          GS_Meas_IMU_A_15_ST3_HAD_BACKUP_CAN_Tx: ComBitPosition=112, ComSystemTemplateSystemSignalRef=Meas_IMU_A_15_ST3
          GS_Meas_IMU_A_16_ST3_HAD_BACKUP_CAN_Tx: ComBitPosition=120, ComSystemTemplateSystemSignalRef=Meas_IMU_A_16_ST3
          GS_Meas_IMU_A_17_ST3_HAD_BACKUP_CAN_Tx: ComBitPosition=128, ComSystemTemplateSystemSignalRef=Meas_IMU_A_17_ST3
          GS_Meas_IMU_A_18_ST3_HAD_BACKUP_CAN_Tx: ComBitPosition=136, ComSystemTemplateSystemSignalRef=Meas_IMU_A_18_ST3
          GS_Meas_IMU_A_19_ST3_HAD_BACKUP_CAN_Tx: ComBitPosition=144, ComSystemTemplateSystemSignalRef=Meas_IMU_A_19_ST3
          GS_Meas_IMU_A_20_ST3_HAD_BACKUP_CAN_Tx: ComBitPosition=152, ComSystemTemplateSystemSignalRef=Meas_IMU_A_20_ST3
          GS_Meas_IMU_A_21_ST3_HAD_BACKUP_CAN_Tx: ComBitPosition=160, ComSystemTemplateSystemSignalRef=Meas_IMU_A_21_ST3
          GS_Meas_IMU_A_22_ST3_HAD_BACKUP_CAN_Tx: ComBitPosition=168, ComSystemTemplateSystemSignalRef=Meas_IMU_A_22_ST3
          GS_Meas_IMU_A_23_ST3_HAD_BACKUP_CAN_Tx: ComBitPosition=176, ComSystemTemplateSystemSignalRef=Meas_IMU_A_23_ST3
          GS_Meas_IMU_A_24_ST3_HAD_BACKUP_CAN_Tx: ComBitPosition=184, ComSystemTemplateSystemSignalRef=Meas_IMU_A_24_ST3
          GS_Meas_IMU_A_25_ST3_HAD_BACKUP_CAN_Tx: ComBitPosition=192, ComSystemTemplateSystemSignalRef=Meas_IMU_A_25_ST3
          GS_Meas_IMU_A_26_ST3_HAD_BACKUP_CAN_Tx: ComBitPosition=200, ComSystemTemplateSystemSignalRef=Meas_IMU_A_26_ST3
          GS_Meas_IMU_A_27_ST3_HAD_BACKUP_CAN_Tx: ComBitPosition=208, ComSystemTemplateSystemSignalRef=Meas_IMU_A_27_ST3
          GS_Meas_IMU_A_28_ST3_HAD_BACKUP_CAN_Tx: ComBitPosition=216, ComSystemTemplateSystemSignalRef=Meas_IMU_A_28_ST3
          GS_Meas_IMU_A_29_ST3_HAD_BACKUP_CAN_Tx: ComBitPosition=224, ComSystemTemplateSystemSignalRef=Meas_IMU_A_29_ST3
          GS_Meas_IMU_A_30_ST3_HAD_BACKUP_CAN_Tx: ComBitPosition=232, ComSystemTemplateSystemSignalRef=Meas_IMU_A_30_ST3
          GS_Meas_IMU_A_31_ST3_HAD_BACKUP_CAN_Tx: ComBitPosition=240, ComSystemTemplateSystemSignalRef=Meas_IMU_A_31_ST3
          GS_Meas_IMU_A_32_ST3_HAD_BACKUP_CAN_Tx: ComBitPosition=248, ComSystemTemplateSystemSignalRef=Meas_IMU_A_32_ST3
          GS_Meas_IMU_A_33_ST3_HAD_BACKUP_CAN_Tx: ComBitPosition=256, ComSystemTemplateSystemSignalRef=Meas_IMU_A_33_ST3
          GS_Meas_IMU_A_34_ST3_HAD_BACKUP_CAN_Tx: ComBitPosition=264, ComSystemTemplateSystemSignalRef=Meas_IMU_A_34_ST3
          GS_Meas_IMU_A_35_ST3_HAD_BACKUP_CAN_Tx: ComBitPosition=272, ComSystemTemplateSystemSignalRef=Meas_IMU_A_35_ST3
          GS_Meas_IMU_A_36_ST3_HAD_BACKUP_CAN_Tx: ComBitPosition=280, ComSystemTemplateSystemSignalRef=Meas_IMU_A_36_ST3
          GS_Meas_IMU_A_37_ST3_HAD_BACKUP_CAN_Tx: ComBitPosition=288, ComSystemTemplateSystemSignalRef=Meas_IMU_A_37_ST3
          GS_Meas_IMU_A_38_ST3_HAD_BACKUP_CAN_Tx: ComBitPosition=296, ComSystemTemplateSystemSignalRef=Meas_IMU_A_38_ST3
          GS_Meas_IMU_A_39_ST3_HAD_BACKUP_CAN_Tx: ComBitPosition=304, ComSystemTemplateSystemSignalRef=Meas_IMU_A_39_ST3
          GS_Meas_IMU_A_40_ST3_HAD_BACKUP_CAN_Tx: ComBitPosition=312, ComSystemTemplateSystemSignalRef=Meas_IMU_A_40_ST3
          GS_Meas_IMU_A_41_ST3_HAD_BACKUP_CAN_Tx: ComBitPosition=320, ComSystemTemplateSystemSignalRef=Meas_IMU_A_41_ST3
          GS_Meas_IMU_A_42_ST3_HAD_BACKUP_CAN_Tx: ComBitPosition=328, ComSystemTemplateSystemSignalRef=Meas_IMU_A_42_ST3
          GS_Meas_IMU_A_43_ST3_HAD_BACKUP_CAN_Tx: ComBitPosition=336, ComSystemTemplateSystemSignalRef=Meas_IMU_A_43_ST3
          GS_Meas_IMU_A_44_ST3_HAD_BACKUP_CAN_Tx: ComBitPosition=344, ComSystemTemplateSystemSignalRef=Meas_IMU_A_44_ST3
          GS_Meas_IMU_A_45_ST3_HAD_BACKUP_CAN_Tx: ComBitPosition=352, ComSystemTemplateSystemSignalRef=Meas_IMU_A_45_ST3
          GS_Meas_IMU_A_46_ST3_HAD_BACKUP_CAN_Tx: ComBitPosition=360, ComSystemTemplateSystemSignalRef=Meas_IMU_A_46_ST3
          GS_Meas_IMU_A_47_ST3_HAD_BACKUP_CAN_Tx: ComBitPosition=368, ComSystemTemplateSystemSignalRef=Meas_IMU_A_47_ST3
          GS_Meas_IMU_A_48_ST3_HAD_BACKUP_CAN_Tx: ComBitPosition=376, ComSystemTemplateSystemSignalRef=Meas_IMU_A_48_ST3
          GS_Meas_IMU_A_49_ST3_HAD_BACKUP_CAN_Tx: ComBitPosition=384, ComSystemTemplateSystemSignalRef=Meas_IMU_A_49_ST3
          GS_Meas_IMU_A_50_ST3_HAD_BACKUP_CAN_Tx: ComBitPosition=392, ComSystemTemplateSystemSignalRef=Meas_IMU_A_50_ST3
          GS_Meas_IMU_A_51_ST3_HAD_BACKUP_CAN_Tx: ComBitPosition=400, ComSystemTemplateSystemSignalRef=Meas_IMU_A_51_ST3
          GS_Meas_IMU_A_52_ST3_HAD_BACKUP_CAN_Tx: ComBitPosition=408, ComSystemTemplateSystemSignalRef=Meas_IMU_A_52_ST3
          GS_Meas_IMU_A_53_ST3_HAD_BACKUP_CAN_Tx: ComBitPosition=416, ComSystemTemplateSystemSignalRef=Meas_IMU_A_53_ST3
          GS_Meas_IMU_A_54_ST3_HAD_BACKUP_CAN_Tx: ComBitPosition=424, ComSystemTemplateSystemSignalRef=Meas_IMU_A_54_ST3
          GS_Meas_IMU_A_55_ST3_HAD_BACKUP_CAN_Tx: ComBitPosition=432, ComSystemTemplateSystemSignalRef=Meas_IMU_A_55_ST3
          GS_Meas_IMU_A_56_ST3_HAD_BACKUP_CAN_Tx: ComBitPosition=440, ComSystemTemplateSystemSignalRef=Meas_IMU_A_56_ST3
          GS_Meas_IMU_A_57_ST3_HAD_BACKUP_CAN_Tx: ComBitPosition=448, ComSystemTemplateSystemSignalRef=Meas_IMU_A_57_ST3
          GS_Meas_IMU_A_58_ST3_HAD_BACKUP_CAN_Tx: ComBitPosition=456, ComSystemTemplateSystemSignalRef=Meas_IMU_A_58_ST3
          GS_Meas_IMU_A_59_ST3_HAD_BACKUP_CAN_Tx: ComBitPosition=464, ComSystemTemplateSystemSignalRef=Meas_IMU_A_59_ST3
          GS_Meas_IMU_A_60_ST3_HAD_BACKUP_CAN_Tx: ComBitPosition=472, ComSystemTemplateSystemSignalRef=Meas_IMU_A_60_ST3
          GS_Meas_IMU_A_61_ST3_HAD_BACKUP_CAN_Tx: ComBitPosition=480, ComSystemTemplateSystemSignalRef=Meas_IMU_A_61_ST3
          GS_Meas_IMU_A_62_ST3_HAD_BACKUP_CAN_Tx: ComBitPosition=488, ComSystemTemplateSystemSignalRef=Meas_IMU_A_62_ST3
          GS_Meas_IMU_A_63_ST3_HAD_BACKUP_CAN_Tx: ComBitPosition=496, ComSystemTemplateSystemSignalRef=Meas_IMU_A_63_ST3
          GS_Meas_IMU_A_64_ST3_HAD_BACKUP_CAN_Tx: ComBitPosition=504, ComSystemTemplateSystemSignalRef=Meas_IMU_A_64_ST3
      3 x ComIPdu, all with ComIPduSignalProcessing=DEFERRED, ComIPduType=NORMAL:
        IP_NM_IMU_A_ST3_HAD_BACKUP_CAN_Tx: ComIPduDirection=SEND, ComIPduSignalRef=S_NM_IMU_A_ST3_PNC_HAD_BACKUP_CAN_Tx, ComPduIdRef=EcucPduCollection/NM_IMU_A_ST3_Com2PduR_HAD_BACKUP_CAN, ComIPduGroupRef=IPG_IMU_A_NM_TX_All_CAN
          ComTxIPdu: ComTxIPduUnusedAreasDefault=0
            ComTxModeTrue
              ComTxMode: ComTxModeMode=NONE
        IP_NmPnEraRxNSduRef_HAD_BACKUP_CAN_Rx: ComIPduDirection=RECEIVE, ComIPduSignalRef=S_NM_IMU_A_CanNmUserDataSig_Era_HAD_BACKUP_CAN_Rx, ComPduIdRef=EcucPduCollection/NM_IMU_A_ST3_ERA_PduR2Com_HAD_BACKUP_CAN, ComIPduGroupRef=IPG_IMU_A_NM_RX_All_CAN
        IP_NmPnEraRxNSduRef_INTERNAL_CAN_Rx: ComIPduDirection=RECEIVE, ComPduIdRef=EcucPduCollection/NM_IMU_A_ST3_ERA_PduR2Com_IMU_INTERNAL_CAN, ComIPduGroupRef=IPG_IMU_A_NM_RX_All_CAN, ComIPduSignalRef=S_NM_IMU_A_CanNmUserDataSig_Era_INTERNAL_CAN_Rx
      IPG_IMU_A_NM_RX_All_CAN (ComIPduGroup)
      IPG_IMU_A_NM_TX_All_CAN (ComIPduGroup)
      3 x ComSignal, all with ComBitPosition=8, ComBitSize=56, ComSignalEndianness=opaque, ComSignalInitValue=0 0 0 0 0 0 0, ComSignalLength=7, ComSignalType=UINT8_N:
        S_NM_IMU_A_Eira_INTERNAL_CAN_Rx
        S_NM_IMU_A_CanNmUserDataSig_Era_HAD_BACKUP_CAN_Rx
        S_NM_IMU_A_CanNmUserDataSig_Era_INTERNAL_CAN_Rx
  module config EcuC
    EcucConfigSet
      EcucPduCollection
        174 x Pdu:
          IMU_A_HAD_BACKUP_COM_Container1_ST3_ContainerIPdu_IpduM2PduR_HAD_BACKUP_CAN: PduLength=64, SysTPduToPduTriggeringRef=IMU_A_HAD_BACKUP_COM_Container1_ST3_5fc40qe7eix9l29216sw0x3pc
          IMU_A_HAD_BACKUP_COM_Container1_ST3_ContainerIPdu_PduR2CanIf_HAD_BACKUP_CAN: PduLength=64, SysTPduToPduTriggeringRef=IMU_A_HAD_BACKUP_COM_Container1_ST3_5fc40qe7eix9l29216sw0x3pc
          IMU_A_HAD_BACKUP_COM_Container1_ST3_ROE_IMU_A_ST3_Com2PduR_HAD_BACKUP_CAN: PduLength=8, SysTPduToPduTriggeringRef=IMU_A_HAD_BACKUP_COM_Container1_ST3_IMU_A_HAD_BACKUP_COM_Container1_ST3_ROE_IMU_A_ST3_f430b8ou54rp0u3dqgmzehof0
          IMU_A_HAD_BACKUP_COM_Container1_ST3_ROE_IMU_A_ST3_PduR2IpduM_HAD_BACKUP_CAN: PduLength=8, SysTPduToPduTriggeringRef=IMU_A_HAD_BACKUP_COM_Container1_ST3_IMU_A_HAD_BACKUP_COM_Container1_ST3_ROE_IMU_A_ST3_f430b8ou54rp0u3dqgmzehof0
          IMU_A_HAD_BACKUP_GW_Container1_ST3_ContainerIPdu_IpduM2PduR_HAD_BACKUP_CAN: PduLength=64, SysTPduToPduTriggeringRef=IMU_A_HAD_BACKUP_GW_Container1_ST3_5f8t0vj1dqcedcau7bepxw1r5
          IMU_A_HAD_BACKUP_GW_Container1_ST3_ContainerIPdu_PduR2CanIf_HAD_BACKUP_CAN: PduLength=64, SysTPduToPduTriggeringRef=IMU_A_HAD_BACKUP_GW_Container1_ST3_5f8t0vj1dqcedcau7bepxw1r5
          ESP_HAD_BACKUP_GW_Container3_ST3_ContainerIPdu_CanIf2PduR_HAD_BACKUP_CAN: PduLength=64, SysTPduToPduTriggeringRef=ESP_HAD_BACKUP_GW_Container3_ST3_es20z922k0hdxd542vyccnt5z
          ESP_HAD_BACKUP_GW_Container3_ST3_ContainerIPdu_PduR2IpduM_HAD_BACKUP_CAN: PduLength=64, SysTPduToPduTriggeringRef=ESP_HAD_BACKUP_GW_Container3_ST3_es20z922k0hdxd542vyccnt5z
          ESP_HAD_BACKUP_GW_Container3_ST3_VSS_TP_Auth_ST3_IpduM2PduR_HAD_BACKUP_CAN: PduLength=8, SysTPduToPduTriggeringRef=ESP_HAD_BACKUP_GW_Container3_ST3_ESP_HAD_BACKUP_GW_Container3_ST3_VSS_TP_Auth_ST3_a5m1oehgi1yzcicgsdebhigxy
          ESP_HAD_BACKUP_GW_Container3_ST3_VSS_TP_Auth_ST3_PduR2Com_HAD_BACKUP_CAN: PduLength=8, SysTPduToPduTriggeringRef=ESP_HAD_BACKUP_GW_Container3_ST3_ESP_HAD_BACKUP_GW_Container3_ST3_VSS_TP_Auth_ST3_a5m1oehgi1yzcicgsdebhigxy
          ESP_HAD_BACKUP_GW_Container3_ST3_VSS_TP_RealTmOffset_ST3_IpduM2PduR_HAD_BACKUP_CAN: PduLength=8, SysTPduToPduTriggeringRef=ESP_HAD_BACKUP_GW_Container3_ST3_ESP_HAD_BACKUP_GW_Container3_ST3_VSS_TP_RealTmOffset_ST3_2686huv0x9rg4cu1k20p07zrz
          ESP_HAD_BACKUP_GW_Container3_ST3_VSS_TP_RealTmOffset_ST3_PduR2Com_HAD_BACKUP_CAN: PduLength=8, SysTPduToPduTriggeringRef=ESP_HAD_BACKUP_GW_Container3_ST3_ESP_HAD_BACKUP_GW_Container3_ST3_VSS_TP_RealTmOffset_ST3_2686huv0x9rg4cu1k20p07zrz
          ESP_HAD_BACKUP_GW_Container3_ST3_VSS_TP_SecTickCount_Lvl1_ST3_IpduM2PduR_HAD_BACKUP_CAN: PduLength=8, SysTPduToPduTriggeringRef=ESP_HAD_BACKUP_GW_Container3_ST3_ESP_HAD_BACKUP_GW_Container3_ST3_VSS_TP_SecTickCount_Lvl1_ST3_azhv8t4onxhjhi2zn8in2my2n
          ESP_HAD_BACKUP_GW_Container3_ST3_VSS_TP_SecTickCount_Lvl1_ST3_PduR2Com_HAD_BACKUP_CAN: PduLength=8, SysTPduToPduTriggeringRef=ESP_HAD_BACKUP_GW_Container3_ST3_ESP_HAD_BACKUP_GW_Container3_ST3_VSS_TP_SecTickCount_Lvl1_ST3_azhv8t4onxhjhi2zn8in2my2n
          ESP_HAD_BACKUP_GW_Container3_ST3_VSS_TP_SharedSecret_ST3_IpduM2PduR_HAD_BACKUP_CAN: PduLength=8, SysTPduToPduTriggeringRef=ESP_HAD_BACKUP_GW_Container3_ST3_ESP_HAD_BACKUP_GW_Container3_ST3_VSS_TP_SharedSecret_ST3_82pb6fg4cswmgotegs6aplrj2
          ESP_HAD_BACKUP_GW_Container3_ST3_VSS_TP_SharedSecret_ST3_PduR2Com_HAD_BACKUP_CAN: PduLength=8, SysTPduToPduTriggeringRef=ESP_HAD_BACKUP_GW_Container3_ST3_ESP_HAD_BACKUP_GW_Container3_ST3_VSS_TP_SharedSecret_ST3_82pb6fg4cswmgotegs6aplrj2
          ESP_HAD_BACKUP_GW_Container3_ST3_VSS_TP_VIN_ST3_IpduM2PduR_HAD_BACKUP_CAN: PduLength=8, SysTPduToPduTriggeringRef=ESP_HAD_BACKUP_GW_Container3_ST3_ESP_HAD_BACKUP_GW_Container3_ST3_VSS_TP_VIN_ST3_3331jz4zbik8yl0ehm51yf8w4
          ESP_HAD_BACKUP_GW_Container3_ST3_VSS_TP_VIN_ST3_PduR2Com_HAD_BACKUP_CAN: PduLength=8, SysTPduToPduTriggeringRef=ESP_HAD_BACKUP_GW_Container3_ST3_ESP_HAD_BACKUP_GW_Container3_ST3_VSS_TP_VIN_ST3_3331jz4zbik8yl0ehm51yf8w4
          IMU_A_Output_ST3_secured_SecOC2PduR_HAD_BACKUP_CAN: PduLength=44, SysTPduToPduTriggeringRef=IMU_A_Output_ST3_32ru3309rvckjvcx6fmcjcw7u
          IMU_A_Output_ST3_secured_PduR2CanIf_HAD_BACKUP_CAN: PduLength=44, SysTPduToPduTriggeringRef=IMU_A_Output_ST3_32ru3309rvckjvcx6fmcjcw7u
          IMU_A_Output_ST3_Com2PduR_HAD_BACKUP_CAN: PduLength=40, SysTPduToPduTriggeringRef=IMU_A_Output_ST3_brfz9q0nahr147hbo9yhq1vvv
          IMU_A_Output_ST3_PduR2SecOC_HAD_BACKUP_CAN: PduLength=40, SysTPduToPduTriggeringRef=IMU_A_Output_ST3_brfz9q0nahr147hbo9yhq1vvv
          IMU_B_Output_ST3_secured_PduR2CanIf_HAD_BACKUP_CAN: PduLength=44, SysTPduToPduTriggeringRef=IMU_B_Output_ST3_bffs41or7tdzn6fa29pvrjq4c
          IMU_B_Output_ST3_secured_SecOC2PduR_HAD_BACKUP_CAN: PduLength=44, SysTPduToPduTriggeringRef=IMU_B_Output_ST3_bffs41or7tdzn6fa29pvrjq4c
          IMU_B_Output_ST3_Com2PduR_HAD_BACKUP_CAN: PduLength=40, SysTPduToPduTriggeringRef=IMU_B_Output_ST3_e7us6pv8twmgl1lendhudwh3s
          IMU_B_Output_ST3_PduR2SecOC_HAD_BACKUP_CAN: PduLength=40, SysTPduToPduTriggeringRef=IMU_B_Output_ST3_e7us6pv8twmgl1lendhudwh3s
          NM_IMU_A_ST3_CanNm2CanIf_HAD_BACKUP_CAN: PduLength=8, SysTPduToFrameTriggeringRef=NM_IMU_A_ST3_mqes5157d517lzmkzlhjas48
          NM_Dummy_ST3_CanIf2CanNm_HAD_BACKUP_CAN: PduLength=8, SysTPduToFrameTriggeringRef=NM_Dummy_ST3_5v44zxwqibhgfzivqlgrinq52
          ECU_Stat_IMU_A_ST3_Com2PduR_HAD_BACKUP_CAN: PduLength=8, SysTPduToPduTriggeringRef=ECU_Stat_IMU_A_ST3_136g7awpfvh0itxq740bqmwve
          ECU_Stat_IMU_A_ST3_PduR2CanIf_HAD_BACKUP_CAN: PduLength=8, SysTPduToPduTriggeringRef=ECU_Stat_IMU_A_ST3_136g7awpfvh0itxq740bqmwve
          NM_IMU_A_ST3_Com2PduR_HAD_BACKUP_CAN: PduLength=8, SysTPduToFrameTriggeringRef=NM_IMU_A_ST3_mqes5157d517lzmkzlhjas48
          NM_IMU_A_ST3_PduR2CanNm_HAD_BACKUP_CAN: PduLength=8, SysTPduToFrameTriggeringRef=NM_IMU_A_ST3_mqes5157d517lzmkzlhjas48
          IMU_A_Output_ST3_secured_SecOC2PduR_IMU_INTERNAL_CAN: PduLength=44, SysTPduToPduTriggeringRef=IMU_A_Output_ST3_6l4id86kym3ykh1x8fnhhai2g
          IMU_A_Output_ST3_secured_PduR2CanIf_IMU_INTERNAL_CAN: PduLength=44, SysTPduToPduTriggeringRef=IMU_A_Output_ST3_6l4id86kym3ykh1x8fnhhai2g
          IMU_A_Output_ST3_Com2PduR_IMU_INTERNAL_CAN: PduLength=40, SysTPduToPduTriggeringRef=IMU_A_Output_ST3_1s7p55wldfbcir6iy5a616rwn
          IMU_A_Output_ST3_PduR2SecOC_IMU_INTERNAL_CAN: PduLength=40, SysTPduToPduTriggeringRef=IMU_A_Output_ST3_1s7p55wldfbcir6iy5a616rwn
          IMU_B_Output_ST3_secured_CanIf2PduR_IMU_INTERNAL_CAN: PduLength=44, SysTPduToPduTriggeringRef=IMU_B_Output_ST3_bwk2sg041c3g1zxomqmr61qdl
          IMU_B_Output_ST3_secured_PduR2SecOC_IMU_INTERNAL_CAN: PduLength=44, SysTPduToPduTriggeringRef=IMU_B_Output_ST3_bwk2sg041c3g1zxomqmr61qdl
          IMU_B_Output_ST3_SecOC2PduR_IMU_INTERNAL_CAN: PduLength=40, SysTPduToPduTriggeringRef=IMU_B_Output_ST3_71wg165b3j1a1mormsg5xnlfr
          IMU_B_Output_ST3_PduR2Com_IMU_INTERNAL_CAN: PduLength=40, SysTPduToPduTriggeringRef=IMU_B_Output_ST3_71wg165b3j1a1mormsg5xnlfr
          NM_IMU_A_ST3_CanNm2CanIf_IMU_INTERNAL_CAN: PduLength=8, SysTPduToFrameTriggeringRef=NM_IMU_A_ST3_6vo2o7b9cyd47cbahjaygi9t7
          NM_Dummy_ST3_CanIf2CanNm_IMU_INTERNAL_CAN: PduLength=8, SysTPduToFrameTriggeringRef=NM_Dummy_ST3_47cxd2tpch3havy6ru1a9do2q
          ECU_Stat_IMU_A_IMU_INTERNAL_ST3_Com2PduR_IMU_INTERNAL_CAN: PduLength=8, SysTPduToPduTriggeringRef=ECU_Stat_IMU_A_IMU_INTERNAL_ST3_a8phq4pa8364mz7zku4m1zggs
          ECU_Stat_IMU_A_IMU_INTERNAL_ST3_PduR2CanIf_IMU_INTERNAL_CAN: PduLength=8, SysTPduToPduTriggeringRef=ECU_Stat_IMU_A_IMU_INTERNAL_ST3_a8phq4pa8364mz7zku4m1zggs
          ECU_Stat_IMU_B_ST3_CanIf2PduR_IMU_INTERNAL_CAN: PduLength=8, SysTPduToPduTriggeringRef=ECU_Stat_IMU_B_ST3_1l9xnste3w36iapn7j8fv2gjj
          ECU_Stat_IMU_B_ST3_PduR2Com_IMU_INTERNAL_CAN: PduLength=8, SysTPduToPduTriggeringRef=ECU_Stat_IMU_B_ST3_1l9xnste3w36iapn7j8fv2gjj
          ROE_IMU_B_ST3_CanIf2PduR_IMU_INTERNAL_CAN: PduLength=8, SysTPduToPduTriggeringRef=ROE_IMU_B_ST3_ybki1p1g4q0gpufyixy3mote
          ROE_IMU_B_ST3_PduR2Com_IMU_INTERNAL_CAN: PduLength=8, SysTPduToPduTriggeringRef=ROE_IMU_B_ST3_ybki1p1g4q0gpufyixy3mote
          NmPnEiraRxNSduRef_CAN_CanNm2PduR_IMU_INTERNAL_CAN: PduLength=8, SysTPduToFrameTriggeringRef=NM_Dummy_ST3_47cxd2tpch3havy6ru1a9do2q
          NmPnEiraRxNSduRef_CAN_PduR2Com_IMU_INTERNAL_CAN: PduLength=8, SysTPduToFrameTriggeringRef=NM_Dummy_ST3_47cxd2tpch3havy6ru1a9do2q
          NM_IMU_A_ST3_Com2PduR_IMU_INTERNAL_CAN: PduLength=8, SysTPduToFrameTriggeringRef=NM_IMU_A_ST3_6vo2o7b9cyd47cbahjaygi9t7
          NM_IMU_A_ST3_PduR2CanNm_IMU_INTERNAL_CAN: PduLength=8, SysTPduToFrameTriggeringRef=NM_IMU_A_ST3_6vo2o7b9cyd47cbahjaygi9t7
          NM_IMU_A_ST3_ERA_PduR2Com_IMU_INTERNAL_CAN: PduLength=8, SysTPduToFrameTriggeringRef=NM_IMU_A_ST3_6vo2o7b9cyd47cbahjaygi9t7
          NM_IMU_A_ST3_ERA_CanNm2PduR_IMU_INTERNAL_CAN: PduLength=8, SysTPduToFrameTriggeringRef=NM_IMU_A_ST3_6vo2o7b9cyd47cbahjaygi9t7
          NM_IMU_A_ST3_ERA_PduR2Com_HAD_BACKUP_CAN: PduLength=8, SysTPduToFrameTriggeringRef=NM_IMU_A_ST3_6vo2o7b9cyd47cbahjaygi9t7
          NM_IMU_A_ST3_ERA_CanNm2PduR_HAD_BACKUP_CAN: PduLength=8, SysTPduToFrameTriggeringRef=NM_IMU_A_ST3_6vo2o7b9cyd47cbahjaygi9t7
          GTS_Main_CAN_ST3_CanTSyn2CanIf_IMU_INTERNAL_CAN: PduLength=8
          GTS_Main_CAN_ST3_CanIf2CanTSyn_HAD_BACKUP_CAN: PduLength=8
          IMU_A_HAD_BACKUP_GW_Container1_ST3_ECU_Stat_IMU_B_ST3_PduR2IpduM_HAD_BACKUP_CAN: PduLength=8, SysTPduToPduTriggeringRef=IMU_A_HAD_BACKUP_GW_Container1_ST3_IMU_A_HAD_BACKUP_GW_Container1_ST3_ECU_Stat_IMU_B_ST3_b0no16iuzsaidp6epdjs3jmj3
          IMU_A_HAD_BACKUP_GW_Container1_ST3_ECU_Stat_IMU_B_ST3_Com2PduR_HAD_BACKUP_CAN: PduLength=8, SysTPduToPduTriggeringRef=IMU_A_HAD_BACKUP_GW_Container1_ST3_IMU_A_HAD_BACKUP_GW_Container1_ST3_ECU_Stat_IMU_B_ST3_b0no16iuzsaidp6epdjs3jmj3
          IMU_A_HAD_BACKUP_GW_Container1_ST3_ROE_IMU_B_ST3_PduR2IpduM_HAD_BACKUP_CAN: PduLength=8, SysTPduToPduTriggeringRef=IMU_A_HAD_BACKUP_GW_Container1_ST3_IMU_A_HAD_BACKUP_GW_Container1_ST3_ROE_IMU_B_ST3_7evmftg8vujspy0p3yge2cozt
          IMU_A_HAD_BACKUP_GW_Container1_ST3_ROE_IMU_B_ST3_Com2PduR_HAD_BACKUP_CAN: PduLength=8, SysTPduToPduTriggeringRef=IMU_A_HAD_BACKUP_GW_Container1_ST3_IMU_A_HAD_BACKUP_GW_Container1_ST3_ROE_IMU_B_ST3_7evmftg8vujspy0p3yge2cozt
          Meas_IMU_A_ST3_Com2PduR_HAD_BACKUP_CAN: PduLength=64, SysTPduToPduTriggeringRef=Meas_IMU_A_ST3_bcya807sfy2xqyg51auylav0f
          Meas_IMU_A_ST3_PduR2CanIf_HAD_BACKUP_CAN: PduLength=64, SysTPduToPduTriggeringRef=Meas_IMU_A_ST3_bcya807sfy2xqyg51auylav0f
          FBL_Cfg_Star3_ST3_CanIf2PduR_HAD_BACKUP_CAN: PduLength=1, SysTPduToPduTriggeringRef=FBL_Cfg_Star3_ST3_27m9sbzvs2f0s09avctwlewte
          FBL_Cfg_Star3_ST3_PduR2Com_HAD_BACKUP_CAN: PduLength=1, SysTPduToPduTriggeringRef=FBL_Cfg_Star3_ST3_27m9sbzvs2f0s09avctwlewte
          ESP_HAD_BACKUP_COM_Container1_ST3_ContainerIPdu_CanIf2PduR_HAD_BACKUP_CAN: PduLength=64, SysTPduToPduTriggeringRef=ESP_HAD_BACKUP_COM_Container1_ST3_9wgr7acccdjxfn4xsmzzlmfj6
          ESP_HAD_BACKUP_COM_Container1_ST3_ContainerIPdu_PduR2IpduM_HAD_BACKUP_CAN: PduLength=64, SysTPduToPduTriggeringRef=ESP_HAD_BACKUP_COM_Container1_ST3_9wgr7acccdjxfn4xsmzzlmfj6
          ESP_HAD_BACKUP_COM_Container1_ST3_ESP_HAD_BACKUP_COM_Container1_ST3_BCS_Whl_Msg1_BTC_ST3_secured_IpduM2PduR_HAD_BACKUP_CAN: PduLength=24, SysTPduToPduTriggeringRef=ESP_HAD_BACKUP_COM_Container1_ST3_ESP_HAD_BACKUP_COM_Container1_ST3_BCS_Whl_Msg1_BTC_ST3_16ebm65e7roje1m2kqzv87azq
          ESP_HAD_BACKUP_COM_Container1_ST3_ESP_HAD_BACKUP_COM_Container1_ST3_BCS_Whl_Msg1_BTC_ST3_secured_PduR2SecOC_HAD_BACKUP_CAN: PduLength=24, SysTPduToPduTriggeringRef=ESP_HAD_BACKUP_COM_Container1_ST3_ESP_HAD_BACKUP_COM_Container1_ST3_BCS_Whl_Msg1_BTC_ST3_16ebm65e7roje1m2kqzv87azq
          ESP_HAD_BACKUP_COM_Container1_ST3_BCS_Whl_Msg1_BTC_ST3_SecOC2PduR_HAD_BACKUP_CAN: PduLength=20, SysTPduToPduTriggeringRef=ESP_HAD_BACKUP_COM_Container1_ST3_ESP_HAD_BACKUP_COM_Container1_ST3_BCS_Whl_Msg1_BTC_ST3_5veu2p0tm6432xnhqor79qs7k
          ESP_HAD_BACKUP_COM_Container1_ST3_BCS_Whl_Msg1_BTC_ST3_PduR2Com_HAD_BACKUP_CAN: PduLength=20, SysTPduToPduTriggeringRef=ESP_HAD_BACKUP_COM_Container1_ST3_ESP_HAD_BACKUP_COM_Container1_ST3_BCS_Whl_Msg1_BTC_ST3_5veu2p0tm6432xnhqor79qs7k
          ESP_HAD_BACKUP_GW_Container2_ST3_ContainerIPdu_CanIf2PduR_HAD_BACKUP_CAN: PduLength=64, SysTPduToPduTriggeringRef=ESP_HAD_BACKUP_GW_Container2_ST3_aadd7dff7rkg0cjrmt2mmksbu
          ESP_HAD_BACKUP_GW_Container2_ST3_ContainerIPdu_PduR2IpduM_HAD_BACKUP_CAN: PduLength=64, SysTPduToPduTriggeringRef=ESP_HAD_BACKUP_GW_Container2_ST3_aadd7dff7rkg0cjrmt2mmksbu
          ESP_HAD_BACKUP_GW_Container2_ST3_ESP_HAD_BACKUP_GW_Container2_ST3_Ign_Stat_ST3_secured_IpduM2PduR_HAD_BACKUP_CAN: PduLength=8, SysTPduToPduTriggeringRef=ESP_HAD_BACKUP_GW_Container2_ST3_ESP_HAD_BACKUP_GW_Container2_ST3_Ign_Stat_ST3_2evpht35ev1p8y12nz0ebo5h3
          ESP_HAD_BACKUP_GW_Container2_ST3_ESP_HAD_BACKUP_GW_Container2_ST3_Ign_Stat_ST3_secured_PduR2SecOC_HAD_BACKUP_CAN: PduLength=8, SysTPduToPduTriggeringRef=ESP_HAD_BACKUP_GW_Container2_ST3_ESP_HAD_BACKUP_GW_Container2_ST3_Ign_Stat_ST3_2evpht35ev1p8y12nz0ebo5h3
          ESP_HAD_BACKUP_GW_Container2_ST3_Ign_Stat_ST3_SecOC2PduR_HAD_BACKUP_CAN: PduLength=4, SysTPduToPduTriggeringRef=ESP_HAD_BACKUP_GW_Container2_ST3_ESP_HAD_BACKUP_GW_Container2_ST3_Ign_Stat_ST3_bcjlclrj2mauvscq34e4kbcj3
          ESP_HAD_BACKUP_GW_Container2_ST3_Ign_Stat_ST3_PduR2Com_HAD_BACKUP_CAN: PduLength=4, SysTPduToPduTriggeringRef=ESP_HAD_BACKUP_GW_Container2_ST3_ESP_HAD_BACKUP_GW_Container2_ST3_Ign_Stat_ST3_bcjlclrj2mauvscq34e4kbcj3
          ESP_HAD_BACKUP_GW_Container2_ST3_ESP_HAD_BACKUP_GW_Container2_ST3_PT4_PTCoor4_ST3_secured_IpduM2PduR_HAD_BACKUP_CAN: PduLength=8, SysTPduToPduTriggeringRef=ESP_HAD_BACKUP_GW_Container2_ST3_ESP_HAD_BACKUP_GW_Container2_ST3_PT4_PTCoor4_ST3_4jwqfrzf6ypk91w3rckoip7tp
          ESP_HAD_BACKUP_GW_Container2_ST3_ESP_HAD_BACKUP_GW_Container2_ST3_PT4_PTCoor4_ST3_secured_PduR2SecOC_HAD_BACKUP_CAN: PduLength=8, SysTPduToPduTriggeringRef=ESP_HAD_BACKUP_GW_Container2_ST3_ESP_HAD_BACKUP_GW_Container2_ST3_PT4_PTCoor4_ST3_4jwqfrzf6ypk91w3rckoip7tp
          ESP_HAD_BACKUP_GW_Container2_ST3_PT4_PTCoor4_ST3_SecOC2PduR_HAD_BACKUP_CAN: PduLength=4, SysTPduToPduTriggeringRef=ESP_HAD_BACKUP_GW_Container2_ST3_ESP_HAD_BACKUP_GW_Container2_ST3_PT4_PTCoor4_ST3_9c9xmhimk3956a8bl74rmvxi7
          ESP_HAD_BACKUP_GW_Container2_ST3_PT4_PTCoor4_ST3_PduR2Com_HAD_BACKUP_CAN: PduLength=4, SysTPduToPduTriggeringRef=ESP_HAD_BACKUP_GW_Container2_ST3_ESP_HAD_BACKUP_GW_Container2_ST3_PT4_PTCoor4_ST3_9c9xmhimk3956a8bl74rmvxi7
          ESP_HAD_BACKUP_GW_Container4_ST3_ContainerIPdu_CanIf2PduR_HAD_BACKUP_CAN: PduLength=64, SysTPduToPduTriggeringRef=ESP_HAD_BACKUP_GW_Container4_ST3_377j3yoh64pojpc5ok3dvykes
          ESP_HAD_BACKUP_GW_Container4_ST3_ContainerIPdu_PduR2IpduM_HAD_BACKUP_CAN: PduLength=64, SysTPduToPduTriggeringRef=ESP_HAD_BACKUP_GW_Container4_ST3_377j3yoh64pojpc5ok3dvykes
          ESP_HAD_BACKUP_GW_Container4_ST3_ESP_HAD_BACKUP_GW_Container4_ST3_DI_OdoSpeedometer_ST3_secured_IpduM2PduR_HAD_BACKUP_CAN: PduLength=12, SysTPduToPduTriggeringRef=ESP_HAD_BACKUP_GW_Container4_ST3_ESP_HAD_BACKUP_GW_Container4_ST3_DI_OdoSpeedometer_ST3_8fnay511jh4db945s2stpdw7p
          ESP_HAD_BACKUP_GW_Container4_ST3_ESP_HAD_BACKUP_GW_Container4_ST3_DI_OdoSpeedometer_ST3_secured_PduR2SecOC_HAD_BACKUP_CAN: PduLength=12, SysTPduToPduTriggeringRef=ESP_HAD_BACKUP_GW_Container4_ST3_ESP_HAD_BACKUP_GW_Container4_ST3_DI_OdoSpeedometer_ST3_8fnay511jh4db945s2stpdw7p
          ESP_HAD_BACKUP_GW_Container4_ST3_DI_OdoSpeedometer_ST3_SecOC2PduR_HAD_BACKUP_CAN: PduLength=8, SysTPduToPduTriggeringRef=ESP_HAD_BACKUP_GW_Container4_ST3_ESP_HAD_BACKUP_GW_Container4_ST3_DI_OdoSpeedometer_ST3_2wrcqkh4ub39zvlu7w28s2r1f
          ESP_HAD_BACKUP_GW_Container4_ST3_DI_OdoSpeedometer_ST3_PduR2Com_HAD_BACKUP_CAN: PduLength=8, SysTPduToPduTriggeringRef=ESP_HAD_BACKUP_GW_Container4_ST3_ESP_HAD_BACKUP_GW_Container4_ST3_DI_OdoSpeedometer_ST3_2wrcqkh4ub39zvlu7w28s2r1f
          ESP_HAD_BACKUP_GW_Container4_ST3_DIAG_Stat_ST3_IpduM2PduR_HAD_BACKUP_CAN: PduLength=4, SysTPduToPduTriggeringRef=ESP_HAD_BACKUP_GW_Container4_ST3_ESP_HAD_BACKUP_GW_Container4_ST3_DIAG_Stat_ST3_a9kzo9c723k3h5cgrsehf20w0
          ESP_HAD_BACKUP_GW_Container4_ST3_DIAG_Stat_ST3_PduR2Com_HAD_BACKUP_CAN: PduLength=4, SysTPduToPduTriggeringRef=ESP_HAD_BACKUP_GW_Container4_ST3_ESP_HAD_BACKUP_GW_Container4_ST3_DIAG_Stat_ST3_a9kzo9c723k3h5cgrsehf20w0
          ESP_HAD_BACKUP_GW_Container4_ST3_ESP_HAD_BACKUP_GW_Container4_ST3_PN14_Master_Stat1_ST3_secured_IpduM2PduR_HAD_BACKUP_CAN: PduLength=12, SysTPduToPduTriggeringRef=ESP_HAD_BACKUP_GW_Container4_ST3_ESP_HAD_BACKUP_GW_Container4_ST3_PN14_Master_Stat1_ST3_11xqv03a1oeng5zctxoxlpsa
          ESP_HAD_BACKUP_GW_Container4_ST3_ESP_HAD_BACKUP_GW_Container4_ST3_PN14_Master_Stat1_ST3_secured_PduR2SecOC_HAD_BACKUP_CAN: PduLength=12, SysTPduToPduTriggeringRef=ESP_HAD_BACKUP_GW_Container4_ST3_ESP_HAD_BACKUP_GW_Container4_ST3_PN14_Master_Stat1_ST3_11xqv03a1oeng5zctxoxlpsa
          ESP_HAD_BACKUP_GW_Container4_ST3_PN14_Master_Stat1_ST3_SecOC2PduR_HAD_BACKUP_CAN: PduLength=8, SysTPduToPduTriggeringRef=ESP_HAD_BACKUP_GW_Container4_ST3_ESP_HAD_BACKUP_GW_Container4_ST3_PN14_Master_Stat1_ST3_6wlpxzn4ez9a5ru3exv8xu1x7
          ESP_HAD_BACKUP_GW_Container4_ST3_PN14_Master_Stat1_ST3_PduR2Com_HAD_BACKUP_CAN: PduLength=8, SysTPduToPduTriggeringRef=ESP_HAD_BACKUP_GW_Container4_ST3_ESP_HAD_BACKUP_GW_Container4_ST3_PN14_Master_Stat1_ST3_6wlpxzn4ez9a5ru3exv8xu1x7
          XCP_Rs_IMU_A_ST3_Xcp2CanIf_HAD_BACKUP_CAN: PduLength=64, SysTPduToPduTriggeringRef=XCP_Rs_IMU_A_ST3_e0uv1agw3pumvtwqzqeqqdzde
          XCP_Rq_IMU_A_ST3_CanIf2Xcp_HAD_BACKUP_CAN: PduLength=64, SysTPduToPduTriggeringRef=XCP_Rq_IMU_A_ST3_dqie47malk6ocg4tljx2c392x
          Develop_Rs_IMU_A_ST3_Com2PduR_HAD_BACKUP_CAN: PduLength=64, SysTPduToPduTriggeringRef=Develop_Rs_IMU_A_ST3_c22v7v5r7ts1wq94m0hjk6z2m
          Develop_Rs_IMU_A_ST3_PduR2CanIf_HAD_BACKUP_CAN: PduLength=64, SysTPduToPduTriggeringRef=Develop_Rs_IMU_A_ST3_c22v7v5r7ts1wq94m0hjk6z2m
          Develop_Rq_IMU_A_ST3_CanIf2PduR_HAD_BACKUP_CAN: PduLength=64, SysTPduToPduTriggeringRef=Develop_Rq_IMU_A_ST3_dvelupst8o3z8i1q272p9utkb
          Develop_Rq_IMU_A_ST3_PduR2Com_HAD_BACKUP_CAN: PduLength=64, SysTPduToPduTriggeringRef=Develop_Rq_IMU_A_ST3_dvelupst8o3z8i1q272p9utkb
          DIAG_IMU_A_23_ExtEth_RS_FD_ST3_CanTp2CanIf_HAD_BACKUP_CAN: PduLength=64, SysTPduToFrameTriggeringRef=DIAG_IMU_A_23_ExtEth_RS_FD_ST3_8u2vhqka8ljfci0txx43axame
          DIAG_IMU_A_23_IntEth_RS_FD_ST3_CanTp2CanIf_HAD_BACKUP_CAN: PduLength=64, SysTPduToFrameTriggeringRef=DIAG_IMU_A_23_IntEth_RS_FD_ST3_849bsdc6tzzgj0adjyz9njsvq
          DIAG_IMU_A_23_ExtEth_RQ_FD_ST3_CanIf2CanTp_HAD_BACKUP_CAN: PduLength=64, SysTPduToFrameTriggeringRef=DIAG_IMU_A_23_ExtEth_RQ_FD_ST3_7xb700pqrdt1vh38750z0qzob
          DIAG_IMU_A_23_IntEth_RQ_FD_ST3_CanIf2CanTp_HAD_BACKUP_CAN: PduLength=64, SysTPduToFrameTriggeringRef=DIAG_IMU_A_23_IntEth_RQ_FD_ST3_4tsd7qfpqz55esfu69cuxd82b
          DIAG_IMU_B_2F_ExtEth_RS_FD_ST3_CanTp2CanIf_HAD_BACKUP_CAN: PduLength=64, SysTPduToFrameTriggeringRef=DIAG_IMU_B_2F_ExtEth_RS_FD_ST3_256gi7icvs395ofy9hvrzd6fb
          DIAG_IMU_B_2F_IntEth_RS_FD_ST3_CanTp2CanIf_HAD_BACKUP_CAN: PduLength=64, SysTPduToFrameTriggeringRef=DIAG_IMU_B_2F_IntEth_RS_FD_ST3_h9mkcioirj2xwqs2u68hl08z
          DIAG_IMU_B_2F_ExtEth_RQ_FD_ST3_CanIf2CanTp_HAD_BACKUP_CAN: PduLength=64, SysTPduToFrameTriggeringRef=DIAG_IMU_B_2F_ExtEth_RQ_FD_ST3_b8vleekm3qeqor4bcb48kea7o
          DIAG_IMU_B_2F_IntEth_RQ_FD_ST3_CanIf2CanTp_HAD_BACKUP_CAN: PduLength=64, SysTPduToFrameTriggeringRef=DIAG_IMU_B_2F_IntEth_RQ_FD_ST3_3duz23zg3pkm5cgefm07bh31
          DIAG_RQ_GLOBAL_ExtEth_FD_ST3_CanIf2CanTp_HAD_BACKUP_CAN: PduLength=64, SysTPduToFrameTriggeringRef=DIAG_RQ_GLOBAL_ExtEth_FD_ST3_drac4kh3ykwkcr8cd30pdhlm2
          DIAG_RQ_GLOBAL_IntEth_FD_ST3_CanIf2CanTp_HAD_BACKUP_CAN: PduLength=64, SysTPduToFrameTriggeringRef=DIAG_RQ_GLOBAL_IntEth_FD_ST3_mrjvnhfpl5eqpw6t1gfcrkzl
          SDU_DIAG_GLOBAL_ExtEth_RQ_HAD_BACKUP_ST3_CanTp2PduR_HAD_BACKUP_CAN: PduLength=7, SysTPduToPduTriggeringRef=SDU_DIAG_GLOBAL_ExtEth_RQ_HAD_BACKUP_ST3_9kgva8jo72uolwbyl2tvx3jpp
          SDU_DIAG_GLOBAL_ExtEth_RQ_HAD_BACKUP_ST3_PduR2Dcm_HAD_BACKUP_CAN: PduLength=7, SysTPduToPduTriggeringRef=SDU_DIAG_GLOBAL_ExtEth_RQ_HAD_BACKUP_ST3_9kgva8jo72uolwbyl2tvx3jpp
          SDU_DIAG_GLOBAL_IntEth_RQ_HAD_BACKUP_ST3_CanTp2PduR_HAD_BACKUP_CAN: PduLength=7, SysTPduToPduTriggeringRef=SDU_DIAG_GLOBAL_IntEth_RQ_HAD_BACKUP_ST3_36xvkiclebcvojwbyp2p4x824
          SDU_DIAG_GLOBAL_IntEth_RQ_HAD_BACKUP_ST3_PduR2Dcm_HAD_BACKUP_CAN: PduLength=7, SysTPduToPduTriggeringRef=SDU_DIAG_GLOBAL_IntEth_RQ_HAD_BACKUP_ST3_36xvkiclebcvojwbyp2p4x824
          SDU_DIAG_IMU_A_23_ExtEth_RQ_HAD_BACKUP_ST3_CanTp2PduR_HAD_BACKUP_CAN: PduLength=4095, SysTPduToPduTriggeringRef=SDU_DIAG_IMU_A_23_ExtEth_RQ_HAD_BACKUP_ST3_9casff9ighrz39df11ucer0n8
          SDU_DIAG_IMU_A_23_ExtEth_RQ_HAD_BACKUP_ST3_PduR2Dcm_HAD_BACKUP_CAN: PduLength=4095, SysTPduToPduTriggeringRef=SDU_DIAG_IMU_A_23_ExtEth_RQ_HAD_BACKUP_ST3_9casff9ighrz39df11ucer0n8
          SDU_DIAG_IMU_A_23_ExtEth_RS_HAD_BACKUP_ST3_Dcm2PduR_HAD_BACKUP_CAN: PduLength=4095, SysTPduToPduTriggeringRef=SDU_DIAG_IMU_A_23_ExtEth_RS_HAD_BACKUP_ST3_2ksocjuezqv8984s6pp40r5d6
          SDU_DIAG_IMU_A_23_ExtEth_RS_HAD_BACKUP_ST3_PduR2CanTp_HAD_BACKUP_CAN: PduLength=4095, SysTPduToPduTriggeringRef=SDU_DIAG_IMU_A_23_ExtEth_RS_HAD_BACKUP_ST3_2ksocjuezqv8984s6pp40r5d6
          SDU_DIAG_IMU_A_23_IntEth_RQ_HAD_BACKUP_ST3_CanTp2PduR_HAD_BACKUP_CAN: PduLength=4095, SysTPduToPduTriggeringRef=SDU_DIAG_IMU_A_23_IntEth_RQ_HAD_BACKUP_ST3_e4fi7jqzxomp82b9yvymagcm9
          SDU_DIAG_IMU_A_23_IntEth_RQ_HAD_BACKUP_ST3_PduR2Dcm_HAD_BACKUP_CAN: PduLength=4095, SysTPduToPduTriggeringRef=SDU_DIAG_IMU_A_23_IntEth_RQ_HAD_BACKUP_ST3_e4fi7jqzxomp82b9yvymagcm9
          SDU_DIAG_IMU_A_23_IntEth_RS_HAD_BACKUP_ST3_Dcm2PduR_HAD_BACKUP_CAN: PduLength=4095, SysTPduToPduTriggeringRef=SDU_DIAG_IMU_A_23_IntEth_RS_HAD_BACKUP_ST3_cucn4cw1hasfgn7m4ka6h2fe5
          SDU_DIAG_IMU_A_23_IntEth_RS_HAD_BACKUP_ST3_PduR2CanTp_HAD_BACKUP_CAN: PduLength=4095, SysTPduToPduTriggeringRef=SDU_DIAG_IMU_A_23_IntEth_RS_HAD_BACKUP_ST3_cucn4cw1hasfgn7m4ka6h2fe5
          SDU_DIAG_IMU_B_2F_ExtEth_RQ_HAD_BACKUP_ST3_CanTp2PduR_HAD_BACKUP_CAN: PduLength=4095, SysTPduToPduTriggeringRef=SDU_DIAG_IMU_B_2F_ExtEth_RQ_HAD_BACKUP_ST3_2n6jjkr6gcqwx1zzfmy7woru4
          SDU_DIAG_IMU_B_2F_ExtEth_RS_HAD_BACKUP_ST3_PduR2CanTp_HAD_BACKUP_CAN: PduLength=4095, SysTPduToPduTriggeringRef=SDU_DIAG_IMU_B_2F_ExtEth_RS_HAD_BACKUP_ST3_9fxks67m6ctclr3m0m184py2q
          SDU_DIAG_IMU_B_2F_IntEth_RQ_HAD_BACKUP_ST3_CanTp2PduR_HAD_BACKUP_CAN: PduLength=4095, SysTPduToPduTriggeringRef=SDU_DIAG_IMU_B_2F_IntEth_RQ_HAD_BACKUP_ST3_bub6m1fvqqj2jfvpjx16sfqco
          SDU_DIAG_IMU_B_2F_IntEth_RS_HAD_BACKUP_ST3_PduR2CanTp_HAD_BACKUP_CAN: PduLength=4095, SysTPduToPduTriggeringRef=SDU_DIAG_IMU_B_2F_IntEth_RS_HAD_BACKUP_ST3_enrimsc4nfc8cqsvlb01bo41l
          FBL_Cfg_Star3_ST3_PduR2CanIf_IMU_INTERNAL_CAN: PduLength=1, SysTPduToPduTriggeringRef=FBL_Cfg_Star3_ST3_99p3uqy39g6epfv2pbzswmxpx
          FBL_Cfg_Star3_ST3_Com2PduR_IMU_INTERNAL_CAN: PduLength=1, SysTPduToPduTriggeringRef=FBL_Cfg_Star3_ST3_99p3uqy39g6epfv2pbzswmxpx
          Ign_Stat_ST3_secured_PduR2CanIf_IMU_INTERNAL_CAN: PduLength=8, SysTPduToPduTriggeringRef=Ign_Stat_ST3_6g0xknvbw6ctbm94m0moj11hz
          Ign_Stat_ST3_secured_SecOC2PduR_IMU_INTERNAL_CAN: PduLength=8, SysTPduToPduTriggeringRef=Ign_Stat_ST3_6g0xknvbw6ctbm94m0moj11hz
          Ign_Stat_ST3_Com2PduR_IMU_INTERNAL_CAN: PduLength=4, SysTPduToPduTriggeringRef=Ign_Stat_ST3_74u0yv4bzub4d7kkohk0jy10a
          Ign_Stat_ST3_PduR2SecOC_IMU_INTERNAL_CAN: PduLength=4, SysTPduToPduTriggeringRef=Ign_Stat_ST3_74u0yv4bzub4d7kkohk0jy10a
          IMU_A_Output_Fast_ST3_secured_SecOC2PduR_IMU_INTERNAL_CAN: PduLength=44, SysTPduToPduTriggeringRef=IMU_A_Output_Fast_ST3_bqi5o7xakr4svvuyh363ta1md
          IMU_A_Output_Fast_ST3_secured_PduR2CanIf_IMU_INTERNAL_CAN: PduLength=44, SysTPduToPduTriggeringRef=IMU_A_Output_Fast_ST3_bqi5o7xakr4svvuyh363ta1md
          IMU_A_Output_Fast_ST3_Com2PduR_IMU_INTERNAL_CAN: PduLength=40, SysTPduToPduTriggeringRef=IMU_A_Output_Fast_ST3_9j5x7ag429n202ymo68kf1vn0
          IMU_A_Output_Fast_ST3_PduR2SecOC_IMU_INTERNAL_CAN: PduLength=40, SysTPduToPduTriggeringRef=IMU_A_Output_Fast_ST3_9j5x7ag429n202ymo68kf1vn0
          BCS_Whl_Msg1_BTC_ST3_secured_PduR2CanIf_IMU_INTERNAL_CAN: PduLength=24, SysTPduToPduTriggeringRef=BCS_Whl_Msg1_BTC_ST3_8a04iqb2oetawgg1tamq1ygln
          BCS_Whl_Msg1_BTC_ST3_secured_SecOC2PduR_IMU_INTERNAL_CAN: PduLength=24, SysTPduToPduTriggeringRef=BCS_Whl_Msg1_BTC_ST3_8a04iqb2oetawgg1tamq1ygln
          BCS_Whl_Msg1_BTC_ST3_Com2PduR_IMU_INTERNAL_CAN: PduLength=20, SysTPduToPduTriggeringRef=BCS_Whl_Msg1_BTC_ST3_c16k4ur8udt67j57b0rf78j53
          BCS_Whl_Msg1_BTC_ST3_PduR2SecOC_IMU_INTERNAL_CAN: PduLength=20, SysTPduToPduTriggeringRef=BCS_Whl_Msg1_BTC_ST3_c16k4ur8udt67j57b0rf78j53
          VSS_TP_RealTmOffset_ST3_PduR2CanIf_IMU_INTERNAL_CAN: PduLength=8, SysTPduToPduTriggeringRef=VSS_TP_RealTmOffset_ST3_4fzwxp0omvccavnefvnhtwbc7
          VSS_TP_RealTmOffset_ST3_Com2PduR_IMU_INTERNAL_CAN: PduLength=8, SysTPduToPduTriggeringRef=VSS_TP_RealTmOffset_ST3_4fzwxp0omvccavnefvnhtwbc7
          VSS_TP_SecTickCount_Lvl1_ST3_PduR2CanIf_IMU_INTERNAL_CAN: PduLength=8, SysTPduToPduTriggeringRef=VSS_TP_SecTickCount_Lvl1_ST3_6z5nkrjami4ggt3euhfetk7ow
          VSS_TP_SecTickCount_Lvl1_ST3_Com2PduR_IMU_INTERNAL_CAN: PduLength=8, SysTPduToPduTriggeringRef=VSS_TP_SecTickCount_Lvl1_ST3_6z5nkrjami4ggt3euhfetk7ow
          VSS_TP_VIN_ST3_PduR2CanIf_IMU_INTERNAL_CAN: PduLength=8, SysTPduToPduTriggeringRef=VSS_TP_VIN_ST3_4nk9rxvqgs3grjwivgjcdu51j
          VSS_TP_VIN_ST3_Com2PduR_IMU_INTERNAL_CAN: PduLength=8, SysTPduToPduTriggeringRef=VSS_TP_VIN_ST3_4nk9rxvqgs3grjwivgjcdu51j
          VSS_TP_Auth_ST3_PduR2CanIf_IMU_INTERNAL_CAN: PduLength=8, SysTPduToPduTriggeringRef=VSS_TP_Auth_ST3_7ysnahxb0suco3wwriicgs0im
          VSS_TP_Auth_ST3_Com2PduR_IMU_INTERNAL_CAN: PduLength=8, SysTPduToPduTriggeringRef=VSS_TP_Auth_ST3_7ysnahxb0suco3wwriicgs0im
          VSS_TP_SharedSecret_ST3_PduR2CanIf_IMU_INTERNAL_CAN: PduLength=8, SysTPduToPduTriggeringRef=VSS_TP_SharedSecret_ST3_88tqqosaxmp4sl3xcmxab9vk5
          VSS_TP_SharedSecret_ST3_Com2PduR_IMU_INTERNAL_CAN: PduLength=8, SysTPduToPduTriggeringRef=VSS_TP_SharedSecret_ST3_88tqqosaxmp4sl3xcmxab9vk5
          PT4_PTCoor4_ST3_secured_PduR2CanIf_IMU_INTERNAL_CAN: PduLength=8, SysTPduToPduTriggeringRef=PT4_PTCoor4_ST3_7k5tx1ze82mns06hxebn4axs5
          PT4_PTCoor4_ST3_secured_SecOC2PduR_IMU_INTERNAL_CAN: PduLength=8, SysTPduToPduTriggeringRef=PT4_PTCoor4_ST3_7k5tx1ze82mns06hxebn4axs5
          PT4_PTCoor4_ST3_Com2PduR_IMU_INTERNAL_CAN: PduLength=4, SysTPduToPduTriggeringRef=PT4_PTCoor4_ST3_831x3bc2a5f0b8lcc0rs7f0hl
          PT4_PTCoor4_ST3_PduR2SecOC_IMU_INTERNAL_CAN: PduLength=4, SysTPduToPduTriggeringRef=PT4_PTCoor4_ST3_831x3bc2a5f0b8lcc0rs7f0hl
          DI_OdoSpeedometer_ST3_PduR2CanIf_IMU_INTERNAL_CAN: PduLength=8, SysTPduToPduTriggeringRef=DI_OdoSpeedometer_ST3_d51h7apu0p6erk4x2uv7ypbjk
          DI_OdoSpeedometer_ST3_Com2PduR_IMU_INTERNAL_CAN: PduLength=8, SysTPduToPduTriggeringRef=DI_OdoSpeedometer_ST3_d51h7apu0p6erk4x2uv7ypbjk
          PN14_Master_Stat1_ST3_secured_PduR2CanIf_IMU_INTERNAL_CAN: PduLength=12, SysTPduToPduTriggeringRef=PN14_Master_Stat1_ST3_ck5rf1gmu93402vsfgdnyzarn
          PN14_Master_Stat1_ST3_secured_SecOC2PduR_IMU_INTERNAL_CAN: PduLength=12, SysTPduToPduTriggeringRef=PN14_Master_Stat1_ST3_ck5rf1gmu93402vsfgdnyzarn
          PN14_Master_Stat1_ST3_Com2PduR_IMU_INTERNAL_CAN: PduLength=8, SysTPduToPduTriggeringRef=PN14_Master_Stat1_ST3_2eb8i7df9hluel7u1vtmv4jbu
          PN14_Master_Stat1_ST3_PduR2SecOC_IMU_INTERNAL_CAN: PduLength=8, SysTPduToPduTriggeringRef=PN14_Master_Stat1_ST3_2eb8i7df9hluel7u1vtmv4jbu
          DIAG_Stat_ST3_PduR2CanIf_IMU_INTERNAL_CAN: PduLength=4, SysTPduToPduTriggeringRef=DIAG_Stat_ST3_7wcdjjvxsq7cvcqwamzuwla9r
          DIAG_Stat_ST3_Com2PduR_IMU_INTERNAL_CAN: PduLength=4, SysTPduToPduTriggeringRef=DIAG_Stat_ST3_7wcdjjvxsq7cvcqwamzuwla9r
          DIAG_IMU_B_2F_ExtEth_RS_FD_ST3_CanIf2CanTp_IMU_INTERNAL_CAN: PduLength=64, SysTPduToFrameTriggeringRef=DIAG_IMU_B_2F_ExtEth_RS_FD_ST3_1h5e6ysxprtb26lqg8oub4kpe
          DIAG_IMU_B_2F_IntEth_RS_FD_ST3_CanIf2CanTp_IMU_INTERNAL_CAN: PduLength=64, SysTPduToFrameTriggeringRef=DIAG_IMU_B_2F_IntEth_RS_FD_ST3_950founsvo2g2zm9h51gr26uz
          DIAG_IMU_B_2F_ExtEth_RQ_FD_ST3_CanTp2CanIf_IMU_INTERNAL_CAN: PduLength=64, SysTPduToFrameTriggeringRef=DIAG_IMU_B_2F_ExtEth_RQ_FD_ST3_1xv547k1fgfi8ltc9elgjwfzs
          DIAG_IMU_B_2F_IntEth_RQ_FD_ST3_CanTp2CanIf_IMU_INTERNAL_CAN: PduLength=64, SysTPduToFrameTriggeringRef=DIAG_IMU_B_2F_IntEth_RQ_FD_ST3_afqpvn3yru684o4w36wuwit32
          SDU_DIAG_GLOBAL_ExtEth_RQ_IMU_INTERNAL_ST3_PduR2CanTp_IMU_INTERNAL_CAN: PduLength=7, SysTPduToPduTriggeringRef=SDU_DIAG_GLOBAL_ExtEth_RQ_IMU_INTERNAL_ST3_8oth9y18deizsgzcw8rxtafoj
          SDU_DIAG_GLOBAL_ExtEth_RQ_IMU_INTERNAL_ST3_Dcm2PduR_IMU_INTERNAL_CAN: PduLength=7, SysTPduToPduTriggeringRef=SDU_DIAG_GLOBAL_ExtEth_RQ_IMU_INTERNAL_ST3_8oth9y18deizsgzcw8rxtafoj
          SDU_DIAG_GLOBAL_IntEth_RQ_IMU_INTERNAL_ST3_PduR2CanTp_IMU_INTERNAL_CAN: PduLength=7, SysTPduToPduTriggeringRef=SDU_DIAG_GLOBAL_IntEth_RQ_IMU_INTERNAL_ST3_21ocqvfmnzkv9x8f5nqo6bpa9
          SDU_DIAG_GLOBAL_IntEth_RQ_IMU_INTERNAL_ST3_Dcm2PduR_IMU_INTERNAL_CAN: PduLength=7, SysTPduToPduTriggeringRef=SDU_DIAG_GLOBAL_IntEth_RQ_IMU_INTERNAL_ST3_21ocqvfmnzkv9x8f5nqo6bpa9
          SDU_DIAG_IMU_B_2F_ExtEth_RS_IMU_INTERNAL_ST3_CanTp2PduR_IMU_INTERNAL_CAN: PduLength=4095, SysTPduToPduTriggeringRef=SDU_DIAG_IMU_B_2F_ExtEth_RS_IMU_INTERNAL_ST3_aj2z7r7k9dlwvjrbkwnnfkar5
          SDU_DIAG_IMU_B_2F_ExtEth_RQ_IMU_INTERNAL_ST3_PduR2CanTp_IMU_INTERNAL_CAN: PduLength=4095, SysTPduToPduTriggeringRef=SDU_DIAG_IMU_B_2F_ExtEth_RQ_IMU_INTERNAL_ST3_8p1t5axok0gymf7lxvm0d86r4
          SDU_DIAG_IMU_B_2F_IntEth_RS_IMU_INTERNAL_ST3_CanTp2PduR_IMU_INTERNAL_CAN: PduLength=4095, SysTPduToPduTriggeringRef=SDU_DIAG_IMU_B_2F_IntEth_RS_IMU_INTERNAL_ST3_aim5b9uh4cxdhsdi0njtzfqhq
          SDU_DIAG_IMU_B_2F_IntEth_RQ_IMU_INTERNAL_ST3_PduR2CanTp_IMU_INTERNAL_CAN: PduLength=4095, SysTPduToPduTriggeringRef=SDU_DIAG_IMU_B_2F_IntEth_RQ_IMU_INTERNAL_ST3_23a5ju54dx0yv2u8skz5uwmio
  module config IpduM: implementation-config-variant=VARIANT-PRE-COMPILE
    IpduMConfig
      3 x IpduMContainedTxPdu, all with IpduMContainedTxPduCollectionSemantics=IPDUM_COLLECT_QUEUED, IpduMContainedTxPduTrigger=IPDUM_TRIGGER_ALWAYS:
        CdTx_IMU_A_HAD_BACKUP_COM_Container1_ST3_IMU_A_HAD_BACKUP_COM_Container1_ST3_ROE_IMU_A__1A754A8EF6CC3BAD7D0FF2B38403C0D53FEBDFDC: IpduMContainedPduHeaderId=3801299, IpduMContainedTxPduSendTimeout=0.01, IpduMContainedTxInContainerPduRef=CrTx_IMU_A_HAD_BACKUP_COM_Container1_ST3_ContainerIPdu_HAD_BACKUP_CAN, IpduMContainedTxPduRef=EcucPduCollection/IMU_A_HAD_BACKUP_COM_Container1_ST3_ROE_IMU_A_ST3_PduR2IpduM_HAD_BACKUP_CAN
        CdTx_IMU_A_HAD_BACKUP_GW_Container1_ST3_IMU_A_HAD_BACKUP_GW_Container1_ST3_ECU_Stat_IMU_C2B4246C4D56BF1B4B8DC7A4FD33AB3A92461030: IpduMContainedPduHeaderId=3800814, IpduMContainedTxInContainerPduRef=CrTx_IMU_A_HAD_BACKUP_GW_Container1_ST3_ContainerIPdu_HAD_BACKUP_CAN, IpduMContainedTxPduRef=EcucPduCollection/IMU_A_HAD_BACKUP_GW_Container1_ST3_ECU_Stat_IMU_B_ST3_PduR2IpduM_HAD_BACKUP_CAN
        CdTx_IMU_A_HAD_BACKUP_GW_Container1_ST3_IMU_A_HAD_BACKUP_GW_Container1_ST3_ROE_IMU_B_ST_E47F1800E664BE01F9A97529B3F331507BA4DD1A: IpduMContainedPduHeaderId=3801313, IpduMContainedTxInContainerPduRef=CrTx_IMU_A_HAD_BACKUP_GW_Container1_ST3_ContainerIPdu_HAD_BACKUP_CAN, IpduMContainedTxPduRef=EcucPduCollection/IMU_A_HAD_BACKUP_GW_Container1_ST3_ROE_IMU_B_ST3_PduR2IpduM_HAD_BACKUP_CAN
      CrTx_IMU_A_HAD_BACKUP_COM_Container1_ST3_ContainerIPdu_HAD_BACKUP_CAN (IpduMContainerTxPdu):
        IpduMContainerHeaderSize = IPDUM_HEADERTYPE_SHORT
        IpduMContainerQueueSize = 1
        IpduMContainerTxFirstContainedPduTrigger = false
        IpduMContainerTxSendTimeout = 0.01
        IpduMContainerTxSizeThreshold = 59
        IpduMContainerTxTriggerMode = IPDUM_DIRECT
        IpduMContainerTxPduRef = EcucPduCollection/IMU_A_HAD_BACKUP_COM_Container1_ST3_ContainerIPdu_IpduM2PduR_HAD_BACKUP_CAN
        IpduMMainFunctionTxRef = IpduMMainFunctionTx
      CrTx_IMU_A_HAD_BACKUP_GW_Container1_ST3_ContainerIPdu_HAD_BACKUP_CAN (IpduMContainerTxPdu):
        IpduMContainerHeaderSize = IPDUM_HEADERTYPE_SHORT
        IpduMContainerQueueSize = 1
        IpduMContainerTxFirstContainedPduTrigger = false
        IpduMContainerTxSendTimeout = 0.015
        IpduMContainerTxSizeThreshold = 59
        IpduMContainerTxTriggerMode = IPDUM_DIRECT
        IpduMContainerTxPduRef = EcucPduCollection/IMU_A_HAD_BACKUP_GW_Container1_ST3_ContainerIPdu_IpduM2PduR_HAD_BACKUP_CAN
        IpduMMainFunctionTxRef = IpduMMainFunctionTx
      IpduMMainFunctionTx: IpduMMainTxTimeBase=0.005, IpduMMainTxPartitionRef=EcucPartition_0
    IpduMGeneral:
      IpduMDevErrorDetect = false
      IpduMHeaderByteOrder = IPDUM_BIG_ENDIAN
      IpduMRxTimeBase = 0.005
      IpduMStaticPartExists = true
      IpduMTxTimeBase = 0.005
      IpduMVersionInfoApi = false
    IpduMPublishedInformation: IpduMRxDirectComInvocation=false
  module config Nm: implementation-config-variant=VARIANT-PRE-COMPILE
    NmGlobalConfig
      NmGlobalConstants: NmNumberOfChannels=2
  module config PduR
    PduRRoutingPaths
      9 x PduRRoutingPath:
        IMU_B_Output_ST3_secured_GATEWAY_IMU_INTERNAL_CAN: PduRDestPduRRef=PduRRoutingPaths/IMU_B_Output_ST3_secured_PduR2CanIf_HAD_BACKUP_CAN, PduRSrcPduRRef=PduRRoutingPaths/IMU_B_Output_ST3_secured_CanIf2PduR_IMU_INTERNAL_CAN
        ECU_Stat_IMU_A_ST3_Com2CanIf_HAD_BACKUP_CAN: PduRDestPduRRef=PduRRoutingPaths/ECU_Stat_IMU_A_ST3_PduR2CanIf_HAD_BACKUP_CAN, PduRSrcPduRRef=PduRRoutingPaths/ECU_Stat_IMU_A_ST3_Com2PduR_HAD_BACKUP_CAN
        NM_IMU_A_ST3_Com2CanNm_HAD_BACKUP_CAN: PduRDestPduRRef=PduRRoutingPaths/NM_IMU_A_ST3_PduR2CanNm_HAD_BACKUP_CAN, PduRSrcPduRRef=PduRRoutingPaths/NM_IMU_A_ST3_Com2PduR_HAD_BACKUP_CAN
        IMU_A_HAD_BACKUP_COM_Container1_ST3_ContainerIPdu_IpduM2CanIf_HAD_BACKUP_CAN: PduRDestPduRRef=PduRRoutingPaths/IMU_A_HAD_BACKUP_COM_Container1_ST3_ContainerIPdu_PduR2CanIf_HAD_BACKUP_CAN, PduRSrcPduRRef=PduRRoutingPaths/IMU_A_HAD_BACKUP_COM_Container1_ST3_ContainerIPdu_IpduM2PduR_HAD_BACKUP_CAN
        IMU_A_HAD_BACKUP_COM_Container1_ST3_ROE_IMU_A_ST3_Com2IpduM_HAD_BACKUP_CAN: PduRDestPduRRef=PduRRoutingPaths/IMU_A_HAD_BACKUP_COM_Container1_ST3_ROE_IMU_A_ST3_PduR2IpduM_HAD_BACKUP_CAN, PduRSrcPduRRef=PduRRoutingPaths/IMU_A_HAD_BACKUP_COM_Container1_ST3_ROE_IMU_A_ST3_Com2PduR_HAD_BACKUP_CAN
        IMU_A_HAD_BACKUP_GW_Container1_ST3_ContainerIPdu_IpduM2CanIf_HAD_BACKUP_CAN: PduRDestPduRRef=PduRRoutingPaths/IMU_A_HAD_BACKUP_GW_Container1_ST3_ContainerIPdu_PduR2CanIf_HAD_BACKUP_CAN, PduRSrcPduRRef=PduRRoutingPaths/IMU_A_HAD_BACKUP_GW_Container1_ST3_ContainerIPdu_IpduM2PduR_HAD_BACKUP_CAN
        ECU_Stat_IMU_B_ST3_GATEWAY_IMU_INTERNAL_CAN: PduRDestPduRRef=PduRRoutingPaths/IMU_A_HAD_BACKUP_GW_Container1_ST3_ECU_Stat_IMU_B_ST3_PduR2IpduM_HAD_BACKUP_CAN, PduRSrcPduRRef=PduRRoutingPaths/ECU_Stat_IMU_B_ST3_CanIf2PduR_IMU_INTERNAL_CAN
        ROE_IMU_B_ST3_GATEWAY_IMU_INTERNAL_CAN: PduRDestPduRRef=PduRRoutingPaths/IMU_A_HAD_BACKUP_GW_Container1_ST3_ROE_IMU_B_ST3_PduR2IpduM_HAD_BACKUP_CAN, PduRSrcPduRRef=PduRRoutingPaths/ROE_IMU_B_ST3_CanIf2PduR_IMU_INTERNAL_CAN
        Meas_IMU_A_ST3_Com2CanIf_HAD_BACKUP_CAN: PduRDestPduRRef=PduRRoutingPaths/Meas_IMU_A_ST3_PduR2CanIf_HAD_BACKUP_CAN, PduRSrcPduRRef=PduRRoutingPaths/Meas_IMU_A_ST3_Com2PduR_HAD_BACKUP_CAN
      4 x PduRDestPdu, all with PduRDestPduDataProvision=PDUR_DIRECT:
        NmPnEiraRxNSduRef_CAN_PduR2Com_IMU_INTERNAL_CAN: PduRDestPduRef=EcucPduCollection/NmPnEiraRxNSduRef_CAN_PduR2Com_IMU_INTERNAL_CAN
        NM_IMU_A_ST3_PduR2CanNm_IMU_INTERNAL_CAN: PduRDestPduRef=EcucPduCollection/NM_IMU_A_ST3_PduR2CanNm_IMU_INTERNAL_CAN
        NM_IMU_A_ST3_ERA_PduR2Com_IMU_INTERNAL_CAN: PduRDestPduRef=EcucPduCollection/NM_IMU_A_ST3_ERA_PduR2Com_IMU_INTERNAL_CAN
        NM_IMU_A_ST3_ERA_PduR2Com_HAD_BACKUP_CAN: PduRDestPduRef=EcucPduCollection/NM_IMU_A_ST3_ERA_PduR2Com_HAD_BACKUP_CAN
      IMU_B_Output_ST3_secured_CanIf2PduR_IMU_INTERNAL_CAN (PduRSrcPdu): PduRSrcPduRef=EcucPduCollection/IMU_B_Output_ST3_secured_CanIf2PduR_IMU_INTERNAL_CAN
      IMU_B_Output_ST3_secured_PduR2CanIf_HAD_BACKUP_CAN (PduRDestPdu): PduRDestPduDataProvision=PDUR_DIRECT, PduRDestPduRef=EcucPduCollection/IMU_B_Output_ST3_secured_PduR2CanIf_HAD_BACKUP_CAN
      ECU_Stat_IMU_A_ST3_Com2PduR_HAD_BACKUP_CAN (PduRSrcPdu): PduRSrcPduRef=EcucPduCollection/ECU_Stat_IMU_A_ST3_Com2PduR_HAD_BACKUP_CAN
      ECU_Stat_IMU_A_ST3_PduR2CanIf_HAD_BACKUP_CAN (PduRDestPdu): PduRDestPduRef=EcucPduCollection/ECU_Stat_IMU_A_ST3_PduR2CanIf_HAD_BACKUP_CAN
      NM_IMU_A_ST3_Com2PduR_HAD_BACKUP_CAN (PduRSrcPdu): PduRSrcPduRef=EcucPduCollection/NM_IMU_A_ST3_Com2PduR_HAD_BACKUP_CAN
      NM_IMU_A_ST3_PduR2CanNm_HAD_BACKUP_CAN (PduRDestPdu): PduRDestPduRef=EcucPduCollection/NM_IMU_A_ST3_PduR2CanNm_HAD_BACKUP_CAN
      IMU_A_HAD_BACKUP_COM_Container1_ST3_ContainerIPdu_IpduM2PduR_HAD_BACKUP_CAN (PduRSrcPdu): PduRSrcPduRef=EcucPduCollection/IMU_A_HAD_BACKUP_COM_Container1_ST3_ContainerIPdu_IpduM2PduR_HAD_BACKUP_CAN
      IMU_A_HAD_BACKUP_COM_Container1_ST3_ContainerIPdu_PduR2CanIf_HAD_BACKUP_CAN (PduRDestPdu): PduRDestPduRef=EcucPduCollection/IMU_A_HAD_BACKUP_COM_Container1_ST3_ContainerIPdu_PduR2CanIf_HAD_BACKUP_CAN
      IMU_A_HAD_BACKUP_COM_Container1_ST3_ROE_IMU_A_ST3_Com2PduR_HAD_BACKUP_CAN (PduRSrcPdu): PduRSrcPduRef=EcucPduCollection/IMU_A_HAD_BACKUP_COM_Container1_ST3_ROE_IMU_A_ST3_Com2PduR_HAD_BACKUP_CAN
      4 x PduRRoutingPath:
        NM_IMU_A_ST3_NmPnEiraRxNSduRef_CanNm2Com_IMU_INTERNAL_CAN: PduRSrcPduRRef=PduRRoutingPaths/NmPnEiraRxNSduRef_CAN_CanNm2PduR_IMU_INTERNAL_CAN, PduRDestPduRRef=PduRRoutingPaths/NmPnEiraRxNSduRef_CAN_PduR2Com_IMU_INTERNAL_CAN
        NM_IMU_A_ST3_Com2CanNm_IMU_INTERNAL_CAN: PduRDestPduRRef=PduRRoutingPaths/NM_IMU_A_ST3_PduR2CanNm_IMU_INTERNAL_CAN, PduRSrcPduRRef=PduRRoutingPaths/NM_IMU_A_ST3_Com2PduR_IMU_INTERNAL_CAN
        NM_IMU_A_ST3_ERA_CanNm2Com_INTERNAL_CAN: PduRDestPduRRef=PduRRoutingPaths/NM_IMU_A_ST3_ERA_PduR2Com_IMU_INTERNAL_CAN, PduRSrcPduRRef=PduRRoutingPaths/NM_IMU_A_ST3_ERA_CanNm2PduR_IMU_INTERNAL_CAN
        NM_IMU_A_ST3_ERA_CanNm2Com_HAD_BACKUP_CAN: PduRDestPduRRef=PduRRoutingPaths/NM_IMU_A_ST3_ERA_PduR2Com_HAD_BACKUP_CAN, PduRSrcPduRRef=PduRRoutingPaths/NM_IMU_A_ST3_ERA_CanNm2PduR_HAD_BACKUP_CAN
      IMU_A_HAD_BACKUP_COM_Container1_ST3_ROE_IMU_A_ST3_PduR2IpduM_HAD_BACKUP_CAN (PduRDestPdu): PduRDestPduRef=EcucPduCollection/IMU_A_HAD_BACKUP_COM_Container1_ST3_ROE_IMU_A_ST3_PduR2IpduM_HAD_BACKUP_CAN
      IMU_A_HAD_BACKUP_GW_Container1_ST3_ContainerIPdu_IpduM2PduR_HAD_BACKUP_CAN (PduRSrcPdu): PduRSrcPduRef=EcucPduCollection/IMU_A_HAD_BACKUP_GW_Container1_ST3_ContainerIPdu_IpduM2PduR_HAD_BACKUP_CAN
      IMU_A_HAD_BACKUP_GW_Container1_ST3_ContainerIPdu_PduR2CanIf_HAD_BACKUP_CAN (PduRDestPdu): PduRDestPduRef=EcucPduCollection/IMU_A_HAD_BACKUP_GW_Container1_ST3_ContainerIPdu_PduR2CanIf_HAD_BACKUP_CAN
      ECU_Stat_IMU_B_ST3_CanIf2PduR_IMU_INTERNAL_CAN (PduRSrcPdu): PduRSrcPduRef=EcucPduCollection/ECU_Stat_IMU_B_ST3_CanIf2PduR_IMU_INTERNAL_CAN
      IMU_A_HAD_BACKUP_GW_Container1_ST3_ECU_Stat_IMU_B_ST3_PduR2IpduM_HAD_BACKUP_CAN (PduRDestPdu):
        PduRDestPduDataProvision = PDUR_DIRECT
        PduRDestPduRef = EcucPduCollection/IMU_A_HAD_BACKUP_GW_Container1_ST3_ECU_Stat_IMU_B_ST3_PduR2IpduM_HAD_BACKUP_CAN
      ROE_IMU_B_ST3_CanIf2PduR_IMU_INTERNAL_CAN (PduRSrcPdu): PduRSrcPduRef=EcucPduCollection/ROE_IMU_B_ST3_CanIf2PduR_IMU_INTERNAL_CAN
      IMU_A_HAD_BACKUP_GW_Container1_ST3_ROE_IMU_B_ST3_PduR2IpduM_HAD_BACKUP_CAN (PduRDestPdu):
        PduRDestPduDataProvision = PDUR_DIRECT
        PduRDestPduRef = EcucPduCollection/IMU_A_HAD_BACKUP_GW_Container1_ST3_ROE_IMU_B_ST3_PduR2IpduM_HAD_BACKUP_CAN
      Meas_IMU_A_ST3_Com2PduR_HAD_BACKUP_CAN (PduRSrcPdu): PduRSrcPduRef=EcucPduCollection/Meas_IMU_A_ST3_Com2PduR_HAD_BACKUP_CAN
      Meas_IMU_A_ST3_PduR2CanIf_HAD_BACKUP_CAN (PduRDestPdu): PduRDestPduRef=EcucPduCollection/Meas_IMU_A_ST3_PduR2CanIf_HAD_BACKUP_CAN
      4 x PduRSrcPdu:
        NmPnEiraRxNSduRef_CAN_CanNm2PduR_IMU_INTERNAL_CAN: PduRSrcPduRef=EcucPduCollection/NmPnEiraRxNSduRef_CAN_CanNm2PduR_IMU_INTERNAL_CAN
        NM_IMU_A_ST3_Com2PduR_IMU_INTERNAL_CAN: PduRSrcPduRef=EcucPduCollection/NM_IMU_A_ST3_Com2PduR_IMU_INTERNAL_CAN
        NM_IMU_A_ST3_ERA_CanNm2PduR_IMU_INTERNAL_CAN: PduRSrcPduRef=EcucPduCollection/NM_IMU_A_ST3_ERA_CanNm2PduR_IMU_INTERNAL_CAN
        NM_IMU_A_ST3_ERA_CanNm2PduR_HAD_BACKUP_CAN: PduRSrcPduRef=EcucPduCollection/NM_IMU_A_ST3_ERA_CanNm2PduR_HAD_BACKUP_CAN
    CanNm (PduRBswModules):
      PduRCancelReceive = false
      PduRCancelTransmit = false
      PduRCommunicationInterface = true
      PduRLowerModule = true
      PduRTransportProtocol = false
      PduRTriggertransmit = true
      PduRTxConfirmation = true
      PduRUpperModule = false
      PduRBswModuleRef = CanNm
    PduRGeneral:
      PduRDevErrorDetect = false
      PduRVersionInfoApi = true
      PduRZeroCostOperation = false
      PduRRbDsmReInitEnabled = false
      PduRRbQueueingSupport = false
      PduRRbMulticastToIfSupport = true
      PduRRbGwTpWithLimitedBuffer = false
      PduRRbIFGatewayOperation = true
      PduRRbTPGatewayOperation = true
    IpduM (PduRBswModules):
      PduRCancelReceive = false
      PduRCancelTransmit = false
      PduRCommunicationInterface = true
      PduRLowerModule = true
      PduRTransportProtocol = false
      PduRTriggertransmit = true
      PduRTxConfirmation = true
      PduRUpperModule = true
      PduRBswModuleRef = IpduM
  module config rba_ComDrv
    rba_ComDrvGeneral: ComDrvCpuCanType=MCU_RB_REN_RH850_P1MC_D3V2, ComDrvCpuType=MCU_RB_REN_RH850_P1MC_D3V2
