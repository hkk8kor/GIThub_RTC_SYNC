AUTOSAR XML (schema 4-2-2)
package /RB/UBK/Project/EcucModuleConfigurationValuess
  module config PduR
    SecOC (PduRBswModules):
      PduRCancelReceive = false
      PduRCancelTransmit = false
      PduRCommunicationInterface = true
      PduRLowerModule = true
      PduRTransportProtocol = true
      PduRTriggertransmit = true
      PduRTxConfirmation = true
      PduRUpperModule = true
      PduRBswModuleRef = SecOC
  module config SecOC
    Tx_IMU_D_DRIVING_Container_Det05_ST3_IMU_D_DRIVING_Container_Det05_ST3_PT4_Det05_IMU_D_Ctrl_ST3_secured (SecOCTxPduProcessing):
      SecOCFreshnessValueLength = 40
      SecOCDataId = 45751
      SecOCFreshnessValueTruncLength = 8
      SecOCProvideTxTruncatedFreshnessValue = true
      SecOCFreshnessValueId = 1
      SecOCAuthInfoTruncLength = 24
      SecOCRbTxPduCryptIF = Csm_rba_CryptoHSM
      SecOCRbTxCryptMode = synchronous
      SecOCRbTxCryptAlgoSecondFamily = AES
      SecOCRbTxCryptAlgoMode = CMAC
      SecOCRbTxCryptAlgoFamily = AES
      SecOCUseTxConfirmation = true
      SecOCRbClearBufferAfterTransmit = true
      SecOCAuthenticationBuildAttempts = 0
      SecOCTxPduUnusedAreasDefault = 0
      SecOCReAuthenticateAfterTriggerTransmit = false
      SecOCTxAuthenticPduLayer: SecOCTxAuthenticLayerPduRef=IMU_D_DRIVING_Container_Det05_ST3_PT4_Det05_IMU_D_Ctrl_ST3_PduR2SecOC
      SecOCTxSecuredPduLayer
        SecOCTxSecuredPdu: SecOCTxSecuredLayerPduRef=IMU_D_DRIVING_Container_Det05_ST3_IMU_D_DRIVING_Container_Det05_ST3_PT4_Det05_IMU_D_Ctrl_ST3_secured_SecOC2PduR
