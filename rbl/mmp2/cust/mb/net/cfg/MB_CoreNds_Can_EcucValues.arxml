AUTOSAR XML (schema 4-2-2)
package /RB/UBK/Project/EcucModuleConfigurationValuess
  module config E2E: implementation-config-variant=VARIANT-PRE-COMPILE
    E2ERbGeneral:
      E2ERbCheckParameterType = E2E_INTEGRATED
      E2ERbCheckStatusTypeCompatibilityMode = true
      E2ERbDataIDBitOrderProfile5 = ORDER_UNCHANGED
      E2ERbDataIDBitOrderProfile6 = ORDER_UNCHANGED
      E2ERbHeaderBitOrderProfile11 = ORDER_UNCHANGED
      E2ERbHeaderBitOrderProfile22 = ORDER_UNCHANGED
      E2ERbHeaderBitOrderProfile4 = ORDER_UNCHANGED
      E2ERbHeaderBitOrderProfile44 = ORDER_UNCHANGED
      E2ERbHeaderBitOrderProfile5 = ORDER_UNCHANGED
      E2ERbHeaderBitOrderProfile6 = ORDER_FLIPPED
      E2ERbHeaderBitOrderProfile7 = ORDER_UNCHANGED
      E2ERbProfile1 = false
      E2ERbProfile11 = false
      E2ERbProfile2 = false
      E2ERbProfile22 = false
      E2ERbProfile4 = false
      E2ERbProfile44 = false
      E2ERbProfile5 = true
      E2ERbProfile6 = false
      E2ERbProfile7 = false
      E2ERbStateMachine = false
      E2ERbVersionInfoApi = true
  module config rba_ComScl: implementation-config-variant=VARIANT-PRE-COMPILE
    rba_ComScl_General:
      rba_ComScl_ComponentPrefix = ComScl
      rba_ComScl_DevErrorDetection = false
      rba_ComScl_DiagnosticErrorReporting = REPORT_ALWAYS
      rba_ComScl_ReceiveCodeGenerationMethod = PDU_BASED
      rba_ComScl_TransmitCodeGenerationMethod = PDU_BASED
