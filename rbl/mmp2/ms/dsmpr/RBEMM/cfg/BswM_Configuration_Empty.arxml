AUTOSAR XML (schema 4-0-3)
package /RB/UBK/Project/EcucModuleConfigurationValuess
  module config BswM
    BswMConfig
      BswMArbitration
      BswMDataTypeMappingSets: BswMDataTypeMappingSetRef=ComMModeMapping
      BswMModeControl
    BswMGeneral:
      BswMCanSMEnabled = true
      BswMComMEnabled = true
      BswMDcmEnabled = true
      BswMDevErrorDetect = true
      BswMEcuMEnabled = false
      BswMEthSMEnabled = false
      BswMFrSMEnabled = true
      BswMGenericRequestEnabled = false
      BswMJ1939DcmEnabled = false
      BswMJ1939NmEnabled = false
      BswMLinSMEnabled = false
      BswMLinTPEnabled = false
      BswMMainFunctionPeriod = 0.01
      BswMNvMEnabled = true
      BswMSchMEnabled = false
      BswMSdEnabled = false
      BswMVersionInfoApi = true
      BswMWdgMEnabled = false
      BswMRbComMPNCEnabled = false
      BswMRbNmEnabled = false
      BswMRbDebugEnable = false
      BswMRbIntrptQueueMaxSize = 4
      BswMRbDynCreate_BSWM_E_INTRPTQUEUE_FULL = Disabled
      BswMUserIncludeFiles: BswMUserIncludeFile=Rte_Main.h
