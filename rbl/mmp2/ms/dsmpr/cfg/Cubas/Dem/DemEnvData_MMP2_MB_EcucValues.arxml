AUTOSAR XML (schema 4-0-2)
package /RB/UBK/Project/EcucModuleConfigurationValuess
  module config Dem
    DemGeneral
      3 x DemDataElementClass:
        EventId
          DemInternalDataElementClass: DemDataElementDataSize=2, DemInternalDataElement=DEM_EVENT_ID
        Dem_Significance
          DemInternalDataElementClass: DemDataElementDataSize=1, DemInternalDataElement=DEM_SIGNIFICANCE
        SecOC
          DemExternalCSDataElementClass: DemDataElementUsePort=true, DemDataElementProvideMonitorData=false, DemDataElementArraySize=2
      3 x DemDidClass:
        Did_Odometer: DemDidIdentifier=266, DemDidDataElementClassRef=Low_Resolution_Odometer
        Did_OperatingTime: DemDidIdentifier=307, DemDidDataElementClassRef=Current_Operating_Time
        Did_SecOC: DemDidIdentifier=395, DemDidDataElementClassRef=SecOC
      DemExtendedDataClass_MMP2_MB (DemExtendedDataClass): DemExtendedDataRecordClassRef=Rec_StandardizedEnvironmentalData_0x01
      Rec_StandardizedEnvironmentalData_0x01 (DemExtendedDataRecordClass):
        DemExtendedDataRecordNumber = 1
        DemExtendedDataRecordTrigger = DEM_TRIGGER_ON_TEST_FAILED
        DemExtendedDataRecordUpdate = DEM_UPDATE_RECORD_YES
        DemDataElementClassRef = Dem_Significance
        DemDataElementClassRef = External_Tester_Present
        DemDataElementClassRef = OccurenceCounter
        DemDataElementClassRef = AgingCounter
        DemDataElementClassRef = EventId
      DemFreezeFrameClass_MMP2_MB (DemFreezeFrameClass): DemDidClassRef=Did_Odometer, DemDidClassRef=Did_OperatingTime
      DemFreezeFrameClass_MMP2_SSA (DemFreezeFrameClass): DemDidClassRef=Did_OperatingTime, DemDidClassRef=Did_Odometer, DemDidClassRef=Did_SecOC
      DemFreezeFrameRecNumClass_MMP2_MB (DemFreezeFrameRecNumClass): DemFreezeFrameRecordClassRef=Rec_SnapshotRec_10, DemFreezeFrameRecordClassRef=Rec_SnapshotRec_20
      Rec_SnapshotRec_10 (DemFreezeFrameRecordClass): DemFreezeFrameRecordNumber=16, DemFreezeFrameRecordTrigger=DEM_TRIGGER_ON_CONFIRMED, DemFreezeFrameRecordUpdate=DEM_UPDATE_RECORD_NO
      Rec_SnapshotRec_20 (DemFreezeFrameRecordClass): DemFreezeFrameRecordNumber=32, DemFreezeFrameRecordTrigger=DEM_TRIGGER_ON_TEST_FAILED, DemFreezeFrameRecordUpdate=DEM_UPDATE_RECORD_YES
