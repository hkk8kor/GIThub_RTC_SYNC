AUTOSAR XML (schema 4-2-2)
package /RB/UBK/Project/EcucModuleConfigurationValuess
  module config Dem
    DemGeneral
      DemClient: DemEventMemorySetRef=DemEventMemorySet
        DemCallbackDTCStatusChanged: DemCallbackDTCStatusChangedFnc=rbl_SwcDiagAdapter_DTCStatusChanged
      3 x DemDataElementClass:
        Low_Resolution_Odometer
          DemExternalCSDataElementClass:
            DemDataElementReadFnc = rbl_SwcDiagAdapter_ReadOdometerData
            DemDataElementUsePort = false
            DemDataElementProvideMonitorData = false
            DemDataElementArraySize = 2
        Current_Operating_Time
          DemExternalCSDataElementClass:
            DemDataElementReadFnc = rbl_SwcDiagAdapter_ReadOperatingTimeData
            DemDataElementUsePort = false
            DemDataElementArraySize = 5
            DemDataElementProvideMonitorData = false
        External_Tester_Present
          DemExternalCSDataElementClass:
            DemDataElementReadFnc = rbl_SwcDiagAdapter_ReadExternalTesterData
            DemDataElementUsePort = false
            DemDataElementArraySize = 1
            DemDataElementProvideMonitorData = false
